## soc/arm/ti_am625/Kconfig.defconfig
```kconfig
# TI TM4C129 platform configuration options
# SPDX-License-Identifier: Apache-2.0

if SOC_TI_AM62X

config SOC
	default "ti_am62x"

config NUM_IRQS
	# must be >= the highest interrupt number used
	# - include the UART interrupts and ethernet interrupts
	default 

config SYS_CLOCK_HW_CYCLES_PER_SEC
	default 

endif # SOC_TI_AM62X
```

## soc/arm/ti_am625/Kconfig.soc
```kconfig
# SPDX-License-Identifier: Apache-2.0

config SOC_TI_AM62X
	bool "TI AM62X"
	select ARM
	select CPU_CORTEX_M4
```

## soc/arm/ti_k3/Kconfig
```kconfig
# Texas Instruments Keystone 3 (K3) Family
#
# Copyright (c) 2023 Texas Instruments Incorporated
# Copyright (c) 2023 L Lakshmanan
#
# SPDX-License-Identifier: Apache-2.0

config SOC_FAMILY_TI_K3
	bool

if SOC_FAMILY_TI_K3

config SOC_FAMILY
	string
	default "ti_k3"

source "soc/arm/ti_k3/*/Kconfig.soc"

endif # SOC_FAMILY_TI_K3
```

## soc/arm/ti_k3/Kconfig.soc
```kconfig
# Texas Instruments Keystone 3 (K3) Family
#
# Copyright (c) 2023 Texas Instruments Incorporated
# Copyright (c) 2023 L Lakshmanan
#
# SPDX-License-Identifier: Apache-2.0

source "soc/arm/ti_k3/*/Kconfig.series"
```

## soc/arm/ti_k3/am62x_m4/Kconfig.defconfig.am62xm4
```kconfig
# Texas Instruments Sitara AM62x-SK-M4 EVM
#
# Copyright (c) 2023 Texas Instruments Incorporated
# Copyright (c) 2023 L Lakshmanan
#
# SPDX-License-Identifier: Apache-2.0

if SOC_AM62x_M4

config SOC
	default "am62x_m4"

endif
```

## soc/arm/ti_k3/am62x_m4/Kconfig.defconfig.series
```kconfig
# Texas Instruments Sitara AM62x-SK-M4 EVM
#
# Copyright (c) 2023 Texas Instruments Incorporated
# Copyright (c) 2023 L Lakshmanan
#
# SPDX-License-Identifier: Apache-2.0

if SOC_SERIES_AM62X_M4

source "soc/arm/ti_k3/am62x_m4/Kconfig.defconfig.am62xm4*"

config SOC_SERIES
	default "am62x_m4"

DT_CHOSEN_Z_FLASH := zephyr,flash

config FLASH_SIZE
	default $(dt_chosen_reg_size_int,$(DT_CHOSEN_Z_FLASH),0,K)

config FLASH_BASE_ADDRESS
	default $(dt_chosen_reg_addr_hex,$(DT_CHOSEN_Z_FLASH))

config NUM_IRQS
	default 64

config SYS_CLOCK_HW_CYCLES_PER_SEC
	int
	default 400000000

config PINCTRL
	default y

if SERIAL

config UART_NS16550
	default y

config UART_NS16550_TI_K3
	default y

choice UART_NS16550_VARIANT
	default UART_NS16550_VARIANT_NS16750
endchoice

endif # SERIAL

config BUILD_OUTPUT_BIN
	default n

source "soc/arm/ti_k3/am62x_m4/Kconfig.defconfig.am62*"

endif # SOC_SERIES_AM62X_M4
```

## soc/arm/ti_k3/am62x_m4/Kconfig.series
```kconfig
# Texas Instruments Sitara AM62x-SK-M4 EVM
#
# Copyright (c) 2023 Texas Instruments Incorporated
# Copyright (c) 2023 L Lakshmanan
#
# SPDX-License-Identifier: Apache-2.0

config SOC_SERIES_AM62X_M4
	bool "TI AM62X M4 Core Series"
	select SOC_FAMILY_TI_K3
	select ARM
	select CPU_CORTEX_M4
	select CPU_CORTEX_M_HAS_SYSTICK
	select DYNAMIC_INTERRUPTS
	select CPU_CORTEX_M_HAS_DWT
	select OPENAMP_RSC_TABLE
	select UART_NS16550_ACCESS_WORD_ONLY
	select EXTERNAL_ADDRESS_TRANSLATION
	select MM_DRV
	select MM_TI_RAT
	help
	  Enable support for AM62X M4 Series.
```

## soc/arm/ti_k3/am62x_m4/Kconfig.soc
```kconfig
# Texas Instruments Sitara AM62x-SK-M4
#
# Copyright (c) 2023 Texas Instruments Incorporated
# Copyright (c) 2023 L Lakshmanan
#
# SPDX-License-Identifier: Apache-2.0

choice
prompt "TI AM62X M4 Selection"
depends on SOC_SERIES_AM62X_M4

config SOC_AM62x_M4
	bool "TI AM62x M4"
	select SOC_PART_NUMBER_AM62x

endchoice

config SOC_PART_NUMBER_AM62x
	bool

config SOC_PART_NUMBER_AM62X_M4
	string
	default "AM62x" if SOC_PART_NUMBER_AM62x
	help
	  Full part number of the SoC. Do not select directly.

config SOC_PART_NUMBER
	default SOC_PART_NUMBER_AM62X_M4 if SOC_SERIES_AM62X_M4
```

## soc/arm/ti_k3/j721e/Kconfig.defconfig
```kconfig
# Copyright (C) 2023 BeagleBoard.org Foundation
# Copyright (C) 2023 S Prashanth
#
# SPDX-License-Identifier: Apache-2.0

if SOC_TI_J721E_R5

config SOC
	default "j721e_r5"

endif
```

## soc/arm/ti_k3/j721e/Kconfig.defconfig.j721e_r5
```kconfig
# Copyright (C) 2023 BeagleBoard.org Foundation
# Copyright (C) 2023 S Prashanth
#
# SPDX-License-Identifier: Apache-2.0

config SOC
	default "j721e_r5"
	depends on SOC_TI_J721E_R5
```

## soc/arm/ti_k3/j721e/Kconfig.defconfig.series
```kconfig
# Copyright (C) 2023 BeagleBoard.org Foundation
# Copyright (C) 2023 S Prashanth
#
# SPDX-License-Identifier: Apache-2.0

if SOC_SERIES_TI_J721E

source "soc/arm/ti_k3/j721e/Kconfig.defconfig.j721e*"

config SOC_SERIES
	default "j721e"

config NUM_IRQS
	default 512

config SYS_CLOCK_HW_CYCLES_PER_SEC
	default 19200000

config SYS_CLOCK_TICKS_PER_SEC
	default 10000

config UART_NS16550
	default y

config UART_NS16550_TI_K3
	default y

choice UART_NS16550_VARIANT
	default UART_NS16550_VARIANT_NS16750
endchoice

config PINCTRL
	default y

if !XIP
	config FLASH_SIZE
		default 0

	config FLASH_BASE_ADDRESS
		default 0
endif # XIP

# This is required for the entry point address for the elf to be zero
config KERNEL_ENTRY
	default "_vector_table"

endif # SOC_SERIES_TI_J721E
```

## soc/arm/ti_k3/j721e/Kconfig.series
```kconfig
# Copyright (C) 2023 BeagleBoard.org Foundation
# Copyright (C) 2023 S Prashanth
#
# SPDX-License-Identifier: Apache-2.0

config SOC_SERIES_TI_J721E
	bool "TI Jacinto J721E SoC series"
	select ARM
	select SOC_FAMILY_TI_K3
	select CPU_CORTEX_R5
	select ARM_CUSTOM_INTERRUPT_CONTROLLER
	select VIM
	select OMAP_DM_TIMER
	help
	  Enable support for the TI Jacinto J721E SoC series
```

## soc/arm/ti_k3/j721e/Kconfig.soc
```kconfig
# Copyright (C) 2023 BeagleBoard.org Foundation
# Copyright (C) 2023 S Prashanth
#
# SPDX-License-Identifier: Apache-2.0

choice
	prompt "TI J721E SoC Selection"
	depends on SOC_SERIES_TI_J721E

config SOC_TI_J721E_R5
	bool "TI J721E R5"

endchoice
```

## soc/arm/ti_lm3s6965/Kconfig
```kconfig
# Kconfig - TI LM3S6965 platform configuration options

#
# Copyright (c) 2014-2015 Wind River Systems, Inc.
#
# SPDX-License-Identifier: Apache-2.0
#

if SOC_TI_LM3S6965

config SOC_TI_LM3S6965_QEMU
	def_bool y
	# Platform has only been tested on QEMU, not on real hardware, so always
	# assume it is used for a QEMU target.

endif # SOC_TI_LM3S6965
```

## soc/arm/ti_lm3s6965/Kconfig.defconfig
```kconfig
# Kconfig - TI LM3S6965 platform configuration options

#
# Copyright (c) 2014-2015 Wind River Systems, Inc.
#
# SPDX-License-Identifier: Apache-2.0
#

if SOC_TI_LM3S6965

config SOC
	default "ti_lm3s6965"

config NUM_IRQS
	# must be >= the highest interrupt number used
	# - include the UART interrupts and ethernet interrupts
	default 43

config SYS_CLOCK_HW_CYCLES_PER_SEC
	default 12000000

if UART_STELLARIS

config UART_STELLARIS_PORT_0
	default y

config UART_STELLARIS_PORT_1
	default y

config UART_STELLARIS_PORT_2
	default y

endif # UART_STELLARIS

endif
```

## soc/arm/ti_lm3s6965/Kconfig.soc
```kconfig
# SPDX-License-Identifier: Apache-2.0

config SOC_TI_LM3S6965
	bool
	select ARM
	select CPU_CORTEX_M3
	select CPU_CORTEX_M_HAS_DWT
	help
	  TI LM3S6965
```

## soc/arm/ti_simplelink/Kconfig
```kconfig
# Texas Instruments SimpleLink Family

# SPDX-License-Identifier: Apache-2.0

config SOC_FAMILY_TISIMPLELINK
	bool

if SOC_FAMILY_TISIMPLELINK

config SOC_FAMILY
	string
	default "ti_simplelink"

source "soc/arm/ti_simplelink/*/Kconfig.soc"

config HAS_TI_CCFG
	bool
	help
	  Selected when CCFG (Customer Configuration) registers
	  appear at the end of flash

endif # SOC_FAMILY_TISIMPLELINK
```

## soc/arm/ti_simplelink/Kconfig.defconfig
```kconfig
# SPDX-License-Identifier: Apache-2.0

source "soc/arm/ti_simplelink/*/Kconfig.defconfig.series"
```

## soc/arm/ti_simplelink/Kconfig.soc
```kconfig
# SPDX-License-Identifier: Apache-2.0

# Kconfig - Texas Instruments SimpleLink Family
#

source "soc/arm/ti_simplelink/*/Kconfig.series"
```

## soc/arm/ti_simplelink/cc13x2_cc26x2/Kconfig.defconfig.cc1352r
```kconfig
# Texas Instruments SimpleLink CC1352R
#
# Copyright (c) 2019 Brett Witherspoon
#
# SPDX-License-Identifier: Apache-2.0

config SOC
	default "cc1352r"
	depends on SOC_CC1352R
```

## soc/arm/ti_simplelink/cc13x2_cc26x2/Kconfig.defconfig.cc2652r
```kconfig
# Texas Instruments SimpleLink CC2652R

# Copyright (c) 2019 Brett Witherspoon
# SPDX-License-Identifier: Apache-2.0

config SOC
	default "cc2652r"
	depends on SOC_CC2652R
```

## soc/arm/ti_simplelink/cc13x2_cc26x2/Kconfig.defconfig.series
```kconfig
# Texas Instruments SimpleLink CC13x2 / CC26x2

# Copyright (c) 2019 Brett Witherspoon
# SPDX-License-Identifier: Apache-2.0

if SOC_SERIES_CC13X2_CC26X2

source "soc/arm/ti_simplelink/cc13x2_cc26x2/Kconfig.defconfig.cc*"

config SOC_SERIES
	default "cc13x2_cc26x2"

config SYS_CLOCK_HW_CYCLES_PER_SEC
	default 32768

# Note that when using the RTC as system clock, this needs to be 32768
# to reduce truncation errors from accumulating due to conversion to/from
# time, ticks, and HW cycles
config SYS_CLOCK_TICKS_PER_SEC
	default 32768

config NUM_IRQS
	default 38

config CC13X2_CC26X2_RTC_TIMER
	default y

config ENTROPY_CC13XX_CC26XX_RNG
	default y
	depends on ENTROPY_GENERATOR

if IEEE802154

config IEEE802154_CC13XX_CC26XX
	default y
	# required for linking with PowerCC26X2_config in
	# soc/arm/ti_simplelink/cc13x2_cc26x2/power.c
	select PM

config IEEE802154_CC13XX_CC26XX_SUB_GHZ
	default y
	# required for linking with PowerCC26X2_config in
	# soc/arm/ti_simplelink/cc13x2_cc26x2/power.c
	select PM

config NET_CONFIG_IEEE802154_DEV_NAME
	default IEEE802154_CC13XX_CC26XX_DRV_NAME

endif # IEEE802154

if BT

config BLE_CC13XX_CC26XX
	bool
	default y

endif # BT

endif # SOC_SERIES_CC13X2_CC26X2
```

## soc/arm/ti_simplelink/cc13x2_cc26x2/Kconfig.series
```kconfig
# Texas Instruments SimpleLink CC13x2 / CC26x2

# Copyright (c) 2019 Brett Witherspoon
# SPDX-License-Identifier: Apache-2.0

config SOC_SERIES_CC13X2_CC26X2
	bool "TI SimpleLink Family CC13x2 / CC26x2"
	select ARM
	select CPU_CORTEX_M4
	select CPU_HAS_ARM_MPU
	select DYNAMIC_INTERRUPTS
	select CPU_CORTEX_M_HAS_DWT
	select CPU_HAS_FPU
	select SOC_FAMILY_TISIMPLELINK
	select HAS_CC13X2_CC26X2_SDK
	select HAS_TI_CCFG
	help
	  Enable support for TI SimpleLink CC13x2 / CC26x2 SoCs
```

## soc/arm/ti_simplelink/cc13x2_cc26x2/Kconfig.soc
```kconfig
# Texas Instruments SimpleLink CC13x2 / CC26x2

# Copyright (c) 2019 Brett Witherspoon
# SPDX-License-Identifier: Apache-2.0

choice
	prompt "TI SimpleLink MCU Selection"
	depends on SOC_SERIES_CC13X2_CC26X2

config SOC_CC2652R
	bool "CC2652R"

config SOC_CC1352R
	bool "CC1352R"

endchoice

menu "Customer Configuration (CCFG)"
depends on SOC_SERIES_CC13X2_CC26X2

config CC13X2_CC26X2_BOOTLOADER_ENABLE
	bool "ROM bootloader"
	help
	  Enable the serial bootloader which resides in ROM on CC13xx / CC26xx
	  devices.

config CC13X2_CC26X2_BOOTLOADER_BACKDOOR_ENABLE
	bool "ROM bootloader backdoor"
	depends on CC13X2_CC26X2_BOOTLOADER_ENABLE
	help
	  Enable the ROM bootloader backdoor which starts the bootloader if the
	  associated pin is at the correct logic level on reset.

config CC13X2_CC26X2_BOOTLOADER_BACKDOOR_PIN
	int "ROM bootloader backdoor pin"
	depends on CC13X2_CC26X2_BOOTLOADER_BACKDOOR_ENABLE
	range 0 255
	default 255
	help
	  Set the pin that is level checked if the bootloader backdoor is
	  enabled.

config CC13X2_CC26X2_BOOTLOADER_BACKDOOR_LEVEL
	int "ROM bootloader backdoor level"
	depends on CC13X2_CC26X2_BOOTLOADER_BACKDOOR_ENABLE
	range 0 1
	default 0
	help
	  Set the active level of the pin selected for the bootloader backdoor.

endmenu
```

## soc/arm/ti_simplelink/cc13x2x7_cc26x2x7/Kconfig.defconfig.cc1352r7
```kconfig
# Texas Instruments SimpleLink CC1352R
#
# Copyright (c) 2022 Vaishnav Achath
#
# SPDX-License-Identifier: Apache-2.0

config SOC
	default "cc1352r7"
	depends on SOC_CC1352R7
```
