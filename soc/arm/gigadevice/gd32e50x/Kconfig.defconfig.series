## soc/arm/gigadevice/gd32e50x/Kconfig.defconfig.series
```kconfig
# Copyright (c) 2022, Teslabs Engineering S.L.
# SPDX-License-Identifier: Apache-2.0

if SOC_SERIES_GD32E50X

source "soc/arm/gigadevice/gd32e50x/Kconfig.defconfig.gd32*"

config SOC_SERIES
	default "gd32e50x"

endif # SOC_SERIES_GD32E50X
```

## soc/arm/gigadevice/gd32e50x/Kconfig.series
```kconfig
# Copyright (c) 2022, Teslabs Engineering S.L.
# SPDX-License-Identifier: Apache-2.0

config SOC_SERIES_GD32E50X
	bool "GigaDevice GD32E50X series Cortex-M33 MCU"
	select ARM
	select CPU_HAS_ARM_MPU
	select CPU_HAS_FPU
	select CPU_CORTEX_M33
	select SOC_FAMILY_GD32_ARM
	select GD32_HAS_AFIO_PINMUX
	select GD32_HAS_IRC_40K
	help
	  Enable support for GigaDevice GD32E50X MCU series
```

## soc/arm/gigadevice/gd32e50x/Kconfig.soc
```kconfig
# Copyright (c) 2022, Teslabs Engineering S.L.
# SPDX-License-Identifier: Apache-2.0

config SOC_GD32E507
	bool
	help
	  gd32e507
```

## soc/arm/gigadevice/gd32f3x0/Kconfig.defconfig.series
```kconfig
# Copyright (c) 2021 BrainCo Inc.
# SPDX-License-Identifier: Apache-2.0

if SOC_SERIES_GD32F3X0

source "soc/arm/gigadevice/gd32f3x0/Kconfig.defconfig.gd32*"

config SOC_SERIES
	default "gd32f3x0"

endif # SOC_SERIES_GD32F3X0
```

## soc/arm/gigadevice/gd32f3x0/Kconfig.series
```kconfig
# Copyright (c) 2021 BrainCo Inc.
# SPDX-License-Identifier: Apache-2.0

config SOC_SERIES_GD32F3X0
	bool "GigaDevice GD32F3X0 series Cortex-M4F MCU"
	select ARM
	select CPU_HAS_FPU
	select CPU_CORTEX_M4
	select SOC_FAMILY_GD32_ARM
	select GD32_HAS_AF_PINMUX
	help
	  Enable support for GigaDevice GD32F3X0 MCU series
```

## soc/arm/gigadevice/gd32f3x0/Kconfig.soc
```kconfig
# Copyright (c) 2021 BrainCo Inc.
# SPDX-License-Identifier: Apache-2.0

config SOC_GD32F350
	bool
	help
	  gd32f350
```

## soc/arm/gigadevice/gd32f4/Kconfig.defconfig.gd32f405
```kconfig
# Copyright (c) 2021 BrainCo Inc.
# SPDX-License-Identifier: Apache-2.0

if SOC_GD32F405R || SOC_GD32F405V || SOC_GD32F405Z

config SOC
	default	"gd32f405r" if SOC_GD32F405R
	default	"gd32f405v" if SOC_GD32F405V
	default	"gd32f405z" if SOC_GD32F405Z

config SOC_SERIES_GD32F405
	bool
	default y

config SYS_CLOCK_HW_CYCLES_PER_SEC
	default 168000000

config NUM_IRQS
	default 82

endif
```

## soc/arm/gigadevice/gd32f4/Kconfig.defconfig.gd32f407
```kconfig
# Copyright (c) 2021 BrainCo Inc.
# SPDX-License-Identifier: Apache-2.0

if SOC_GD32F407R || SOC_GD32F407V || SOC_GD32F407Z

config SOC
	default	"gd32f407r" if SOC_GD32F407R
	default	"gd32f407v" if SOC_GD32F407V
	default	"gd32f407z" if SOC_GD32F407Z

config SOC_SERIES_GD32F407
	bool
	default y

config SYS_CLOCK_HW_CYCLES_PER_SEC
	default 168000000

config NUM_IRQS
	default 82

endif
```

## soc/arm/gigadevice/gd32f4/Kconfig.defconfig.gd32f450
```kconfig
# Copyright (c) 2021 BrainCo Inc.
# SPDX-License-Identifier: Apache-2.0

if SOC_GD32F450V || SOC_GD32F450Z || SOC_GD32F450I

config SOC
	default	"gd32f450v" if SOC_GD32F450V
	default	"gd32f450z" if SOC_GD32F450Z
	default	"gd32f450i" if SOC_GD32F450I

config SOC_SERIES_GD32F450
	bool
	default y

config SYS_CLOCK_HW_CYCLES_PER_SEC
	default 200000000

config NUM_IRQS
	default 91

endif
```

## soc/arm/gigadevice/gd32f4/Kconfig.defconfig.series
```kconfig
# Copyright (c) 2021, ATL Electronics
# SPDX-License-Identifier: Apache-2.0

if SOC_SERIES_GD32F4

source "soc/arm/gigadevice/gd32f4/Kconfig.defconfig.gd32f4*"

config SOC_SERIES
	default "gd32f4"

endif   # SOC_SERIES_GD32F4
```

## soc/arm/gigadevice/gd32f4/Kconfig.soc
```kconfig
# Copyright (c) 2021, ATL Electronics
# Copyright (c) 2021 BrainCo Inc.
# SPDX-License-Identifier: Apache-2.0

choice
	prompt "GigaDevice GD32F4xx MCU Selection"
	depends on SOC_SERIES_GD32F4

	config SOC_GD32F403R
		bool "gd32f403r"

	config SOC_GD32F403V
		bool "gd32f403v"

	config SOC_GD32F403Z
		bool "gd32f403z"

	config SOC_GD32F405R
		bool "gd32f405r"

	config SOC_GD32F405V
		bool "gd32f405v"

	config SOC_GD32F405Z
		bool "gd32f405z"

	config SOC_GD32F407R
		bool "gd32f407r"

	config SOC_GD32F407V
		bool "gd32f407v"

	config SOC_GD32F407Z
		bool "gd32f407z"

	config SOC_GD32F450V
		bool "gd32f450v"

	config SOC_GD32F450Z
		bool "gd32f450z"

	config SOC_GD32F450I
		bool "gd32f450i"

endchoice
```

## soc/arm/gigadevice/gd32f403/Kconfig.defconfig.gd32f403
```kconfig
# Copyright (c) 2021, ATL Electronics
# SPDX-License-Identifier: Apache-2.0

config SOC
	default "gd32f403"

config SYS_CLOCK_HW_CYCLES_PER_SEC
	default 168000000

config NUM_IRQS
	default 68
```

## soc/arm/gigadevice/gd32f403/Kconfig.defconfig.series
```kconfig
# Copyright (c) 2021, ATL Electronics
# SPDX-License-Identifier: Apache-2.0

if SOC_SERIES_GD32F403

source "soc/arm/gigadevice/gd32f403/Kconfig.defconfig.gd32f403"

config SOC_SERIES
	default "gd32f403"

endif   # SOC_SERIES_GD32F403
```

## soc/arm/gigadevice/gd32f403/Kconfig.series
```kconfig
# Copyright (c) 2021, ATL Electronics
# SPDX-License-Identifier: Apache-2.0

config SOC_SERIES_GD32F403
	bool "GigaDevice GD32F403 series Cortex-M4F MCU"
	select ARM
	select CPU_HAS_ARM_MPU
	select CPU_HAS_FPU
	select CPU_CORTEX_M4
	select CPU_CORTEX_M_HAS_SYSTICK
	select CPU_CORTEX_M_HAS_VTOR
	select SOC_FAMILY_GD32_ARM
	select GD32_HAS_AFIO_PINMUX
	select GD32_HAS_IRC_40K
	help
	  Enable support for GigaDevice GD32F403 MCU series
```

## soc/arm/gigadevice/gd32f403/Kconfig.soc
```kconfig
# Copyright (c) 2021, ATL Electronics
# SPDX-License-Identifier: Apache-2.0

config SOC_GD32F403
	bool
	help
	  gd32f403
```

## soc/arm/gigadevice/gd32f4xx/Kconfig.defconfig.gd32f405
```kconfig
# Copyright (c) 2021 BrainCo Inc.
# SPDX-License-Identifier: Apache-2.0

if SOC_GD32F405

config SOC
	default "gd32f405"

config SYS_CLOCK_HW_CYCLES_PER_SEC
	default $(dt_node_int_prop_int,/cpus/cpu@0,clock-frequency)

config NUM_IRQS
	default 82

endif # SOC_GD32F405
```

## soc/arm/gigadevice/gd32f4xx/Kconfig.defconfig.gd32f450
```kconfig
# Copyright (c) 2021, Teslabs Engineering S.L.
# SPDX-License-Identifier: Apache-2.0

if SOC_GD32F450

config SOC
	default "gd32f450"

config SYS_CLOCK_HW_CYCLES_PER_SEC
	default 200000000

config NUM_IRQS
	default 91

endif # SOC_GD32F450
```

## soc/arm/gigadevice/gd32f4xx/Kconfig.defconfig.series
```kconfig
# Copyright (c) 2021, Teslabs Engineering S.L.
# SPDX-License-Identifier: Apache-2.0

if SOC_SERIES_GD32F4XX

source "soc/arm/gigadevice/gd32f4xx/Kconfig.defconfig.gd32*"

config SOC_SERIES
	default "gd32f4xx"

endif # SOC_SERIES_GD32F4XX
```

## soc/arm/gigadevice/gd32f4xx/Kconfig.series
```kconfig
# Copyright (c) 2021, Teslabs Engineering S.L.
# SPDX-License-Identifier: Apache-2.0

config SOC_SERIES_GD32F4XX
	bool "GigaDevice GD32F4XX series Cortex-M4F MCU"
	select ARM
	select CPU_HAS_ARM_MPU
	select CPU_HAS_FPU
	select CPU_CORTEX_M4
	select SOC_FAMILY_GD32_ARM
	select GD32_HAS_AF_PINMUX
	help
	  Enable support for GigaDevice GD32F4XX MCU series
```

## soc/arm/gigadevice/gd32f4xx/Kconfig.soc
```kconfig
# Copyright (c) 2021, Teslabs Engineering S.L.
# Copyright (c) 2022, Rtone.
# SPDX-License-Identifier: Apache-2.0

config SOC_GD32F405
	bool
	help
	  gd32f405

config SOC_GD32F407
	bool
	help
	  gd32f407

config SOC_GD32F450
	bool
	help
	  gd32f450

config SOC_GD32F470
	bool
	help
	  gd32f470
```

## soc/arm/gigadevice/gd32l23x/Kconfig.defconfig.gd32l233
```kconfig
# Copyright (c) 2022 BrainCo Inc.
# SPDX-License-Identifier: Apache-2.0

config SOC
	default "gd32l233"

config SYS_CLOCK_HW_CYCLES_PER_SEC
	default $(dt_node_int_prop_int,/cpus/cpu@0,clock-frequency)

config NUM_IRQS
	default 69
```

## soc/arm/gigadevice/gd32l23x/Kconfig.defconfig.series
```kconfig
# Copyright (c) 2022 BrainCo Inc.
# SPDX-License-Identifier: Apache-2.0

if SOC_SERIES_GD32L23X

source "soc/arm/gigadevice/gd32l23x/Kconfig.defconfig.gd32*"

config SOC_SERIES
	default "gd32l23x"

endif # SOC_SERIES_GD32L23X
```

## soc/arm/gigadevice/gd32l23x/Kconfig.series
```kconfig
# Copyright (c) 2022 BrainCo Inc.
# SPDX-License-Identifier: Apache-2.0

config SOC_SERIES_GD32L23X
	bool "GigaDevice GD32L23X series Cortex-M23 MCU"
	select ARM
	select CPU_CORTEX_M23
	select CPU_CORTEX_M_HAS_SYSTICK
	select SOC_FAMILY_GD32_ARM
	select GD32_HAS_AF_PINMUX
	select GD32_HAS_IRC_32K
	help
	  Enable support for GigaDevice GD32L23X MCU series
```

## soc/arm/gigadevice_gd32/Kconfig
```kconfig
# ST Microelectronics STM32 MCU line

# Copyright (c) 2016 Open-RnD Sp. z o.o.
# SPDX-License-Identifier: Apache-2.0

config SOC_FAMILY_GD32
	bool
	select HAS_SEGGER_RTT
	select BUILD_OUTPUT_HEX

if SOC_FAMILY_GD32

config SOC_FAMILY
	string
	default "gigadevice_gd32"

source "soc/arm/gigadevice_gd32/*/Kconfig.soc"

endif # SOC_FAMILY_GD32
```

## soc/arm/gigadevice_gd32/Kconfig.defconfig
```kconfig
# SPDX-License-Identifier: Apache-2.0

source "soc/arm/gigadevice_gd32/*/Kconfig.defconfig.series"
```
