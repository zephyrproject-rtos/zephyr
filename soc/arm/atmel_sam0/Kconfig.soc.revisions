## soc/arm/atmel_sam0/samd51/Kconfig.series
```kconfig
# Atmel SAMD51 MCU series

# Copyright (c) 2019 ML!PA Consulting GmbH
# SPDX-License-Identifier: Apache-2.0

config SOC_SERIES_SAMD51
	bool "Atmel SAMD51 MCU"
	select ARM
	select CPU_CORTEX_M4
	select SOC_FAMILY_SAM0
	select CPU_HAS_FPU
	select CPU_HAS_ARM_MPU
	select CPU_CORTEX_M_HAS_DWT
	select ASF
	help
	  Enable support for Atmel SAMD51 Cortex-M4F microcontrollers.
```

## soc/arm/atmel_sam0/samd51/Kconfig.soc
```kconfig
# Atmel SAMD51 MCU series

# Copyright (c) 2019 ML!PA Consulting GmbH
# SPDX-License-Identifier: Apache-2.0

config SOC_PART_NUMBER_SAMD51G18A
	bool
	help
	  SAMD51G18A

config SOC_PART_NUMBER_SAMD51G19A
	bool
	help
	  SAMD51G19A

config SOC_PART_NUMBER_SAMD51J18A
	bool
	help
	  SAMD51J18A

config SOC_PART_NUMBER_SAMD51J19A
	bool
	help
	  SAMD51J19A

config SOC_PART_NUMBER_SAMD51J20A
	bool
	help
	  SAMD51J20A

config SOC_PART_NUMBER_SAMD51N19A
	bool
	help
	  SAMD51N19A

config SOC_PART_NUMBER_SAMD51N20A
	bool
	help
	  SAMD51N20A

config SOC_PART_NUMBER_SAMD51P19A
	bool
	help
	  SAMD51P19A

config SOC_PART_NUMBER_SAMD51P20A
	bool
	help
	  SAMD51P20A
```

## soc/arm/atmel_sam0/same51/Kconfig.defconfig.series
```kconfig
# Atmel SAME51 MCU series configuration options

# Copyright (c) 2019 ML!PA Consulting GmbH
# SPDX-License-Identifier: Apache-2.0

if SOC_SERIES_SAME51

config SOC_SERIES
	string
	default "same51"

config SOC_PART_NUMBER
	string
	default "same51j18a" if SOC_PART_NUMBER_SAME51J18A
	default "same51j19a" if SOC_PART_NUMBER_SAME51J19A
	default "same51j20a" if SOC_PART_NUMBER_SAME51J20A
	default "same51n19a" if SOC_PART_NUMBER_SAME51N19A
	default "same51n20a" if SOC_PART_NUMBER_SAME51N20A

config NUM_IRQS
	int
	default 137

config ROM_START_OFFSET
	default 0x400 if BOOTLOADER_MCUBOOT

config SYS_CLOCK_HW_CYCLES_PER_SEC
	int
	default 120000000

endif # SOC_SERIES_SAME51
```

## soc/arm/atmel_sam0/same51/Kconfig.series
```kconfig
# Atmel SAME51 MCU series

# Copyright (c) 2019 ML!PA Consulting GmbH
# SPDX-License-Identifier: Apache-2.0

config SOC_SERIES_SAME51
	bool "Atmel SAME51 MCU"
	select ARM
	select CPU_CORTEX_M4
	select SOC_FAMILY_SAM0
	select CPU_HAS_FPU
	select CPU_HAS_ARM_MPU
	select CPU_CORTEX_M_HAS_DWT
	select ASF
	help
	  Enable support for Atmel SAME51 Cortex-M4F microcontrollers.
```

## soc/arm/atmel_sam0/same51/Kconfig.soc
```kconfig
# Atmel SAME51 MCU series

# Copyright (c) 2019 ML!PA Consulting GmbH
# SPDX-License-Identifier: Apache-2.0

choice
	prompt "Atmel SAME51 MCU Selection"
	depends on SOC_SERIES_SAME51

config SOC_PART_NUMBER_SAME51J18A
	bool "SAME51J18A"

config SOC_PART_NUMBER_SAME51J19A
	bool "SAME51J19A"

config SOC_PART_NUMBER_SAME51J20A
	bool "SAME51J20A"

config SOC_PART_NUMBER_SAME51N19A
	bool "SAME51N19A"

config SOC_PART_NUMBER_SAME51N20A
	bool "SAME51N20A"

endchoice
```

## soc/arm/atmel_sam0/same53/Kconfig.soc
```kconfig
# Atmel SAME53 MCU series

# Copyright (c) 2019 ML!PA Consulting GmbH
# SPDX-License-Identifier: Apache-2.0

config SOC_PART_NUMBER_SAME53J18A
	bool
	help
	  SAME53J18A

config SOC_PART_NUMBER_SAME53J19A
	bool
	help
	  SAME53J19A

config SOC_PART_NUMBER_SAME53J20A
	bool
	help
	  SAME53J20A

config SOC_PART_NUMBER_SAME53N19A
	bool
	help
	  SAME53N19A

config SOC_PART_NUMBER_SAME53N20A
	bool
	help
	  SAME53N20A
```

## soc/arm/atmel_sam0/same54/Kconfig.defconfig.series
```kconfig
# Atmel SAME MCU series configuration options

# Copyright (c) 2019 ML!PA Consulting GmbH
# SPDX-License-Identifier: Apache-2.0

if SOC_SERIES_SAME54

config SOC_SERIES
	string
	default "same54"

config SOC_PART_NUMBER
	string
	default "same54n19a" if SOC_PART_NUMBER_SAME54N19A
	default "same54n20a" if SOC_PART_NUMBER_SAME54N20A
	default "same54p19a" if SOC_PART_NUMBER_SAME54P19A
	default "same54p20a" if SOC_PART_NUMBER_SAME54P20A

config NUM_IRQS
	int
	default 137

config ROM_START_OFFSET
	default 0x400 if BOOTLOADER_MCUBOOT

config SYS_CLOCK_HW_CYCLES_PER_SEC
	int
	default 120000000

endif # SOC_SERIES_SAME54
```

## soc/arm/atmel_sam0/same54/Kconfig.series
```kconfig
# Atmel SAME54 MCU series

# Copyright (c) 2019 ML!PA Consulting GmbH
# SPDX-License-Identifier: Apache-2.0

config SOC_SERIES_SAME54
	bool "Atmel SAME54 MCU"
	select ARM
	select CPU_CORTEX_M4
	select SOC_FAMILY_SAM0
	select CPU_HAS_FPU
	select CPU_HAS_ARM_MPU
	select CPU_CORTEX_M_HAS_DWT
	select ASF
	help
	  Enable support for Atmel SAME54 Cortex-M4F microcontrollers.
```
