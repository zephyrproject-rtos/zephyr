## soc/arm/atmel_sam0/Kconfig.soc.revisions
```kconfig
# Copyright (c) 2022 Gerson Fernando Budke <nandojve@gmail.com>
# SPDX-License-Identifier: Apache-2.0

config SOC_SERIES_REVISION_N
	bool

config SOC_SERIES_REVISION
	string
	default "n" if SOC_SERIES_REVISION_N
	default ""
```

## soc/arm/atmel_sam0/common/Kconfig.defconfig.series
```kconfig
# Atmel SAM0 MCU family configuration options

# Copyright (c) 2020 Google LLC.
# SPDX-License-Identifier: Apache-2.0

if SOC_FAMILY_SAM0

config HWINFO_SAM0
	default HWINFO

if USB_DEVICE_DRIVER

config HEAP_MEM_POOL_SIZE
	default 1024

endif # USB_DEVICE_DRIVER

endif # SOC_FAMILY_SAM0
```

## soc/arm/atmel_sam0/common/Kconfig.samd2x
```kconfig
# SPDX-License-Identifier: Apache-2.0

if SOC_SERIES_SAMD20 || SOC_SERIES_SAMD21 || SOC_SERIES_SAMR21

config SOC_ATMEL_SAMD_XOSC32K
	bool "External 32 kHz crystal oscillator"
	help
	  Say y to enable the external 32 kHZ crystal oscillator at
	  startup.  This can then be selected as the main clock source
	  for the SOC.

config SOC_ATMEL_SAMD_XOSC
	bool "External crystal oscillator"
	help
	  Say y to enable the external crystal oscillator at startup.

choice
	prompt "Main clock source"
	help
	  Selects the clock that the main clocks, such as the CPU
	  clock and AHB clock, will be derived from.

config SOC_ATMEL_SAMD_XOSC32K_AS_MAIN
	depends on SOC_ATMEL_SAMD_XOSC32K
	bool "XOSC32K"

config SOC_ATMEL_SAMD_XOSC_AS_MAIN
	depends on SOC_ATMEL_SAMD_XOSC
	bool "XOSC"

config SOC_ATMEL_SAMD_OSC8M_AS_MAIN
	bool "OSC8M"

endchoice

endif # SOC_SERIES_SAMD20 || SOC_SERIES_SAMD21
```

## soc/arm/atmel_sam0/common/Kconfig.samd5x
```kconfig
# Copyright (c) 2019 ML!PA Consulting GmbH
# SPDX-License-Identifier: Apache-2.0

if SOC_SERIES_SAMD51 || SOC_SERIES_SAME51 || SOC_SERIES_SAME53 || SOC_SERIES_SAME54

config SOC_ATMEL_SAMD5X_XOSC32K
	bool "The external 32 kHz crystal oscillator"
	help
	  Say y to enable the external 32 kHZ crystal oscillator at
	  startup.  This can then be selected as the main clock source
	  for the SOC.

config SOC_ATMEL_SAMD5X_XOSC_20MHZ
	bool "Enable the external 20MHz Oscillator"
	help
	  Say y to enable the external 20 MHz oscillator at
	  startup.  This can then be selected as the main clock source
	  for the SOC.

config SOC_ATMEL_SAMD5X_DPLL
	bool "Enable the DPLL"
	help
	  Say y to enable the DPLL, which assumes 32kHz on GCLK1.  This can then be selected as the main clock source
	  for the SOC.

config SOC_ATMEL_SAMD5X_DPLL
	bool "Enable the DFLL"
	help
	  Say y to enable the DFLL.

choice
	prompt "Main clock source"
	help
	  Selects the clock that the main clocks, such as the CPU
	  clock and AHB clock, will be derived from.

config SOC_ATMEL_SAMD5X_XOSC32K_AS_MAIN
	depends on SOC_ATMEL_SAMD5X_XOSC32K
	bool "XOSC32K"

config SOC_ATMEL_SAMD5X_OSCULP32K_AS_MAIN
	bool "OSCULP32K"

config SOC_ATMEL_SAMD5X_DPLL_MAIN_CLK
	depends on SOC_ATMEL_SAMD5X_DPLL
	bool "DPLL"

config SOC_ATMEL_SAMD5X_XOSC_20MHZ_AS_MAIN
	depends on SOC_ATMEL_SAMD5X_XOSC_20MHZ
	bool "XOSC20MHZ"

endchoice

endif
```

## soc/arm/atmel_sam0/common/Kconfig.saml2x
```kconfig
# Copyright (c) 2021 Argentum Systems Ltd.
# SPDX-License-Identifier: Apache-2.0

if SOC_SERIES_SAML21 || SOC_SERIES_SAMR34 || SOC_SERIES_SAMR35

config SOC_ATMEL_SAML_DEBUG_PAUSE
	bool "Insert a pause at boot, to allow a debugger to attach"
	default y
	help
	  Issues have been observed while attempting to attach a debugger.
	  These can be mitigated by inserting a small delay during the early boot
	  sequence, before the system clock is configured.

	  If you ever intend to attach a debugger, say y.
	  If you are confident that you will never attach a debugger to the
	  resulting binary, or require the best possible boot time, say n.

config SOC_ATMEL_SAML_OSC32K
	bool "Internal 32.768 kHz RC oscillator"
	help
	  Eable the internal 32.768 kHz RC oscillator at startup.
	  This can then be selected as the main clock reference for the SOC.

config SOC_ATMEL_SAML_XOSC32K
	bool "External 32.768 kHz clock source"
	help
	  Enable the external 32.768 kHz cloud source at startup.
	  This can then be selected as the main clock reference for the SOC.

config SOC_ATMEL_SAML_XOSC32K_CRYSTAL
	bool "External 32.768 kHz clock is a crystal oscillator"
	depends on SOC_ATMEL_SAML_XOSC32K
	default y
	help
	  Enable the crystal oscillator (if disabled, expect a clock signal on
	  XIN32).

config SOC_ATMEL_SAML_OSC16M
	bool "Internal 16 MHz RC oscillator"
	help
	  Enable the internal 16 MHz RC oscillator at startup.
	  This can then be selected as the main clock reference for the SOC.

# NOTE: XOSC is not currently supported


choice
	prompt "Main clock reference"
	default SOC_ATMEL_SAML_OPENLOOP_AS_MAIN
	help
	  Selects the clock that will be used for the DFLL48M's reference.
	  Main clocks, such as the CPU and AHB clocks will be derived from
	  DFLL48M configured for 48 MHz.

config SOC_ATMEL_SAML_OPENLOOP_AS_MAIN
	bool "OPENLOOP"
	help
	  Note, this mode can only be used with an LDO regulator.

config SOC_ATMEL_SAML_OSC32K_AS_MAIN
	bool "OSC32K"
	depends on SOC_ATMEL_SAML_OSC32K

config SOC_ATMEL_SAML_XOSC32K_AS_MAIN
	bool "XOSC32K"
	depends on SOC_ATMEL_SAML_XOSC32K

config SOC_ATMEL_SAML_OSC16M_AS_MAIN
	bool "OSC16M"
	depends on SOC_ATMEL_SAML_OSC16M

endchoice

endif # SOC_SERIES_SAML21 || SOC_SERIES_SAMR34 || SOC_SERIES_SAMR35

config SOC_ATMEL_SAMR3X_RADIO_OFF_SETUP
	bool "Configure LoRa radio pins if not in use"
	default y if !LORA
	depends on SOC_SERIES_SAMR34 || SOC_SERIES_SAMR35
	help
	  As detailed in DS70005356C, LoRa radio SPI pins do not have pull-ups,
	  so when the radio is not in use, it's important that CS is kept high,
	  to avoid unexpected behavior and increased current consumption. To
	  further reduce power consumption, radio can be kept in reset state by
	  keeping nRST pin low. When enabling this option, both CS and nRST will
	  be configured high and low, respectively.
```

## soc/arm/atmel_sam0/samc20/Kconfig.defconfig.series
```kconfig
# Atmel SAMC MCU series configuration options

# Copyright (c) 2022 Kamil Serwus
# SPDX-License-Identifier: Apache-2.0

if SOC_SERIES_SAMC20

config SOC_SERIES
	default "samc20"

config SOC_PART_NUMBER
	default "samc20e15a" if SOC_PART_NUMBER_SAMC20E15A
	default "samc20e16a" if SOC_PART_NUMBER_SAMC20E16A
	default "samc20e17a" if SOC_PART_NUMBER_SAMC20E17A
	default "samc20e18a" if SOC_PART_NUMBER_SAMC20E18A
	default "samc20g15a" if SOC_PART_NUMBER_SAMC20G15A
	default "samc20g16a" if SOC_PART_NUMBER_SAMC20G16A
	default "samc20g17a" if SOC_PART_NUMBER_SAMC20G17A
	default "samc20g18a" if SOC_PART_NUMBER_SAMC20G18A
	default "samc20j15a" if SOC_PART_NUMBER_SAMC20J15A
	default "samc20j16a" if SOC_PART_NUMBER_SAMC20J16A
	default "samc20j17a" if SOC_PART_NUMBER_SAMC20J17A
	default "samc20j17au" if SOC_PART_NUMBER_SAMC20J17AU
	default "samc20j18a" if SOC_PART_NUMBER_SAMC20J18A
	default "samc20j18au" if SOC_PART_NUMBER_SAMC20J18AU
	default "samc20n17a" if SOC_PART_NUMBER_SAMC20N17A
	default "samc20n18a" if SOC_PART_NUMBER_SAMC20N18A

config NUM_IRQS
	default 32

config SYS_CLOCK_HW_CYCLES_PER_SEC
	default	$(dt_node_int_prop_int,/cpus/cpu@0,clock-frequency)

endif # SOC_SERIES_SAMC20
```

## soc/arm/atmel_sam0/samc20/Kconfig.series
```kconfig
# Atmel SAMC20 MCU series

# Copyright (c) 2022 Kamil Serwus
# SPDX-License-Identifier: Apache-2.0

config SOC_SERIES_SAMC20
	bool "Atmel SAMC20 MCU"
	select ARM
	select CPU_CORTEX_M0PLUS
	select SOC_FAMILY_SAM0
	select CPU_CORTEX_M_HAS_SYSTICK
	select CPU_CORTEX_M_HAS_VTOR
	select ASF
	help
	  Enable support for Atmel SAMC20 Cortex-M0+ microcontrollers.
```

## soc/arm/atmel_sam0/samc20/Kconfig.soc
```kconfig
# Atmel SAMC MCU series

# Copyright (c) 2022 Kamil Serwus
# SPDX-License-Identifier: Apache-2.0

choice
	prompt "Atmel SAMC20 MCU Selection"
	depends on SOC_SERIES_SAMC20

config SOC_PART_NUMBER_SAMC20E15A
	bool "SAMC20E15A"

config SOC_PART_NUMBER_SAMC20E16A
	bool "SAMC20E16A"

config SOC_PART_NUMBER_SAMC20E17A
	bool "SAMC20E17A"

config SOC_PART_NUMBER_SAMC20E18A
	bool "SAMC20E18A"

config SOC_PART_NUMBER_SAMC20G15A
	bool "SAMC20G15A"

config SOC_PART_NUMBER_SAMC20G16A
	bool "SAMC20G16A"

config SOC_PART_NUMBER_SAMC20G17A
	bool "SAMC20G17A"

config SOC_PART_NUMBER_SAMC20G18A
	bool "SAMC20G18A"

config SOC_PART_NUMBER_SAMC20J15A
	bool "SAMC20J15A"

config SOC_PART_NUMBER_SAMC20J16A
	bool "SAMC20J16A"

config SOC_PART_NUMBER_SAMC20J17A
	bool "SAMC20J17A"

config SOC_PART_NUMBER_SAMC20J17AU
	bool "SAMC20J17AU"

config SOC_PART_NUMBER_SAMC20J18A
	bool "SAMC20J18A"

config SOC_PART_NUMBER_SAMC20J18AU
	bool "SAMC20J18AU"

config SOC_PART_NUMBER_SAMC20N17A
	bool "SAMC20N17A"
	select SOC_SERIES_REVISION_N

config SOC_PART_NUMBER_SAMC20N18A
	bool "SAMC20N18A"
	select SOC_SERIES_REVISION_N

endchoice
```

## soc/arm/atmel_sam0/samc21/Kconfig.series
```kconfig
# Atmel SAMC21 MCU series

# Copyright (c) 2022 Kamil Serwus
# Copyright (c) 2023 Gerson Fernando Budke <nandojve@gmail.com>
# SPDX-License-Identifier: Apache-2.0

config SOC_SERIES_SAMC21
	bool "Atmel SAMC21 MCU"
	select ARM
	select CPU_CORTEX_M0PLUS
	select CPU_CORTEX_M_HAS_SYSTICK
	select CPU_CORTEX_M_HAS_VTOR
	select SOC_FAMILY_SAM0
	select PLATFORM_SPECIFIC_INIT
	select ASF
	help
	  Enable support for Atmel SAMC21 Cortex-M0+ microcontrollers.
```

## soc/arm/atmel_sam0/samc21/Kconfig.soc
```kconfig
# Atmel SAMC MCU series

# Copyright (c) 2022 Kamil Serwus
# SPDX-License-Identifier: Apache-2.0

choice
	prompt "Atmel SAMC21 MCU Selection"
	depends on SOC_SERIES_SAMC21

config SOC_PART_NUMBER_SAMC21E15A
	bool "SAMC21E15A"

config SOC_PART_NUMBER_SAMC21E16A
	bool "SAMC21E16A"

config SOC_PART_NUMBER_SAMC21E17A
	bool "SAMC21E17A"

config SOC_PART_NUMBER_SAMC21E18A
	bool "SAMC21E18A"

config SOC_PART_NUMBER_SAMC21G15A
	bool "SAMC21G15A"

config SOC_PART_NUMBER_SAMC21G16A
	bool "SAMC21G16A"

config SOC_PART_NUMBER_SAMC21G17A
	bool "SAMC21G17A"

config SOC_PART_NUMBER_SAMC21G18A
	bool "SAMC21G18A"

config SOC_PART_NUMBER_SAMC21J15A
	bool "SAMC21J15A"

config SOC_PART_NUMBER_SAMC21J16A
	bool "SAMC21J16A"

config SOC_PART_NUMBER_SAMC21J17A
	bool "SAMC21J17A"

config SOC_PART_NUMBER_SAMC21J17AU
	bool "SAMC21J17AU"

config SOC_PART_NUMBER_SAMC21J18A
	bool "SAMC21J18A"

config SOC_PART_NUMBER_SAMC21J18AU
	bool "SAMC21J18AU"

config SOC_PART_NUMBER_SAMC21N17A
	bool "SAMC21N17A"
	select SOC_SERIES_REVISION_N

config SOC_PART_NUMBER_SAMC21N18A
	bool "SAMC21N18A"
	select SOC_SERIES_REVISION_N

endchoice
```

## soc/arm/atmel_sam0/samd20/Kconfig.defconfig.series
```kconfig
# Kconfig - Atmel SAMD MCU series configuration options
#
# Copyright (c) 2018 Sean Nyekjaer
# SPDX-License-Identifier: Apache-2.0

if SOC_SERIES_SAMD20

config SOC_SERIES
	default "samd20"

config SOC_PART_NUMBER
	default "samd20e14" if SOC_PART_NUMBER_SAMD20E14
	default "samd20e15" if SOC_PART_NUMBER_SAMD20E15
	default "samd20e16" if SOC_PART_NUMBER_SAMD20E16
	default "samd20e17" if SOC_PART_NUMBER_SAMD20E17
	default "samd20e18" if SOC_PART_NUMBER_SAMD20E18
	default "samd20g14" if SOC_PART_NUMBER_SAMD20G14
	default "samd20g15" if SOC_PART_NUMBER_SAMD20G15
	default "samd20g16" if SOC_PART_NUMBER_SAMD20G16
	default "samd20g17" if SOC_PART_NUMBER_SAMD20G17
	default "samd20g17u" if SOC_PART_NUMBER_SAMD20G17U
	default "samd20g18" if SOC_PART_NUMBER_SAMD20G18
	default "samd20g18u" if SOC_PART_NUMBER_SAMD20G18U
	default "samd20j14" if SOC_PART_NUMBER_SAMD20J14
	default "samd20j15" if SOC_PART_NUMBER_SAMD20J15
	default "samd20j16" if SOC_PART_NUMBER_SAMD20J16
	default "samd20j17" if SOC_PART_NUMBER_SAMD20J17
	default "samd20j18" if SOC_PART_NUMBER_SAMD20J18

config NUM_IRQS
	default 25

config SYS_CLOCK_HW_CYCLES_PER_SEC
	default 48000000

endif # SOC_SERIES_SAMD20
```

## soc/arm/atmel_sam0/samd20/Kconfig.series
```kconfig
# Kconfig - Atmel SAMD20 MCU series
#
# Copyright (c) 2018 Sean Nyekjaer
# SPDX-License-Identifier: Apache-2.0

config SOC_SERIES_SAMD20
	bool "Atmel SAMD20 MCU"
	select SOC_FAMILY_SAMD2X
	help
	  Enable support for Atmel SAMD20 Cortex-M0+ microcontrollers.
```

## soc/arm/atmel_sam0/samd20/Kconfig.soc
```kconfig
# Atmel SAMD MCU series

# Copyright (c) 2018 Sean Nyekjaer
# SPDX-License-Identifier: Apache-2.0

choice
	prompt "Atmel SAMD20 MCU Selection"
	depends on SOC_SERIES_SAMD20

config SOC_PART_NUMBER_SAMD20E14
	bool "SAMD20E14"

config SOC_PART_NUMBER_SAMD20E15
	bool "SAMD20E15"

config SOC_PART_NUMBER_SAMD20E16
	bool "SAMD20E16"

config SOC_PART_NUMBER_SAMD20E17
	bool "SAMD20E17"

config SOC_PART_NUMBER_SAMD20E18
	bool "SAMD20E18"

config SOC_PART_NUMBER_SAMD20G14
	bool "SAMD20G14"

config SOC_PART_NUMBER_SAMD20G15
	bool "SAMD20G15"

config SOC_PART_NUMBER_SAMD20G16
	bool "SAMD20G16"

config SOC_PART_NUMBER_SAMD20G17
	bool "SAMD20G17"

config SOC_PART_NUMBER_SAMD20G17U
	bool "SAMD20G17U"

config SOC_PART_NUMBER_SAMD20G18
	bool "SAMD20G18"

config SOC_PART_NUMBER_SAMD20G18U
	bool "SAMD20G18U"

config SOC_PART_NUMBER_SAMD20J14
	bool "SAMD20J14"

config SOC_PART_NUMBER_SAMD20J15
	bool "SAMD20J15"

config SOC_PART_NUMBER_SAMD20J16
	bool "SAMD20J16"

config SOC_PART_NUMBER_SAMD20J17
	bool "SAMD20J17"

config SOC_PART_NUMBER_SAMD20J18
	bool "SAMD20J18"

endchoice
```

## soc/arm/atmel_sam0/samd21/Kconfig.defconfig.series
```kconfig
# Atmel SAMD MCU series configuration options

# Copyright (c) 2017 Google LLC.
# SPDX-License-Identifier: Apache-2.0

if SOC_SERIES_SAMD21

config SOC_SERIES
	default "samd21"

config SOC_PART_NUMBER
	default "samd21e15a" if SOC_PART_NUMBER_SAMD21E15A
	default "samd21e16a" if SOC_PART_NUMBER_SAMD21E16A
	default "samd21e17a" if SOC_PART_NUMBER_SAMD21E17A
	default "samd21e18a" if SOC_PART_NUMBER_SAMD21E18A
	default "samd21g15a" if SOC_PART_NUMBER_SAMD21G15A
	default "samd21g16a" if SOC_PART_NUMBER_SAMD21G16A
	default "samd21g17a" if SOC_PART_NUMBER_SAMD21G17A
	default "samd21g17au" if SOC_PART_NUMBER_SAMD21G17AU
	default "samd21g18a" if SOC_PART_NUMBER_SAMD21G18A
	default "samd21g18au" if SOC_PART_NUMBER_SAMD21G18AU
	default "samd21j15a" if SOC_PART_NUMBER_SAMD21J15A
	default "samd21j16a" if SOC_PART_NUMBER_SAMD21J16A
	default "samd21j17a" if SOC_PART_NUMBER_SAMD21J17A
	default "samd21j18a" if SOC_PART_NUMBER_SAMD21J18A

config NUM_IRQS
	default 28

config SYS_CLOCK_HW_CYCLES_PER_SEC
	default 48000000

endif # SOC_SERIES_SAMD21
```

## soc/arm/atmel_sam0/samd21/Kconfig.series
```kconfig
# Atmel SAMD21 MCU series

# Copyright (c) 2017 Google LLC.
# SPDX-License-Identifier: Apache-2.0

config SOC_SERIES_SAMD21
	bool "Atmel SAMD21 MCU"
	select ARM
	select CPU_CORTEX_M0PLUS
	select SOC_FAMILY_SAM0
	select CPU_CORTEX_M_HAS_SYSTICK
	select CPU_CORTEX_M_HAS_VTOR
	select ASF
	help
	  Enable support for Atmel SAMD21 Cortex-M0+ microcontrollers.
```

## soc/arm/atmel_sam0/samd21/Kconfig.soc
```kconfig
# Atmel SAMD MCU series

# Copyright (c) 2017 Google LLC.
# SPDX-License-Identifier: Apache-2.0

config SOC_PART_NUMBER_SAMD21E15A
	bool
	help
	  SAMD21E15A

config SOC_PART_NUMBER_SAMD21E16A
	bool
	help
	  SAMD21E16A

config SOC_PART_NUMBER_SAMD21E17A
	bool
	help
	  SAMD21E17A

config SOC_PART_NUMBER_SAMD21E18A
	bool
	help
	  SAMD21E18A

config SOC_PART_NUMBER_SAMD21G15A
	bool
	help
	  SAMD21G15A

config SOC_PART_NUMBER_SAMD21G16A
	bool
	help
	  SAMD21G16A

config SOC_PART_NUMBER_SAMD21G17A
	bool
	help
	  SAMD21G17A

config SOC_PART_NUMBER_SAMD21G17AU
	bool
	help
	  SAMD21G17AU

config SOC_PART_NUMBER_SAMD21G18A
	bool
	help
	  SAMD21G18A

config SOC_PART_NUMBER_SAMD21G18AU
	bool
	help
	  SAMD21G18AU

config SOC_PART_NUMBER_SAMD21J15A
	bool
	help
	  SAMD21J15A

config SOC_PART_NUMBER_SAMD21J16A
	bool
	help
	  SAMD21J16A

config SOC_PART_NUMBER_SAMD21J17A
	bool
	help
	  SAMD21J17A

config SOC_PART_NUMBER_SAMD21J18A
	bool
	help
	  SAMD21J18A
```
