## soc/arm/atmel_sam0/same54/Kconfig.soc
```kconfig
# Atmel SAME MCU series

# Copyright (c) 2019 ML!PA Consulting GmbH
# SPDX-License-Identifier: Apache-2.0

choice
	prompt "Atmel SAME54 MCU Selection"
	depends on SOC_SERIES_SAME54

config SOC_PART_NUMBER_SAME54N19A
	bool "SAME54N19A"

config SOC_PART_NUMBER_SAME54N20A
	bool "SAME54N20A"

config SOC_PART_NUMBER_SAME54P19A
	bool "SAME54P19A"

config SOC_PART_NUMBER_SAME54P20A
	bool "SAME54P20A"

endchoice
```

## soc/arm/atmel_sam0/saml21/Kconfig.defconfig.series
```kconfig
# Atmel SAML MCU series configuration options

# Copyright (c) 2021 Argentum Systems Ltd.
# SPDX-License-Identifier: Apache-2.0

if SOC_SERIES_SAML21

config SOC_SERIES
	default "saml21"

config SOC_PART_NUMBER
	default "saml21e15b" if SOC_PART_NUMBER_SAML21E15B
	default "saml21e16b" if SOC_PART_NUMBER_SAML21E16B
	default "saml21e17b" if SOC_PART_NUMBER_SAML21E17B
	default "saml21e18b" if SOC_PART_NUMBER_SAML21E18B
	default "saml21g16b" if SOC_PART_NUMBER_SAML21G16B
	default "saml21g17b" if SOC_PART_NUMBER_SAML21G17B
	default "saml21g18b" if SOC_PART_NUMBER_SAML21G18B
	default "saml21j16b" if SOC_PART_NUMBER_SAML21J16B
	default "saml21j17b" if SOC_PART_NUMBER_SAML21J17B
	default "saml21j17bu" if SOC_PART_NUMBER_SAML21J17BU
	default "saml21j18b" if SOC_PART_NUMBER_SAML21J18B
	default "saml21j18bu" if SOC_PART_NUMBER_SAML21J18BU

config NUM_IRQS
	default 29

config SYS_CLOCK_HW_CYCLES_PER_SEC
	default	$(dt_node_int_prop_int,/cpus/cpu@0,clock-frequency)

endif # SOC_SERIES_SAML21
```

## soc/arm/atmel_sam0/saml21/Kconfig.series
```kconfig
# Atmel SAML21 MCU series

# Copyright (c) 2021 Argentum Systems Ltd.
# SPDX-License-Identifier: Apache-2.0

config SOC_SERIES_SAML21
	bool "Atmel SAML21 MCU"
	select ARM
	select CPU_CORTEX_M0PLUS
	select SOC_FAMILY_SAM0
	select CPU_CORTEX_M_HAS_SYSTICK
	select CPU_CORTEX_M_HAS_VTOR
	select ASF
	help
	  Enable support for Atmel SAML21 Cortex-M0+ microcontrollers.
```

## soc/arm/atmel_sam0/saml21/Kconfig.soc
```kconfig
# Atmel SAML MCU series

# Copyright (c) 2021 Argentum Systems Ltd.
# SPDX-License-Identifier: Apache-2.0

config SOC_PART_NUMBER_SAML21E15B
	bool
	help
	  SAML21E15B

config SOC_PART_NUMBER_SAML21E16B
	bool
	help
	  SAML21E16B

config SOC_PART_NUMBER_SAML21E17B
	bool
	help
	  SAML21E17B

config SOC_PART_NUMBER_SAML21E18B
	bool
	help
	  SAML21E18B

config SOC_PART_NUMBER_SAML21G16B
	bool
	help
	  SAML21G16B

config SOC_PART_NUMBER_SAML21G17B
	bool
	help
	  SAML21G17B

config SOC_PART_NUMBER_SAML21G18B
	bool
	help
	  SAML21G18B

config SOC_PART_NUMBER_SAML21J16B
	bool
	help
	  SAML21J16B

config SOC_PART_NUMBER_SAML21J17B
	bool
	help
	  SAML21J17B

config SOC_PART_NUMBER_SAML21J17BU
	bool
	help
	  SAML21J17BU

config SOC_PART_NUMBER_SAML21J18B
	bool
	help
	  SAML21J18B

config SOC_PART_NUMBER_SAML21J18BU
	bool
	help
	  SAML21J18BU
```

## soc/arm/atmel_sam0/samr21/Kconfig.defconfig.series
```kconfig
# Atmel SAMR21 MCU series configuration options

# Copyright (c) 2019 Benjamin Valentin
# SPDX-License-Identifier: Apache-2.0

if SOC_SERIES_SAMR21

config SOC_SERIES
	default "samr21"

config SOC_PART_NUMBER
	default "samr21e16a" if SOC_PART_NUMBER_SAMR21E16A
	default "samr21e17a" if SOC_PART_NUMBER_SAMR21E17A
	default "samr21e18a" if SOC_PART_NUMBER_SAMR21E18A
	default "samr21e19a" if SOC_PART_NUMBER_SAMR21E19A
	default "samr21g16a" if SOC_PART_NUMBER_SAMR21G16A
	default "samr21g17a" if SOC_PART_NUMBER_SAMR21G17A
	default "samr21g18a" if SOC_PART_NUMBER_SAMR21G18A

config NUM_IRQS
	default 28

config SYS_CLOCK_HW_CYCLES_PER_SEC
	default 48000000

endif # SOC_SERIES_SAMR21
```

## soc/arm/atmel_sam0/samr21/Kconfig.series
```kconfig
# Kconfig - Atmel SAMR21 MCU series
#
# Copyright (c) 2017 Google LLC.
# SPDX-License-Identifier: Apache-2.0

config SOC_SERIES_SAMR21
	bool "Atmel SAMR21 MCU"
	select SOC_FAMILY_SAMD2X
	help
	  Enable support for Atmel SAMR21 Cortex-M0+ microcontrollers.
```

## soc/arm/atmel_sam0/samr21/Kconfig.soc
```kconfig
# Atmel SAMR21 MCU series

# Copyright (c) 2017 Google LLC.
# SPDX-License-Identifier: Apache-2.0

config SOC_PART_NUMBER_SAMR21E16A
	bool
	help
	  SAMR21E16A

config SOC_PART_NUMBER_SAMR21E17A
	bool
	help
	  SAMR21E17A

config SOC_PART_NUMBER_SAMR21E18A
	bool
	help
	  SAMR21E18A

config SOC_PART_NUMBER_SAMR21E19A
	bool
	help
	  SAMR21E19A

config SOC_PART_NUMBER_SAMR21G16A
	bool
	help
	  SAMR21G16A

config SOC_PART_NUMBER_SAMR21G17A
	bool
	help
	  SAMR21G17A

config SOC_PART_NUMBER_SAMR21G18A
	bool
	help
	  SAMR21G18A
```

## soc/arm/atmel_sam0/samr34/Kconfig.defconfig.series
```kconfig
# Atmel SAML MCU series configuration options

# Copyright (c) 2021 Argentum Systems Ltd.
# SPDX-License-Identifier: Apache-2.0

if SOC_SERIES_SAMR34

config SOC_SERIES
	default "samr34"

config SOC_PART_NUMBER
	default "samr34j16b" if SOC_PART_NUMBER_SAMR34J16B
	default "samr34j17b" if SOC_PART_NUMBER_SAMR34J17B
	default "samr34j18b" if SOC_PART_NUMBER_SAMR34J18B

config NUM_IRQS
	default 23

config SYS_CLOCK_HW_CYCLES_PER_SEC
	default	$(dt_node_int_prop_int,/cpus/cpu@0,clock-frequency)

endif # SOC_SERIES_SAMR34
```

## soc/arm/atmel_sam0/samr34/Kconfig.series
```kconfig
# Atmel SAMR34 MCU series

# Copyright (c) 2021 Argentum Systems Ltd.
# SPDX-License-Identifier: Apache-2.0

config SOC_SERIES_SAMR34
	bool "Atmel SAMR34 MCU"
	select ARM
	select CPU_CORTEX_M0PLUS
	select SOC_FAMILY_SAM0
	select CPU_CORTEX_M_HAS_SYSTICK
	select CPU_CORTEX_M_HAS_VTOR
	select ASF
	help
	  Enable support for Atmel SAMR34 Cortex-M0+ microcontrollers.
```

## soc/arm/atmel_sam0/samr34/Kconfig.soc
```kconfig
# Atmel SAMR MCU series

# Copyright (c) 2021 Argentum Systems Ltd.
# SPDX-License-Identifier: Apache-2.0

choice
	prompt "Atmel SAMR34 MCU Selection"
	depends on SOC_SERIES_SAMR34

config SOC_PART_NUMBER_SAMR34J16B
	bool "SAMR34J16B"

config SOC_PART_NUMBER_SAMR34J17B
	bool "SAMR34J17B"

config SOC_PART_NUMBER_SAMR34J18B
	bool "SAMR34J18B"

endchoice
```

## soc/arm/atmel_sam0/samr35/Kconfig.defconfig.series
```kconfig
# Atmel SAML MCU series configuration options

# Copyright (c) 2021 Argentum Systems Ltd.
# SPDX-License-Identifier: Apache-2.0

if SOC_SERIES_SAMR35

config SOC_SERIES
	default "samr35"

config SOC_PART_NUMBER
	default "samr35j16b" if SOC_PART_NUMBER_SAMR35J16B
	default "samr35j17b" if SOC_PART_NUMBER_SAMR35J17B
	default "samr35j18b" if SOC_PART_NUMBER_SAMR35J18B

config NUM_IRQS
	default 23

config SYS_CLOCK_HW_CYCLES_PER_SEC
	default	$(dt_node_int_prop_int,/cpus/cpu@0,clock-frequency)

endif # SOC_SERIES_SAMR35
```

## soc/arm/atmel_sam0/samr35/Kconfig.series
```kconfig
# Atmel SAMR35 MCU series

# Copyright (c) 2021 Argentum Systems Ltd.
# SPDX-License-Identifier: Apache-2.0

config SOC_SERIES_SAMR35
	bool
	select ARM
	select CPU_CORTEX_M0PLUS
	select SOC_FAMILY_SAM0
	select CPU_CORTEX_M_HAS_SYSTICK
	select CPU_CORTEX_M_HAS_VTOR
	select ASF
	help
	  Enable support for Atmel SAMR35 Cortex-M0+ microcontrollers.
```

## soc/arm/atmel_sam0/samr35/Kconfig.soc
```kconfig
# Atmel SAMR MCU series

# Copyright (c) 2021 Argentum Systems Ltd.
# SPDX-License-Identifier: Apache-2.0

config SOC_PART_NUMBER_SAMR35J16B
	bool
	help
	  SAMR35J16B

config SOC_PART_NUMBER_SAMR35J17B
	bool
	help
	  SAMR35J17B

config SOC_PART_NUMBER_SAMR35J18B
	bool
	help
	  SAMR35J18B
```

## soc/arm/atmosic/ATM33/Kconfig.defconfig.ATM33xx-5
```kconfig
# Copyright (c) 2021 Atmosic
#
# SPDX-License-Identifier: Apache-2.0

if SOC_ATM33xx_5

config SOC
	string
	default "ATM33xx-5"

endif # SOC_ATM33xx_5
```

## soc/arm/atmosic/ATM33/Kconfig.defconfig.series
```kconfig
# Copyright (c) 2021 Atmosic
#
# SPDX-License-Identifier: Apache-2.0

if SOC_SERIES_ATM33

gsource "soc/arm/atmosic/ATM33/Kconfig.defconfig.ATM33*"

config SOC_SERIES
	default "ATM33"

 config ROM_START_OFFSET
	default 0 if MERGE_SPE_NSPE && BOOTLOADER_MCUBOOT
	default 0x800 if BOOTLOADER_MCUBOOT

config SYS_CLOCK_HW_CYCLES_PER_SEC
	int
	default 16000000

config NUM_IRQS
	int
	default 448

config BUILD_OUTPUT_HEX
	default "y"

if PM

config PM_DEVICE
	default y

config IDLE_STACK_SIZE
	int
	default 1024

endif # PM


SLOT1_NODE_LABEL := $(dt_nodelabel_path,slot1_partition)
SLOT1_SIZE := $(dt_node_reg_size_int,$(SLOT1_NODE_LABEL),0)
SLOT1_PARENT := $(dt_node_parent,$(SLOT1_NODE_LABEL))
SLOT1_GPARENT := $(dt_node_parent,$(SLOT1_PARENT))
SLOT1_GPARENT_EB := $(dt_node_int_prop_int,$(SLOT1_GPARENT),erase-block-size)
MAX_SECTORS := $(shell, python3 -c "print(int($(SLOT1_SIZE)/$(SLOT1_GPARENT_EB))) if $(SLOT1_SIZE) else print(0)")

if MCUBOOT || BOOTLOADER_MCUBOOT

config BOOT_MAX_IMG_SECTORS
	int
	default $(MAX_SECTORS)

endif #  MCUBOOT || BOOTLOADER_MCUBOOT

if TRUSTED_EXECUTION_NONSECURE

config SPE_PATH
	string "Path to SPE build directory"

config ARM_FIRMWARE_USES_SECURE_ENTRY_FUNCS
	default y if SPE_PATH != ""

config MERGE_SPE_NSPE
	bool "Merge SPE and application into single image"
	depends on SPE_PATH != ""
	default y if BOOTLOADER_MCUBOOT
	default n
	help
	  Option to merge SPE and NSPE to a single image. This config must
	  be set if building with MCUboot as the merged image is signed.
	  However, it can also be set to allow a single `west flash` to flash
	  both the spe and nspe.

if BOOTLOADER_MCUBOOT

config MCUBOOT_EXTRA_IMGTOOL_ARGS
	# Need to override header-size for image tool to the SPE header allocation
	default "--header-size=0x800" if MERGE_SPE_NSPE

endif # BOOTLOADER_MCUBOOT

endif # TRUSTED_EXECUTION_NONSECURE

endif # SOC_SERIES_ATM33
```

## soc/arm/atmosic/ATM33/Kconfig.series
```kconfig
# Copyright (c) 2021 Atmosic
#
# SPDX-License-Identifier: Apache-2.0

config SOC_SERIES_ATM33
	bool "Atmosic Technologies ATM33 series"
	select ARM
	select CPU_CORTEX_M33
	select CPU_HAS_ARM_SAU
	select CPU_HAS_ARM_MPU
	select CPU_HAS_FPU
	select FPU
	select ARMV8_M_DSP
	select CPU_HAS_TEE
	select SOC_FAMILY_ATM
	select HAS_PM
	help
	  Enable support for ATM33 series
```

## soc/arm/atmosic/ATM33/Kconfig.soc
```kconfig
# Copyright (c) 2021 Atmosic
#
# SPDX-License-Identifier: Apache-2.0

choice
prompt "ATM33 selection"
depends on SOC_SERIES_ATM33

config SOC_ATM33xx_5
	bool "ATM33xx-5"

endchoice
```

## soc/arm/atmosic/ATM34/Kconfig.defconfig.ATM34xx
```kconfig
# Copyright (c) 2021-2023 Atmosic
#
# SPDX-License-Identifier: Apache-2.0

if SOC_SERIES_ATM34

config SOC
	string
	default "ATM34xx"

endif # SOC_SERIES_ATM34
```

## soc/arm/atmosic/ATM34/Kconfig.defconfig.series
```kconfig
# Copyright (c) 2021-2023 Atmosic
#
# SPDX-License-Identifier: Apache-2.0

if SOC_SERIES_ATM34

gsource "soc/arm/atmosic/ATM34/Kconfig.defconfig.ATM34*"

config SOC_SERIES
	default "ATM34"

 config ROM_START_OFFSET
	default 0 if MERGE_SPE_NSPE && BOOTLOADER_MCUBOOT
	default 0x800 if BOOTLOADER_MCUBOOT

config SYS_CLOCK_HW_CYCLES_PER_SEC
	int
	default 16000000 if CORTEX_M_SYSTICK_EXTERNAL_REF
	default 32000000

config NUM_IRQS
	int
	default 448

config BUILD_OUTPUT_HEX
	default "y"

if PM

config IDLE_STACK_SIZE
	int
	default 1024

endif # PM

if TRUSTED_EXECUTION_NONSECURE

config SPE_PATH
	string "Path to SPE build directory"

config ARM_FIRMWARE_USES_SECURE_ENTRY_FUNCS
	default y if SPE_PATH != ""

config MERGE_SPE_NSPE
	bool "Merge SPE and application into single image"
	depends on SPE_PATH != ""
	default y if BOOTLOADER_MCUBOOT
	default n
	help
	  Option to merge SPE and NSPE to a single image. This config must
	  be set if building with MCUboot as the merged image is signed.
	  However, it can also be set to allow a single `west flash` to flash
	  both the spe and nspe.

config ATM_SPLIT_IMG
	depends on FLASH
	bool "Image split across multiple memory regions"

config MCUBOOT_EXTRA_IMGTOOL_ARGS
	# Need to override header-size for image tool to the SPE header allocation
	default "--header-size=0x800" if MERGE_SPE_NSPE

endif # TRUSTED_EXECUTION_NONSECURE

endif # SOC_SERIES_ATM34
```

## soc/arm/atmosic/ATM34/Kconfig.soc
```kconfig
# Copyright (c) 2021-2023 Atmosic
#
# SPDX-License-Identifier: Apache-2.0

choice
prompt "ATM34 selection"
depends on SOC_SERIES_ATM34

config SOC_ATM34xx_2
	bool "ATM34xx-2"

config SOC_ATM34xx_5
	bool "ATM34xx-5"

endchoice
```

## soc/arm/atmosic/ATMx2/Kconfig.defconfig.ATMx2xx-x1x
```kconfig
if SOC_ATMx2xx_x1x

config SOC
	string
	default "ATMx2xx-x1x"

endif # SOC_ATMx2xx_x1x
```

## soc/arm/atmosic/ATMx2/Kconfig.defconfig.series
```kconfig
if SOC_SERIES_ATMx2

gsource "soc/arm/atmosic/ATMx2/Kconfig.defconfig.ATMx2*"

config SOC_SERIES
	default "ATMx2"

config ATMx2_ROM
	bool
	default y

config SYS_CLOCK_HW_CYCLES_PER_SEC
	int
	default 16000000

config NUM_IRQS
	int
	default 32

if PM

config IDLE_STACK_SIZE
	int
	default 1024

endif # PM

endif # SOC_SERIES_ATMx2
```

## soc/arm/atmosic/ATMx2/Kconfig.series
```kconfig
config SOC_SERIES_ATMx2
	bool "Atmosic Technologies ATMx2 series"
	select ARM
	select CPU_CORTEX_M0
	select CPU_CORTEX_M_HAS_SYSTICK
	select SOC_FAMILY_ATM
	select HAS_PM
	help
	  Enable support for ATMx2 series
```

## soc/arm/atmosic/ATMx2/Kconfig.soc
```kconfig
choice
prompt "ATMx2 selection"
depends on SOC_SERIES_ATMx2

config SOC_ATMx2xx_x1x
	bool "ATMx2xx-x1x"

endchoice
```

## soc/arm/atmosic/Kconfig
```kconfig
# Copyright (c) 2024 Atmosic
#
# SPDX-License-Identifier: Apache-2.0

config SOC_FAMILY_ATM
	bool
	select HAS_SEGGER_RTT if ZEPHYR_SEGGER_MODULE
	# omit prompt to signify a "hidden" option

if SOC_FAMILY_ATM
config SOC_FAMILY
	string
	default "atmosic"

config AUTO_TEST
	bool "Enable auto test"
	default n

source "soc/arm/atmosic/Kconfig.peripherals"
gsource "soc/arm/atmosic/*/Kconfig.soc"

endif # SOC_FAMILY_ATM
```
