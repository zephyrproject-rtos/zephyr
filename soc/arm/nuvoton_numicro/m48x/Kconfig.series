## soc/arm/nuvoton_numicro/m48x/Kconfig.series
```kconfig
# SPDX-License-Identifier: Apache-2.0
#
# Copyright (c) 2020 Linumiz
# Author: Saravanan Sekar <saravanan@linumiz.com>

config SOC_SERIES_M48X
	bool "Nuvoton M48X Series MCU"
	select ARM
	select CPU_CORTEX_M4
	select CPU_CORTEX_M_HAS_DWT
	select CPU_HAS_FPU
	select CPU_HAS_ARM_MPU
	select CORTEX_M_SYSTICK
	select SOC_FAMILY_NUMICRO
	help
	  Enable support for NUVOTON M48X MCU series
```

## soc/arm/nuvoton_numicro/m48x/Kconfig.soc
```kconfig
# SPDX-License-Identifier: Apache-2.0
#
# Copyright (c) 2020 Linumiz
# Author: Saravanan Sekar <saravanan@linumiz.com>

config SOC_M487
	bool
	select HAS_NUMICRO_HAL
	help
	  M487
```

## soc/arm/nxp_imx/Kconfig
```kconfig
# Copyright (c) 2017-2021, NXP
# SPDX-License-Identifier: Apache-2.0

config SOC_FAMILY_IMX
	bool
	select HAS_SEGGER_RTT

if SOC_FAMILY_IMX

config SOC_FAMILY
	string
	default "nxp_imx"


# Used for default value in FLASH_MCUX_FLEXSPI_XIP
DT_CHOSEN_Z_FLASH := zephyr,flash
DT_COMPAT_FLEXSPI := nxp,imx-flexspi
# Macros to shorten Kconfig definitions
DT_CHOSEN_FLASH_NODE := $(dt_chosen_path,$(DT_CHOSEN_Z_FLASH))
DT_CHOSEN_FLASH_PARENT := $(dt_node_parent,$(DT_CHOSEN_FLASH_NODE))


source "soc/arm/nxp_imx/*/Kconfig.soc"

config SOC_PART_NUMBER
	default SOC_PART_NUMBER_IMX_RT5XX if SOC_SERIES_IMX_RT5XX
	default SOC_PART_NUMBER_IMX_RT6XX if SOC_SERIES_IMX_RT6XX
	default SOC_PART_NUMBER_IMX_RT if SOC_SERIES_IMX_RT
	default SOC_PART_NUMBER_IMX_6X_M4 if SOC_SERIES_IMX_6X_M4
	default SOC_PART_NUMBER_IMX7_M4 if SOC_SERIES_IMX7_M4
	default SOC_PART_NUMBER_IMX8MM_M4 if SOC_SERIES_IMX8MM_M4
	default SOC_PART_NUMBER_IMX8ML_M7 if SOC_SERIES_IMX8ML_M7
	default SOC_PART_NUMBER_IMX8MQ_M4 if SOC_SERIES_IMX8MQ_M4

config FLASH_MCUX_FLEXSPI_XIP
	bool "MCUX FlexSPI flash access with xip"
	default $(dt_node_has_compat,$(DT_CHOSEN_FLASH_PARENT),$(DT_COMPAT_FLEXSPI))
	depends on (CODE_FLEXSPI || CODE_FLEXSPI2 || SOC_SERIES_IMX_RT6XX || SOC_SERIES_IMX_RT5XX)
	select XIP
	help
	  Allows for the soc to safely initialize the clocks for the
	  FlexSpi when planning to execute code in FlexSpi Memory.


endif # SOC_FAMILY_IMX
```

## soc/arm/nxp_imx/Kconfig.defconfig
```kconfig
# Copyright (c) 2017, NXP
# blah
# SPDX-License-Identifier: Apache-2.0

config SERIAL_INIT_PRIORITY
	default 55
	depends on SERIAL

source "soc/arm/nxp_imx/*/Kconfig.defconfig.series"
```

## soc/arm/nxp_imx/Kconfig.soc
```kconfig
# Copyright (c) 2017, NXP
# blah
# SPDX-License-Identifier: Apache-2.0

source "soc/arm/nxp_imx/*/Kconfig.series"
```

## soc/arm/nxp_imx/mcimx6x_m4/Kconfig.defconfig.mcimx6x_m4
```kconfig
# i.MX 6SoloX

# Copyright (c) 2018, NXP
# SPDX-License-Identifier: Apache-2.0

if SOC_MCIMX6X_M4

config SOC
	default "mcimx6x"

config FPU
	default y

config GPIO_IMX
	default y
	depends on GPIO

config UART_IMX
	default y
	depends on SERIAL

config I2C_IMX
	default y
	depends on I2C

config IPM_IMX
	default y
	depends on IPM

config COUNTER_IMX_EPIT
	default y
	depends on COUNTER

endif # SOC_MCIMX6X_M4
```

## soc/arm/nxp_imx/mcimx6x_m4/Kconfig.defconfig.series
```kconfig
# Kconfig - i.MX 6SoloX M4 core series
#
# Copyright (c) 2018, NXP
#
# SPDX-License-Identifier: Apache-2.0
#

if SOC_SERIES_IMX_6X_M4

config SOC_SERIES
	default "mcimx6x_m4"

config NUM_IRQS
	int
	# must be >= the highest interrupt number used
	default 128

source "soc/arm/nxp_imx/mcimx6x_m4/Kconfig.defconfig.mcimx6x_m4"

endif # SOC_SERIES_IMX_6X_M4
```

## soc/arm/nxp_imx/mcimx6x_m4/Kconfig.series
```kconfig
# Kconfig - i.MX 6SoloX M4 core series
#
# Copyright (c) 2018, NXP
#
# SPDX-License-Identifier: Apache-2.0
#

config SOC_SERIES_IMX_6X_M4
	bool "i.MX 6SoloX M4 Core Series"
	select CPU_CORTEX_M4
	select HAS_IMX_HAL
	select SOC_FAMILY_IMX
	select CPU_HAS_FPU
	select CLOCK_CONTROL
	help
	  Enable support for M4 core of i.MX 6SoloX MCU series
```

## soc/arm/nxp_imx/mcimx6x_m4/Kconfig.soc
```kconfig
# i.MX 6SoloX M4 core series

# Copyright (c) 2018, NXP
# SPDX-License-Identifier: Apache-2.0

choice
	prompt "i.MX 6SoloX Selection"
	depends on SOC_SERIES_IMX_6X_M4

config SOC_MCIMX6X_M4
	bool "SOC_MCIMX6X_M4"
	select HAS_IMX_HAL
	select HAS_IMX_GPIO
	select HAS_IMX_EPIT
	select HAS_IMX_I2C
	select HAS_IMX_IOMUXC

endchoice

if SOC_SERIES_IMX_6X_M4

config SOC_PART_NUMBER_MCIMX6X1EVK10AB
	bool

config SOC_PART_NUMBER_MCIMX6X1EVK10AC
	bool

config SOC_PART_NUMBER_MCIMX6X3EVK10AB
	bool

config SOC_PART_NUMBER_MCIMX6X3EVK10AC
	bool

config SOC_PART_NUMBER_MCIMX6X1EVO10AB
	bool

config SOC_PART_NUMBER_MCIMX6X1EVO10AC
	bool

config SOC_PART_NUMBER_MCIMX6X3EVO10AB
	bool

config SOC_PART_NUMBER_MCIMX6X3EVO10AC
	bool

config SOC_PART_NUMBER_MCIMX6X2EVN10AB
	bool

config SOC_PART_NUMBER_MCIMX6X2EVN10AC
	bool

config SOC_PART_NUMBER_MCIMX6X3EVN10AB
	bool

config SOC_PART_NUMBER_MCIMX6X3EVN10AC
	bool

config SOC_PART_NUMBER_MCIMX6X4EVM10AB
	bool

config SOC_PART_NUMBER_MCIMX6X4EVM10AC
	bool

config SOC_PART_NUMBER_IMX_6X_M4
	string
	default "MCIMX6X1EVK10AB" if SOC_PART_NUMBER_MCIMX6X1EVK10AB
	default "MCIMX6X1EVK10AC" if SOC_PART_NUMBER_MCIMX6X1EVK10AC
	default "MCIMX6X3EVK10AB" if SOC_PART_NUMBER_MCIMX6X3EVK10AB
	default "MCIMX6X3EVK10AC" if SOC_PART_NUMBER_MCIMX6X3EVK10AC
	default "MCIMX6X1EVO10AB" if SOC_PART_NUMBER_MCIMX6X1EVO10AB
	default "MCIMX6X1EVO10AC" if SOC_PART_NUMBER_MCIMX6X1EVO10AC
	default "MCIMX6X3EVO10AB" if SOC_PART_NUMBER_MCIMX6X3EVO10AB
	default "MCIMX6X3EVO10AC" if SOC_PART_NUMBER_MCIMX6X3EVO10AC
	default "MCIMX6X2EVN10AB" if SOC_PART_NUMBER_MCIMX6X2EVN10AB
	default "MCIMX6X2EVN10AC" if SOC_PART_NUMBER_MCIMX6X2EVN10AC
	default "MCIMX6X3EVN10AB" if SOC_PART_NUMBER_MCIMX6X3EVN10AB
	default "MCIMX6X3EVN10AC" if SOC_PART_NUMBER_MCIMX6X3EVN10AC
	default "MCIMX6X4EVM10AB" if SOC_PART_NUMBER_MCIMX6X4EVM10AB
	default "MCIMX6X4EVM10AC" if SOC_PART_NUMBER_MCIMX6X4EVM10AC
	help
	  This string holds the full part number of the SoC. It is a hidden option
	  that you should not set directly. The part number selection choice defines
	  the default value for this string.

endif # SOC_SERIES_IMX_6X_M4
```

## soc/arm/nxp_imx/mcimx7_m4/Kconfig.defconfig.mcimx7_m4
```kconfig
# iMX7 M4 core series

# Copyright (c) 2017, NXP
# SPDX-License-Identifier: Apache-2.0

if SOC_MCIMX7_M4

config SOC
	default "mcimx7d"

config SYS_CLOCK_HW_CYCLES_PER_SEC
	default 200000000

config GPIO
	default y

config I2C_IMX
	default y
	depends on I2C

config IPM_IMX
	default y
	depends on IPM

endif # SOC_MCIMX7_M4
```

## soc/arm/nxp_imx/mcimx7_m4/Kconfig.defconfig.series
```kconfig
# Kconfig - iMX7 M4 core series
#
# Copyright (c) 2017, NXP
#
# SPDX-License-Identifier: Apache-2.0
#

if SOC_SERIES_IMX7_M4

config SOC_SERIES
	default "mcimx7_m4"

config NUM_IRQS
	# must be >= the highest interrupt number used
	default 127

source "soc/arm/nxp_imx/mcimx7_m4/Kconfig.defconfig.mcimx7_m4"

endif # SOC_SERIES_IMX7_M4
```

## soc/arm/nxp_imx/mcimx7_m4/Kconfig.series
```kconfig
# iMX7 M4 core series

# Copyright (c) 2017, NXP
# SPDX-License-Identifier: Apache-2.0

config SOC_SERIES_IMX7_M4
	bool "i.MX7 M4 Core Series"
	select ARM
	select CPU_CORTEX_M4
	select CPU_CORTEX_M_HAS_DWT
	select SOC_FAMILY_IMX
	select CLOCK_CONTROL
	select CPU_HAS_FPU
	help
	  Enable support for i.MX7 M4 MCU series
```

## soc/arm/nxp_imx/mcimx7_m4/Kconfig.soc
```kconfig
# Kconfig - iMX7 M4 core series
#
# Copyright (c) 2017, NXP
#
# SPDX-License-Identifier: Apache-2.0
#

choice
prompt "i.MX7 M4 Selection"
depends on SOC_SERIES_IMX7_M4

config SOC_MCIMX7_M4
	bool "SOC_MCIMX7_M4"
	select HAS_IMX_HAL
	select HAS_IMX_GPIO
	select HAS_IMX_I2C

endchoice

if SOC_MCIMX7_M4

config SOC_PART_NUMBER_MCIMX7D5EVM10SC
	bool

config SOC_PART_NUMBER_MCIMX7S3DVK08SA
	bool

config SOC_PART_NUMBER_IMX7_M4
	string
	default "MCIMX7D5EVM10SC" if SOC_PART_NUMBER_MCIMX7D5EVM10SC
	default "MCIMX7S3DVK08SA" if SOC_PART_NUMBER_MCIMX7S3DVK08SA
	help
	  This string holds the full part number of the SoC. It is a hidden option
	  that you should not set directly. The part number selection choice defines
	  the default value for this string.

endif # SOC_SERIES_IMX7_M4
```

## soc/arm/nxp_imx/mimx8ml8_m7/Kconfig.defconfig.mimx8ml8_m7
```kconfig
# MIMX8ML8 SoC defconfig

# Copyright (c) 2021, Laird Connectivity
# SPDX-License-Identifier: Apache-2.0

if SOC_MIMX8ML8

config SOC
	string
	default "mimx8ml8"

config SYS_CLOCK_HW_CYCLES_PER_SEC
	int
	default 800000000

if PINMUX

config PINMUX_MCUX
	default y

endif # PINMUX

config GPIO
	default y

config IPM_IMX_REV2
	default y
	depends on IPM

if CODE_ITCM

config FLASH_SIZE
	default $(dt_node_reg_size_int,/soc/itcm@0,0,K)

config FLASH_BASE_ADDRESS
	default $(dt_node_reg_addr_hex,/soc/itcm@0)

endif # CODE_ITCM

if CODE_DDR

config FLASH_SIZE
	default $(dt_node_reg_size_int,/soc/code@80000000,0,K)

config FLASH_BASE_ADDRESS
	default $(dt_node_reg_addr_hex,/soc/code@80000000)

endif # CODE_DDR

endif # SOC_MIMX8ML8
```

## soc/arm/nxp_imx/mimx8ml8_m7/Kconfig.defconfig.series
```kconfig
# i.MX8ML M7 SoC series defconfig

# Copyright (c) 2021, Laird Connectivity
# SPDX-License-Identifier: Apache-2.0

if SOC_SERIES_IMX8ML_M7

config SOC_SERIES
	default "mimx8ml8_m7"

config NUM_IRQS
	int
	# must be >= the highest interrupt number used
	default 159

config PINCTRL_IMX
	default y if HAS_MCUX_IOMUXC
	depends on PINCTRL

source "soc/arm/nxp_imx/mimx8ml8_m7/Kconfig.defconfig.mimx8ml8_m7"

endif # SOC_SERIES_IMX8ML_M7
```

## soc/arm/nxp_imx/mimx8ml8_m7/Kconfig.series
```kconfig
# i.MX8ML M7 core series

# Copyright (c) 2021, Laird Connectivity
# SPDX-License-Identifier: Apache-2.0

config SOC_SERIES_IMX8ML_M7
	bool "i.MX8ML M7 Core Series"
	select ARM
	select CPU_CORTEX_M7
	select SOC_FAMILY_IMX
	select CPU_HAS_FPU
	select INIT_VIDEO_PLL
	help
	  Enable support for i.MX8ML M7 MCU series
```

## soc/arm/nxp_imx/mimx8ml8_m7/Kconfig.soc
```kconfig
# i.MX8ML M7 SoC series

# Copyright (c) 2021, Laird Connectivity
# SPDX-License-Identifier: Apache-2.0

choice
prompt "i.MX8ML M7 Selection"
depends on SOC_SERIES_IMX8ML_M7

config SOC_MIMX8ML8
	bool "SOC_MIMX8ML8"
	select HAS_MCUX
	select HAS_MCUX_CCM
	select HAS_MCUX_RDC
	select CPU_HAS_ARM_MPU
	select CPU_HAS_CUSTOM_FIXED_SOC_MPU_REGIONS
	select ARM_MPU
	select HAS_MCUX_IGPIO
	select HAS_MCUX_IOMUXC

endchoice

if SOC_SERIES_IMX8ML_M7

config SOC_PART_NUMBER_MIMX8ML8DVNLZ
	bool

config SOC_PART_NUMBER_IMX8ML_M7
	string
	default "MIMX8ML8DVNLZ" if SOC_PART_NUMBER_MIMX8ML8DVNLZ
	help
	  This string holds the full part number of the SoC. It is a hidden option
	  that you should not set directly. The part number selection choice defines
	  the default value for this string.

choice CODE_LOCATION
	prompt "Code location selection"

config CODE_ITCM
	bool "Link code into internal instruction tightly coupled memory (ITCM)"

config CODE_DDR
	bool "Link code into DDR memory"

endchoice

config INIT_VIDEO_PLL
	bool "Initialize Video PLL"

endif # SOC_SERIES_IMX8ML_M7
```

## soc/arm/nxp_imx/mimx8mm6_m4/Kconfig.defconfig.mimx8mm6_m4
```kconfig
# MIMX8MM6 SoC defconfig

# Copyright (c) 2020, Manivannan Sadhasivam <mani@kernel.org>
# SPDX-License-Identifier: Apache-2.0

if SOC_MIMX8MM6

config SOC
	string
	default "mimx8mm6"

config SYS_CLOCK_HW_CYCLES_PER_SEC
	int
	default 400000000

if PINMUX

config PINMUX_MCUX
	default y

endif # PINMUX

config IPM_IMX_REV2
	default y
	depends on IPM

endif # SOC_MIMX8MM6
```

## soc/arm/nxp_imx/mimx8mm6_m4/Kconfig.defconfig.series
```kconfig
# i.MX8MM M4 SoC series defconfig

# Copyright (c) 2020, Manivannan Sadhasivam <mani@kernel.org>
# SPDX-License-Identifier: Apache-2.0

if SOC_SERIES_IMX8MM_M4

config SOC_SERIES
	default "mimx8mm6_m4"

config NUM_IRQS
	int
	# must be >= the highest interrupt number used
	default 127

config PINCTRL_IMX
	default y if HAS_MCUX_IOMUXC
	depends on PINCTRL

source "soc/arm/nxp_imx/mimx8mm6_m4/Kconfig.defconfig.mimx8mm6_m4"

endif # SOC_SERIES_IMX8MM_M4
```

## soc/arm/nxp_imx/mimx8mm6_m4/Kconfig.series
```kconfig
# i.MX8MM M4 core series

# Copyright (c) 2020, Manivannan Sadhasivam <mani@kernel.org>
# SPDX-License-Identifier: Apache-2.0

config SOC_SERIES_IMX8MM_M4
	bool "i.MX8MM M4 Core Series"
	select ARM
	select CPU_CORTEX_M4
	select SOC_FAMILY_IMX
	select CPU_HAS_FPU
	help
	  Enable support for i.MX8MM M4 MCU series
```

## soc/arm/nxp_imx/mimx8mm6_m4/Kconfig.soc
```kconfig
# i.MX8MM M4 SoC series

# Copyright (c) 2020, Manivannan Sadhasivam <mani@kernel.org>
# SPDX-License-Identifier: Apache-2.0

choice
prompt "i.MX8MM M4 Selection"
depends on SOC_SERIES_IMX8MM_M4

config SOC_MIMX8MM6
	bool "SOC_MIMX8MM6"
	select HAS_MCUX
	select HAS_MCUX_CCM
	select HAS_MCUX_RDC
	select HAS_MCUX_IGPIO
	select HAS_MCUX_IOMUXC

endchoice

if SOC_SERIES_IMX8MM_M4

config SOC_PART_NUMBER_MIMX8MM6DVTLZ
	bool

config SOC_PART_NUMBER_IMX8MM_M4
	string
	default "MIMX8MM6DVTLZ" if SOC_PART_NUMBER_MIMX8MM6DVTLZ
	help
	  This string holds the full part number of the SoC. It is a hidden option
	  that you should not set directly. The part number selection choice defines
	  the default value for this string.

endif # SOC_SERIES_IMX8MM_M4
```

## soc/arm/nxp_imx/mimx8mn6_m7/Kconfig.defconfig.mimx8mn6_m7
```kconfig
# MIMX8MN6 SoC defconfig

# Copyright (c) 2021, Waseem Hassan
# SPDX-License-Identifier: Apache-2.0

if SOC_MIMX8MN6

config SOC
	string
	default "mimx8mn6"

config SYS_CLOCK_HW_CYCLES_PER_SEC
	int
	default 24000000

if CLOCK_CONTROL

config CLOCK_CONTROL_MCUX_CCM
	default y if HAS_MCUX_CCM

endif # CLOCK_CONTROL

if PINMUX

config PINMUX_MCUX
	default y

endif # PINMUX

if SERIAL

config UART_MCUX_IUART
	default y

endif # SERIAL

if GPIO

config GPIO_MCUX_IGPIO
	default y if HAS_MCUX_IGPIO

endif # GPIO

if COUNTER

config COUNTER_MCUX_GPT
	default n

endif # COUNTER

endif # SOC_MIMX8MN6
```

## soc/arm/nxp_imx/mimx8mn6_m7/Kconfig.defconfig.series
```kconfig
# i.MX8MN M7 SoC series defconfig

# Copyright (c) 2021, Waseem Hassan
# SPDX-License-Identifier: Apache-2.0

if SOC_SERIES_IMX8MN_M7

config SOC_SERIES
	default "mimx8mn6_m7"

config NUM_IRQS
	int
	# must be >= the highest interrupt number used
	default 127

source "soc/arm/nxp_imx/mimx8mn6_m7/Kconfig.defconfig.mimx8mn6_m7"

endif # SOC_SERIES_IMX8MN_M7
```

## soc/arm/nxp_imx/mimx8mn6_m7/Kconfig.series
```kconfig
# i.MX8MN M7 core series

# Copyright (c) 2021, Waseem Hassan
# SPDX-License-Identifier: Apache-2.0

config SOC_SERIES_IMX8MN_M7
	bool "i.MX8MN M7 Core Series"
	select ARM
	select CPU_CORTEX_M7
	select SOC_FAMILY_IMX
	select CPU_HAS_FPU
	help
	  Enable support for i.MX8MN M7 MCU series
```

## soc/arm/nxp_imx/mimx8mn6_m7/Kconfig.soc
```kconfig
# i.MX8MN M7 SoC series

# Copyright (c) 2021, Waseem Hassan
# SPDX-License-Identifier: Apache-2.0

choice
	prompt "i.MX8MN M7 Selection"
	depends on SOC_SERIES_IMX8MN_M7

config SOC_MIMX8MN6
	bool "SOC_MIMX8MN6"
	select HAS_MCUX
	select HAS_MCUX_CCM
	select HAS_MCUX_RDC
	select HAS_MCUX_IGPIO
	select HAS_MCUX_GPT

endchoice

if SOC_SERIES_IMX8MN_M7

config SOC_PART_NUMBER_MIMX8MN6DVTJZ
	bool

config SOC_PART_NUMBER_IMX8MN_M7
	string
	default "MIMX8MN6DVTJZ" if SOC_PART_NUMBER_MIMX8MN6DVTJZ
	help
	  This string holds the full part number of the SoC. It is a hidden option
	  that you should not set directly. The part number selection choice defines
	  the default value for this string.

config IMX8MNANO_PM
	bool "MIMX8MN Power Management"	  
	help
 	 Enable IMX8MNANO dedicated low power INT based operation. Kernel is stopped for this option. 
 	 Inherited from MCUXpresso SDK. An INT is needed to configure and initialize the low power mode.
 	 Wakeup call needs to be implemented inside the used ISR.

endif # SOC_SERIES_IMX8MN_M7
```
