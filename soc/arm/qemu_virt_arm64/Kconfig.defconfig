## soc/arm/qemu_virt_arm64/Kconfig.defconfig
```kconfig
# Copyright (c) 2022 Huawei France Technologies SAS
# SPDX-License-Identifier: Apache-2.0

if SOC_QEMU_VIRT_ARM64

config NUM_IRQS
	# must be >= the highest interrupt number used
	# - include the UART interrupts
	# - LPIs (starting at 8192) if GIC_V3_ITS is used
	default 16384 if GIC_V3_ITS
	default 220 if !GIC_V3_ITS

# Dummy value, read at runtime
config SYS_CLOCK_HW_CYCLES_PER_SEC
	default 1

endif # SOC_QEMU_VIRT_ARM64
```

## soc/arm/qemu_virt_arm64/Kconfig.soc
```kconfig
# Copyright (c) 2022 Huawei France Technologies SAS
# SPDX-License-Identifier: Apache-2.0

config SOC_QEMU_VIRT_ARM64
	bool
	select SOC_FAMILY_ARM64

config SOC
	default "qemu_virt_arm64" if SOC_QEMU_VIRT_ARM64
```

## soc/arm/quicklogic_eos_s3/Kconfig
```kconfig
# Copyright (c) 2020 Antmicro <www.antmicro.com>
# SPDX-License-Identifier: Apache-2.0

config SOC_EOS_S3
	bool
```

## soc/arm/quicklogic_eos_s3/Kconfig.defconfig
```kconfig
# Copyright (c) 2020 Antmicro <www.antmicro.com>
# SPDX-License-Identifier: Apache-2.0

if SOC_EOS_S3

config SOC
	default "quicklogic_eos_s3"

config NUM_IRQS
	default 52

config SYS_CLOCK_HW_CYCLES_PER_SEC
	default 61440000

if SERIAL

config UART_PL011
	default y

config UART_INTERRUPT_DRIVEN
	default y

endif # SERIAL

if GPIO

config GPIO_EOS_S3
	default y

endif # GPIO

endif # SOC_EOS_S3
```

## soc/arm/raspberrypi/Kconfig
```kconfig
# Raspberry Pi (RP) MCU line

# Copyright (c) 2021 Nordic Semiconductor ASA
# Copyright (c) 2021 Yonatan Schachter
# SPDX-License-Identifier: Apache-2.0

config SOC_FAMILY_RASPBERRY_PI
	bool

if SOC_FAMILY_RASPBERRY_PI
config SOC_FAMILY
	string
	default "raspberrypi"

source "soc/arm/raspberrypi/*/Kconfig.soc"

endif # SOC_FAMILY_RASPBERRY_PI
```

## soc/arm/raspberrypi/Kconfig.defconfig
```kconfig
# Raspberry Pi (RP) MCU line

# Copyright (c) 2021 Nordic Semiconductor ASA
# SPDX-License-Identifier: Apache-2.0

if SOC_FAMILY_RASPBERRY_PI

source "soc/arm/raspberrypi/*/Kconfig.defconfig.series"

endif # SOC_FAMILY_RASPBERRY_PI
```

## soc/arm/raspberrypi/rp2/Kconfig.defconfig.rp2040
```kconfig
# # Raspberry Pi RP2040 MCU

# Copyright (c) 2021 Nordic Semiconductor ASA
# SPDX-License-Identifier: Apache-2.0

config SOC
	default "rp2040"
	depends on SOC_RP2040
```

## soc/arm/raspberrypi/rp2/Kconfig.defconfig.series
```kconfig
# Raspberry Pi RP20XX MCU line

# Copyright (c) 2021 Nordic Semiconductor ASA
# Copyright (c) 2021 Yonatan Schachter
# SPDX-License-Identifier: Apache-2.0

if SOC_SERIES_RP2XXX

source "soc/arm/raspberrypi/rp2/Kconfig.defconfig.rp2*"

config SOC_SERIES
	default "rp2"

config NUM_IRQS
	default 26

choice
	prompt "Raspberry Pi flash type"

config RP2_FLASH_W25Q080
	bool "W25Q080"

config RP2_FLASH_GENERIC_03H
	bool "Generic 03H"

config RP2_FLASH_IS25LP080
	bool "IS25LP080"

config RP2_FLASH_W25X10CL
	bool "W25X10CL"

endchoice

config RP2_FLASH_BOOT_FILE
	string
	default "boot2_w25q080.S" if RP2_FLASH_W25Q080
	default "boot2_generic_03h.S" if RP2_FLASH_GENERIC_03H
	default "boot2_is25lp080.S" if RP2_FLASH_IS25LP080
	default "boot2_w25x10cl.S" if RP2_FLASH_W25X10CL

config UART_RASPBERRYPI
        default y
        depends on SERIAL

config GPIO_RASPBERRYPI
	default y
	depends on GPIO

endif # SOC_SERIES_RP2XXX
```

## soc/arm/raspberrypi/rp2/Kconfig.soc
```kconfig
# Raspberry Pi RP2XXX MCU line

# Copyright (c) 2021 Nordic Semiconductor ASA
# Copyright (c) 2021 Yonatan Schachter
# SPDX-License-Identifier: Apache-2.0

choice
	prompt "RP2xxx MCU Selection"
	depends on SOC_SERIES_RP2XXX

config SOC_RP2040
	bool "Raspberry Pi RP2040"

endchoice
```

## soc/arm/raspberrypi/rp20/Kconfig.defconfig.series
```kconfig
# Raspberry Pi RP20XX MCU line

# Copyright (c) 2021 Nordic Semiconductor ASA
# SPDX-License-Identifier: Apache-2.0

if SOC_SERIES_RP20XX

source "soc/arm/raspberry_pi/rp20/Kconfig.defconfig.rp20*"

config SOC_SERIES
	default "rp2040"

config NUM_IRQS
	default 26

endif # SOC_SERIES_RP20XX
```

## soc/arm/raspberrypi/rp20/Kconfig.series
```kconfig
# Raspberry Pi RP20XX MCU line

# Copyright (c) 2021 Nordic Semiconductor ASA
# SPDX-License-Identifier: Apache-2.0

config SOC_SERIES_RP20XX
	bool "Raspberry Pi RP20 series MCU"
	select ARM
	select CPU_CORTEX_M0_PLUS
	select CPU_CORTEX_M_HAS_SYSTICK
	select CPU_CORTEX_M_HAS_VTOR
	select CPU_HAS_ARM_MPU
	select SOC_FAMILY_RASPBERRY_PI
	select XIP
	help
	  Enable support for Raspberry Pi RP20 MCU series
```

## soc/arm/raspberrypi/rp20/Kconfig.soc
```kconfig
# Raspberry Pi RP20XX MCU line

# Copyright (c) 2021 Nordic Semiconductor ASA
# SPDX-License-Identifier: Apache-2.0

choice
	prompt "RP20xx MCU Selection"
	depends on SOC_SERIES_RP20XX

config SOC_RP2040
	bool "Raspberry Pi RP2040"

endchoice
```

## soc/arm/renesas_ra/Kconfig
```kconfig
# Copyright (c) 2023 TOKITA Hiroshi <tokita.hiroshi@fujitsu.com>
# SPDX-License-Identifier: Apache-2.0

config SOC_FAMILY_RA
	bool

if SOC_FAMILY_RA

config SOC_FAMILY
	string
	default "renesas_ra"

config SERIES_SPECIFIC_SOC_INIT
	bool "Use series specific initialize"

source "soc/arm/renesas_ra/*/Kconfig.soc"

endif # SOC_FAMILY_RA
```

## soc/arm/renesas_ra/Kconfig.soc
```kconfig
# Copyright (c) 2023 TOKITA Hiroshi <tokita.hiroshi@fujitsu.com>
# SPDX-License-Identifier: Apache-2.0

source "soc/arm/renesas_ra/*/Kconfig.series"
```

## soc/arm/renesas_ra/ra4m1/Kconfig.defconfig.r7fa4m1xxxxxx
```kconfig
# Copyright (c) 2023 TOKITA Hiroshi <tokita.hiroshi@fujitsu.com>
# SPDX-License-Identifier: Apache-2.0

if SOC_R7FA4M1AB3CFM

config SOC
	default "r7fa4m1ab3cfm"

endif # SOC_R7FA4M1AB3CFM
```

## soc/arm/renesas_rcar/Kconfig
```kconfig
# Renesas R-Car SoC line

# Copyright (c) 2021 IoT.bzh
# SPDX-License-Identifier: Apache-2.0

config SOC_FAMILY_RCAR
	bool

if SOC_FAMILY_RCAR

config SOC_FAMILY
	string
	default "renesas_rcar"

source "soc/arm/renesas_rcar/*/Kconfig.soc"

endif # SOC_FAMILY_RCAR
```

## soc/arm/renesas_rcar/Kconfig.defconfig
```kconfig
# Copyright (c) 2021 IoT.bzh
# SPDX-License-Identifier: Apache-2.0

source "soc/arm/renesas_rcar/*/Kconfig.defconfig.series"
```

## soc/arm/renesas_rcar/gen3/Kconfig.defconfig.r8a77951
```kconfig
# Copyright (c) 2021 IoT.bzh
# SPDX-License-Identifier: Apache-2.0

if SOC_R8A77951

config SOC
	default "r8a77951"

endif # SOC_R8A77951
```

## soc/arm/renesas_rcar/gen3/Kconfig.defconfig.r8a77961
```kconfig
# Copyright (c) 2021 IoT.bzh
# SPDX-License-Identifier: Apache-2.0

if SOC_R8A77961

config SOC
	default "r8a77961"

endif # SOC_R8A77961
```

## soc/arm/renesas_rcar/gen3/Kconfig.series
```kconfig
# Copyright (c) 2021 IoT.bzh
# SPDX-License-Identifier: Apache-2.0

config SOC_SERIES_RCAR_GEN3
	bool "Renesas RCAR Gen3 Cortex R7"
	select ARM
	select CPU_CORTEX_R7
	select PLATFORM_SPECIFIC_INIT
	select GIC_V2
	select CPU_HAS_DCLS
	select SOC_FAMILY_RCAR
	select CLOCK_CONTROL_RCAR_CPG_MSSR if CLOCK_CONTROL
	select PINMUX_RCAR if PINMUX
	help
	  Enable support for Renesas RCar Gen3 SoC series

config PINMUX_RCAR
	bool "Renesas RCar Gen3 pinmux driver"
	depends on SOC_SERIES_RCAR_GEN3
	help
	  Enable the Renesas RCar Gen3 pinmux driver.
```

## soc/arm/renesas_rcar/gen3/Kconfig.soc
```kconfig
# Copyright (c) 2021 IoT.bzh
# SPDX-License-Identifier: Apache-2.0

config SOC_R8A77951
	bool
	help
	  R8A77951
```

## soc/arm/renesas_rcar/gen4/Kconfig.defconfig.series
```kconfig
# Renesas R-Car Gen4 SoC line

# Copyright (c) 2023 IoT.bzh
# SPDX-License-Identifier: Apache-2.0

if SOC_SERIES_RCAR_GEN4

source "soc/arm/renesas_rcar/gen4/Kconfig.defconfig.r8a779*"

config SOC_SERIES
	default "gen4"

endif # SOC_SERIES_RCAR_GEN4
```

## soc/arm/renesas_rcar/gen4/Kconfig.series
```kconfig
# Copyright (c) 2023 IoT.bzh
# SPDX-License-Identifier: Apache-2.0

config SOC_SERIES_RCAR_GEN4
	bool "Renesas R-Car Gen4 Cortex R52"
	select ARM
	select CPU_CORTEX_R52
	select GIC_SINGLE_SECURITY_STATE
	select SOC_FAMILY_RCAR
	select CLOCK_CONTROL_RCAR_CPG_MSSR if CLOCK_CONTROL
	select ARM_ARCH_TIMER
	help
	  Enable support for Renesas R-Car Gen4 SoC series
```

## soc/arm/renesas_rcar/gen4/Kconfig.soc
```kconfig
# Copyright (c) 2023 IoT.bzh
# SPDX-License-Identifier: Apache-2.0

choice
	prompt "Renesas RCar SoC Selection"
	depends on SOC_SERIES_RCAR_GEN4

config SOC_R8A779F0
	bool "r8a779f0"

endchoice
```

## soc/arm/renesas_rzt2m/Kconfig
```kconfig
# Copyright (c) 2023 Antmicro <www.antmicro.com>
# SPDX-License-Identifier: Apache-2.0

config SOC_RENESAS_RZT2M
	bool

if SOC_RENESAS_RZT2M

config SOC_PART_NUMBER_R9A07G075
	bool

config SOC_PART_NUMBER
	default SOC_PART_NUMBER_R9A07G075

endif # SOC_RENESAS_RZT2M
```
