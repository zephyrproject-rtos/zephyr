## soc/arm/ti_simplelink/cc13x2x7_cc26x2x7/Kconfig.defconfig.cc2652r7
```kconfig
# Texas Instruments SimpleLink CC2652R

# Copyright (c) 2022 Vaishnav Achath
# SPDX-License-Identifier: Apache-2.0

config SOC
	default "cc2652r7"
	depends on SOC_CC2652R7
```

## soc/arm/ti_simplelink/cc13x2x7_cc26x2x7/Kconfig.defconfig.series
```kconfig
# Texas Instruments SimpleLink CC13x2 / CC26x2

# Copyright (c) 2022 Vaishnav Achath
# SPDX-License-Identifier: Apache-2.0

if SOC_SERIES_CC13X2X7_CC26X2X7

source "soc/arm/ti_simplelink/cc13x2x7_cc26x2x7/Kconfig.defconfig.cc*"

config SOC_SERIES
	default "cc13x2x7_cc26x2x7"

config SYS_CLOCK_HW_CYCLES_PER_SEC
	default 32768

# Note that when using the RTC as system clock, this needs to be 32768
# to reduce truncation errors from accumulating due to conversion to/from
# time, ticks, and HW cycles
config SYS_CLOCK_TICKS_PER_SEC
	default 32768

config NUM_IRQS
	default 38

if IEEE802154

config IEEE802154_CC13XX_CC26XX
	# required for linking with PowerCC26X2_config in
	# soc/arm/ti_simplelink/cc13x2_cc26x2/power.c
	select PM

config IEEE802154_CC13XX_CC26XX_SUB_GHZ
	# required for linking with PowerCC26X2_config in
	# soc/arm/ti_simplelink/cc13x2_cc26x2/power.c
	select PM

endif # IEEE802154

if BT

config BLE_CC13XX_CC26XX
	bool
	default y

endif # BT

endif # SOC_SERIES_CC13X2X7_CC26X2X7
```

## soc/arm/ti_simplelink/cc13x2x7_cc26x2x7/Kconfig.soc
```kconfig
# Texas Instruments SimpleLink CC13x2 / CC26x2

# Copyright (c) 2022 Vaishnav Achath
# SPDX-License-Identifier: Apache-2.0

choice
	prompt "TI SimpleLink MCU Selection"
	depends on SOC_SERIES_CC13X2X7_CC26X2X7

config SOC_CC2652R7
	bool "CC2652R7"

config SOC_CC1352R7
	bool "CC1352R7"

config SOC_CC2652P7
	bool "CC2652P7"

config SOC_CC1352P7
	bool "CC1352P7"

endchoice

menu "Customer Configuration (CCFG)"
depends on SOC_SERIES_CC13X2X7_CC26X2X7

config CC13X2_CC26X2_BOOST_MODE
	bool "Radio boost mode (VDDR_HH)"
	help
	  Enable the radio boost mode +14dBm (sets CCFG_FORCE_VDDR_HH to 1).

config CC13X2_CC26X2_HAS_CUSTOM_RF_HWATTRS
	bool "Board defines custom RFCC26XX hwAttrs structure"
	help
	  The board defines its own RFCC26XX_hwAttrs structure (e.g., for
	  custom antenna switching callback).

config CC13X2_CC26X2_BOOTLOADER_ENABLE
	bool "ROM bootloader"
	help
	  Enable the serial bootloader which resides in ROM on CC13xx / CC26xx
	  devices.

config CC13X2_CC26X2_BOOTLOADER_BACKDOOR_ENABLE
	bool "ROM bootloader backdoor"
	depends on CC13X2_CC26X2_BOOTLOADER_ENABLE
	help
	  Enable the ROM bootloader backdoor which starts the bootloader if the
	  associated pin is at the correct logic level on reset.

config CC13X2_CC26X2_BOOTLOADER_BACKDOOR_PIN
	int "ROM bootloader backdoor pin"
	depends on CC13X2_CC26X2_BOOTLOADER_BACKDOOR_ENABLE
	range 0 255
	default 255
	help
	  Set the pin that is level checked if the bootloader backdoor is
	  enabled.

config CC13X2_CC26X2_BOOTLOADER_BACKDOOR_LEVEL
	int "ROM bootloader backdoor level"
	depends on CC13X2_CC26X2_BOOTLOADER_BACKDOOR_ENABLE
	range 0 1
	default 0
	help
	  Set the active level of the pin selected for the bootloader backdoor.

endmenu
```

## soc/arm/ti_simplelink/cc2650/Kconfig.soc
```kconfig
# Texas Instruments CC2650

# SPDX-License-Identifier: Apache-2.0

choice
	prompt "TI SimpleLink MCU Selection"
	depends on SOC_SERIES_CC2650

config SOC_CC2650
	bool "CC2650"

endchoice

if SOC_SERIES_CC2650

config TI_CCFG_PRESENT
	bool
	default y

config SOC
	default "cc2650"

config SOC_DEPRECATED_RELEASE
	default "2.2.0"

endif # SOC_SERIES_CC2650
```

## soc/arm/ti_simplelink/cc32xx/Kconfig.defconfig.cc3220sf
```kconfig
# TI SimpleLink CC3220SF SoC

# SPDX-License-Identifier: Apache-2.0

if SOC_CC3220SF

config SOC
	default "cc3220sf"

config NUM_IRQS
	# must be >= the highest interrupt number used
	# This includes the NWP interrupt
	default 178

config SYS_CLOCK_HW_CYCLES_PER_SEC
	default 80000000

config ROM_START_OFFSET
	default 0x800 if XIP
	default 0x0   if !XIP

# Override the setting in misc/Kconfig to allow full use of SRAM:
config BOOTLOADER_SRAM_SIZE
	default 0 if !XIP

if !XIP
config FLASH_SIZE
	default 0
config FLASH_BASE_ADDRESS
	default 0
endif

endif # SOC_CC3220SF
```

## soc/arm/ti_simplelink/cc32xx/Kconfig.defconfig.cc3235s
```kconfig
# TI SimpleLink CC3235S SoC

# Copyright (c) 2021 ithinx GmbH
# SPDX-License-Identifier: Apache-2.0

if SOC_CC3235S

config SOC
	default "cc3235s"

config NUM_IRQS
	# must be >= the highest interrupt number used
	# This includes the NWP interrupt
	default 179

config SYS_CLOCK_HW_CYCLES_PER_SEC
	default 80000000

config ROM_START_OFFSET
	default 0x0

config BOOTLOADER_SRAM_SIZE
	default 16 if !CC3235S_DEBUG
	default 0  if CC3235S_DEBUG

config SRAM_BASE_ADDRESS
	default 0x20004000 if !CC3235S_DEBUG
	default 0x20000000 if CC3235S_DEBUG

if GPIO

config GPIO_CC32XX
	default y

endif # GPIO

config FLASH_SIZE
	default 0
config FLASH_BASE_ADDRESS
	default 0

endif # SOC_CC3235S
```

## soc/arm/ti_simplelink/cc32xx/Kconfig.defconfig.cc3235sf
```kconfig
# Copyright (c) 2019, Texas Instruments Incorporated
#
# SPDX-License-Identifier: Apache-2.0

# Kconfig.defconfig.cc3235sf - TI SimpleLink CC3235SF SoC
#

if SOC_CC3235SF

config SOC
	default "cc3235sf"

config NUM_IRQS
	# must be >= the highest interrupt number used
	# This includes the NWP interrupt
	default 179

config SYS_CLOCK_HW_CYCLES_PER_SEC
	default 80000000

config TEXT_SECTION_OFFSET
	default 0x800 if XIP
	default 0x0   if !XIP

# Override the setting in misc/Kconfig to allow full use of SRAM:
config BOOTLOADER_SRAM_SIZE
	default 0 if !XIP

if GPIO

config GPIO_CC32XX
	default y

config GPIO_CC32XX_A0
	default n

config GPIO_CC32XX_A1
	default y

config GPIO_CC32XX_A2
	default y

config GPIO_CC32XX_A3
	default n

endif # GPIO

if !XIP
config FLASH_SIZE
	default 0
config FLASH_BASE_ADDRESS
	default 0
endif

endif # SOC_CC3235SF
```

## soc/arm/ti_simplelink/cc32xx/Kconfig.defconfig.series
```kconfig
# TI SimpleLink Family

# SPDX-License-Identifier: Apache-2.0

if SOC_SERIES_CC32XX

source "soc/arm/ti_simplelink/cc32xx/Kconfig.defconfig.cc32*"

config SOC_SERIES
	default "cc32xx"

endif # SOC_SERIES_CC32XX
```

## soc/arm/ti_simplelink/cc32xx/Kconfig.series
```kconfig
# TI SimpleLink CC32xx

# SPDX-License-Identifier: Apache-2.0

config SOC_SERIES_CC32XX
	bool "TI SimpleLink Family"
	select ARM
	select CPU_CORTEX_M4
	select CPU_CORTEX_M_HAS_DWT
	select DYNAMIC_INTERRUPTS
	select SOC_FAMILY_TISIMPLELINK
	help
	  Enable support for TI SimpleLink CC32xx
```

## soc/arm/ti_simplelink/cc32xx/Kconfig.soc
```kconfig
# Texas Instruments CC32XX

# SPDX-License-Identifier: Apache-2.0

config SOC_CC3220SF
	bool
	select HAS_CC3220SDK
	help
	  CC3220SF

config SOC_CC3235SF
	bool
	select HAS_CC3220SDK
	help
	  CC3235SF

config CC3220SF_DEBUG
	bool "Prepend debug header, disabling flash verification" if XIP
	default XIP
	depends on SOC_CC3220SF

config CC3235SF_DEBUG
	bool "Prepend debug header, disabling flash verification" if XIP
	default XIP
	depends on SOC_CC3235SF
```

## soc/arm/ti_simplelink/msp432e4xx/Kconfig.defconfig.msp432e401y
```kconfig
# TI SimpleLink MSP432E401Y SoC

# Copyright (c) 2021, pipei.sandor@gmail.com
# SPDX-License-Identifier: Apache-2.0

if SOC_MSP432E401Y

config SOC
	default "msp432e401y"

config SYS_CLOCK_HW_CYCLES_PER_SEC
	default 120000000

config NUM_IRQS
	default 109

endif # SOC_MSP432E401Y
```

## soc/arm/ti_simplelink/msp432e4xx/Kconfig.defconfig.series
```kconfig
# TI SimpleLink MSP432E4XX

# Copyright (c) 2017, pipei.sandor@gmail.com
# SPDX-License-Identifier: Apache-2.0

if SOC_SERIES_MSP432E4XX

source "soc/arm/ti_simplelink/msp432e4xx/Kconfig.defconfig.msp432e4*"

config SOC_SERIES
	default "msp432e4xx"

endif # SOC_SERIES_MSP432E4XX
```

## soc/arm/ti_simplelink/msp432e4xx/Kconfig.series
```kconfig
# TI SimpleLink MSP432E4XX

# Copyright (c) 2021, pipei.sandor@gmail.com
# SPDX-License-Identifier: Apache-2.0

config SOC_SERIES_MSP432E4XX
	bool "TI SimpleLink Family MSP432E4XX"
	select ARM
	select CPU_HAS_ARM_MPU
	select CPU_CORTEX_M4
	select CPU_CORTEX_M_HAS_DWT
	select SOC_FAMILY_TISIMPLELINK
	select CPU_HAS_FPU
	help
	  Enable support for TI SimpleLink MSP432E4XX.
```

## soc/arm/ti_simplelink/msp432e4xx/Kconfig.soc
```kconfig
# Texas Instruments MSP432E401Y

# Copyright (c) 2021, pipei.sandor@gmail.com
# SPDX-License-Identifier: Apache-2.0

choice
	prompt "TI SimpleLink MCU Selection"
	depends on SOC_SERIES_MSP432E4XX

config SOC_MSP432E401Y
	bool "MSP432E401Y SDK"
	select HAS_MSP432E4XXSDK
endchoice
```

## soc/arm/ti_simplelink/msp432p4xx/Kconfig.defconfig.msp432p401r
```kconfig
# SPDX-License-Identifier: Apache-2.0
#
# Copyright (c) 2017, Linaro Ltd
#
# Kconfig.defconfig.msp432p401r- TI SimpleLink MSP432P401R SoC
#

if SOC_MSP432P401R

config SOC
	default "msp432p401r"

config SYS_CLOCK_HW_CYCLES_PER_SEC
	default 48000000

config NUM_IRQS
	default 64

endif # SOC_MSP432P401R
```

## soc/arm/ti_simplelink/msp432p4xx/Kconfig.defconfig.series
```kconfig
# SPDX-License-Identifier: Apache-2.0
#
# Copyright (c) 2017, Linaro Ltd
#
# Kconfig.defconfig.series - TI SimpleLink MSP432P4XX
#

if SOC_SERIES_MSP432P4XX

source "soc/arm/ti_simplelink/msp432p4xx/Kconfig.defconfig.msp432p4*"

config SOC_SERIES
	default "msp432p4xx"

endif # SOC_SERIES_MSP432P4XX
```

## soc/arm/ti_simplelink/msp432p4xx/Kconfig.series
```kconfig
# TI SimpleLink MSP432P4XX

# Copyright (c) 2017, Linaro Ltd
# SPDX-License-Identifier: Apache-2.0

config SOC_SERIES_MSP432P4XX
	bool "TI SimpleLink Family MSP432P4XX"
	select ARM
	select CPU_CORTEX_M4
	select CPU_CORTEX_M_HAS_DWT
	select FP_SP_D16_FP16_FMAC_DSP
	select SOC_FAMILY_TISIMPLELINK
	help
	  Enable support for TI SimpleLink MSP432P4XX.
```

## soc/arm/ti_simplelink/msp432p4xx/Kconfig.soc
```kconfig
# Texas Instruments MSP432P401R

# Copyright (c) 2017, Linaro Ltd
# SPDX-License-Identifier: Apache-2.0

choice
	prompt "TI SimpleLink MCU Selection"
	depends on SOC_SERIES_MSP432P4XX

config SOC_MSP432P401R
	bool "MSP432P401R"
	select HAS_MSP432P4XXSDK
endchoice
```

## soc/arm/unisoc_uwp/Kconfig
```kconfig
# UNISOC UWP SoC

# Copyright (c) 2018, UNISOC Incorporated
# SPDX-License-Identifier: Apache-2.0

config SOC_FAMILY_UWP
	bool

if SOC_FAMILY_UWP
config SOC_FAMILY
	string
	default "unisoc_uwp"
endif

source "soc/arm/unisoc_uwp/uwp566x/Kconfig.soc"
```

## soc/arm/unisoc_uwp/Kconfig.defconfig
```kconfig
# UNISOC UWP SoC defconfig

# Copyright (c) 2018, UNISOC Incorporated
# SPDX-License-Identifier: Apache-2.0

source "soc/arm/unisoc_uwp/*/Kconfig.defconfig.series"
```

## soc/arm/unisoc_uwp/Kconfig.soc
```kconfig
# UNISOC UWP SoC

# Copyright (c) 2018, UNISOC Incorporated
# SPDX-License-Identifier: Apache-2.0

source "soc/arm/unisoc_uwp/uwp566x/Kconfig.series"
```

## soc/arm/unisoc_uwp/uwp566x/Kconfig.defconfig.series
```kconfig
# UNISOC UWP566X family default configuration

# Copyright (c) 2018, UNISOC Incorporated
# Copyright (c) 2019, Manivannan Sadhasivam
# SPDX-License-Identifier: Apache-2.0

if SOC_SERIES_UWP566X

source "soc/arm/unisoc_uwp/uwp566x/Kconfig.defconfig.uwp5661"

config SOC_SERIES
	string
	default "uwp566x"

config TEXT_SECTION_OFFSET
	default 0x1000 if XIP && BOOTLOADER_MCUBOOT
	default 0x0

if SERIAL

config UART_UWP
	default y

endif #SERIAL

if !XIP
config FLASH_SIZE
	default 0
config FLASH_BASE_ADDRESS
	default 0
endif

endif # SOC_SERIES_UWP566X
```

## soc/arm/unisoc_uwp/uwp566x/Kconfig.defconfig.uwp5661
```kconfig
# UNISOC UWP5661 SoC default configuration

# Copyright (c) 2018, UNISOC Incorporated
# Copyright (c) 2019, Manivannan Sadhasivam
# SPDX-License-Identifier: Apache-2.0

if SOC_UWP5661

config SOC
	string
	default "uwp5661"

config NUM_IRQS
	int
	# must be >= the highest interrupt number used
	default 179

config 2ND_LVL_INTR_00_OFFSET
	default 1

config 2ND_LVL_INTR_01_OFFSET
	default 0

config 2ND_LVL_INTR_02_OFFSET
	default 20

config MAX_IRQ_PER_AGGREGATOR
	default 32

config NUM_2ND_LEVEL_AGGREGATORS
	default 3

config 2ND_LVL_ISR_TBL_OFFSET
	default 64

config SYS_CLOCK_HW_CYCLES_PER_SEC
	int
	default 416000000

endif # SOC_UWP5661
```

## soc/arm/unisoc_uwp/uwp566x/Kconfig.series
```kconfig
# UNISOC UWP566x family configuration

# Copyright (c) 2018, UNISOC Incorporated
# Copyright (c) 2019, Manivannan Sadhasivam
# SPDX-License-Identifier: Apache-2.0

config  SOC_SERIES_UWP566X
	bool "UNISOC UWP566X"
	select ARM
	select CPU_CORTEX_M4
	select SOC_FAMILY_UWP
	select HAS_UWP
	help
	  Enable support for UNISOC UWP566x series SoCs.
```

## soc/arm/unisoc_uwp/uwp566x/Kconfig.soc
```kconfig
# UNISOC UWP5661 SoC configuration

# Copyright (c) 2018, UNISOC Incorporated
# Copyright (c) 2019, Manivannan Sadhasivam
# SPDX-License-Identifier: Apache-2.0

choice
prompt "UNISOC UWP5661 MCU Selection"
depends on SOC_SERIES_UWP566X

config SOC_UWP5661
	bool "uwp5661"
endchoice

if SOC_UWP5661

config UWP5661_DEBUG
	bool "Prepend debug header, disabling flash verification"
	depends on XIP

endif # SOC_UWP5661
```
