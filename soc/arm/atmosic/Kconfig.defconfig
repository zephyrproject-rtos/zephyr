## soc/arm/atmosic/Kconfig.defconfig
```kconfig
# Copyright (c) 2024 Atmosic
#
# SPDX-License-Identifier: Apache-2.0

if SOC_FAMILY_ATM

gsource "soc/arm/atmosic/*/Kconfig.defconfig.series"

if ENTROPY_ATM_TRNG

# default the RNG to a PRNG seeded by the ATM TRNG
choice RNG_GENERATOR_CHOICE
	default XOSHIRO_RANDOM_GENERATOR
endchoice

if MBEDTLS || TINYCRYPT
# ATM TRNG HW should be used as an entropy source for a
# secure PRNG implementation.  Use the default AES-CTR mode drbg.
choice CSPRNG_GENERATOR_CHOICE
	default CTR_DRBG_CSPRNG_GENERATOR
endchoice
endif # MBEDTLS || TINYCRYPT

endif # ENTROPY_ATM_TRNG

endif # SOC_FAMILY_ATM
```

## soc/arm/bcm_vk/Kconfig
```kconfig
# SPDX-License-Identifier: Apache-2.0
#
# Copyright 2020 Broadcom.
#

config SOC_FAMILY_BCMVK
	bool

if SOC_FAMILY_BCMVK
config SOC_FAMILY
	string
	default "bcm_vk"

source "soc/arm/bcm_vk/*/Kconfig.soc"

endif
```

## soc/arm/bcm_vk/Kconfig.defconfig
```kconfig
# SPDX-License-Identifier: Apache-2.0
#
# Copyright 2020 Broadcom.
#

source "soc/arm/bcm_vk/*/Kconfig.defconfig.series"
```

## soc/arm/bcm_vk/valkyrie/Kconfig.defconfig.series
```kconfig
# SPDX-License-Identifier: Apache-2.0
#
# Copyright 2020 Broadcom.
#

if SOC_SERIES_VALKYRIE

config SOC_SERIES
	default "valkyrie"

config NUM_IRQS
	int
	default 240

config SYS_CLOCK_HW_CYCLES_PER_SEC
	int
	default 500000000

source "soc/arm/bcm_vk/valkyrie/Kconfig.defconfig.valkyrie*"

endif # SOC_SERIES_VALKYRIE
```

## soc/arm/bcm_vk/valkyrie/Kconfig.defconfig.valkyrie_bcm58400
```kconfig
# SPDX-License-Identifier: Apache-2.0
#
# Copyright 2020 Broadcom.

config SOC
	default "BCM58400"
	depends on SOC_BCM58400
```

## soc/arm/bcm_vk/valkyrie/Kconfig.series
```kconfig
# SPDX-License-Identifier: Apache-2.0
#
# Copyright 2020 Broadcom.
#

config SOC_SERIES_VALKYRIE
	bool "Broadcom Valkyrie Series"
	select ARM
	select CPU_CORTEX_M7
	select CPU_CORTEX_M_HAS_CACHE
	select SOC_FAMILY_BCMVK
	select CPU_CORTEX_M_HAS_SYSTICK
	select CPU_HAS_ARM_MPU
	help
	  Enable support for Broadcom Valkyrie Series
```

## soc/arm/bcm_vk/valkyrie/Kconfig.soc
```kconfig
# SPDX-License-Identifier: Apache-2.0
#
# Copyright 2020 Broadcom.
#

config SOC_BCM58400
	bool
	help
	  Broadcom BCM58400
```

## soc/arm/bcm_vk/viper/Kconfig.defconfig.viper_bcm58402_m7
```kconfig
# Copyright 2020 Broadcom
# SPDX-License-Identifier: Apache-2.0

if SOC_BCM58402_M7

config SOC
	default "bcm58402_m7"

config NUM_IRQS
	int
	default 240

config SYS_CLOCK_HW_CYCLES_PER_SEC
	int
	default 500000000

# Viper SOC does not appear to have cache support present.
# Disable DCACHE and ICACHE functionality

config DCACHE
	default n

config ICACHE
	default n

endif
```

## soc/arm/bcm_vk/viper/Kconfig.soc
```kconfig
# Copyright 2020 Broadcom
# SPDX-License-Identifier: Apache-2.0

config SOC_BCM58402_M7
	bool
	select CPU_CORTEX_M7
	select CPU_CORTEX_M_HAS_SYSTICK
	select CPU_HAS_ARM_MPU
	help
	  Broadcom BCM58402 M7
```

## soc/arm/beetle/Kconfig
```kconfig
# ARM LTD Beetle SoC configuration options

# Copyright (c) 2016 Linaro Limited
# Copyright 2025 Arm Limited and/or its affiliates <open-source-office@arm.com>
# SPDX-License-Identifier: Apache-2.0

config SOC_SERIES_BEETLE
	select ARM
	select PINCTRL
	select CPU_CORTEX_M3
	select CPU_HAS_ARM_MPU
	select CPU_CORTEX_M_HAS_DWT
	select SOC_EARLY_INIT_HOOK
```

## soc/arm/beetle/Kconfig.soc
```kconfig
# ARM LTD Beetle SoC configuration options

# Copyright (c) 2016 Linaro Limited
# SPDX-License-Identifier: Apache-2.0

config SOC_SERIES_BEETLE
	bool
	select SOC_FAMILY_ARM
	help
	  Enable support for Beetle MCU Series

config SOC_BEETLE_R0
	bool
	select SOC_SERIES_BEETLE
	help
	  ARM BEETLE R0

config SOC_SERIES
	default "beetle" if SOC_SERIES_BEETLE

config SOC
	default "beetle_r0" if SOC_BEETLE_R0
```

## soc/arm/cypress/Kconfig
```kconfig
# Copyright (c) 2018, Cypress
# Copyright (c) 2020, ATL Electronics
# SPDX-License-Identifier: Apache-2.0

choice
	prompt "Cypress PSoC6 MCU Selection"
	depends on SOC_SERIES_PSOC62 || \
		   SOC_SERIES_PSOC63

config SOC_PSOC6_M0
	bool "SOC_PSOC6_M0"
	select CPU_CORTEX_M0PLUS
	select CPU_CORTEX_M_HAS_SYSTICK
	select CPU_CORTEX_M_HAS_VTOR

config SOC_PSOC6_M4
	bool "SOC_PSOC6_M4"
	select CPU_CORTEX_M4
	select CPU_CORTEX_M_HAS_DWT
	select CPU_CORTEX_M_HAS_SYSTICK

endchoice

config SOC_FAMILY_PSOC6
	bool

if SOC_FAMILY_PSOC6

config SOC_FAMILY
	string
	default "cypress"

source "soc/arm/cypress/*/Kconfig.soc"

endif # SOC_FAMILY_PSOC6
```

## soc/arm/cypress/Kconfig.soc
```kconfig
# Copyright (c) 2018, Cypress
# SPDX-License-Identifier: Apache-2.0

source "soc/arm/cypress/*/Kconfig.series"
```

## soc/arm/cypress/psoc6/Kconfig.defconfig.psoc6_m0
```kconfig
# Kconfig - Cypress PSoC6 CM0 platform configuration options
#
# Copyright (c) 2018, Cypress
#
# SPDX-License-Identifier: Apache-2.0
#

if SOC_PSOC6_M0

config SOC
	default "psoc6_m0"

if SERIAL

config UART_PSOC6
	default y

endif # SERIAL

endif # SOC_PSOC6_M0
```

## soc/arm/cypress/psoc6/Kconfig.defconfig.psoc6_m4
```kconfig
# Cypress PSoC6 CM4 platform configuration options

# Copyright (c) 2018, Cypress
# SPDX-License-Identifier: Apache-2.0

if SOC_PSOC6_M4

config SOC
	default "psoc6_m4"

config NUM_IRQS
	default 147

endif # SOC_PSOC6_M4
```

## soc/arm/cypress/psoc6/Kconfig.defconfig.series
```kconfig
# Kconfig.defconfig.series - Cypress Semiconductor PSoC6 series configuration
# options
#
# Copyright (c) 2018, Cypress
#
# SPDX-License-Identifier: Apache-2.0
#

if SOC_SERIES_PSOC62

config SOC_SERIES
	default "psoc6"

config SOC_PART_NUMBER
	default "CY8C6247BZI_D54" if SOC_PART_NUMBER_CY8C6247BZI_D54

config NUM_IRQS
	# must be >= the highest interrupt number used
	default 40

config SYS_CLOCK_HW_CYCLES_PER_SEC
	default 50000000

source "soc/arm/cypress/psoc6/Kconfig.defconfig.psoc*"

endif # SOC_SERIES_PSOC62
```

## soc/arm/cypress/psoc6/Kconfig.series
```kconfig
# Cypress PSoC6 MCU line

# Copyright (c) 2018, Cypress Semiconductor
# Copyright (c) 2020, ATL Electronics
# SPDX-License-Identifier: Apache-2.0

config SOC_SERIES_PSOC62
	bool
	select ARM
	select SOC_FAMILY_PSOC6
	select HAS_CYPRESS_DRIVERS
	help
	  Enable support for Cypress PSoC6 MCU series

config SOC_SERIES_PSOC63
	bool
	select ARM
	select SOC_FAMILY_PSOC6
	select HAS_CYPRESS_DRIVERS
	help
	  Enable support for Cypress PSoC6-BLE MCU series
```

## soc/arm/cypress/psoc6/Kconfig.soc
```kconfig
# Cypress PSOC6 MCU line

# Copyright (c) 2018, Cypress
# Copyright (c) 2020, ATL Electronics
# SPDX-License-Identifier: Apache-2.0

config SOC_PART_NUMBER_CY8C6247BZI_D54
	bool
	depends on SOC_SERIES_PSOC62
	help
	  CY8C6247BZI_D54

config SOC_PART_NUMBER_CY8C6347BZI_BLD53
	bool
	depends on SOC_SERIES_PSOC63
	help
	  CY8C6347BZI_BLD53
```

## soc/arm/designstart/Kconfig
```kconfig
# Copyright (c) 2020 Henrik Brix Andersen <henrik@brixandersen.dk>
# SPDX-License-Identifier: Apache-2.0

config SOC_SERIES_DESIGNSTART
	select ARM

config SOC_DESIGNSTART_FPGA_CORTEX_M1
	select CPU_CORTEX_M1
	imply XIP
	select HAS_SEGGER_RTT if ZEPHYR_SEGGER_MODULE

config SOC_DESIGNSTART_FPGA_CORTEX_M3
	select CPU_CORTEX_M3
	imply XIP
	select HAS_SEGGER_RTT if ZEPHYR_SEGGER_MODULE
```

## soc/arm/designstart/Kconfig.soc
```kconfig
# Copyright (c) 2020 Henrik Brix Andersen <henrik@brixandersen.dk>
# SPDX-License-Identifier: Apache-2.0

config SOC_SERIES_DESIGNSTART
	bool
	select SOC_FAMILY_ARM
	help
	  ARM DesignStart SoC Series

config SOC_DESIGNSTART_FPGA_CORTEX_M1
	bool
	select SOC_SERIES_DESIGNSTART
	help
	  ARM Cortex-M1 DesignStart FPGA

config SOC_DESIGNSTART_FPGA_CORTEX_M3
	bool
	select SOC_SERIES_DESIGNSTART
	help
	  ARM Cortex-M3 DesignStart FPGA

config SOC_SERIES
	default "designstart" if SOC_SERIES_DESIGNSTART

config SOC
	default "designstart_fpga_cortex_m1" if SOC_DESIGNSTART_FPGA_CORTEX_M1
	default "designstart_fpga_cortex_m3" if SOC_DESIGNSTART_FPGA_CORTEX_M3
```

## soc/arm/elkhart_lake_pse/Kconfig.defconfig
```kconfig
# Kconfig - PSE platform configuration options

# Copyright (c) 2021 Intel Corporation
#
# SPDX-License-Identifier: Apache-2.0
#

if SOC_ELKHART_LAKE_PSE

config SOC
	default "elkhart_lake_pse"

config NUM_IRQS
	int
	# must be >= the highest interrupt number used
	# - include the UART interrupts
	default 106

config SYS_CLOCK_HW_CYCLES_PER_SEC
	int
	default 32768

config XIP
	bool

config BUILD_OUTPUT_BIN
	bool

config BOOTLOADER_SRAM_SIZE
	default 0

if TRACING_CTF
config TRACING_CTF_BOTTOM_SHMEM
	bool
	default y
endif
endif
```

## soc/arm/elkhart_lake_pse/Kconfig.soc
```kconfig
# Kconfig - PSE platform configuration options

# Copyright (c) 2021 Intel Corporation
#
# SPDX-License-Identifier: Apache-2.0
#

config SOC_ELKHART_LAKE_PSE
	bool "INTEL PSE"
	select ARM
	select CPU_CORTEX_M7
	select CPU_HAS_FPU
	select CPU_HAS_FPU_DOUBLE_PRECISION
	select HAS_SEDI
	select CPU_HAS_ARM_MPU
	select HAS_CMSIS_CORE
	select HAS_SYS_POWER_STATE_SLEEP_1
	select HAS_SYS_POWER_STATE_SLEEP_2
	select HAS_SYS_POWER_STATE_SLEEP_3
	select HAS_SYS_POWER_STATE_DEEP_SLEEP_2
	select HAS_SYS_POWER_STATE_DEEP_SLEEP_3
	select CPU_HAS_CUSTOM_FIXED_SOC_MPU_REGIONS
if SOC_ELKHART_LAKE_PSE
config ICCM_MEMORY_BASE_ADDRESS
	hex
	prompt "ICCM base address"
	default $(dt_node_reg_addr_hex,/memory@0)
	range 0 0x00060000
	help
	  Set PSE ICCM memory base address

config ICCM_MEMORY_SIZE
	hex
	prompt "ICCM memory size"
	default $(dt_node_reg_size_hex,/memory@0)
	range 0 0x00060000
	help
	  Set PSE ICCM memory size

config DCCM_MEMORY_BASE_ADDRESS
	hex
	prompt "DCCM base address"
	default $(dt_node_reg_addr_hex,/memory@20040000)
	range 0x20000000 0x20060000
	help
	  Set PSE DCCM memory base address

config DCCM_MEMORY_SIZE
	hex
	prompt "DCCM memory size"
	default $(dt_node_reg_size_hex,/memory@20040000)
	range 0 0x00060000
	help
	  Set PSE DCCM memory size

config L2SRAM_RO_MEMORY_BASE_ADDRESS
	hex
	prompt "L2SRAM RO base address"
	default $(dt_node_reg_addr_hex,/memory@60000000)
	range 0x60000000 0x60080000
	help
	  Set PSE L2SRAM RO memory base address

config L2SRAM_RO_MEMORY_SIZE
	hex
	prompt "L2SRAM RO memory size"
	default $(dt_node_reg_size_hex,/memory@60000000)
	range 0 0x80000
	help
	  Set PSE L2SRAM RO memory size

config L2SRAM_RW_MEMORY_BASE_ADDRESS
	hex
	prompt "L2SRAM RW base address"
	default $(dt_node_reg_addr_hex,/memory@60080000)
	range 0x60080000 0x60100000
	help
	  Set PSE L2SRAM RW memory base address

config L2SRAM_RW_MEMORY_SIZE
	hex
	prompt "L2SRAM RW memory size"
	default $(dt_node_reg_size_hex,/memory@60080000)
	range 0 0x80000
	help
	  Set PSE L2SRAM RW memory size

config AONRF_MEMORY_BASE_ADDRESS
	hex
	prompt "AONRF base address"
	default $(dt_node_reg_addr_hex,/memory@70000000)
	range 0x70000000 0x70010000
	help
	  Set PSE AONRF memory base address

config AONRF_MEMORY_SIZE
	hex
	prompt "AONRF memory size"
	default $(dt_node_reg_size_hex,/memory@70000000)
	range 0 0x10000
	help
	  Set PSE AONRF memory size

config EN_L2SRAM_RELOCATION_MEM
	bool
	prompt "Enable L2SRAM as relocation memory"
	help
	  Set L2SRAM as relocation memory

config EN_MPU_L2SRAM_MEM_ACCESS
	bool
	prompt "Enable MPU L2SRAM memory access"
	default y
	help
	  Enable MPU L2SRAM memory access

config EN_MPU_ICCM_MEM_ACCESS
	bool
	prompt "Enable MPU ICCM memory access"
	default y
	help
	  Enable MPU ICCM memory access

config EN_MPU_DCCM_MEM_ACCESS
	bool
	prompt "Enable MPU DCCM memory access"
	default y
	help
	  Enable MPU DCCM memory access

config MPU_LOG_LEVEL
	int
	prompt "Config MPU log Level"
	default 0
	help
	  Set MPU log Level

config CACHE_DISABLE
	bool "Disable L1 I/D caches"
	help
	  This configure option is to temporarily disable L1 I/D caches

config FPGA_GBE_RGMII_PHY_RX
	bool "Init GBE_RGMII_PHY_RX trunk clocks on FPGA"
	help
	  This configure option is to gate/ungate GBE_RGMII_PHY_RX
	  trunk clocks on FPGA, set to y only when GBE AOB PHY daughter
	  board is connected.

config ENABLE_SOC_NMI
	bool "Enable SOC NMI handling"
	select RUNTIME_NMI
	help
	  This configuraiton option enables SOC NMI handling.

config SOC_TEMP_LOG_LEVEL
	int "Enable log level for SOC temp config"
	default 0
	help
	  This configure log level for SOC.

config MAP_MPU_UNUSED_REGION
	bool "config unused memory under MPU"
	help
	  This configure unused memory under MPU.

config DISABLE_SOC_PM_INIT
	bool "Configure not to do PM init in soc init"
	help
	  This configure option is to temporarily disable PM init.

config CLOCK_SOURCE_DOWNSCALED
	bool "PSE HPET timer/rtc frequency downscale"
	help
	  there is a frequency division of the main frequency of HPET/RTC.

config CLK_SCALE
	depends on PSE_CLOCK_SOURCE_DOWNSCALED
	int "Frequency division coefficient of HPET/RTC timer's frequency"
	default 5

endif # SOC_ELKHART_LAKE_PSE
```

## soc/arm/ene_kb1200/Kconfig
```kconfig
# ENE Cortex-M4 Embedded Controller

# Copyright (c) 2020 ENE Technology Corporation.
# SPDX-License-Identifier: Apache-2.0

config SOC_ENE_KB1200
	bool
```
