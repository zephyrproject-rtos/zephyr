## soc/arm/nuvoton_npcx/npcx4/Kconfig.defconfig.npcx4m3f
```kconfig
# Nuvoton Cortex-M4 Embedded Controller

# Copyright (c) 2023 Nuvoton Technology Corporation.
# SPDX-License-Identifier: Apache-2.0

if SOC_NPCX4M3F

config SOC
	default "npcx4m3f"

endif # SOC_NPCX4M3F
```

## soc/arm/nuvoton_npcx/npcx4/Kconfig.defconfig.npcx4m8f
```kconfig
# Nuvoton Cortex-M4 Embedded Controller

# Copyright (c) 2023 Nuvoton Technology Corporation.
# SPDX-License-Identifier: Apache-2.0

if SOC_NPCX4M8F

config SOC
	default "npcx4m8f"

endif # SOC_NPCX4M8F
```

## soc/arm/nuvoton_npcx/npcx4/Kconfig.defconfig.series
```kconfig
# Nuvoton Cortex-M4 Embedded Controller

# Copyright (c) 2023 Nuvoton Technology Corporation.
# SPDX-License-Identifier: Apache-2.0

if SOC_SERIES_NPCX4

config SOC_SERIES
	default "npcx4"

config NUM_IRQS
	default 128

config CORTEX_M_SYSTICK
	default !NPCX_ITIM_TIMER

config ESPI_NPCX
	default y
	depends on ESPI

source "soc/arm/nuvoton_npcx/npcx4/Kconfig.defconfig.npcx4*"

endif # SOC_SERIES_NPCX4
```

## soc/arm/nuvoton_npcx/npcx4/Kconfig.series
```kconfig
# Nuvoton Cortex-M4 Embedded Controller NPCX4 series

# Copyright (c) 2023 Nuvoton Technology Corporation.
# SPDX-License-Identifier: Apache-2.0

config SOC_SERIES_NPCX4
	bool "Nuvoton NPCX4 Series"
	select ARM
	select CPU_CORTEX_M4
	select CPU_CORTEX_M_HAS_DWT
	select CPU_HAS_FPU
	select CPU_HAS_ARM_MPU
	select SOC_FAMILY_NPCX
	help
	  Enable support for Nuvoton NPCX4 series
```

## soc/arm/nuvoton_npcx/npcx7/Kconfig.defconfig.npcx7m6fb
```kconfig
# Nuvoton Cortex-M4 Embedded Controller

# Copyright (c) 2020 Nuvoton Technology Corporation.
# SPDX-License-Identifier: Apache-2.0

if SOC_NPCX7M6FB

config SOC
	default "npcx76mfb"

endif # SOC_NPCX7M6FB
```

## soc/arm/nuvoton_npcx/npcx7/Kconfig.defconfig.npcx7m7fc
```kconfig
# Nuvoton Cortex-M4 Embedded Controller

# Copyright (c) 2021 Nuvoton Technology Corporation.
# SPDX-License-Identifier: Apache-2.0

if SOC_NPCX7M7FC

config SOC
	default "npcx7m7fc"

endif # SOC_NPCX7M7FC
```

## soc/arm/nuvoton_npcx/npcx7/Kconfig.defconfig.series
```kconfig
# Nuvoton Cortex-M4 Embedded Controller

# Copyright (c) 2020 Nuvoton Technology Corporation.
# SPDX-License-Identifier: Apache-2.0

if SOC_SERIES_NPCX7

config SOC_SERIES
	default "npcx7"

config NUM_IRQS
	default 64

config CORTEX_M_SYSTICK
	default !NPCX_ITIM_TIMER

config ESPI_NPCX
	default y
	depends on ESPI

source "soc/arm/nuvoton_npcx/npcx7/Kconfig.defconfig.npcx7*"

endif # SOC_SERIES_NPCX7
```

## soc/arm/nuvoton_npcx/npcx7/Kconfig.soc
```kconfig
# Nuvoton NPCX7 EC series

# Copyright (c) 2020 Nuvoton Technology Corporation.
# SPDX-License-Identifier: Apache-2.0

config SOC_NPCX7M6FB
	bool
	help
	  NPCX7M6FB

config SOC_NPCX7M6FC
	bool
	help
	  NPCX7M6FC

config SOC_NPCX7M7FC
	bool
	help
	  NPCX7M7FC
```

## soc/arm/nuvoton_npcx/npcx9/Kconfig.defconfig.npcx9m3f
```kconfig
# Nuvoton Cortex-M4 Embedded Controller

# Copyright (c) 2021 Nuvoton Technology Corporation.
# SPDX-License-Identifier: Apache-2.0

if SOC_NPCX9M3F

config SOC
	default "npcx9m3f"

endif # SOC_NPCX9M3F
```

## soc/arm/nuvoton_npcx/npcx9/Kconfig.defconfig.npcx9m7f
```kconfig
# Nuvoton Cortex-M4 Embedded Controller

# Copyright (c) 2022 Nuvoton Technology Corporation.
# SPDX-License-Identifier: Apache-2.0

if SOC_NPCX9M7F

config SOC
	default "npcx9m7f"

endif # SOC_NPCX9M7F
```

## soc/arm/nuvoton_npcx/npcx9/Kconfig.defconfig.npcx9mfp
```kconfig
# Nuvoton Cortex-M4 Embedded Controller

# Copyright (c) 2023 Nuvoton Technology Corporation.
# SPDX-License-Identifier: Apache-2.0

if SOC_NPCX9MFP

config SOC
	default "npcx9mfp"

endif # SOC_NPCX9MFP
```

## soc/arm/nuvoton_npcx/npcx9/Kconfig.defconfig.series
```kconfig
# Nuvoton Cortex-M4 Embedded Controller

# Copyright (c) 2021 Nuvoton Technology Corporation.
# SPDX-License-Identifier: Apache-2.0

if SOC_SERIES_NPCX9

config SOC_SERIES
	default "npcx9"

config NUM_IRQS
	default 64

config CORTEX_M_SYSTICK
	default !NPCX_ITIM_TIMER

config CLOCK_CONTROL_NPCX
	default y
	depends on CLOCK_CONTROL

config UART_NPCX
	default y
	depends on SERIAL

config GPIO_NPCX
	default y
	depends on GPIO

config PWM_NPCX
	default y
	depends on PWM

config ADC_NPCX
	default y
	depends on ADC

config WDT_NPCX
	default y
	depends on WATCHDOG

config ESPI_NPCX
	default y
	depends on ESPI

config I2C_NPCX
	default y
	depends on I2C

config TACH_NPCX
	default y
	depends on SENSOR

config SPI_NPCX_FIU
	default y
	depends on SPI

source "soc/arm/nuvoton_npcx/npcx9/Kconfig.defconfig.npcx9*"

endif # SOC_SERIES_NPCX9
```

## soc/arm/nuvoton_npcx/npcx9/Kconfig.series
```kconfig
# Nuvoton Cortex-M4 Embedded Controller NPCX9 series

# Copyright (c) 2021 Nuvoton Technology Corporation.
# SPDX-License-Identifier: Apache-2.0

config SOC_SERIES_NPCX9
	bool "Nuvoton NPCX9 Series"
	select ARM
	select CPU_CORTEX_M4
	select CPU_CORTEX_M_HAS_DWT
	select CPU_HAS_FPU
	select CPU_HAS_ARM_MPU
	select SOC_FAMILY_NPCX
	help
	  Enable support for Nuvoton NPCX9 series
```

## soc/arm/nuvoton_npcx/npcx9/Kconfig.soc
```kconfig
# Nuvoton NPCX9 EC series

# Copyright (c) 2021 Nuvoton Technology Corporation.
# SPDX-License-Identifier: Apache-2.0

choice
	prompt "NPCX9 Selection"
	depends on SOC_SERIES_NPCX9

config SOC_NPCX9M3F
	bool "NPCX9M3F"

config SOC_NPCX9M6F
	bool "NPCX9M6F"

config SOC_NPCX9M7F
	bool "NPCX9M7F"

endchoice
```

## soc/arm/nuvoton_numaker/Kconfig
```kconfig
# Copyright (c) 2023 Nuvoton Technology Corporation.
#
# SPDX-License-Identifier: Apache-2.0


config SOC_FAMILY_NUMAKER
	select PLATFORM_SPECIFIC_INIT
	bool

if SOC_FAMILY_NUMAKER

config SOC_FAMILY
	string
	default "nuvoton_numaker"

source "soc/arm/nuvoton_numaker/*/Kconfig.soc"

endif # SOC_FAMILY_NUMAKER
```

## soc/arm/nuvoton_numaker/Kconfig.defconfig
```kconfig
# Copyright (c) 2023 Nuvoton Technology Corporation.
#
# SPDX-License-Identifier: Apache-2.0

source "soc/arm/nuvoton_numaker/*/Kconfig.defconfig.series"

if SOC_FAMILY_NUMAKER

config RESET
	default y

endif
```

## soc/arm/nuvoton_numaker/Kconfig.soc
```kconfig
# Copyright (c) 2023 Nuvoton Technology Corporation.
#
# SPDX-License-Identifier: Apache-2.0

source "soc/arm/nuvoton_numaker/*/Kconfig.series"
```

## soc/arm/nuvoton_numaker/m46x/Kconfig.defconfig.m467
```kconfig
# Copyright (c) 2023 Nuvoton Technology Corporation.
#
# SPDX-License-Identifier: Apache-2.0

if SOC_M467

config NUM_IRQS
	default 127

endif # SOC_M467
```

## soc/arm/nuvoton_numaker/m46x/Kconfig.defconfig.series
```kconfig
# Copyright (c) 2023 Nuvoton Technology Corporation.
#
# SPDX-License-Identifier: Apache-2.0

if SOC_SERIES_M46X

source "soc/arm/nuvoton_numaker/m46x/Kconfig.defconfig.m46*"

config SOC_SERIES
	default "m46x"

endif # SOC_SERIES_M46X
```

## soc/arm/nuvoton_numaker/m46x/Kconfig.series
```kconfig
# Copyright (c) 2023 Nuvoton Technology Corporation.
#
# SPDX-License-Identifier: Apache-2.0

config SOC_SERIES_M46X
	bool "Nuvoton M46X Series MCU"
	select ARM
	select CPU_CORTEX_M4
	select CPU_CORTEX_M_HAS_DWT
	select CPU_HAS_FPU
	select CPU_HAS_ARM_MPU
	select CORTEX_M_SYSTICK if SYS_CLOCK_EXISTS
	select SOC_FAMILY_NUMAKER
	help
	  Enable support for Nuvoton M46X MCU series
```

## soc/arm/nuvoton_numaker/m46x/Kconfig.soc
```kconfig
# Copyright (c) 2023 Nuvoton Technology Corporation.
#
# SPDX-License-Identifier: Apache-2.0

choice
	prompt "Nuvoton M46X MCU Selection"
	depends on SOC_SERIES_M46X

config SOC_M467
	bool "M467"
	select HAS_NUMAKER_HAL

endchoice
```

## soc/arm/nuvoton_numicro/Kconfig
```kconfig
# SPDX-License-Identifier: Apache-2.0
#
# Copyright (c) 2020 Linumiz
# Author: Saravanan Sekar <saravanan@linumiz.com>

config SOC_FAMILY_NUMICRO
	select PLATFORM_SPECIFIC_INIT
	bool

if SOC_FAMILY_NUMICRO
config SOC_FAMILY
	string
	default "nuvoton_numicro"

source "soc/arm/nuvoton_numicro/*/Kconfig.soc"

endif # SOC_FAMILY_NUMICRO
```

## soc/arm/nuvoton_numicro/Kconfig.soc
```kconfig
# SPDX-License-Identifier: Apache-2.0
#
# Copyright (c) 2020 Linumiz
# Author: Saravanan Sekar <saravanan@linumiz.com>

source "soc/arm/nuvoton_numicro/*/Kconfig.series"
```

## soc/arm/nuvoton_numicro/m48x/Kconfig.defconfig.m487
```kconfig
# SPDX-License-Identifier: Apache-2.0
#
# Copyright (c) 2020 Linumiz
# Author: Saravanan Sekar <saravanan@linumiz.com>

if SOC_M487

config NUM_IRQS
	default 108

endif # SOC_M487
```

## soc/arm/nuvoton_numicro/m48x/Kconfig.defconfig.series
```kconfig
# SPDX-License-Identifier: Apache-2.0
#
# Copyright (c) 2020 Linumiz
# Author: Saravanan Sekar <saravanan@linumiz.com>

if SOC_SERIES_M48X

source "soc/arm/nuvoton_numicro/m48x/Kconfig.defconfig.m48*"

config SOC_SERIES
	default "m48x"

endif # SOC_SERIES_M48X
```
