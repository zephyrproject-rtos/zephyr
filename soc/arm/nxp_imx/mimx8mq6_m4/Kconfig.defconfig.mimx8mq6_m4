## soc/arm/nxp_imx/mimx8mq6_m4/Kconfig.defconfig.mimx8mq6_m4
```kconfig
# MIMX8MQ6 SoC defconfig

# Copyright (c) 2021, Kwon Tae-young <tykwon@m2i.co.kr>
# SPDX-License-Identifier: Apache-2.0

if SOC_MIMX8MQ6

config SOC
	string
	default "mimx8mq6"

config SYS_CLOCK_HW_CYCLES_PER_SEC
	int
	default 266000000

config PINCTRL_IMX
	default y if HAS_MCUX_IOMUXC
	depends on PINCTRL

endif # SOC_MIMX8MQ6
```

## soc/arm/nxp_imx/mimx8mq6_m4/Kconfig.defconfig.series
```kconfig
# i.MX8MQ M4 SoC series defconfig

# Copyright (c) 2021, Kwon Tae-young <tykwon@m2i.co.kr>
# SPDX-License-Identifier: Apache-2.0

if SOC_SERIES_IMX8MQ_M4

config SOC_SERIES
	default "mimx8mq6_m4"

config NUM_IRQS
	int
	# must be >= the highest interrupt number used
	default 127

source "soc/arm/nxp_imx/mimx8mq6_m4/Kconfig.defconfig.mimx8mq6_m4"

endif # SOC_SERIES_IMX8MQ_M4
```

## soc/arm/nxp_imx/mimx8mq6_m4/Kconfig.series
```kconfig
# i.MX8MQ M4 core series

# Copyright (c) 2021, Kwon Tae-young <tykwon@m2i.co.kr>
# SPDX-License-Identifier: Apache-2.0

config SOC_SERIES_IMX8MQ_M4
	bool "i.MX8MQ M4 Core Series"
	select ARM
	select CPU_CORTEX_M4
	select SOC_FAMILY_IMX
	select CPU_HAS_FPU
	help
	  Enable support for i.MX8MQ M4 MCU series
```

## soc/arm/nxp_imx/mimx8mq6_m4/Kconfig.soc
```kconfig
# i.MX8MQ M4 SoC series

# Copyright (c) 2021, Kwon Tae-young <tykwon@m2i.co.kr>
# SPDX-License-Identifier: Apache-2.0

config SOC_MIMX8MQ6
	bool
	select HAS_MCUX
	select HAS_MCUX_CCM
	select HAS_MCUX_RDC
	select HAS_MCUX_IOMUXC
	help
	  SOC_MIMX8MQ6

if SOC_SERIES_IMX8MQ_M4

config SOC_PART_NUMBER_MIMX8MQ6DVAJZ
	bool

config SOC_PART_NUMBER_IMX8MQ_M4
	string
	default "MIMX8MQ6DVAJZ" if SOC_PART_NUMBER_MIMX8MQ6DVAJZ
	help
	  This string holds the full part number of the SoC. It is a hidden option
	  that you should not set directly. The part number selection choice defines
	  the default value for this string.

endif # SOC_SERIES_IMX8MQ_M4
```

## soc/arm/nxp_imx/rt/Kconfig.defconfig.mimxrt1010
```kconfig
# i.MX RT1010

# Copyright (c) 2019, NXP
# SPDX-License-Identifier: Apache-2.0

if SOC_MIMXRT1011

config SOC
	string
	default "mimxrt1011"

config NUM_IRQS
	default 80

config DCDC_VALUE
	default 0x12

config GPIO
	default y

config FLEXSPI_CONFIG_BLOCK_OFFSET
	default 0x400

endif # SOC_MIMXRT1010
```

## soc/arm/nxp_imx/rt/Kconfig.defconfig.mimxrt1015
```kconfig
# i.MX RT1015

# Copyright (c) 2019, NXP
# SPDX-License-Identifier: Apache-2.0

if SOC_MIMXRT1015

config SOC
	default "mimxrt1015"

config NUM_IRQS
	default 142

config ARM_DIV
	default 0

config AHB_DIV
	default 0

config IPG_DIV
	default 3

config DCDC_VALUE
	default 0x12

config GPIO
	default y

endif # SOC_MIMXRT1015
```

## soc/arm/nxp_imx/rt/Kconfig.defconfig.mimxrt1021
```kconfig
# i.MX RT1021

# Copyright (c) 2018, NXP
# SPDX-License-Identifier: Apache-2.0

if SOC_MIMXRT1021

config SOC
	default "mimxrt1021"

config NUM_IRQS
	default 142

config ARM_DIV
	default 0

config AHB_DIV
	default 0

config IPG_DIV
	default 3

config DCDC_VALUE
	default 0x12

config GPIO
	default y

endif # SOC_MIMXRT1021
```

## soc/arm/nxp_imx/rt/Kconfig.defconfig.mimxrt1024
```kconfig
# i.MX RT1024

# Copyright (c) 2020, NXP
# SPDX-License-Identifier: Apache-2.0

if SOC_MIMXRT1024

config SOC
	default "mimxrt1024"

config NUM_IRQS
	default 142

config DCDC_VALUE
	default 0x12

config GPIO
	default y

endif # SOC_MIMXRT1024
```

## soc/arm/nxp_imx/rt/Kconfig.defconfig.mimxrt1042
```kconfig
# Copyright 2023 NXP
# SPDX-License-Identifier: Apache-2.0

if SOC_MIMXRT1042

config SOC
	default "mimxrt1042"

config NUM_IRQS
	default 157

config GPIO
	default y

# Set DCDC to 1.275V for 600 MHz AHB operation
config DCDC_VALUE
	default 0x13

endif # SOC_MIMXRT1042
```

## soc/arm/nxp_imx/rt/Kconfig.defconfig.mimxrt1052
```kconfig
# i.MX RT1052

# Copyright (c) 2017, NXP
# SPDX-License-Identifier: Apache-2.0

if SOC_MIMXRT1052

config SOC
	default "mimxrt1052"

config NUM_IRQS
	default 160

config GPIO
	default y

endif # SOC_MIMXRT1052
```

## soc/arm/nxp_imx/rt/Kconfig.defconfig.mimxrt1062
```kconfig
# i.MX RT1062

# Copyright (c) 2018, NXP
# SPDX-License-Identifier: Apache-2.0

if SOC_MIMXRT1062

config SOC
	default "mimxrt1062"

config NUM_IRQS
	default 160

config GPIO
	default y

endif # SOC_MIMXRT1062
```

## soc/arm/nxp_imx/rt/Kconfig.defconfig.mimxrt1064
```kconfig
# i.MX RT1064

# Copyright (c) 2018, NXP
# SPDX-License-Identifier: Apache-2.0

if SOC_MIMXRT1064

config SOC
	default "mimxrt1064"

config NUM_IRQS
	default 160

config ARM_DIV
	default 1

config AHB_DIV
	default 0

config IPG_DIV
	default 3

config GPIO
	default y

endif # SOC_MIMXRT1064
```

## soc/arm/nxp_imx/rt/Kconfig.defconfig.mimxrt1166_cm4
```kconfig
# i.MX RT1160 CM4

# Copyright (c) 2021, NXP
# SPDX-License-Identifier: Apache-2.0

if SOC_MIMXRT1166_CM4

config SOC
	default "mimxrt1166_cm4"

config NUM_IRQS
	default 218

config GPIO
	default y

endif # SOC_MIMXRT1166_CM4
```

## soc/arm/nxp_imx/rt/Kconfig.defconfig.mimxrt1166_cm7
```kconfig
# i.MX RT1160 CM7

# Copyright (c) 2021, NXP
# SPDX-License-Identifier: Apache-2.0

if SOC_MIMXRT1166_CM7

config SOC
	default "mimxrt1166_cm7"

config NUM_IRQS
	default 218

config GPIO
	default y

endif # SOC_MIMXRT1166_CM7
```

## soc/arm/nxp_imx/rt/Kconfig.defconfig.mimxrt1176_cm7
```kconfig
# i.MX RT1170 CM7

# Copyright (c) 2021, NXP
# SPDX-License-Identifier: Apache-2.0

if SOC_MIMXRT1176_CM7

config SOC
	default "mimxrt1176_cm7"

config NUM_IRQS
	default 218

config GPIO
	default y

config SYS_CLOCK_HW_CYCLES_PER_SEC
	default 996000000 if CORTEX_M_SYSTICK

endif # SOC_MIMXRT1176_CM7
```

## soc/arm/nxp_imx/rt/Kconfig.defconfig.series
```kconfig
# i.MX RT series

# Copyright (c) 2017-2021, NXP
# SPDX-License-Identifier: Apache-2.0

if SOC_SERIES_IMX_RT

config SOC_SERIES
	default "rt"

config ROM_START_OFFSET
	default 0x400 if BOOTLOADER_MCUBOOT
	default 0x2000 if BOOT_FLEXSPI_NOR || BOOT_SEMC_NOR

config PINCTRL_IMX
	default y if HAS_MCUX_IOMUXC
	depends on PINCTRL

config ADC_MCUX_12B1MSPS_SAR
	default y if HAS_MCUX_12B1MSPS_SAR
	depends on ADC

config LOG_BACKEND_SWO_FREQ_HZ
	default 7500000
	depends on LOG_BACKEND_SWO

if FLASH_MCUX_FLEXSPI_XIP

# Avoid RWW hazards by defaulting logging to disabled
choice FLASH_LOG_LEVEL_CHOICE
	default FLASH_LOG_LEVEL_OFF
endchoice

choice MEMC_LOG_LEVEL_CHOICE
	default MEMC_LOG_LEVEL_OFF
endchoice

endif

# set the tick per sec as a divider of the GPT clock source
config SYS_CLOCK_TICKS_PER_SEC
	default 4096 if MCUX_GPT_TIMER

DT_SYSCLK_PATH := $(dt_nodelabel_path,sysclk)

config SYS_CLOCK_HW_CYCLES_PER_SEC
	default $(dt_node_int_prop_int,$(DT_SYSCLK_PATH),clock-frequency) if SOC_SERIES_IMX_RT10XX && CORTEX_M_SYSTICK
	default 32768 if MCUX_GPT_TIMER

# Disable systick if using MCUX_GPT_TIMER, as they will conflict
config CORTEX_M_SYSTICK
	default n if MCUX_GPT_TIMER

config PM_MCUX_GPC
	default y if HAS_MCUX_GPC
	depends on SOC_SERIES_IMX_RT11XX && PM

# Don't allow SOC to sleep after tests complete when PM is enabled
config ZTEST_NO_YIELD
	default y if (ZTEST && PM)

if SOC_SERIES_IMX_RT10XX && PM

config CODE_DATA_RELOCATION
	default y

config PM_MCUX_GPC
	default y if HAS_MCUX_GPC

config PM_MCUX_DCDC
	default y if HAS_MCUX_DCDC

config PM_MCUX_PMU
	default y if HAS_MCUX_PMU

endif # SOC_SERIES_IMX_RT10XX && PM

DT_CHOSEN_Z_FLASH := zephyr,flash
DT_COMPAT_FLEXSPI := nxp,imx-flexspi

DT_CHOSEN_FLASH_NODE := $(dt_chosen_path,$(DT_CHOSEN_Z_FLASH))
DT_CHOSEN_FLASH_PARENT := $(dt_node_parent,$(DT_CHOSEN_FLASH_NODE))

DT_FLASH_PARENT_IS_FLEXSPI := $(dt_node_has_compat,$(DT_CHOSEN_FLASH_PARENT),$(DT_COMPAT_FLEXSPI))
DT_FLASH_HAS_SIZE_PROP := $(dt_node_has_prop,$(DT_CHOSEN_FLASH_NODE),size)

config FLASH_BASE_ADDRESS
	default $(dt_node_reg_addr_hex,$(DT_CHOSEN_FLASH_PARENT),1) \
		if $(DT_FLASH_PARENT_IS_FLEXSPI)

config FLASH_SIZE
	default $(dt_node_int_prop_int,$(DT_CHOSEN_FLASH_NODE),size,Kb) \
		if $(DT_FLASH_HAS_SIZE_PROP)

choice USB_MCUX_CONTROLLER_TYPE
	default USB_DC_NXP_EHCI
endchoice

DT_CHOSEN_Z_DTCM := zephyr,dtcm

choice SEGGER_RTT_SECTION
	default SEGGER_RTT_SECTION_DTCM if $(dt_chosen_enabled,$(DT_CHOSEN_Z_DTCM))
	depends on USE_SEGGER_RTT
endchoice

choice SEGGER_SYSVIEW_SECTION
	default SEGGER_SYSVIEW_SECTION_DTCM if $(dt_chosen_enabled,$(DT_CHOSEN_Z_DTCM))
	depends on SEGGER_SYSTEMVIEW
endchoice

#
# MBEDTLS is larger but much faster than TinyCrypt so choose wisely
#
config MBEDTLS
#config TINYCRYPT
	default y if CSPRING_ENABLED
	depends on ENTROPY_GENERATOR

if MBEDTLS
#
# MBEDTLS CTR_DRBG code path needs extra stack space for initialization than
# what the ztest_thread_stack defaults to.
#
config TEST_EXTRA_STACK_SIZE
	int
	default 1024
endif # MBEDTLS

source "soc/arm/nxp_imx/rt/Kconfig.defconfig.mimxrt*"

endif # SOC_SERIES_IMX_RT
```

## soc/arm/nxp_imx/rt/Kconfig.series
```kconfig
# iMX RT series

# Copyright (c) 2017-2021, NXP
# SPDX-License-Identifier: Apache-2.0

config SOC_SERIES_IMX_RT
	bool "i.MX RT Series"
	select ARM
	select SOC_FAMILY_IMX
	select CLOCK_CONTROL
	help
	  Enable support for i.MX RT MCU series
```
