## soc/arm/nxp_imx/rt6xx/Kconfig.soc
```kconfig
# i.MX RT6XX Series

# Copyright (c) 2020, NXP
# SPDX-License-Identifier: Apache-2.0

choice
	prompt "i.MX RT6XX Series MCU Selection"
	depends on SOC_SERIES_IMX_RT6XX

config SOC_MIMXRT685S_CM33
	bool "SOC_MIMXRT685S M33"
	select CPU_HAS_ARM_SAU
	select CPU_HAS_ARM_MPU
	select CPU_HAS_FPU
	select ARMV8_M_DSP
	select ARM_TRUSTZONE_M
	select CPU_CORTEX_M_HAS_SYSTICK
	select HAS_MCUX
	select HAS_MCUX_SYSCON
	select HAS_MCUX_FLEXCOMM
	select HAS_MCUX_FLEXSPI
	select HAS_MCUX_CACHE
	select HAS_MCUX_LPC_DMA
	select HAS_MCUX_LPADC
	select HAS_MCUX_OS_TIMER
	select HAS_MCUX_LPC_RTC
	select HAS_MCUX_TRNG
	select HAS_MCUX_SCTIMER
	select HAS_MCUX_USDHC1
	select HAS_MCUX_USDHC2
	select INIT_SYS_PLL
	select HAS_MCUX_USB_LPCIP3511
	select HAS_MCUX_CTIMER
endchoice

if SOC_SERIES_IMX_RT6XX

config SOC_PART_NUMBER_MIMXRT685SFVKB
	bool

config SOC_PART_NUMBER_MIMXRT685SFFOB
	bool

config SOC_PART_NUMBER_MIMXRT685SFAWBR
	bool

config SOC_PART_NUMBER_IMX_RT6XX
	string
	default "MIMXRT685SFVKB" if SOC_PART_NUMBER_MIMXRT685SFVKB
	default "MIMXRT685SFFOB" if SOC_PART_NUMBER_MIMXRT685SFFOB
	default "MIMXRT685SFAWBR" if SOC_PART_NUMBER_MIMXRT685SFAWBR

	help
	  This string holds the full part number of the SoC. It is a hidden
	  option that you should not set directly. The part number selection
	  choice defines the default value for this string.

config INIT_SYS_PLL
	bool "Initialize SYS PLL"

config INIT_AUDIO_PLL
	bool "Initialize Audio PLL"

config XTAL_SYS_CLK_HZ
	int "External oscillator frequency"
	help
	  Set the external oscillator frequency in Hz. This should be set by the
	  board's defconfig.

config SYSOSC_SETTLING_US
	int "System oscillator settling time"
	help
	  Set the board system oscillator settling time in us. This should be set by the
	  board's defconfig.

menuconfig NXP_IMX_RT6XX_BOOT_HEADER
	bool "Boot header"
	depends on !BOOTLOADER_MCUBOOT
	help
	  Enable data structures required by the boot ROM to boot the
	  application from an external flash device.

if NXP_IMX_RT6XX_BOOT_HEADER

choice BOOT_DEVICE
	prompt "Boot device selection"
	default BOOT_FLEXSPI_NOR

config BOOT_FLEXSPI_NOR
	bool "FlexSPI serial NOR"

endchoice

config FLASH_CONFIG_OFFSET
	hex "Flash config data offset"
	default 0x400
	help
	  The flash config offset provides the boot ROM with the on-board
	  flash type and parameters. The boot ROM requires a fixed flash config
	  offset for FlexSPI device.

config IMAGE_VECTOR_TABLE_OFFSET
	hex "Image vector table offset"
	default 0x1000
	help
	  The Image Vector Table (IVT) provides the boot ROM with pointers to
	  the application entry point and device configuration data. The boot
	  ROM requires a fixed IVT offset for each type of boot device.

endif # NXP_IMX_RT6XX_BOOT_HEADER

config IMXRT6XX_CODE_CACHE
	bool "Code cache"
	default y
	help
	  Enable code cache for FlexSPI region at boot. If this Kconfig is
	  cleared, the CACHE64 controller will be disabled during SOC init

endif # SOC_SERIES_IMX_RT6XX
```

## soc/arm/nxp_kinetis/Kconfig.defconfig
```kconfig
# SPDX-License-Identifier: Apache-2.0

config SERIAL_INIT_PRIORITY
	default 55
	depends on SERIAL

config ADC_INIT_PRIORITY
	default 80 if ADC_MCUX_ADC16_ENABLE_EDMA
	depends on ADC

source "soc/arm/nxp_kinetis/*/Kconfig.defconfig.series"
```

## soc/arm/nxp_kinetis/Kconfig.soc
```kconfig
# Copyright (c) 2016 Intel Corporation
# SPDX-License-Identifier: Apache-2.0

source "soc/arm/nxp_kinetis/*/Kconfig.series"
```

## soc/arm/nxp_kinetis/k0x/Kconfig.soc
```kconfig
# Kconfig - Kinetis K0X MCU line
#
# Copyright (c) 2018 Prevas A/S
#
# SPDX-License-Identifier: Apache-2.0
#

choice
prompt "Kinetis K0x MCU Selection"
depends on SOC_SERIES_KINETIS_K0X

config SOC_MK02F12810
	bool "SOC_MK02F12810"
	select HAS_MCUX
	select HAS_MCUX_ADC16
	select HAS_MCUX_FTM
	select HAS_MCUX_RNGA
	select HAS_MCUX_SIM
	select HAS_OSC
	select HAS_MCG
	select CPU_HAS_FPU
	select SMC_MCUX

endchoice

if SOC_SERIES_KINETIS_K0X

config SOC_PART_NUMBER_MK02FN128VLH10
	bool

config SOC_PART_NUMBER_KINETIS_K0X
	string
	default "MK02FN128VLH10" if SOC_PART_NUMBER_MK02FN128VLH10
	help
	  This string holds the full part number of the SoC. It is a hidden option
	  that you should not set directly. The part number selection choice defines
	  the default value for this string.

config K0X_CORE_CLOCK_DIVIDER
	int "Freescale K0x core clock divider"
	default 1
	help
	  This option specifies the divide value for the K22 processor core clock
	  from the system clock.

config K0X_BUS_CLOCK_DIVIDER
	int "Freescale K0x bus clock divider"
	default 2
	help
	  This option specifies the divide value for the K22 bus clock from the
	  system clock.

config K0X_FLEXBUS_CLOCK_DIVIDER
	int "Freescale K0x FlexBus clock divider"
	default 4
	help
	  This option specifies the divide value for the K22 FlexBus clock from the
	  system clock.

config K0X_FLASH_CLOCK_DIVIDER
	int "Freescale K0X flash clock divider"
	default 5
	help
	  This option specifies the divide value for the K64 flash clock from the
	  system clock.

config SMC_MCUX
	bool "System Management Controller"

config WDOG_INIT
	def_bool y
	# omit prompt to signify a "hidden" option
	help
	  This processor enables the watchdog timer with a short timeout
	  upon reset. Therefore, this requires that the watchdog be configured
	  during reset handling.

endif # SOC_SERIES_KINETIS_K0X
```

## soc/arm/nxp_kinetis/k2x/Kconfig.defconfig.mk22f12
```kconfig
# FSL FRDM K22F platform configuration options

# Copyright (c) 2018 Prevas A/S
# SPDX-License-Identifier: Apache-2.0

if SOC_MK22F51212

config SOC
	default "mk22f51212"

config GPIO
	default y

endif # SOC_MK22F12
```

## soc/arm/nxp_kinetis/k2x/Kconfig.defconfig.mk22fa12
```kconfig
# Kconfig - Kinetis FA12 configuration options
#
# Copyright (c) 2018 Prevas A/S
# Copyright (c) 2019 bytes at work AG
#
# SPDX-License-Identifier: Apache-2.0
#

if SOC_MK22FA12

config SOC
	string
	default "mk22fa12"

if ADC

config ADC_MCUX_ADC16
	default y

endif # ADC

if CAN

config CAN_MCUX_FLEXCAN
	default y

endif # CAN

if CLOCK_CONTROL

config CLOCK_CONTROL_MCUX_SIM
	default y

endif # CLOCK_CONTROL

if PINMUX

config PINMUX_MCUX
	default y

endif # PINMUX

config GPIO
	default y

if GPIO

config GPIO_MCUX
	default y

endif # GPIO

if I2C

config I2C_MCUX
	default y

endif # I2C

if PWM

config PWM_MCUX_FTM
	default y

endif # PWM

if SPI

config SPI_MCUX_DSPI
	default y

endif # SPI

if ENTROPY_GENERATOR

config ENTROPY_MCUX_RNGA
	default y

endif # ENTROPY_GENERATOR

if FLASH

config SOC_FLASH_MCUX
	default y

endif # FLASH

if SERIAL

config UART_MCUX
	default y

endif # SERIAL

if USB

config USB_KINETIS
	default y

endif # USB

if WATCHDOG

config WDT_MCUX_WDOG
	default y

endif # WATCHDOG

endif # SOC_MK22FA12
```

## soc/arm/nxp_kinetis/k2x/Kconfig.defconfig.series
```kconfig
# Kconfig - Kinetis K2x series configuration options
#
# Copyright (c) 2018 Prevas A/S
# Copyright (c) 2019 Thomas Burdick <thomas.burdick@gmail.com>

#
# SPDX-License-Identifier: Apache-2.0
#

if SOC_SERIES_KINETIS_K2X

config SOC_SERIES
	default "k2x"

config NUM_IRQS
	default 74

source "soc/arm/nxp_kinetis/k2x/Kconfig.defconfig.mk*"

endif # SOC_SERIES_KINETIS_K2X
```

## soc/arm/nxp_kinetis/k2x/Kconfig.series
```kconfig
# Kinetis K2X MCU line

# Copyright (c) 2018 Prevas A/S
# Copyright (c) 2019 Thomas Burdick <thomas.burdick@gmail.com>

#
# SPDX-License-Identifier: Apache-2.0
#

config SOC_SERIES_KINETIS_K2X
	bool "Kinetis K2x Series MCU"
	select ARM
	select CPU_CORTEX_M4
	select CPU_CORTEX_M_HAS_DWT
	select SOC_FAMILY_KINETIS
	select CLOCK_CONTROL
	select PLATFORM_SPECIFIC_INIT
	help
	  Enable support for Kinetis K2x MCU series
```

## soc/arm/nxp_kinetis/k2x/Kconfig.soc
```kconfig
# Kconfig - Kinetis K2X MCU line
#
# Copyright (c) 2018 Prevas A/S
# Copyright (c) 2019 Thomas Burdick <thomas.burdick@gmail.com>

#
# SPDX-License-Identifier: Apache-2.0
#

choice
prompt "Kinetis K2x MCU Selection"
depends on SOC_SERIES_KINETIS_K2X

config SOC_MK22F51212
	bool "SOC_MK22F51212"
	select HAS_MCUX
	select HAS_MCUX_SMC
	select HAS_MCUX_ADC16
	select HAS_MCUX_FTFX
	select HAS_MCUX_FTM
	select HAS_MCUX_RNGA
	select HAS_MCUX_SIM
	select HAS_OSC
	select HAS_MCG
	select CPU_HAS_FPU

endchoice

if SOC_SERIES_KINETIS_K2X

config SOC_PART_NUMBER_MK22FN512VLH12
	bool

config SOC_PART_NUMBER_MK22FX512AVLK12
	bool

config SOC_PART_NUMBER_KINETIS_K2X
	string
	default "MK22FN512VLH12" if SOC_PART_NUMBER_MK22FN512VLH12
	help
	  This string holds the full part number of the SoC. It is a hidden option
	  that you should not set directly. The part number selection choice defines
	  the default value for this string.

config K22_CORE_CLOCK_DIVIDER
	int "Freescale K22 core clock divider"
	default 1
	help
	  This option specifies the divide value for the K22 processor core clock
	  from the system clock.

config K22_BUS_CLOCK_DIVIDER
	int "Freescale K22 bus clock divider"
	default 2
	help
	  This option specifies the divide value for the K22 bus clock from the
	  system clock.

config K22_FLEXBUS_CLOCK_DIVIDER
	int "Freescale K22 FlexBus clock divider"
	default 3
	help
	  This option specifies the divide value for the K22 FlexBus clock from the
	  system clock.

config K22_FLASH_CLOCK_DIVIDER
	int "Freescale K22 flash clock divider"
	default 3
	help
	  This option specifies the divide value for the K64 flash clock from the
	  system clock.

config WDOG_INIT
	def_bool y
	help
	  This processor enables the watchdog timer with a short timeout
	  upon reset. Therefore, this requires that the watchdog be configured
	  during reset handling.

endif # SOC_SERIES_KINETIS_K2X
```

## soc/arm/nxp_kinetis/k32l2b/Kconfig.defconfig.k32l2b3
```kconfig
# Kinetis K32L2x SoC configuration options

# Copyright (c) 2019, NXP
# SPDX-License-Identifier: Apache-2.0

if SOC_K32L2B

config SOC
	default "k32l2b31a"

config NUM_IRQS
	default 32

if ADC

config ADC_MCUX_ADC16
	default y

endif # ADC

if CLOCK_CONTROL

config CLOCK_CONTROL_MCUX_SIM
	default y

endif # CLOCK_CONTROL

if PINMUX

config PINMUX_MCUX
	default y

endif # PINMUX

if GPIO

config GPIO_MCUX
	default y

endif # GPIO

if SERIAL

config UART_MCUX_LPUART
	default y

endif # SERIAL

if I2C

config I2C_MCUX
	default y

endif # I2C

if FLASH

config SOC_FLASH_MCUX
	default y

endif # FLASH

if USB

config USB_KINETIS
	default y

endif # USB

endif # SOC_K32L2B
```

## soc/arm/nxp_kinetis/k32l2b/Kconfig.defconfig.series
```kconfig
# Kinetis K32L2B series configuration options

# Copyright (c) 2019, NXP
# SPDX-License-Identifier: Apache-2.0

if SOC_SERIES_KINETIS_K32L2B

config SOC_SERIES
	default "k32l2b"

if KINETIS_FLASH_CONFIG

config KINETIS_FLASH_CONFIG_FOPT
	default 0x3f

endif # KINETIS_FLASH_CONFIG

source "soc/arm/nxp_kinetis/k32l2b/Kconfig.defconfig.k32l2*"

endif # SOC_SERIES_KINETIS_K32L2B
```

## soc/arm/nxp_kinetis/k32l2b/Kconfig.series
```kconfig
# KINETIS K32L2B MCU series

# Copyright (c) 2019, NXP
# SPDX-License-Identifier: Apache-2.0

config SOC_SERIES_KINETIS_K32L2B
	bool "KINETIS K32L2B Series MCU"
	select CPU_CORTEX_M0PLUS
	select SOC_FAMILY_KINETIS
	select CPU_CORTEX_M_HAS_SYSTICK
	select CLOCK_CONTROL
	help
	  Enable support for KINETIS K32L2B MCU series
```

## soc/arm/nxp_kinetis/k32l2b/Kconfig.soc
```kconfig
# KINETIS K32L2B MCU series

# Copyright (c) 2019, NXP
# SPDX-License-Identifier: Apache-2.0

choice
	prompt "KINETIS K32L2B MCU Selection"
	depends on SOC_SERIES_KINETIS_K32L2B

config SOC_K32L2B
	bool "SOC_K32L2B"
	select CPU_CORTEX_M0PLUS
	select HAS_MCUX
	select HAS_MCUX_ADC16
	select HAS_MCUX_FTFX
	select HAS_MCUX_LPUART
	select HAS_MCUX_SIM
	select HAS_MCGLITE

endchoice

if SOC_SERIES_KINETIS_K32L2B

config SOC_PART_NUMBER_K32L2B11VFM0A
	bool

config SOC_PART_NUMBER_K32L2B11VFT0A
	bool

config SOC_PART_NUMBER_K32L2B11VLH0A
	bool

config SOC_PART_NUMBER_K32L2B11VMP0A
	bool

config SOC_PART_NUMBER_K32L2B21VFM0A
	bool

config SOC_PART_NUMBER_K32L2B21VFT0A
	bool

config SOC_PART_NUMBER_K32L2B21VLH0A
	bool

config SOC_PART_NUMBER_K32L2B21VMP0A
	bool

config SOC_PART_NUMBER_K32L2B31VFM0A
	bool

config SOC_PART_NUMBER_K32L2B31VFT0A
	bool

config SOC_PART_NUMBER_K32L2B31VLH0A
	bool

config SOC_PART_NUMBER_K32L2B31VMP0A
	bool

config SOC_PART_NUMBER_KINETIS_K32L2B
	string
	default "K32L2B11VFM0A" if SOC_PART_NUMBER_K32L2B11VFM0A
	default "K32L2B11VFT0A" if SOC_PART_NUMBER_K32L2B11VFT0A
	default "K32L2B11VLH0A" if SOC_PART_NUMBER_K32L2B11VLH0A
	default "K32L2B11VMP0A" if SOC_PART_NUMBER_K32L2B11VMP0A
	default "K32L2B21VFM0A" if SOC_PART_NUMBER_K32L2B21VFM0A
	default "K32L2B21VFT0A" if SOC_PART_NUMBER_K32L2B21VFT0A
	default "K32L2B21VLH0A" if SOC_PART_NUMBER_K32L2B21VLH0A
	default "K32L2B21VMP0A" if SOC_PART_NUMBER_K32L2B21VMP0A
	default "K32L2B31VFM0A" if SOC_PART_NUMBER_K32L2B31VFM0A
	default "K32L2B31VFT0A" if SOC_PART_NUMBER_K32L2B31VFT0A
	default "K32L2B31VLH0A" if SOC_PART_NUMBER_K32L2B31VLH0A
	default "K32L2B31VMP0A" if SOC_PART_NUMBER_K32L2B31VMP0A
	help
	  This string holds the full part number of the SoC. It is a hidden option
	  that you should not set directly. The part number selection choice defines
	  the default value for this string.

endif # SOC_SERIES_KINETIS_K32L2B
```

## soc/arm/nxp_kinetis/k6x/Kconfig.defconfig.mk64f12
```kconfig
# FSL FRDM K64F platform configuration options

# Copyright (c) 2014-2016 Wind River Systems, Inc.
# SPDX-License-Identifier: Apache-2.0

if SOC_MK64F12

config SOC
	default "mk64f12"

config NUM_IRQS
	# must be >= the highest interrupt number used
	default 86

config GPIO
	default y

config SPI
	default n

endif # SOC_MK64F12
```

## soc/arm/nxp_kinetis/k6x/Kconfig.defconfig.mk66f18
```kconfig
# FSL SEGGER K66F platform configuration options

# Copyright (c) 2020 DENX Software Engineering GmbH, 2021 Electromaticus LLC, 2021 NXP
# SPDX-License-Identifier: Apache-2.0

if SOC_MK66F18

config SOC
	default "mk66f18"

config NUM_IRQS
	# must be >= the highest interrupt number used
	default 100

config GPIO
	default y

endif # SOC_MK66F18
```

## soc/arm/nxp_kinetis/k6x/Kconfig.defconfig.series
```kconfig
# Kinetis K6x series configuration options

# Copyright (c) 2014-2016 Wind River Systems, Inc.
# SPDX-License-Identifier: Apache-2.0

if SOC_SERIES_KINETIS_K6X

config SOC_SERIES
	default "k6x"

config CPU_HAS_CUSTOM_FIXED_SOC_MPU_REGIONS
	default y

source "soc/arm/nxp_kinetis/k6x/Kconfig.defconfig.mk*"

endif # SOC_SERIES_KINETIS_K6X
```

## soc/arm/nxp_kinetis/k6x/Kconfig.series
```kconfig
# Kinetis K6X MCU line

# Copyright (c) 2016 Open-RnD Sp. z o.o.
# SPDX-License-Identifier: Apache-2.0

config SOC_SERIES_KINETIS_K6X
	bool "Kinetis K6x Series MCU"
	select ARM
	select CPU_CORTEX_M4
	select CPU_CORTEX_M_HAS_DWT
	select SOC_FAMILY_KINETIS
	select CPU_HAS_NXP_MPU
	select HAS_MCUX_PIT
	select CLOCK_CONTROL
	select PLATFORM_SPECIFIC_INIT
	help
	  Enable support for Kinetis K6x MCU series
```
