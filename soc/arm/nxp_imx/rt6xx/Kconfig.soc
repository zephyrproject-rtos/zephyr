## soc/arm/nxp_kinetis/k6x/Kconfig.soc
```kconfig
# Kconfig - Kinetis K6X MCU line
#
# Copyright (c) 2016 Open-RnD Sp. z o.o.
#
# SPDX-License-Identifier: Apache-2.0
#

choice
prompt "Kinetis K6x MCU Selection"
depends on SOC_SERIES_KINETIS_K6X

config SOC_MK64F12
	bool "SOC_MK64F12"
	select HAS_MCUX
	select HAS_MCUX_ADC16
	select HAS_MCUX_ENET
	select HAS_MCUX_FLEXCAN
	select HAS_MCUX_FTFX
	select HAS_MCUX_FTM
	select HAS_MCUX_RNGA
	select HAS_MCUX_SIM
	select HAS_OSC
	select HAS_MCG
	select CPU_HAS_FPU

endchoice

if SOC_SERIES_KINETIS_K6X

config SOC_PART_NUMBER_MK64FN1M0CAJ12
	bool

config SOC_PART_NUMBER_MK64FN1M0VDC12
	bool

config SOC_PART_NUMBER_MK64FN1M0VLL12
	bool

config SOC_PART_NUMBER_MK64FN1M0VLQ12
	bool

config SOC_PART_NUMBER_MK64FN1M0VMD12
	bool

config SOC_PART_NUMBER_MK64FX512VDC12
	bool

config SOC_PART_NUMBER_MK64FX512VLL12
	bool

config SOC_PART_NUMBER_MK64FX512VLQ12
	bool

config SOC_PART_NUMBER_MK64FX512VMD12
	bool

config SOC_PART_NUMBER_KINETIS_K6X
	string
	default "MK64FN1M0CAJ12" if SOC_PART_NUMBER_MK64FN1M0CAJ12
	default "MK64FN1M0VDC12" if SOC_PART_NUMBER_MK64FN1M0VDC12
	default "MK64FN1M0VLL12" if SOC_PART_NUMBER_MK64FN1M0VLL12
	default "MK64FN1M0VLQ12" if SOC_PART_NUMBER_MK64FN1M0VLQ12
	default "MK64FN1M0VMD12" if SOC_PART_NUMBER_MK64FN1M0VMD12
	default "MK64FX512VDC12" if SOC_PART_NUMBER_MK64FX512VDC12
	default "MK64FX512VLL12" if SOC_PART_NUMBER_MK64FX512VLL12
	default "MK64FX512VLQ12" if SOC_PART_NUMBER_MK64FX512VLQ12
	default "MK64FX512VMD12" if SOC_PART_NUMBER_MK64FX512VMD12
	help
	  This string holds the full part number of the SoC. It is a hidden option
	  that you should not set directly. The part number selection choice defines
	  the default value for this string.

config K64_CORE_CLOCK_DIVIDER
	int "Freescale K64 core clock divider"
	default 1
	help
	  This option specifies the divide value for the K64 processor core clock
	  from the system clock.

config K64_BUS_CLOCK_DIVIDER
	int "Freescale K64 bus clock divider"
	default 2
	help
	  This option specifies the divide value for the K64 bus clock from the
	  system clock.

config K64_FLEXBUS_CLOCK_DIVIDER
	int "Freescale K64 FlexBus clock divider"
	default 3
	help
	  This option specifies the divide value for the K64 FlexBus clock from the
	  system clock.

config K64_FLASH_CLOCK_DIVIDER
	int "Freescale K64 flash clock divider"
	default 5
	help
	  This option specifies the divide value for the K64 flash clock from the
	  system clock.

config WDOG_INIT
	def_bool y
	help
	  This processor enables the watchdog timer with a short timeout
	  upon reset. Therefore, this requires that the watchdog be configured
	  during reset handling.

endif # SOC_SERIES_KINETIS_K6X
```

## soc/arm/nxp_kinetis/k8x/Kconfig.defconfig.mk80f25615
```kconfig
# Kinetis K80F25615 configuration options

# Copyright (c) 2019 SEAL AG
# SPDX-License-Identifier: Apache-2.0

config SOC
	default "mk80f25615"
	depends on SOC_MK80F25615
```

## soc/arm/nxp_kinetis/k8x/Kconfig.defconfig.mk82f25615
```kconfig
# Kinetis K82F25615 configuration options

# Copyright (c) 2019 SEAL AG
# SPDX-License-Identifier: Apache-2.0

config SOC
	default "mk82f25615"
	depends on SOC_MK82F25615
```

## soc/arm/nxp_kinetis/k8x/Kconfig.defconfig.series
```kconfig
# Kinetis K8x series configuration options

# Copyright (c) 2019 SEAL AG
# SPDX-License-Identifier: Apache-2.0

if SOC_SERIES_KINETIS_K8X

config SOC_SERIES
	default "k8x"

config NUM_IRQS
	# must be >= the highest interrupt number used
	default 106

config CPU_HAS_CUSTOM_FIXED_SOC_MPU_REGIONS
	default y

config KINETIS_FLASH_CONFIG_FOPT
	default 0x3f
	depends on KINETIS_FLASH_CONFIG

config GPIO
	default y

source "soc/arm/nxp_kinetis/k8x/Kconfig.defconfig.mk*"

endif # SOC_SERIES_KINETIS_K8X
```

## soc/arm/nxp_kinetis/k8x/Kconfig.series
```kconfig
# Kinetis K8x series MCU

# Copyright (c) 2019 SEAL AG
# SPDX-License-Identifier: Apache-2.0

config SOC_SERIES_KINETIS_K8X
	bool "Kinetis K8x Series MCU"
	select ARM
	select CPU_CORTEX_M4
	select CPU_CORTEX_M_HAS_DWT
	select SOC_FAMILY_KINETIS
	select CPU_HAS_NXP_MPU
	select CPU_HAS_FPU
	select CLOCK_CONTROL
	select HAS_MCUX
	select HAS_MCUX_ADC16
	select HAS_MCUX_FTFX
	select HAS_MCUX_FTM
	select HAS_MCUX_LPUART
	select HAS_MCUX_PIT
	select HAS_MCUX_RTC
	select HAS_MCUX_SIM
	select HAS_MCUX_TRNG
	select HAS_OSC
	select HAS_MCG
	help
	  Enable support for Kinetis K8x MCU series
```

## soc/arm/nxp_kinetis/k8x/Kconfig.soc
```kconfig
# Kinetis K8x series MCU

# Copyright (c) 2019 SEAL AG
# SPDX-License-Identifier: Apache-2.0

choice
	prompt "Kinetis K8x MCU Selection"
	depends on SOC_SERIES_KINETIS_K8X

config SOC_MK80F25615
	bool "MK80F25615"

config SOC_MK82F25615
	bool "MK82F25615"

endchoice

if SOC_SERIES_KINETIS_K8X

config SOC_PART_NUMBER_MK80FN256VDC15
	bool

config SOC_PART_NUMBER_MK80FN256VLL15
	bool

config SOC_PART_NUMBER_MK82FN256VDC15
	bool

config SOC_PART_NUMBER_MK82FN256VLL15
	bool

config SOC_PART_NUMBER_KINETIS_K8X
	string
	default "MK80FN256VDC15" if SOC_PART_NUMBER_MK80FN256VDC15
	default "MK80FN256VLL15" if SOC_PART_NUMBER_MK80FN256VLL15
	default "MK82FN256VDC15" if SOC_PART_NUMBER_MK82FN256VDC15
	default "MK82FN256VLL15" if SOC_PART_NUMBER_MK82FN256VLL15
	help
	  This string holds the full part number of the SoC. It is a
	  hidden option that you should not set directly. The part
	  number selection choice defines the default value for this
	  string.

endif # SOC_SERIES_KINETIS_K8X
```

## soc/arm/nxp_kinetis/ke1xf/Kconfig.defconfig.mke14f16
```kconfig
# Kinetis KE14F16 configuration options

# Copyright (c) 2019 Vestas Wind Systems A/S
# SPDX-License-Identifier: Apache-2.0

config SOC
	default "mke14f16"
	depends on SOC_MKE14F16
```

## soc/arm/nxp_kinetis/ke1xf/Kconfig.defconfig.mke16f16
```kconfig
# Kinetis KE16F16 configuration options

# Copyright (c) 2019 Vestas Wind Systems A/S
# SPDX-License-Identifier: Apache-2.0

if SOC_MKE16F16

config SOC
	default "mke16f16"

config CAN_MCUX_FLEXCAN
	default y
	depends on CAN

endif # SOC_MKE16F16
```
