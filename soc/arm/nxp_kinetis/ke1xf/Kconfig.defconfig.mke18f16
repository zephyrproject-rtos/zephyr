## soc/arm/nxp_kinetis/ke1xf/Kconfig.defconfig.mke18f16
```kconfig
# Kinetis KE18F16 configuration options

# Copyright (c) 2019 Vestas Wind Systems A/S
# SPDX-License-Identifier: Apache-2.0

if SOC_MKE18F16

config SOC
	default "mke18f16"

endif # SOC_MKE18F16
```

## soc/arm/nxp_kinetis/ke1xf/Kconfig.defconfig.series
```kconfig
# Kinetis KE1xF series configuration options

# Copyright (c) 2019-2021 Vestas Wind Systems A/S
# SPDX-License-Identifier: Apache-2.0

if SOC_SERIES_KINETIS_KE1XF

config SOC_SERIES
	default "ke1xf"

config MCUX_LPTMR_TIMER
	default y if PM

config CORTEX_M_SYSTICK
	default n if MCUX_LPTMR_TIMER

config SYS_CLOCK_HW_CYCLES_PER_SEC
	default $(dt_node_int_prop_int,/cpus/cpu@0,clock-frequency) if CORTEX_M_SYSTICK
	default $(dt_node_int_prop_int,/soc/lptmr@40040000,clock-frequency) if MCUX_LPTMR_TIMER

config NUM_IRQS
	# must be >= the highest interrupt number used
	default 91

config CPU_HAS_CUSTOM_FIXED_SOC_MPU_REGIONS
	default y

config KINETIS_FLASH_CONFIG_FOPT
	default 0x7d
	depends on KINETIS_FLASH_CONFIG

config WDT_MCUX_WDOG32
	default y
	depends on WATCHDOG

if COUNTER

config COUNTER_MCUX_RTC
	default y

config COUNTER_MCUX_LPTMR
	default y

endif # COUNTER

config PWM_MCUX_PWT
	default y
	depends on PWM_CAPTURE

config GPIO
	default y

config SOC_FLASH_MCUX
	default y
	depends on FLASH

config ADC_MCUX_ADC12
	default y
	depends on ADC

config DAC_MCUX_DAC32
	default y
	depends on DAC

config DMA_MCUX_EDMA
	default y
	depends on DMA

source "soc/arm/nxp_kinetis/ke1xf/Kconfig.defconfig.mke*"

endif # SOC_SERIES_KINETIS_KE1XF
```

## soc/arm/nxp_kinetis/ke1xf/Kconfig.series
```kconfig
# Kinetis KE1xF series MCU

# Copyright (c) 2019 Vestas Wind Systems A/S
# SPDX-License-Identifier: Apache-2.0

config SOC_SERIES_KINETIS_KE1XF
	bool "Kinetis KE1xF Series MCU"
	select ARM
	select CPU_CORTEX_M4
	select CPU_CORTEX_M_HAS_DWT
	select SOC_FAMILY_KINETIS
	select CPU_HAS_NXP_MPU
	select CPU_HAS_FPU
	select CLOCK_CONTROL
	select HAS_MCUX
	select HAS_MCUX_CACHE
	select HAS_MCUX_FTFX
	select HAS_MCUX_LPI2C
	select HAS_MCUX_LPSPI
	select HAS_MCUX_LPUART
	select HAS_MCUX_PCC
	select HAS_MCUX_RTC
	select HAS_MCUX_SIM
	select HAS_MCUX_ADC12
	select HAS_MCUX_SCG
	select HAS_MCUX_WDOG32
	select HAS_MCUX_FTM
	select HAS_MCUX_LPTMR
	select HAS_MCUX_DAC32
	select HAS_MCUX_EDMA
	select HAS_MCUX_ACMP
	select HAS_MCUX_PWT
	select HAS_MCUX_RCM
	help
	  Enable support for Kinetis KE1xF MCU series
```

## soc/arm/nxp_kinetis/ke1xf/Kconfig.soc
```kconfig
# Kinetis KE1xF MCU line

# Copyright (c) 2019 Vestas Wind Systems A/S
# SPDX-License-Identifier: Apache-2.0

choice
	prompt "Kinetis KE1xF MCU Selection"
	depends on SOC_SERIES_KINETIS_KE1XF

config SOC_MKE14F16
	bool "MKE14F16"

config SOC_MKE16F16
	bool "MKE16F16"
	select HAS_MCUX_FLEXCAN

config SOC_MKE18F16
	bool "MKE18F16"
	select HAS_MCUX_FLEXCAN

endchoice

if SOC_SERIES_KINETIS_KE1XF

config SOC_PART_NUMBER_MKE14F256VLH16
	bool

config SOC_PART_NUMBER_MKE14F256VLL16
	bool

config SOC_PART_NUMBER_MKE14F512VLH16
	bool

config SOC_PART_NUMBER_MKE14F512VLL16
	bool

config SOC_PART_NUMBER_MKE16F256VLH16
	bool

config SOC_PART_NUMBER_MKE16F256VLL16
	bool

config SOC_PART_NUMBER_MKE16F512VLH16
	bool

config SOC_PART_NUMBER_MKE16F512VLL16
	bool

config SOC_PART_NUMBER_MKE18F256VLH16
	bool

config SOC_PART_NUMBER_MKE18F256VLL16
	bool

config SOC_PART_NUMBER_MKE18F512VLH16
	bool

config SOC_PART_NUMBER_MKE18F512VLL16
	bool

config SOC_PART_NUMBER_KINETIS_KE1XF
	string
	default "MKE14F256VLH16" if SOC_PART_NUMBER_MKE14F256VLH16
	default "MKE14F256VLL16" if SOC_PART_NUMBER_MKE14F256VLL16
	default "MKE14F512VLH16" if SOC_PART_NUMBER_MKE14F512VLH16
	default "MKE14F512VLL16" if SOC_PART_NUMBER_MKE14F512VLL16
	default "MKE16F256VLH16" if SOC_PART_NUMBER_MKE16F256VLH16
	default "MKE16F256VLL16" if SOC_PART_NUMBER_MKE16F256VLL16
	default "MKE16F512VLH16" if SOC_PART_NUMBER_MKE16F512VLH16
	default "MKE16F512VLL16" if SOC_PART_NUMBER_MKE16F512VLL16
	default "MKE18F256VLH16" if SOC_PART_NUMBER_MKE18F256VLH16
	default "MKE18F256VLL16" if SOC_PART_NUMBER_MKE18F256VLL16
	default "MKE18F512VLH16" if SOC_PART_NUMBER_MKE18F512VLH16
	default "MKE18F512VLL16" if SOC_PART_NUMBER_MKE18F512VLL16
	help
	  This string holds the full part number of the SoC. It is a
	  hidden option that you should not set directly. The part
	  number selection choice defines the default value for this
	  string.

config WDOG_ENABLE_AT_BOOT
	bool "Keep watchdog timer enabled at boot"
	depends on WDOG_INIT
	help
	  Keep the watchdog timer enabled at boot with the internal
	  128kHz LPO clock (and a prescaler of 256) as clock
	  source. The application can take over control of the
	  watchdog timer after boot and install a different timeout,
	  if needed.

config WDOG_INITIAL_TIMEOUT
	int "Initial timeout for the watchdog timer in milliseconds"
	depends on WDOG_ENABLE_AT_BOOT
	range 2 131070
	default 2048
	help
	  Initial timeout value for the watchdog timer in
	  milliseconds.

config KINETIS_KE1XF_ENABLE_CODE_CACHE
	bool "Code cache"
	default y

endif # SOC_SERIES_KINETIS_KE1XF
```

## soc/arm/nxp_kinetis/kl2x/Kconfig.defconfig.mkl25z4
```kconfig
# Kinetis KL2x SoC configuration options

# Copyright (c) 2017, NXP
# SPDX-License-Identifier: Apache-2.0

if SOC_MKL25Z4

config SOC
	default "mkl25z4"

config NUM_IRQS
	default 32

endif # SOC_MKL25Z
```

## soc/arm/nxp_kinetis/kl2x/Kconfig.defconfig.series
```kconfig
# Kconfig - Kinetis KL2x series configuration options
#
# Copyright (c) 2017, NXP
#
# SPDX-License-Identifier: Apache-2.0
#

if SOC_SERIES_KINETIS_KL2X

config SOC_SERIES
	default "kl2x"

source "soc/arm/nxp_kinetis/kl2x/Kconfig.defconfig.mk*"

endif # SOC_SERIES_KINETIS_KL2X
```

## soc/arm/nxp_kinetis/kl2x/Kconfig.series
```kconfig
# Kconfig - Kinetis KL2x MCU series
#
# Copyright (c) 2017, NXP
#
# SPDX-License-Identifier: Apache-2.0
#

config SOC_SERIES_KINETIS_KL2X
	bool "Kinetis KL2x Series MCU"
	select CPU_CORTEX_M0PLUS
	select SOC_FAMILY_KINETIS
	select CPU_CORTEX_M_HAS_SYSTICK
	select CLOCK_CONTROL
	help
	 Enable support for Kinetis KL2x MCU series
```

## soc/arm/nxp_kinetis/kl2x/Kconfig.soc
```kconfig
# Kinetis KL2x MCU series

# Copyright (c) 2017, NXP
# SPDX-License-Identifier: Apache-2.0

choice
	prompt "Kinetis KL2x MCU Selection"
	depends on SOC_SERIES_KINETIS_KL2X

config SOC_MKL25Z4
	bool "SOC_MKL25Z4"
	select CPU_CORTEX_M0PLUS
	select HAS_MCUX
	select HAS_MCUX_ADC16
	select HAS_MCUX_FTFX
	select HAS_MCUX_LPSCI
	select HAS_MCUX_SIM
	select HAS_OSC
	select HAS_MCG
	select HAS_MCUX_RCM

endchoice

if SOC_SERIES_KINETIS_KL2X

config SOC_PART_NUMBER_MKL25Z32VFM4
	bool

config SOC_PART_NUMBER_MKL25Z64VFM4
	bool

config SOC_PART_NUMBER_MKL25Z128VFM4
	bool

config SOC_PART_NUMBER_MKL25Z32VFT4
	bool

config SOC_PART_NUMBER_MKL25Z64VFT4
	bool

config SOC_PART_NUMBER_MKL25Z128VFT4
	bool

config SOC_PART_NUMBER_MKL25Z32VLH4
	bool

config SOC_PART_NUMBER_MKL25Z64VLH4
	bool

config SOC_PART_NUMBER_MKL25Z128VLH4
	bool

config SOC_PART_NUMBER_MKL25Z32VLK4
	bool

config SOC_PART_NUMBER_MKL25Z64VLK4
	bool

config SOC_PART_NUMBER_MKL25Z128VLK4
	bool

config SOC_PART_NUMBER_KINETIS_KL2X
	string
	default "MKL25Z32VFM4" if SOC_PART_NUMBER_MKL25Z32VFM4
	default "MKL25Z64VFM4" if SOC_PART_NUMBER_MKL25Z64VFM4
	default "MKL25Z128VFM4" if SOC_PART_NUMBER_MKL25Z128VFM4
	default "MKL25Z32VFT4" if SOC_PART_NUMBER_MKL25Z32VFT4
	default "MKL25Z64VFT4" if SOC_PART_NUMBER_MKL25Z64VFT4
	default "MKL25Z128VFT4" if SOC_PART_NUMBER_MKL25Z128VFT4
	default "MKL25Z32VLH4" if SOC_PART_NUMBER_MKL25Z32VLH4
	default "MKL25Z64VLH4" if SOC_PART_NUMBER_MKL25Z64VLH4
	default "MKL25Z128VLH4" if SOC_PART_NUMBER_MKL25Z128VLH4
	default "MKL25Z32VLK4" if SOC_PART_NUMBER_MKL25Z32VLK4
	default "MKL25Z64VLK4" if SOC_PART_NUMBER_MKL25Z64VLK4
	default "MKL25Z128VLK4" if SOC_PART_NUMBER_MKL25Z128VLK4
	help
	  This string holds the full part number of the SoC. It is a hidden option
	  that you should not set directly. The part number selection choice defines
	  the default value for this string.

endif # SOC_SERIES_KINETIS_KL2X
```

## soc/arm/nxp_kinetis/kl4x/Kconfig.defconfig.series
```kconfig
# Kinetis KL4x series configuration options
#
# Copyright (c) 2017, NXP
#
# SPDX-License-Identifier: Apache-2.0
#

if SOC_SERIES_KINETIS_KL4X

config SOC_SERIES
	default "kl4x"

source "soc/arm/nxp_kinetis/kl4x/Kconfig.defconfig.mk*"

endif # SOC_SERIES_KINETIS_KL4X
```

## soc/arm/nxp_kinetis/kl4x/Kconfig.series
```kconfig
# Kinetis KL4x MCU series
#
# Copyright (c) 2017, NXP
#
# SPDX-License-Identifier: Apache-2.0
#

config SOC_SERIES_KINETIS_KL4X
	bool "Kinetis KL4x Series MCU"
	select CPU_CORTEX_M0PLUS
	select SOC_FAMILY_KINETIS
	select CPU_CORTEX_M_HAS_SYSTICK
	select CLOCK_CONTROL
	help
	 Enable support for Kinetis KL2x MCU series
```

## soc/arm/nxp_kinetis/kl4x/Kconfig.soc
```kconfig
# Kinetis KL4x MCU series
#
# Copyright (c) 2017, NXP
#
# SPDX-License-Identifier: Apache-2.0
#

choice
prompt "Kinetis KL4x MCU Selection"
depends on SOC_SERIES_KINETIS_KL4X

config SOC_MKL46Z4
	bool "SOC_MKL46Z4"
	select CPU_CORTEX_M0PLUS
	select HAS_MCUX
	select HAS_MCUX_ADC16
	select HAS_MCUX_FTFX
	select HAS_MCUX_LPSCI
	select HAS_MCUX_SIM
	select HAS_OSC
	select HAS_MCG

endchoice

if SOC_SERIES_KINETIS_KL4X

config SOC_PART_NUMBER_MKL46Z256VLL4
	bool

config SOC_PART_NUMBER_KINETIS_KL4X
	string
	default "MKL46Z256VLL4" if SOC_PART_NUMBER_MKL46Z256VLL4
	help
	  This string holds the full part number of the SoC. It is a hidden option
	  that you should not set directly. The part number selection choice defines
	  the default value for this string.

endif # SOC_SERIES_KINETIS_KL4X
```

## soc/arm/nxp_kinetis/ks2x/Kconfig.defconfig.mks22f12
```kconfig
# FSL FRDM KS22F platform configuration options

# Copyright (c) 2018 Prevas A/S
# Copyright (c) 2020 Rick Talbott <rtalbott@fastmail.com>
# SPDX-License-Identifier: Apache-2.0

if SOC_MKS22F12

config SOC
	default "mks22f12"

config ADC_MCUX_ADC16
	default y
	depends on ADC

config CLOCK_CONTROL_MCUX_SIM
	default y
	depends on CLOCK_CONTROL

config PINMUX_MCUX
	default y
	depends on PINMUX

config GPIO
	default y

config GPIO_MCUX
	default y
	depends on GPIO

config I2C_MCUX_LPI2C
	default y
	depends on I2C

config PWM_MCUX_TPM
	default y
	depends on PWM

config SPI_MCUX_LPSPI
	default y
	depends on SPI

config ENTROPY_MCUX_RNGA
	default y
	depends on ENTROPY_GENERATOR

config SOC_FLASH_MCUX
	default y
	depends on FLASH

config USB_KINETIS
	default y
	depends on USB

config WDT_MCUX_WDOG
	default y
	depends on WATCHDOG

endif # SOC_MKS22FN256
```

## soc/arm/nxp_kinetis/ks2x/Kconfig.defconfig.series
```kconfig
# Kinetis K2x series configuration options

# Copyright (c) 2018 Prevas A/S
# Copyright (c) 2019 Thomas Burdick <thomas.burdick@gmail.com>
# Copyright (c) 2020 Rick Talbott <rtalbott@fastmail.com>

#
# SPDX-License-Identifier: Apache-2.0
#

if SOC_SERIES_KINETIS_KS2X

config SOC_SERIES
	default "ks2x"

config NUM_IRQS
	default 74

source "soc/arm/nxp_kinetis/ks2x/Kconfig.defconfig.mk*"

endif # SOC_SERIES_KINETIS_KS2X
```

## soc/arm/nxp_kinetis/ks2x/Kconfig.soc
```kconfig
# Kinetis KS2X MCU line

# Copyright (c) 2018 Prevas A/S
# Copyright (c) 2019 Thomas Burdick <thomas.burdick@gmail.com>
# Copyright (c) 2020 Rick Talbott <rtalbott@fastmail.com>

#
# SPDX-License-Identifier: Apache-2.0
#

choice
	prompt "Kinetis KS2x MCU Selection"
	depends on SOC_SERIES_KINETIS_KS2X

config SOC_MKS22F12
	bool "SOC_MKS22F12"
	select HAS_MCUX
	select HAS_MCUX_SMC
	select HAS_MCUX_ADC16
	select HAS_MCUX_FTFX
	select HAS_MCUX_TPM
	select HAS_MCUX_RNGA
	select HAS_MCUX_SIM
	select HAS_OSC
	select HAS_MCG
	select CPU_HAS_FPU

endchoice

if SOC_SERIES_KINETIS_KS2X

config SOC_PART_NUMBER_MKS22FN256VLH12
	bool

config SOC_PART_NUMBER_MKS22FX256AVLK12
	bool

config SOC_PART_NUMBER_KINETIS_KS2X
	string
	default "MKS22FN256VLH12" if SOC_PART_NUMBER_MKS22FN256VLH12
	help
	  This string holds the full part number of the SoC. It is a hidden option
	  that you should not set directly. The part number selection choice defines
	  the default value for this string.

config KS22_CORE_CLOCK_DIVIDER
	int "Freescale KS22 core clock divider"
	default 1
	help
	  This option specifies the divide value for the KS22 processor core clock
	  from the system clock.

config KS22_BUS_CLOCK_DIVIDER
	int "Freescale KS22 bus clock divider"
	default 2
	help
	  This option specifies the divide value for the KS22 bus clock from the
	  system clock.

config KS22_FLEXBUS_CLOCK_DIVIDER
	int "Freescale KS22 FlexBus clock divider"
	default 2
	help
	  This option specifies the divide value for the KS22 FlexBus clock from the
	  system clock.

config KS22_FLASH_CLOCK_DIVIDER
	int "Freescale KS22 flash clock divider"
	default 4
	help
	  This option specifies the divide value for the KS64 flash clock from the
	  system clock.

endif # SOC_SERIES_KINETIS_KS2X
```

## soc/arm/nxp_kinetis/kv5x/Kconfig.defconfig.mkv56f24
```kconfig
# Kinetis KV56F24 configuration options

# Copyright (c) 2019 SEAL AG
# SPDX-License-Identifier: Apache-2.0

config SOC
	default "mkv56f24"
	depends on SOC_MKV56F24
```

## soc/arm/nxp_kinetis/kv5x/Kconfig.defconfig.mkv58f24
```kconfig
# Kinetis KV58F24 configuration options

# Copyright (c) 2019 SEAL AG
# SPDX-License-Identifier: Apache-2.0

if SOC_MKV58F24

config SOC
	default "mkv58f24"

endif # SOC_MKV58F24
```

## soc/arm/nxp_kinetis/kv5x/Kconfig.defconfig.series
```kconfig
# Kinetis KV5x series configuration options

# Copyright (c) 2019 SEAL AG
# SPDX-License-Identifier: Apache-2.0

if SOC_SERIES_KINETIS_KV5X

config SOC_SERIES
	default "kv5x"

config NUM_IRQS
	# must be >= the highest interrupt number used
	default 121

config ADC_MCUX_ADC16
	default y
	depends on ADC

config SOC_FLASH_MCUX
	default y
	depends on FLASH

config GPIO
	default y

source "soc/arm/nxp_kinetis/kv5x/Kconfig.defconfig.mkv*"

endif # SOC_SERIES_KINETIS_KV5X
```

## soc/arm/nxp_kinetis/kv5x/Kconfig.series
```kconfig
# Kinetis KV5x series MCU

# Copyright (c) 2019 SEAL AG
# SPDX-License-Identifier: Apache-2.0

config SOC_SERIES_KINETIS_KV5X
	bool "Kinetis KV5x Series MCU"
	select ARM
	select CPU_CORTEX_M7
	select CPU_CORTEX_M_HAS_DWT
	select SOC_FAMILY_KINETIS
	select CPU_HAS_ARM_MPU
	select CPU_HAS_FPU
	select CLOCK_CONTROL
	select HAS_MCUX
	select HAS_MCUX_ADC16
	select HAS_MCUX_FTFX
	select HAS_MCUX_FTM
	select HAS_MCUX_SIM
	select HAS_OSC
	select HAS_MCG
	select HAS_MCUX_RCM
	select PLATFORM_SPECIFIC_INIT
	help
	  Enable support for Kinetis KV5x MCU series
```
