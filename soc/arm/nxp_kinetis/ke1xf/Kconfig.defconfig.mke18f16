## soc/arm/nxp_kinetis/kv5x/Kconfig.soc
```kconfig
# Kinetis KV5x series MCU

# Copyright (c) 2019 SEAL AG
# SPDX-License-Identifier: Apache-2.0

choice
	prompt "Kinetis KV5x MCU Selection"
	depends on SOC_SERIES_KINETIS_KV5X

config SOC_MKV56F24
	bool "MKV56F24"

config SOC_MKV58F24
	bool "MKV58F24"

endchoice

if SOC_SERIES_KINETIS_KV5X

config SOC_PART_NUMBER_MKV56F512VLL24
	bool

config SOC_PART_NUMBER_MKV56F512VLQ24
	bool

config SOC_PART_NUMBER_MKV56F1M0VLL24
	bool

config SOC_PART_NUMBER_MKV56F1M0VLQ24
	bool

config SOC_PART_NUMBER_MKV58F512VLL24
	bool

config SOC_PART_NUMBER_MKV58F512VLQ24
	bool

config SOC_PART_NUMBER_MKV58F1M0VLL24
	bool

config SOC_PART_NUMBER_MKV58F1M0VLQ24
	bool

config SOC_PART_NUMBER_KINETIS_KV5X
	string
	default "MKV56F512VLL24" if SOC_PART_NUMBER_MKV56F512VLL24
	default "MKV56F512VLQ24" if SOC_PART_NUMBER_MKV56F512VLQ24
	default "MKV56F1M0VLL24" if SOC_PART_NUMBER_MKV56F1M0VLL24
	default "MKV56F1M0VLQ24" if SOC_PART_NUMBER_MKV56F1M0VLQ24
	default "MKV58F512VLL24" if SOC_PART_NUMBER_MKV58F512VLL24
	default "MKV58F512VLQ24" if SOC_PART_NUMBER_MKV58F512VLQ24
	default "MKV58F1M0VLL24" if SOC_PART_NUMBER_MKV58F1M0VLL24
	default "MKV58F1M0VLQ24" if SOC_PART_NUMBER_MKV58F1M0VLQ24
	help
	  This string holds the full part number of the SoC. It is a
	  hidden option that you should not set directly. The part
	  number selection choice defines the default value for this
	  string.

config KINETIS_KV5X_ENABLE_CODE_CACHE
	bool "Code cache"
	default y

config KINETIS_KV5X_ENABLE_DATA_CACHE
	bool "Data cache"
	default y

endif # SOC_SERIES_KINETIS_KV5X
```

## soc/arm/nxp_kinetis/kwx/Kconfig.defconfig.mkw2xd512
```kconfig
# Kinetis KW2xD SoC configuration options

# Copyright (c) 2017, Phytec Messtechnik GmbH
# SPDX-License-Identifier: Apache-2.0

if SOC_MKW22D5 || SOC_MKW24D5

config SOC
	default "mkw22d5"
	depends on SOC_MKW22D5

config SOC
	default "mkw24d5"
	depends on SOC_MKW24D5

config NUM_IRQS
	default 65

config SPI
	default y

endif # SOC_MKW2xD512
```

## soc/arm/nxp_kinetis/kwx/Kconfig.defconfig.mkw40z4
```kconfig
# Kinetis KWx SoC configuration options

# SPDX-License-Identifier: Apache-2.0

if SOC_MKW40Z4

config SOC
	default "mkw40z4"

config NUM_IRQS
	default 32

choice CSPRNG_GENERATOR_CHOICE
	default CTR_DRBG_CSPRNG_GENERATOR
endchoice

choice RNG_GENERATOR_CHOICE
	default XOSHIRO_RANDOM_GENERATOR
endchoice

config TINYCRYPT
	default y

endif # SOC_MKW40Z4
```

## soc/arm/nxp_kinetis/kwx/Kconfig.defconfig.mkw41z4
```kconfig
# Kinetis KWx SoC configuration options

# Copyright (c) 2017, NXP
# SPDX-License-Identifier: Apache-2.0

if SOC_MKW41Z4

config SOC
	default "mkw41z4"

config NUM_IRQS
	default 32

config ADC_MCUX_ADC16
	default y
	depends on ADC

config CLOCK_CONTROL_MCUX_SIM
	default y
	depends on CLOCK_CONTROL

config COUNTER_MCUX_RTC
	default y
	depends on COUNTER

config PINMUX_MCUX
	default y
	depends on PINMUX

config GPIO_MCUX
	default y
	depends on GPIO

config UART_MCUX_LPUART
	default y
	depends on SERIAL

config I2C_MCUX
	default y
	depends on I2C

config SPI_MCUX_DSPI
	default y
	depends on SPI

config ENTROPY_MCUX_TRNG
	default y
	depends on ENTROPY_GENERATOR

config SOC_FLASH_MCUX
	default y
	depends on FLASH

config PWM_MCUX_TPM
	default y
	depends on PWM

if NETWORKING

config NET_L2_IEEE802154
	default y
	depends on !NET_L2_OPENTHREAD

config IEEE802154_KW41Z
	default y

config NET_CONFIG_IEEE802154_DEV_NAME
	default IEEE802154_KW41Z_DRV_NAME

endif # NETWORKING

choice CSPRNG_GENERATOR_CHOICE
	default CTR_DRBG_CSPRNG_GENERATOR
endchoice

#
# MBEDTLS is larger but much faster than TinyCrypt so choose wisely
#
#config MBEDTLS
config TINYCRYPT
	default y
	depends on ENTROPY_GENERATOR

#
# KW41Z TRNG entropy source cannot be used as a Hardware RNG source so
# use XOROSHIRO for PRNG
#
choice RNG_GENERATOR_CHOICE
	default XOROSHIRO_RANDOM_GENERATOR
endchoice

endif # SOC_MKW41Z4
```

## soc/arm/nxp_kinetis/kwx/Kconfig.defconfig.series
```kconfig
# Kconfig - Kinetis KWx series configuration options
#
# Copyright (c) 2017, NXP
#
# SPDX-License-Identifier: Apache-2.0
#

if SOC_SERIES_KINETIS_KWX

config SOC_SERIES
	default "kwx"

source "soc/arm/nxp_kinetis/kwx/Kconfig.defconfig.mk*"

endif # SOC_SERIES_KINETIS_KWX
```

## soc/arm/nxp_kinetis/kwx/Kconfig.series
```kconfig
# Kinetis KWx MCU series

# Copyright (c) 2017, NXP
# SPDX-License-Identifier: Apache-2.0

config SOC_SERIES_KINETIS_KWX
	bool "Kinetis KWx Series MCU"
	select ARM
	select SOC_FAMILY_KINETIS
	select CPU_CORTEX_M_HAS_SYSTICK
	select CLOCK_CONTROL
	help
	  Enable support for Kinetis KWx MCU series
```

## soc/arm/nxp_kinetis/kwx/Kconfig.soc
```kconfig
# Kinetis KWx MCU series

# Copyright (c) 2017, NXP
# SPDX-License-Identifier: Apache-2.0

config SOC_MKW22D5
	bool
	select CPU_CORTEX_M4
	select CPU_CORTEX_M_HAS_DWT
	select HAS_MCUX
	select HAS_MCUX_ADC16
	select HAS_MCUX_FTFX
	select HAS_MCUX_FTM
	select HAS_MCUX_RNGA
	select HAS_MCUX_SIM
	select HAS_OSC
	select HAS_MCG
	select HAS_MCUX_RCM
	help
	  SOC_MKW22D5

config SOC_MKW24D5
	bool
	select CPU_CORTEX_M4
	select CPU_CORTEX_M_HAS_DWT
	select HAS_MCUX
	select HAS_MCUX_ADC16
	select HAS_MCUX_FTFX
	select HAS_MCUX_FTM
	select HAS_MCUX_RNGA
	select HAS_MCUX_SIM
	select HAS_OSC
	select HAS_MCG
	select HAS_MCUX_RCM
	help
	  SOC_MKW24D5

config SOC_MKW40Z4
	bool
	select CPU_CORTEX_M0PLUS
	select HAS_MCUX
	select HAS_MCUX_ADC16
	select HAS_MCUX_LPUART
	select HAS_MCUX_SIM
	select HAS_MCUX_TRNG
	select HAS_OSC
	select HAS_MCG
	select HAS_MCUX_RCM
	help
	  SOC_MKW40Z4

config SOC_MKW41Z4
	bool
	select CPU_CORTEX_M0PLUS
	select HAS_MCUX
	select HAS_MCUX_ADC16
	select HAS_MCUX_FTFX
	select HAS_MCUX_LPUART
	select HAS_MCUX_RTC
	select HAS_MCUX_SIM
	select HAS_MCUX_TPM
	select HAS_MCUX_TRNG
	select HAS_OSC
	select HAS_MCG
	select HAS_MCUX_RCM
	help
	  SOC_MKW41Z4

if SOC_SERIES_KINETIS_KWX

config SOC_PART_NUMBER_MKW22D512VHA5
	bool

config SOC_PART_NUMBER_MKW24D512VHA5
	bool

config SOC_PART_NUMBER_MKW40Z160VHT4
	bool

config SOC_PART_NUMBER_MKW41Z256VHT4
	bool

config SOC_PART_NUMBER_MKW41Z512VHT4
	bool

config SOC_PART_NUMBER_KINETIS_KWX
	string
	default "MKW22D512VHA5" if SOC_PART_NUMBER_MKW22D512VHA5
	default "MKW24D512VHA5" if SOC_PART_NUMBER_MKW24D512VHA5
	default "MKW40Z160VHT4" if SOC_PART_NUMBER_MKW40Z160VHT4
	default "MKW41Z256VHT4" if SOC_PART_NUMBER_MKW41Z256VHT4
	default "MKW41Z512VHT4" if SOC_PART_NUMBER_MKW41Z512VHT4
	help
	  This string holds the full part number of the SoC. It is a hidden option
	  that you should not set directly. The part number selection choice defines
	  the default value for this string.

endif # SOC_SERIES_KINETIS_KWX
```
