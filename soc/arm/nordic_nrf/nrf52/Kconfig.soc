## soc/arm/nordic_nrf/nrf54h/Kconfig.series
```kconfig
# Nordic Semiconductor nRF54H MCU line

# Copyright (c) 2024 Nordic Semiconductor ASA
# SPDX-License-Identifier: Apache-2.0

config SOC_SERIES_NRF54HX
	bool "Nordic Semiconductor nRF54H series MCU"
	select ARM
	select ARMV8_M_DSP
	select CPU_CORTEX_M33
	select SOC_FAMILY_NRF
	select HAS_NRFX
	select HAS_NORDIC_DRIVERS
	select HAS_SEGGER_RTT if ZEPHYR_SEGGER_MODULE
	help
	  Enable support for nRF54H MCU series
```

## soc/arm/nordic_nrf/nrf54h/Kconfig.soc
```kconfig
# Nordic Semiconductor nRF54H MCU line

# Copyright (c) 2024 Nordic Semiconductor ASA
# SPDX-License-Identifier: Apache-2.0

config SOC_NRF54H20
	bool "nRF54H20"
	depends on SOC_SERIES_NRF54HX

if SOC_NRF54H20

choice
	prompt "nRF54H20 MCU Selection"

config SOC_NRF54H20_ENGA_CPUAPP
	bool "nRF54H20 ENGA CPUAPP"
	select CPU_HAS_ARM_MPU
	select CPU_HAS_ARM_SAU
	select CPU_HAS_DCACHE
	select CPU_HAS_ICACHE
	select CPU_HAS_FPU

config SOC_NRF54H20_ENGA_CPURAD
	bool "nRF54H20 ENGA CPURAD"
	select CPU_HAS_ARM_MPU
	select CPU_HAS_ARM_SAU
	select CPU_HAS_DCACHE
	select CPU_HAS_ICACHE
	select CPU_HAS_FPU

endchoice

config NRF_ENABLE_ICACHE
	bool "Instruction cache (I-Cache)"
	default y

endif # SOC_NRF54H20
```

## soc/arm/nordic_nrf/nrf54l/Kconfig.defconfig.nrf54l15_enga_cpuapp
```kconfig
# Nordic Semiconductor nRF54L15 MCU

# Copyright (c) 2024 Nordic Semiconductor ASA
# SPDX-License-Identifier: Apache-2.0

if SOC_NRF54L15_ENGA_CPUAPP

config SOC
	string
	default "nrf54l15_cpuapp"

config NUM_IRQS
	default 271

config IEEE802154_NRF5
	default IEEE802154

endif # SOC_NRF54L15_ENGA_CPUAPP
```

## soc/arm/nordic_nrf/nrf54l/Kconfig.series
```kconfig
# Nordic Semiconductor nRF54L MCU line

# Copyright (c) 2024 Nordic Semiconductor ASA
# SPDX-License-Identifier: Apache-2.0

config SOC_SERIES_NRF54LX
	bool "Nordic Semiconductor nRF54L series MCU"
	select HAS_NRFX
	select HAS_NORDIC_DRIVERS
	select HAS_SEGGER_RTT if ZEPHYR_SEGGER_MODULE
	select SOC_FAMILY_NRF
	help
	  Enable support for nRF54L MCU series
```

## soc/arm/nordic_nrf/nrf91/Kconfig.defconfig.nrf9160_SICA
```kconfig
# Kconfig.defconfig.nrf9160 - Nordic Semiconductor nRF9160 MCU
#
# Copyright (c) 2018 Nordic Semiconductor ASA
#
# SPDX-License-Identifier: Apache-2.0
#


if SOC_NRF9160_SICA

config SOC
	default "nRF9160_SICA"

config NUM_IRQS
	default 65

endif # SOC_NRF9160_SICA
```

## soc/arm/nordic_nrf/nrf91/Kconfig.defconfig.nrf9161_LACA
```kconfig
# Nordic Semiconductor nRF9161 MCU

# Copyright (c) 2023 Nordic Semiconductor ASA
# SPDX-License-Identifier: Apache-2.0

if SOC_NRF9161_LACA

config SOC
	default "nRF9161_LACA"

config NUM_IRQS
	default 65

endif # SOC_NRF9161_LACA
```

## soc/arm/nordic_nrf/nrf91/Kconfig.defconfig.nrf9161_SICA
```kconfig
# Nordic Semiconductor nRF9161 MCU

# Copyright (c) 2023 Nordic Semiconductor ASA
# SPDX-License-Identifier: Apache-2.0

if SOC_NRF9161_SICA

config SOC
	default "nRF9161_SICA"

config NUM_IRQS
	default 65

endif # SOC_NRF9161_SICA
```

## soc/arm/nordic_nrf/nrf91/Kconfig.defconfig.series
```kconfig
# Kconfig.defconfig.series - Nordic Semiconductor nRF91 MCU line
#
# Copyright (c) 2018 Nordic Semiconductor ASA
#
# SPDX-License-Identifier: Apache-2.0
#

if SOC_SERIES_NRF91X

source "soc/arm/nordic_nrf/nrf91/Kconfig.defconfig.nrf91*"

config SOC_SERIES
	default "nrf91"

endif # SOC_SERIES_NRF91X
```

## soc/arm/nordic_nrf/nrf91/Kconfig.series
```kconfig
# Nordic Semiconductor nRF91 MCU line

# Copyright (c) 2018 Nordic Semiconductor ASA
# SPDX-License-Identifier: Apache-2.0

config SOC_SERIES_NRF91X
	bool "Nordic Semiconductor nRF91 series MCU"
	select ARM
	select CPU_CORTEX_M33
	select CPU_CORTEX_M_HAS_DWT
	select CPU_HAS_ARM_MPU
	select CPU_HAS_NRF_IDAU
	select CPU_HAS_FPU
	select ARMV8_M_DSP
	select SOC_FAMILY_NRF
	imply XIP
	select HAS_NRFX
	select HAS_SEGGER_RTT if ZEPHYR_SEGGER_MODULE
	select HAS_POWEROFF
	help
	  Enable support for NRF91 MCU series

if SOC_SERIES_NRF91X
config NRF_SPU_FLASH_REGION_SIZE
	hex
	default 0x8000
	help
	  FLASH region size for the NRF_SPU peripheral

config NRF_SPU_RAM_REGION_SIZE
	hex
	default 0x2000
	help
	  RAM region size for the NRF_SPU peripheral
endif
```

## soc/arm/nordic_nrf/nrf91/Kconfig.soc
```kconfig
# Nordic Semiconductor nRF91 MCU line

# Copyright (c) 2018 Nordic Semiconductor ASA
# SPDX-License-Identifier: Apache-2.0

if SOC_SERIES_NRF91X

config SOC_NRF9120
	bool

config SOC_NRF9160
	bool

choice
	prompt "nRF91x MCU Selection"

config SOC_NRF9160_SICA
	bool "NRF9160_SICA"
	select SOC_NRF9160

# The nRF9161 is technically a SiP (System-in-Package) that consists of
# the nRF9120 SoC and additional components like PMIC, FEM, and XTAL,
# so for nrfx/MDK the nRF9120 SoC is to be indicated as the build target,
# but since the nRF9161 is what a user can actually see on a board, using
# only nRF9120 in the Zephyr build infrastructure might be confusing.
# That's why in the top level of SoC definitions (for user-configurable
# options in Kconfig, for example) the nRF9161 term is used and nRF9120
# underneath.
config SOC_NRF9161_LACA
	bool "NRF9161_LACA"
	select SOC_NRF9120

config SOC_NRF9131_LACA
	bool "NRF9131_LACA"
	select SOC_NRF9120

endchoice

config NRF_ENABLE_ICACHE
	bool "Instruction cache (I-Cache)"
	default y

endif # SOC_SERIES_NRF91X
```

## soc/arm/nuvoton/Kconfig
```kconfig
# SPDX-License-Identifier: Apache-2.0
#
# Copyright (c) 2020 Linumiz
# Author: Saravanan Sekar <saravanan@linumiz.com>

config SOC_FAMILY_NUMICRO
	select PLATFORM_SPECIFIC_INIT
	bool

if SOC_FAMILY_NUMICRO
config SOC_FAMILY
	string
	default "nuvoton"

source "soc/arm/nuvoton/*/Kconfig.soc"

endif # SOC_FAMILY_NUMICRO
```

## soc/arm/nuvoton_npcx/Kconfig
```kconfig
# Nuvoton Cortex-M4 Embedded Controller

# Copyright (c) 2020 Nuvoton Technology Corporation.
# SPDX-License-Identifier: Apache-2.0

config SOC_FAMILY_NPCX
	bool

if SOC_FAMILY_NPCX
config SOC_FAMILY
	string
	default "nuvoton_npcx"

menuconfig NPCX_HEADER
	bool "The output binary with NPCX binary header"
	help
	  On NPCX series chip, the NPCX ROM code loads firmware image from flash
	  to RAM by the firmware binary header setting. Enable this to invoke
	  the 'ecst' which generates the NPCX firmware header.

if NPCX_HEADER

config NPCX_IMAGE_OUTPUT_BIN
	bool "Build npcx binary in BIN format"
	default y
	help
	  Build a "raw" binary zephyr/zephyr.npcx.bin in the build directory.
	  The name of this file can be customized with CONFIG_KERNEL_BIN_NAME.

config NPCX_IMAGE_OUTPUT_HEX
	bool "Build npcx binary in HEX format"
	depends on NPCX_IMAGE_OUTPUT_BIN
	help
	  Build an HEX binary zephyr/zephyr.npcx.hex in the build directory.
	  This is generated from the npcx BIN image.
	  The name of this file can be customized with CONFIG_KERNEL_BIN_NAME.

config NPCX_HEADER_CHIP
	string
	default "npcx7m6" if SOC_NPCX7M6FB || SOC_NPCX7M6FC
	default "npcx7m7" if SOC_NPCX7M7FC
	default "npcx9m3" if SOC_NPCX9M3F
	default "npcx9m6" if SOC_NPCX9M6F
	default "npcx9m7" if SOC_NPCX9M7F
	default "npcx4m3" if SOC_NPCX4M3F
	default "npcx4m8" if SOC_NPCX4M8F

choice NPCX_HEADER_SPI_MAX_CLOCK_CHOICE
	prompt "Clock rate to use for SPI flash"
	default NPCX_HEADER_SPI_MAX_CLOCK_20
	help
	  This selects the max clock rate that will be used for loading firmware
	  binary from flash to RAM.

config NPCX_HEADER_SPI_MAX_CLOCK_20
	bool "SPI flash max clock rate of 20 MHz"

config NPCX_HEADER_SPI_MAX_CLOCK_25
	bool "SPI flash max clock rate of 25 MHz"

config NPCX_HEADER_SPI_MAX_CLOCK_33
	bool "SPI flash max clock rate of 33 MHz"
	depends on !SOC_SERIES_NPCX9

config NPCX_HEADER_SPI_MAX_CLOCK_40
	bool "SPI flash max clock rate of 40 MHz"

config NPCX_HEADER_SPI_MAX_CLOCK_50
	bool "SPI flash max clock rate of 50 MHz"
endchoice

config NPCX_HEADER_SPI_MAX_CLOCK
	int
	default 20 if NPCX_HEADER_SPI_MAX_CLOCK_20
	default 25 if NPCX_HEADER_SPI_MAX_CLOCK_25
	default 33 if NPCX_HEADER_SPI_MAX_CLOCK_33
	default 40 if NPCX_HEADER_SPI_MAX_CLOCK_40
	default 50 if NPCX_HEADER_SPI_MAX_CLOCK_50

choice NPCX_HEADER_SPI_READ_MODE_CHOICE
	prompt "Reading mode used by the SPI flash"
	default NPCX_HEADER_SPI_READ_MODE_NORMAL
	help
	  This sets the reading mode that can be used by the SPI flash.
	  Reading modes supported are normal, fast, dual, and quad.

config NPCX_HEADER_SPI_READ_MODE_NORMAL
	bool "SPI flash operates with normal reading mode"

config NPCX_HEADER_SPI_READ_MODE_FAST
	bool "SPI flash operates with fast reading mode"

config NPCX_HEADER_SPI_READ_MODE_DUAL
	bool "SPI flash operates with dual reading mode"

config NPCX_HEADER_SPI_READ_MODE_QUAD
	bool "SPI flash operates with quad reading mode"
endchoice

config NPCX_HEADER_SPI_READ_MODE
	string
	default "normal" if NPCX_HEADER_SPI_READ_MODE_NORMAL
	default "fast" if NPCX_HEADER_SPI_READ_MODE_FAST
	default "dual" if NPCX_HEADER_SPI_READ_MODE_DUAL
	default "quad" if NPCX_HEADER_SPI_READ_MODE_QUAD

choice NPCX_HEADER_CORE_CLOCK_SPI_CLOCK_RATIO_CHOICE
	prompt "Core clock to SPI flash clock ratio"
	default NPCX_HEADER_CORE_CLOCK_SPI_CLOCK_RATIO_1
	help
	  This sets the clock ratio (core clock / SPI clock)

config NPCX_HEADER_CORE_CLOCK_SPI_CLOCK_RATIO_1
	bool "NPCX SPI clock ratio 1"
	help
	  The SPI flash clock has the same frequency as the core clock.

config NPCX_HEADER_CORE_CLOCK_SPI_CLOCK_RATIO_2
	bool "NPCX SPI clock ratio 2"
	help
	  The core clock frequency is twice the flash clock frequency.
endchoice

config NPCX_HEADER_CORE_CLOCK_SPI_CLOCK_RATIO
	int
	default 1 if NPCX_HEADER_CORE_CLOCK_SPI_CLOCK_RATIO_1
	default 2 if NPCX_HEADER_CORE_CLOCK_SPI_CLOCK_RATIO_2

config NPCX_HEADER_ENABLE_HEADER_CRC
	bool "Header crc check"
	help
	  When enabled, the header will be verified at boot using a crc
	  checksum.

config NPCX_HEADER_ENABLE_FIRMWARE_CRC
	bool "Firmware image crc check"
	help
	  When enabled, the firmware image will be verified at boot using a
	  crc checksum.

choice NPCX_HEADER_FLASH_SIZE_CHOICE
	prompt "Flash size"
	default NPCX_HEADER_FLASH_SIZE_0P5M_1M if SOC_SERIES_NPCX7 || \
						  SOC_SERIES_NPCX9
	default NPCX_HEADER_FLASH_SIZE_16M
	help
	  This sets the SPI flash size.

config NPCX_HEADER_FLASH_SIZE_0P5M_1M
	bool "SPI flash size 0.5M or 1M Bytes"
	help
	  The SPI flash size is 0.5M or 1M Bytes.

config NPCX_HEADER_FLASH_SIZE_2M
	bool "SPI flash size 2M Bytes"
	help
	  The SPI flash size is 2M Bytes.

config NPCX_HEADER_FLASH_SIZE_4M
	bool "SPI flash size 4M Bytes"
	help
	  The SPI flash size is 4M Bytes.

config NPCX_HEADER_FLASH_SIZE_8M
	bool "SPI flash size 8M Bytes"
	help
	  The SPI flash size is 8M Bytes.

config NPCX_HEADER_FLASH_SIZE_16M
	bool "SPI flash size 16M Bytes"
	help
	  The SPI flash size is 16M Bytes.
endchoice

config NPCX_HEADER_FLASH_SIZE
	int
	default 1 if NPCX_HEADER_FLASH_SIZE_0P5M_1M
	default 2 if NPCX_HEADER_FLASH_SIZE_2M
	default 4 if NPCX_HEADER_FLASH_SIZE_4M
	default 8 if NPCX_HEADER_FLASH_SIZE_8M
	default 16 if NPCX_HEADER_FLASH_SIZE_16M

endif # NPCX_HEADER

# Select SoC Part No. and configuration options
source "soc/arm/nuvoton_npcx/*/Kconfig.soc"

config NPCX_PM_TRACE
	bool "Trace System Power Management in NPCX family"
	depends on PM
	help
	  Internal config to enable runtime power management traces.

endif # SOC_FAMILY_NPCX
```

## soc/arm/nuvoton_npcx/Kconfig.defconfig
```kconfig
# SPDX-License-Identifier: Apache-2.0

# Copyright (c) 2020 Nuvoton Technology Corporation.
# SPDX-License-Identifier: Apache-2.0

source "soc/arm/nuvoton_npcx/*/Kconfig.defconfig.series"
```

## soc/arm/nuvoton_npcx/Kconfig.soc
```kconfig
# Nuvoton Cortex-M4 Embedded Controller

# Copyright (c) 2020 Nuvoton Technology Corporation.
# SPDX-License-Identifier: Apache-2.0

source "soc/arm/nuvoton_npcx/*/Kconfig.series"
```
