## soc/espressif/common/Kconfig.deprecated.defconfig
```kconfig
# Copyright (c) 2026 Espressif Systems (Shanghai) Co., Ltd.
# SPDX-License-Identifier: Apache-2.0

configdefault SOC_FAMILY_ESPRESSIF_BOOTLOADER_FLASH_XMC_SUPPORT
	default n if !BOOTLOADER_FLASH_XMC_SUPPORT

configdefault SOC_FAMILY_ESPRESSIF_BOOTLOADER_REGION_PROTECTION_ENABLE
	default n if !BOOTLOADER_REGION_PROTECTION_ENABLE && (!RISCV_PMP && BOOTLOADER_MCUBOOT)

configdefault SOC_ESP32_D0WD_PSRAM_CLK_IO
	default D0WD_PSRAM_CLK_IO

configdefault SOC_ESP32_D0WD_PSRAM_CS_IO
	default D0WD_PSRAM_CS_IO

configdefault SOC_ESP32_D2WD_PSRAM_CLK_IO
	default D2WD_PSRAM_CLK_IO

configdefault SOC_ESP32_D2WD_PSRAM_CS_IO
	default D2WD_PSRAM_CS_IO

configdefault SOC_ESP32_BT_RESERVE_DRAM
	default ESP32_BT_RESERVE_DRAM

configdefault SOC_FAMILY_ESPRESSIF_PM_POWER_DOWN_CPU_IN_LIGHT_SLEEP
	default n if !ESP32_PM_POWER_DOWN_CPU_IN_LIGHT_SLEEP

configdefault SOC_ESP32S3_PM_RESTORE_CACHE_TAGMEM_AFTER_LIGHT_SLEEP
	default n if !ESP32_PM_RESTORE_CACHE_TAGMEM_AFTER_LIGHT_SLEEP

configdefault SOC_FAMILY_ESPRESSIF_PPA_MAX_PENDING
	default ESP32_PPA_MAX_PENDING

configdefault SOC_FAMILY_ESPRESSIF_PPA_WAIT_TIMEOUT_US
	default ESP32_PPA_WAIT_TIMEOUT_US

configdefault SOC_ESP32_REGION_1_NOINIT
	default n if !ESP32_REGION_1_NOINIT && (!(SOC_FAMILY_ESPRESSIF_ENABLE_APPCPU || \
		SOC_ESP32_APPCPU || BOOTLOADER_MCUBOOT))

configdefault SOC_FAMILY_ESPRESSIF_SLEEP_SPI_FLASH_ENTER_DPD_MODE_DELAY
	default ESP32_SLEEP_SPI_FLASH_ENTER_DPD_MODE_DELAY

configdefault SOC_FAMILY_ESPRESSIF_SLEEP_SPI_FLASH_EXIT_DPD_MODE_DELAY
	default ESP32_SLEEP_SPI_FLASH_EXIT_DPD_MODE_DELAY

configdefault SOC_FAMILY_ESPRESSIF_SLEEP_WAIT_FLASH_READY_EXTRA_DELAY
	default ESP32_SLEEP_WAIT_FLASH_READY_EXTRA_DELAY

configdefault SOC_FAMILY_ESPRESSIF_ULP_ENABLED
	default n if !ESP32_ULP_COPROC_ENABLED && (SOC_ESP32C5_LPCORE || SOC_ESP32C6_LPCORE || \
		SOC_ESP32P4_LPCORE || MBOX_ESP32)

configdefault SOC_FAMILY_ESPRESSIF_ULP_LP_CORE_LP_TIMER_SLEEP_DURATION_US
	default ESP32_ULP_LP_CORE_LP_TIMER_SLEEP_DURATION_US

configdefault SOC_FAMILY_ESPRESSIF_ULP_ROM_PRINT_ENABLE
	default n if !ESP32_ULP_ROM_PRINT_ENABLE

configdefault SOC_FAMILY_ESPRESSIF_ULP_TRAP_WAKEUP
	default n if !ESP32_ULP_TRAP_WAKEUP

configdefault SOC_ESP32S3_FLASH_MODE_AUTO_DETECT
	default n if !ESPTOOLPY_FLASH_MODE_AUTO_DETECT

configdefault SOC_FAMILY_ESPRESSIF_APPCPU_DRAM_SIZE
	default ESP_APPCPU_DRAM_SIZE

configdefault SOC_FAMILY_ESPRESSIF_APPCPU_DROM_SIZE
	default ESP_APPCPU_DROM_SIZE

configdefault SOC_FAMILY_ESPRESSIF_APPCPU_IRAM_SIZE
	default ESP_APPCPU_IRAM_SIZE

configdefault SOC_FAMILY_ESPRESSIF_APPCPU_IROM_SIZE
	default ESP_APPCPU_IROM_SIZE

configdefault SOC_FAMILY_ESPRESSIF_SIMPLE_BOOT
	default n if !ESP_SIMPLE_BOOT && (!BOOTLOADER_MCUBOOT && !MCUBOOT)

configdefault SOC_FAMILY_ESPRESSIF_SPIRAM_BSS_RELOC_LIBS_AND_OBJS
	default ESP_SPIRAM_BSS_RELOC_LIBS_AND_OBJS

configdefault SOC_FAMILY_ESPRESSIF_SPIRAM_HEAP_SIZE
	default ESP_SPIRAM_HEAP_SIZE

configdefault SOC_FAMILY_ESPRESSIF_SPIRAM_SIZE
	default ESP_SPIRAM_SIZE

configdefault SOC_FAMILY_ESPRESSIF_USB_SERIAL_JTAG_ENABLED
	default n if !ESP_USB_SERIAL_JTAG_ENABLED

configdefault SOC_ESP32_PICO_PSRAM_CS_IO
	default PICO_PSRAM_CS_IO

configdefault SOC_FAMILY_ESPRESSIF_ENABLE_PVT
	default n if !SOC_ESP32_ENABLE_PVT && !SOC_SERIES_ESP32C6

configdefault SOC_FAMILY_ESPRESSIF_PM_WAKEUP_MARGIN_US
	default SOC_ESP32_PM_WAKEUP_MARGIN_US

configdefault SOC_ESP32P4_SLEEP_DCM_VSET_VAL_IN_SLEEP
	default SOC_ESP32_SLEEP_DCM_VSET_VAL_IN_SLEEP

configdefault SOC_ESP32_SPIRAM_SPIWP_SD3_PIN
	default SPIRAM_SPIWP_SD3_PIN

configdefault SOC_FAMILY_ESPRESSIF_SPI_FLASH_ROM_DRIVER_PATCH
	default n if !SPI_FLASH_ROM_DRIVER_PATCH

configdefault SOC_FAMILY_ESPRESSIF_SPI_FLASH_BOYA
	default n if !SPI_FLASH_SUPPORT_BOYA_CHIP && !SOC_SERIES_ESP32

configdefault SOC_FAMILY_ESPRESSIF_SPI_FLASH_GD
	default n if !SPI_FLASH_SUPPORT_GD_CHIP

configdefault SOC_FAMILY_ESPRESSIF_SPI_FLASH_ISSI
	default n if !SPI_FLASH_SUPPORT_ISSI_CHIP

configdefault SOC_FAMILY_ESPRESSIF_SPI_FLASH_MXIC
	default n if !SPI_FLASH_SUPPORT_MXIC_CHIP

configdefault SOC_ESP32S3_SPI_FLASH_MXIC_OPI
	default n if !SPI_FLASH_SUPPORT_MXIC_OPI_CHIP

configdefault SOC_FAMILY_ESPRESSIF_SPI_FLASH_TH
	default n if !SPI_FLASH_SUPPORT_TH_CHIP && !SOC_SERIES_ESP32

configdefault SOC_FAMILY_ESPRESSIF_SPI_FLASH_WINBOND
	default n if !SPI_FLASH_SUPPORT_WINBOND_CHIP

choice SOC_ESP32P4_CACHE_L2_LINE_SIZE_CHOICE
	default SOC_ESP32P4_CACHE_L2_LINE_128B if ESP32_CACHE_L2_LINE_128B
	default SOC_ESP32P4_CACHE_L2_LINE_64B if ESP32_CACHE_L2_LINE_64B
endchoice

choice SOC_ESP32P4_CACHE_L2_SIZE_CHOICE
	default SOC_ESP32P4_CACHE_L2_128KB if ESP32_CACHE_L2_128KB
	default SOC_ESP32P4_CACHE_L2_256KB if ESP32_CACHE_L2_256KB
	default SOC_ESP32P4_CACHE_L2_512KB if ESP32_CACHE_L2_512KB
endchoice

choice SOC_ESP32S2_DATA_CACHE_LINE_SIZE
	default SOC_ESP32S2_DATA_CACHE_LINE_16B if ESP32S2_DATA_CACHE_LINE_16B
	default SOC_ESP32S2_DATA_CACHE_LINE_32B if ESP32S2_DATA_CACHE_LINE_32B
endchoice

choice SOC_ESP32S2_DATA_CACHE_SIZE
	default SOC_ESP32S2_DATA_CACHE_0KB if ESP32S2_DATA_CACHE_0KB
	default SOC_ESP32S2_DATA_CACHE_16KB if ESP32S2_DATA_CACHE_16KB
	default SOC_ESP32S2_DATA_CACHE_8KB if ESP32S2_DATA_CACHE_8KB
endchoice

choice SOC_ESP32S2_INSTRUCTION_CACHE_LINE_SIZE
	default SOC_ESP32S2_INSTRUCTION_CACHE_LINE_16B if ESP32S2_INSTRUCTION_CACHE_LINE_16B
	default SOC_ESP32S2_INSTRUCTION_CACHE_LINE_32B if ESP32S2_INSTRUCTION_CACHE_LINE_32B
endchoice

choice SOC_ESP32S2_INSTRUCTION_CACHE_SIZE
	default SOC_ESP32S2_INSTRUCTION_CACHE_16KB if ESP32S2_INSTRUCTION_CACHE_16KB
	default SOC_ESP32S2_INSTRUCTION_CACHE_8KB if ESP32S2_INSTRUCTION_CACHE_8KB
endchoice

choice SOC_ESP32S3_DATA_CACHE_LINE_SIZE
	default SOC_ESP32S3_DATA_CACHE_LINE_16B if ESP32S3_DATA_CACHE_LINE_16B
	default SOC_ESP32S3_DATA_CACHE_LINE_32B if ESP32S3_DATA_CACHE_LINE_32B
	default SOC_ESP32S3_DATA_CACHE_LINE_64B if ESP32S3_DATA_CACHE_LINE_64B
endchoice

choice SOC_ESP32S3_DATA_CACHE_SIZE
	default SOC_ESP32S3_DATA_CACHE_16KB if ESP32S3_DATA_CACHE_16KB
	default SOC_ESP32S3_DATA_CACHE_32KB if ESP32S3_DATA_CACHE_32KB
	default SOC_ESP32S3_DATA_CACHE_64KB if ESP32S3_DATA_CACHE_64KB
endchoice

choice SOC_ESP32S3_DCACHE_ASSOCIATED_WAYS
	default SOC_ESP32S3_DATA_CACHE_4WAYS if ESP32S3_DATA_CACHE_4WAYS
	default SOC_ESP32S3_DATA_CACHE_8WAYS if ESP32S3_DATA_CACHE_8WAYS
endchoice

choice SOC_ESP32S3_ICACHE_ASSOCIATED_WAYS
	default SOC_ESP32S3_INSTRUCTION_CACHE_4WAYS if ESP32S3_INSTRUCTION_CACHE_4WAYS
	default SOC_ESP32S3_INSTRUCTION_CACHE_8WAYS if ESP32S3_INSTRUCTION_CACHE_8WAYS
endchoice

choice SOC_ESP32S3_INSTRUCTION_CACHE_LINE_SIZE
	default SOC_ESP32S3_INSTRUCTION_CACHE_LINE_16B if ESP32S3_INSTRUCTION_CACHE_LINE_16B
	default SOC_ESP32S3_INSTRUCTION_CACHE_LINE_32B if ESP32S3_INSTRUCTION_CACHE_LINE_32B
endchoice

choice SOC_ESP32S3_INSTRUCTION_CACHE_SIZE
	default SOC_ESP32S3_INSTRUCTION_CACHE_16KB if ESP32S3_INSTRUCTION_CACHE_16KB
	default SOC_ESP32S3_INSTRUCTION_CACHE_32KB if ESP32S3_INSTRUCTION_CACHE_32KB
endchoice

choice SOC_FAMILY_ESPRESSIF_BOOTLOADER_VDDSDIO_BOOST
	default SOC_FAMILY_ESPRESSIF_BOOTLOADER_VDDSDIO_BOOST_1_8V if BOOTLOADER_VDDSDIO_BOOST_1_8V
	default SOC_FAMILY_ESPRESSIF_BOOTLOADER_VDDSDIO_BOOST_1_9V if BOOTLOADER_VDDSDIO_BOOST_1_9V
endchoice

choice SOC_FAMILY_ESPRESSIF_FLASH_FREQ
	default SOC_FAMILY_ESPRESSIF_FLASH_FREQ_120M if ESPTOOLPY_FLASHFREQ_120M
	default SOC_FAMILY_ESPRESSIF_FLASH_FREQ_20M if ESPTOOLPY_FLASHFREQ_20M
	default SOC_FAMILY_ESPRESSIF_FLASH_FREQ_26M if ESPTOOLPY_FLASHFREQ_26M
	default SOC_FAMILY_ESPRESSIF_FLASH_FREQ_40M if ESPTOOLPY_FLASHFREQ_40M
	default SOC_FAMILY_ESPRESSIF_FLASH_FREQ_48M if ESPTOOLPY_FLASHFREQ_48M
	default SOC_FAMILY_ESPRESSIF_FLASH_FREQ_60M if ESPTOOLPY_FLASHFREQ_60M
	default SOC_FAMILY_ESPRESSIF_FLASH_FREQ_80M if ESPTOOLPY_FLASHFREQ_80M
endchoice

choice SOC_FAMILY_ESPRESSIF_FLASH_MODE
	default SOC_FAMILY_ESPRESSIF_FLASH_MODE_DIO if ESPTOOLPY_FLASHMODE_DIO
	default SOC_FAMILY_ESPRESSIF_FLASH_MODE_DOUT if ESPTOOLPY_FLASHMODE_DOUT
	default SOC_FAMILY_ESPRESSIF_FLASH_MODE_OPI if ESPTOOLPY_FLASHMODE_OPI
	default SOC_FAMILY_ESPRESSIF_FLASH_MODE_QIO if ESPTOOLPY_FLASHMODE_QIO
	default SOC_FAMILY_ESPRESSIF_FLASH_MODE_QOUT if ESPTOOLPY_FLASHMODE_QOUT
endchoice

choice SOC_FAMILY_ESPRESSIF_FLASH_SAMPLE_MODE
	default SOC_FAMILY_ESPRESSIF_FLASH_SAMPLE_MODE_DTR if ESPTOOLPY_FLASH_SAMPLE_MODE_DTR
	default SOC_FAMILY_ESPRESSIF_FLASH_SAMPLE_MODE_STR if ESPTOOLPY_FLASH_SAMPLE_MODE_STR
endchoice

choice SOC_FAMILY_ESPRESSIF_PM_CPU_RETENTION_STRATEGY
	default SOC_FAMILY_ESPRESSIF_PM_CPU_RETENTION_DYNAMIC if ESP32_PM_CPU_RETENTION_DYNAMIC
	default SOC_FAMILY_ESPRESSIF_PM_CPU_RETENTION_STATIC if ESP32_PM_CPU_RETENTION_STATIC
endchoice

choice SOC_FAMILY_ESPRESSIF_SPIRAM_MODE
	default SOC_FAMILY_ESPRESSIF_SPIRAM_MODE_HEX if SPIRAM_MODE_HEX
	default SOC_FAMILY_ESPRESSIF_SPIRAM_MODE_OCT if SPIRAM_MODE_OCT
	default SOC_FAMILY_ESPRESSIF_SPIRAM_MODE_QUAD if SPIRAM_MODE_QUAD
endchoice

choice SOC_FAMILY_ESPRESSIF_SPIRAM_SPEED
	default SOC_FAMILY_ESPRESSIF_SPIRAM_SPEED_120M if SPIRAM_SPEED_120M
	default SOC_FAMILY_ESPRESSIF_SPIRAM_SPEED_200M if SPIRAM_SPEED_200M
	default SOC_FAMILY_ESPRESSIF_SPIRAM_SPEED_20M if SPIRAM_SPEED_20M
	default SOC_FAMILY_ESPRESSIF_SPIRAM_SPEED_26M if SPIRAM_SPEED_26M
	default SOC_FAMILY_ESPRESSIF_SPIRAM_SPEED_40M if SPIRAM_SPEED_40M
	default SOC_FAMILY_ESPRESSIF_SPIRAM_SPEED_80M if SPIRAM_SPEED_80M
endchoice

choice SOC_FAMILY_ESPRESSIF_ULP_LP_CORE_WAKEUP_SOURCE
	default SOC_FAMILY_ESPRESSIF_ULP_LP_CORE_WAKEUP_SOURCE_HP_CPU if \
		ESP32_ULP_LP_CORE_WAKEUP_SOURCE_HP_CPU
	default SOC_FAMILY_ESPRESSIF_ULP_LP_CORE_WAKEUP_SOURCE_LP_IO if \
		ESP32_ULP_LP_CORE_WAKEUP_SOURCE_LP_IO
	default SOC_FAMILY_ESPRESSIF_ULP_LP_CORE_WAKEUP_SOURCE_LP_TIMER if \
		ESP32_ULP_LP_CORE_WAKEUP_SOURCE_LP_TIMER
endchoice

choice SOC_FAMILY_ESPRESSIF_ULP_TYPE
	default SOC_FAMILY_ESPRESSIF_ULP_TYPE_FSM if ESP32_ULP_COPROC_TYPE_FSM
	default SOC_FAMILY_ESPRESSIF_ULP_TYPE_LP_CORE if ESP32_ULP_COPROC_TYPE_LP_CORE
	default SOC_FAMILY_ESPRESSIF_ULP_TYPE_RISCV if ESP32_ULP_COPROC_TYPE_RISCV
endchoice
```

## soc/espressif/common/Kconfig.esp_timer
```kconfig
# Copyright (c) 2026 Espressif Systems (Shanghai) Co., Ltd.
# SPDX-License-Identifier: Apache-2.0

choice SOC_ESP32_TIMER_TASK_CORE
	prompt "esp_timer task core"
	depends on SMP && SCHED_CPU_MASK
	default SOC_ESP32_TIMER_TASK_PINNED_TO_CORE_0
	help
	  Core the esp_timer dispatch task is pinned to under SMP. esp_timer
	  callbacks drive Wi-Fi and BLE housekeeping, so the task should share
	  the core where those stacks run (core 0 by default) to avoid
	  cross-core wakeups and lock contention.

config SOC_ESP32_TIMER_TASK_PINNED_TO_CORE_0
	bool "Core 0"

config SOC_ESP32_TIMER_TASK_PINNED_TO_CORE_1
	bool "Core 1"

endchoice # SOC_ESP32_TIMER_TASK_CORE

config SOC_ESP32_TIMER_TASK_CORE_ID
	int
	default 1 if SOC_ESP32_TIMER_TASK_PINNED_TO_CORE_1
	default 0
	help
	  Resolved core id for the esp_timer task (0 or 1). Consumed by the
	  esp_timer task-create path to pin the task.

config ESP32_TIMER_IN_IRAM
	bool
	help
	  Place the esp_timer arm, disarm and time query paths in IRAM so
	  they can run while the flash cache is suspended. Selected by the
	  light sleep IRAM option and enabled for SMP builds, where the radio
	  blobs call these from IRAM interrupt handlers on a core that may be
	  parked during a flash operation on the other core.
```
