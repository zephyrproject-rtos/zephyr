## soc/espressif/common/Kconfig.esptool
```kconfig
# Copyright (c) 2024 Espressif Systems (Shanghai) Co., Ltd.
# SPDX-License-Identifier: Apache-2.0

if SOC_FAMILY_ESPRESSIF

config SOC_ESP32S3_FLASH_OCTAL
	bool "Use Octal Flash"
	depends on SOC_SERIES_ESP32S3
	help
	  Enable only when the board actually mounts an octal (OPI) flash chip.
	  This selects OPI flash mode and tuned DTR sample timing. Flash and
	  PSRAM line modes are independent: most octal-PSRAM modules (such as
	  N8R8 and N16R8) pair octal PSRAM with quad flash, so leave this
	  disabled unless the flash chip itself is octal.

config SOC_ESP32S3_FLASH_MODE_AUTO_DETECT
	depends on SOC_SERIES_ESP32S3
	bool "Choose flash mode automatically (please read help)"
	default y
	help
	  This config option helps decide whether flash is Quad or Octal, but please note some limitations:

	  1. If the flash chip is an Octal one, even if one of "QIO", "QOUT", "DIO", "DOUT" options is
	      selected in `SOC_FAMILY_ESPRESSIF_FLASH_MODE`, our code will
	      automatically change the mode to "OPI" and the sample mode will be STR.
	  2. If the flash chip is a Quad one, even if "OPI" is selected in
	     `SOC_FAMILY_ESPRESSIF_FLASH_MODE`, our code will automatically change
	     the mode to "DIO".
	  3. Please do not rely on this option when you are pretty sure that you are using Octal flash,
	     please enable `SOC_ESP32S3_FLASH_OCTAL` option, then you can choose `DTR` sample mode
	     in `SOC_FAMILY_ESPRESSIF_FLASH_SAMPLE_MODE`. Otherwise, only `STR` mode is available.
	  4. Enabling this feature reduces available internal RAM size (around 900 bytes).
	     If your IRAM space is insufficient and you're aware of your flash type,
	     disable this option and select corresponding flash type options.

choice SOC_FAMILY_ESPRESSIF_FLASH_MODE
	prompt "Flash SPI mode"
	default SOC_FAMILY_ESPRESSIF_FLASH_MODE_DIO
	default SOC_FAMILY_ESPRESSIF_FLASH_MODE_OPI if SOC_ESP32S3_FLASH_OCTAL
	help
	  Mode the flash chip is flashed in, as well as the default mode for the
	  binary to run in.

config SOC_FAMILY_ESPRESSIF_FLASH_MODE_QIO
	bool "QIO"
	depends on !SOC_ESP32S3_FLASH_OCTAL

config SOC_FAMILY_ESPRESSIF_FLASH_MODE_QOUT
	bool "QOUT"
	depends on !SOC_ESP32S3_FLASH_OCTAL

config SOC_FAMILY_ESPRESSIF_FLASH_MODE_DIO
	bool "DIO"
	depends on !SOC_ESP32S3_FLASH_OCTAL

config SOC_FAMILY_ESPRESSIF_FLASH_MODE_DOUT
	bool "DOUT"
	depends on !SOC_ESP32S3_FLASH_OCTAL

config SOC_FAMILY_ESPRESSIF_FLASH_MODE_OPI
	bool "OPI"
	depends on SOC_ESP32S3_FLASH_OCTAL

endchoice # SOC_FAMILY_ESPRESSIF_FLASH_MODE

choice SOC_FAMILY_ESPRESSIF_FLASH_SAMPLE_MODE
	prompt "Flash Sampling Mode"
	default SOC_FAMILY_ESPRESSIF_FLASH_SAMPLE_MODE_DTR if SOC_ESP32S3_FLASH_OCTAL
	default SOC_FAMILY_ESPRESSIF_FLASH_SAMPLE_MODE_STR if !SOC_ESP32S3_FLASH_OCTAL

config SOC_FAMILY_ESPRESSIF_FLASH_SAMPLE_MODE_STR
	bool "STR Mode"

config SOC_FAMILY_ESPRESSIF_FLASH_SAMPLE_MODE_DTR
	bool "DTR Mode"
	depends on SOC_ESP32S3_FLASH_OCTAL

endchoice # SOC_FAMILY_ESPRESSIF_FLASH_SAMPLE_MODE

config SOC_FAMILY_ESPRESSIF_FLASH_MODE
	string
	default "dio" if SOC_FAMILY_ESPRESSIF_FLASH_MODE_QIO
	default "dio" if SOC_FAMILY_ESPRESSIF_FLASH_MODE_QOUT
	default "dio" if SOC_FAMILY_ESPRESSIF_FLASH_MODE_DIO
	default "dout" if SOC_FAMILY_ESPRESSIF_FLASH_MODE_DOUT
	# The 1st and 2nd bootloader doesn't support opi mode,
	# using fastrd instead. For now the ESPTOOL doesn't support
	# fasted (see ESPTOOL-274), using dout instead. In ROM the flash mode
	# information get from efuse, so don't care this dout choice.
	default "dout" if SOC_FAMILY_ESPRESSIF_FLASH_MODE_OPI

choice SOC_FAMILY_ESPRESSIF_FLASH_FREQ
	prompt "Flash SPI speed"
	default SOC_FAMILY_ESPRESSIF_FLASH_FREQ_40M if SOC_SERIES_ESP32
	default SOC_FAMILY_ESPRESSIF_FLASH_FREQ_48M if SOC_SERIES_ESP32H2
	default SOC_FAMILY_ESPRESSIF_FLASH_FREQ_60M if SOC_SERIES_ESP32C2
	default SOC_FAMILY_ESPRESSIF_FLASH_FREQ_80M if SOC_FAMILY_ESPRESSIF_FLASH_FREQ_80M_DEFAULT

config SOC_FAMILY_ESPRESSIF_FLASH_FREQ_120M
	bool "120 MHz"
	select SOC_ESP32S3_SPI_FLASH_HPM_ENABLE if SOC_SERIES_ESP32S3
	depends on SOC_SERIES_ESP32C5 || SOC_SERIES_ESP32S3
	depends on SOC_FAMILY_ESPRESSIF_FLASH_SAMPLE_MODE_STR
	help
	  - Flash 120 MHz SDR mode is stable.
	  - Flash 120 MHz DDR mode is an experimental feature, it works when
	  the temperature is stable.

	  Risks:
	  If your chip powers on at a certain temperature, then after the temperature
	  increases or decreases by approximately 20 Celsius degrees (depending on the
	  chip), the program will crash randomly.

config SOC_FAMILY_ESPRESSIF_FLASH_FREQ_80M
	bool "80 MHz"

config SOC_FAMILY_ESPRESSIF_FLASH_FREQ_60M
	bool "60 MHz"

config SOC_FAMILY_ESPRESSIF_FLASH_FREQ_48M
	bool "48 MHz"

config SOC_FAMILY_ESPRESSIF_FLASH_FREQ_40M
	bool "40 MHz"

config SOC_FAMILY_ESPRESSIF_FLASH_FREQ_26M
	bool "26 MHz"
	depends on !SOC_SERIES_ESP32S3

config SOC_FAMILY_ESPRESSIF_FLASH_FREQ_20M
	bool "20 MHz"

endchoice # SOC_FAMILY_ESPRESSIF_FLASH_FREQ

config SOC_FAMILY_ESPRESSIF_FLASH_FREQ_80M_DEFAULT
	bool
	default y if SOC_SERIES_ESP32S2 || SOC_SERIES_ESP32S3 || SOC_SERIES_ESP32C3 || \
		SOC_SERIES_ESP32C5 || SOC_SERIES_ESP32C6 || SOC_SERIES_ESP32C61 || \
		SOC_SERIES_ESP32P4
	help
	  This is an invisible item, used to define the targets that defaults to use 80MHz Flash SPI speed.

config SOC_FAMILY_ESPRESSIF_FLASH_FREQ
	string
	# On some of the ESP chips, max boot frequency would be equal to (or even lower than) 80m.
	# We currently define this to `80m`.
	default '80m' if SOC_FAMILY_ESPRESSIF_FLASH_FREQ_120M
	default '80m' if SOC_FAMILY_ESPRESSIF_FLASH_FREQ_80M
	default '60m' if SOC_FAMILY_ESPRESSIF_FLASH_FREQ_60M
	default '48m' if SOC_FAMILY_ESPRESSIF_FLASH_FREQ_48M
	default '40m' if SOC_FAMILY_ESPRESSIF_FLASH_FREQ_40M
	default '26m' if SOC_FAMILY_ESPRESSIF_FLASH_FREQ_26M
	default '20m' if SOC_FAMILY_ESPRESSIF_FLASH_FREQ_20M
	default '20m' # if no clock can match in bin headers, go with minimal.

endif # SOC_FAMILY_ESPRESSIF
```

## soc/espressif/common/Kconfig.lcd_cam
```kconfig
# Copyright (c) 2025 Chen Xingyu <hi@xingrz.me>
# SPDX-License-Identifier: Apache-2.0

config ESP32_LCD_CAM
	bool
	default y if DT_HAS_ESPRESSIF_ESP32_LCD_CAM_DVP_ENABLED
	default y if DT_HAS_ESPRESSIF_ESP32_LCD_CAM_MIPI_DBI_ENABLED
	depends on DT_HAS_ESPRESSIF_ESP32_LCD_CAM_ENABLED

configdefault VIDEO_BUFFER_SMH_ATTRIBUTE
	default 2 if ESP_SPIRAM # SMH_REG_ATTR_EXTERNAL

configdefault VIDEO_BUFFER_POOL_ZEPHYR_REGION
	default y

configdefault VIDEO_BUFFER_POOL_ZEPHYR_REGION_NAME
	default ".ext_ram_noinit.video"

configdefault DMA_ESP32_MAX_DESCRIPTOR_NUM
	default 64
```

## soc/espressif/common/Kconfig.ppa
```kconfig
# Copyright (c) 2026 Espressif Systems (Shanghai) Co., Ltd.
# SPDX-License-Identifier: Apache-2.0

config ESP32_PPA
	bool "ESP32 pixel processing accelerator"
	depends on DT_HAS_ESPRESSIF_ESP32_PPA_ENABLED
	help
	  Enable support for the pixel processing accelerator, which performs
	  fill, blend and scale-rotate-mirror operations in hardware.

if ESP32_PPA

config ESP32_PPA_WAIT_TIMEOUT_US
	int "Blocking operation timeout in microseconds"
	default 100000
	help
	  How long a blocking operation waits for the hardware to finish
	  before giving up.

config ESP32_PPA_MAX_PENDING
	int "Operation queue depth"
	default 4
	range 1 32
	help
	  Number of operations that can be queued at once, including the one
	  running on the hardware.

endif # ESP32_PPA
```

## soc/espressif/common/Kconfig.sdm
```kconfig
# Copyright (c) 2026 Espressif Systems (Shanghai) Co., Ltd.
# SPDX-License-Identifier: Apache-2.0

config ESP32_SDM
	bool "Espressif sigma-delta modulator"
	default y
	depends on DT_HAS_ESPRESSIF_ESP32_SDM_ENABLED
	help
	  Enable the sigma-delta modulator for Espressif SoCs. Each channel
	  outputs a pulse-density stream on one GPIO selected through pinctrl.
```

## soc/espressif/esp32/Kconfig
```kconfig
# Copyright (c) 2023 Espressif Systems (Shanghai) Co., Ltd.
# SPDX-License-Identifier: Apache-2.0

config SOC_SERIES_ESP32
	select XTENSA
	select CLOCK_CONTROL
	select DYNAMIC_INTERRUPTS
	select ATOMIC_OPERATIONS_BUILTIN
	select ARCH_HAS_GDBSTUB
	select ARCH_SUPPORTS_COREDUMP
	select ARCH_HAS_WORD_GRANULAR_ACCESS_INSTR_MEM
	select PINCTRL
	select HAS_ESPRESSIF_HAL
	select CPU_HAS_FPU
	select HAS_PM
	select HAS_POWEROFF
	select ARCH_HAS_DIRECTED_IPIS
	select SCHED_IPI_SUPPORTED if SMP
	imply XTENSA_ENABLE_BACKTRACE

if SOC_SERIES_ESP32

config SOC_ESP32_BT_RESERVE_DRAM
	hex "Bluetooth controller reserved RAM region"
	default 0xdb5c if BT
	default 0

config SOC_ESP32_REGION_1_NOINIT
	bool "Use DRAM region 1 to spill noinit section"
	default y if !(SOC_FAMILY_ESPRESSIF_ENABLE_APPCPU || SOC_ESP32_APPCPU || BOOTLOADER_MCUBOOT)
	help
	  ESP32 has two banks of size 192K and 128K which can be used
	  as DRAM. Enabling this option would allocate .noinit sections
	  in the DRAM region 1, instead of default region 0.

config SOC_ESP32_EMAC
	bool
	default y if ETH_ESP32
	default y if ETH_ESP32_DWC_ETHER_1000
	default y if MDIO_ESP32
	help
	  Hidden option to enable the ESP32 Ethernet MAC driver.
	  Both Ethernet and MDIO depend on this driver.
	  This option allows enabling MDIO independently of Ethernet.

rsource "Kconfig.caps"

endif # SOC_SERIES_ESP32
```

## soc/espressif/esp32c2/Kconfig
```kconfig
# Copyright (c) 2024 Espressif Systems (Shanghai) Co., Ltd.
# SPDX-License-Identifier: Apache-2.0

config SOC_SERIES_ESP32C2
	select RISCV
	select RISCV_SOC_HAS_GP_RELATIVE_ADDRESSING
	select DYNAMIC_INTERRUPTS
	select CLOCK_CONTROL
	select PINCTRL
	select HAS_ESPRESSIF_HAL
	select HAS_PM
	select HAS_POWEROFF

if SOC_SERIES_ESP32C2

config SOC_ESP32C2_REV_2_0
	bool "SOC is revision v2.0 (ECO4)"
	help
	  ESP32-C2 revision v2.0 has updated ROM functions.

rsource "Kconfig.caps"

endif # SOC_SERIES_ESP32C2
```

## soc/espressif/esp32c2/Kconfig.caps
```kconfig
# Copyright (c) 2026 Espressif Systems (Shanghai) Co., Ltd.
# SPDX-License-Identifier: Apache-2.0

config SOC_ESP32_FLASH_SUPPORTED
	bool
	default y

config SOC_ESP32_PM_SUPPORT_VDDSDIO_PD
	bool
	default y

config SOC_ESP32_WIFI_SUPPORT_VARIABLE_BEACON_WINDOW
	bool
	default y

config SOC_ESP32_FLASH_ENCRYPTION_XTS_AES
	bool
	default y

config SOC_ESP32_FLASH_ENCRYPTION_XTS_AES_OPTIONS
	bool
	default y

config SOC_ESP32_FLASH_ENCRYPTION_XTS_AES_128
	bool
	default y

config SOC_ESP32_FLASH_ENCRYPTION_XTS_AES_128_DERIVED
	bool
	default y

config SOC_ESP32_EFUSE_XTS_AES_KEY_128
	bool
	default y

config SOC_ESP32_SUPPORTS_SECURE_DL_MODE
	bool
	default y

config SOC_ESP32_EFUSE_DIS_DOWNLOAD_ICACHE
	bool
	default y
```

## soc/espressif/esp32c3/Kconfig
```kconfig
# Copyright (c) 2023 Espressif Systems (Shanghai) Co., Ltd.
# SPDX-License-Identifier: Apache-2.0

config SOC_SERIES_ESP32C3
	select RISCV
	select RISCV_SOC_HAS_GP_RELATIVE_ADDRESSING
	select DYNAMIC_INTERRUPTS
	select CLOCK_CONTROL
	select PINCTRL
	select HAS_ESPRESSIF_HAL
	select HAS_PM
	select HAS_POWEROFF

if SOC_SERIES_ESP32C3

config SOC_ESP32C3_REV_1_1
	bool "SOC is revision v1.1"
	help
	  ESP32-C3 revision v1.1 has updated ROM functions for Wi-Fi and BLE that
	  can free up to 35kB of RAM.

rsource "Kconfig.caps"

endif # SOC_SERIES_ESP32C3
```

## soc/espressif/esp32c3/Kconfig.caps
```kconfig
# Copyright (c) 2026 Espressif Systems (Shanghai) Co., Ltd.
# SPDX-License-Identifier: Apache-2.0

config SOC_FAMILY_ESPRESSIF_PM_SUPPORT_CPU_PD
	bool
	default y

config SOC_FAMILY_ESPRESSIF_WIFI_SUPPORT_VARIABLE_BEACON_WINDOW
	bool
	default y
```

## soc/espressif/esp32c5/Kconfig
```kconfig
# Copyright (c) 2026 Espressif Systems (Shanghai) Co., Ltd.
# SPDX-License-Identifier: Apache-2.0

config SOC_SERIES_ESP32C5
	select RISCV
	select RISCV_SOC_HAS_GP_RELATIVE_ADDRESSING
	select RISCV_PMP if SOC_ESP32C5_HPCORE && !MCUBOOT
	select DYNAMIC_INTERRUPTS if SOC_ESP32C5_HPCORE
	select CLOCK_CONTROL if SOC_ESP32C5_HPCORE
	select PINCTRL if SOC_ESP32C5_HPCORE
	select HAS_ESPRESSIF_HAL
	select CPU_HAS_DCACHE if SOC_ESP32C5_HPCORE
	select HAS_PM
	select HAS_POWEROFF
	select SOC_HAS_TIMING_FUNCTIONS if SOC_ESP32C5_HPCORE

if SOC_SERIES_ESP32C5

rsource "Kconfig.caps"

endif # SOC_SERIES_ESP32C5
```

## soc/espressif/esp32c5/Kconfig.caps
```kconfig
# Copyright (c) 2026 Espressif Systems (Shanghai) Co., Ltd.
# SPDX-License-Identifier: Apache-2.0

config SOC_FAMILY_ESPRESSIF_PM_SUPPORT_CPU_PD
	bool
	default y

config SOC_FAMILY_ESPRESSIF_SPI_MEM_SUPPORT_TIMING_TUNING
	bool
	default y

config SOC_FAMILY_ESPRESSIF_PM_SUPPORT_BEACON_WAKEUP
	bool
	default y

config SOC_FAMILY_ESPRESSIF_WIFI_HE_SUPPORT
	bool
	default y

config SOC_FAMILY_ESPRESSIF_WIFI_SUPPORT_5G
	bool
	default y

config SOC_FAMILY_ESPRESSIF_PM_SUPPORT_TOP_PD
	bool
	default y

config SOC_FAMILY_ESPRESSIF_PAU_SUPPORTED
	bool
	default y

config SOC_FAMILY_ESPRESSIF_PM_CPU_RETENTION_BY_SW
	bool
	default y

config SOC_FAMILY_ESPRESSIF_PM_FLASH_KEEP_POWER_IN_LSLP
	bool
	default y

config SOC_FAMILY_ESPRESSIF_ETM_SUPPORTED
	bool
	default y
```
