## soc/silabs/silabs_sim3/Kconfig.defconfig
```kconfig
# Copyright (c) 2024 Silicon Laboratories Inc.
# SPDX-License-Identifier: Apache-2.0

rsource "*/Kconfig.defconfig"
```

## soc/silabs/silabs_sim3/Kconfig.soc
```kconfig
# Copyright (c) 2024 GARDENA GmbH
#
# SPDX-License-Identifier: Apache-2.0

config SOC_FAMILY_SILABS_SIM3
	bool

rsource "*/Kconfig.soc"
```

## soc/silabs/silabs_sim3/sim3u/Kconfig
```kconfig
# Copyright (c) 2024 GARDENA GmbH
#
# SPDX-License-Identifier: Apache-2.0

config SOC_SERIES_SIM3U
	select ARM
	select CLOCK_CONTROL
	select CPU_CORTEX_M3
	select CPU_CORTEX_M_HAS_SYSTICK
	select HAS_SILABS_SI32
	select SOC_EARLY_INIT_HOOK
```

## soc/silabs/silabs_sim3/sim3u/Kconfig.defconfig
```kconfig
# SiM3U series configuration options

# Copyright (c) 2024 GARDENA GmbH
#
# SPDX-License-Identifier: Apache-2.0

if SOC_SERIES_SIM3U

config SYS_CLOCK_HW_CYCLES_PER_SEC
	default $(dt_node_int_prop_int,/cpus/cpu@0,clock-frequency)

config NUM_IRQS
	int
	# must be >= the highest interrupt number used
	default 53

endif # SOC_SERIES_SIM3U
```

## soc/silabs/silabs_sim3/sim3u/Kconfig.soc
```kconfig
# Copyright (c) 2024 GARDENA GmbH
#
# SPDX-License-Identifier: Apache-2.0

config SOC_SERIES_SIM3U
	bool
	select SOC_FAMILY_SILABS_SIM3
	help
	  Enable support for SiM3U MCU series

config SOC_SIM3U167BGM
	bool
	select SOC_SERIES_SIM3U

config SOC_SIM3U167AGQ
	bool
	select SOC_SERIES_SIM3U

config SOC_SERIES
	default "sim3u" if SOC_SERIES_SIM3U

config SOC
	default "sim3u167" if SOC_SIM3U167BGM
	default "sim3u167" if SOC_SIM3U167AGQ
```

## soc/silabs/silabs_siwx91x/Kconfig
```kconfig
# Copyright (c) 2023 Antmicro
# Copyright (c) 2024 Silicon Laboratories Inc.
# SPDX-License-Identifier: Apache-2.0

config SOC_FAMILY_SILABS_SIWX91X
	select ARM
	select CPU_CORTEX_M4
	select CPU_HAS_FPU
	select CPU_HAS_ARM_MPU
	select HAS_SILABS_WISECONNECT
	select HAS_SEGGER_RTT if ZEPHYR_SEGGER_MODULE
	select HAS_PM
	select PM_STATE_SET_IRQ_UNLOCKED
	select SILABS_SIWX91X_NWP if PM
	select SILABS_SLEEPTIMER_TIMER if PM
	select CPU_HAS_ICACHE
	select CACHE_MANAGEMENT

if SOC_FAMILY_SILABS_SIWX91X

rsource "*/Kconfig"

config SILABS_SIWX91X_SLOW_FLASH_DATA
	bool "Limit access to data in flash (EXPERIMENTAL)"
	select SLOW_FLASH_DATA
	help
	  The main flash on siwx91x does not have a data cache. Use this option to request the
	  compiler to limit access to data in flash.

	  The benefit depends on the workload. Some kernel benchmarks (tests/benchmarks/app_kernel/)
	  run up to 300% faster, while the typical improvement is around 10-50%.

	  This option pulls the limitations described in CONFIG_SLOW_FLASH_DATA. The users have to
	  make sure they are aware of them.

config SILABS_SIWX91X_NWP
	bool "Silabs Network Coprocessor"
	depends on DT_HAS_SILABS_SIWX91X_NWP_ENABLED
	select CODE_DATA_RELOCATION_SRAM
	select CMSIS_RTOS_V2
	select POLL
	select DYNAMIC_THREAD
	select THREAD_NAME
	select THREAD_STACK_INFO
	select THREAD_MONITOR
	select INIT_STACKS
	help
	  Add support for Network Coprocessor (also named NWP) presents on SiWx91x parts.

config SIWX91X_NWP_INIT_PRIORITY
	int "SiWx91x Network Processor init priority"
	default 39
	help
	  Initialization priority of the SiWx91x Network Processor. NWP init must
	  have a higher priority than services that depend on it, such as Bluetooth,
	  Wi-Fi and crypto.

config SIWX91X_SIGN_KEY
	string "Signing key"
	help
	  Sign the firmware using this private key. This value is passed as-is
	  to the command "commander rps convert". The value is usually a path to
	  PEM formatted file.

config SIWX91X_MIC_KEY
	string "Integrity Code (MIC) key"
	help
	  Check integrity of the firmware using MIC (AES CBC-MAC) based
	  integrity check instead of CRC based check.
	  This value is passed as-is to the command "commander rps convert". The
	  value is usually a string of 32 hexadecimal number representing the
	  AES-256 key.

config SIWX91X_ENCRYPT
	bool "Also encrypt the firmware"
	depends on SIWX91X_MIC_KEY != ""
	help
	  Encrypt the application image using AES ECB encryption.
	  The key used is the value of CONFIG_SIWX91X_MIC_KEY. This value is
	  passed as-is to the command "commander rps convert".

config SIWX91X_FIRMWARE_UPGRADE
	bool "Support for firmware upgrade"
	select SILABS_SIWX91X_NWP
	help
	  The firmware upgrade process for SiWx91x devices involves coordinated
	  communication with both the Network Co-Processor (NCP) and the ROM
	  bootloader. The NCP is responsible for writing the firmware image to
	  flash memory, while the ROM bootloader handles the A/B upgrade logic
	  to ensure reliable firmware switching.
	  This option provides the necessary APIs to perform these upgrade tasks
	  and is agnostic to the underlying transport protocol. It does not handle
	  firmware retrieval directly; instead, the application layer is responsible
	  for acquiring the firmware image (e.g., via an HTTP client or other means)
	  and invoking the appropriate APIs to initiate and complete the upgrade
	  process.
	  For more information, visit:
	  https://docs.silabs.com/wiseconnect/latest/wiseconnect-api-reference-guide-si91x-driver/si91-x-firmware-update-from-host-functions#sl-si91x-fwup-load

if SIWX91X_FIRMWARE_UPGRADE

config SIWX91X_FIRMWARE_UPGRADE_SHELL
	bool "Shell command for firmware upgrade"
	depends on SHELL
	depends on NET_TCP
	select SILABS_SHELL
	select HTTP_CLIENT
	select NET_SOCKETS
	select REBOOT
	default y
	help
	  Adds an "silabs fota <URL>" shell command that downloads a firmware image
	  over HTTP or HTTPS and flash it. Wi-Fi must already be connected before
	  issuing the command. The device reboots automatically when the upgrade
	  completes.

	  To get support for HTTPS, user has to enable support for TLS. Usually,
	  overlays files provided by http_client (samples/net/sockets/http_client/overlay-tls.conf)
	  should work.

endif

config SIWX91X_VERSION_SHELL
	bool "Shell command for NWP firmware version"
	depends on SILABS_SIWX91X_NWP
	depends on SHELL
	select SILABS_SHELL
	default y
	help
	  Adds a "silabs nwp_version [-c]" shell command that prints the NWP
	  firmware version. With -c, verifies that it matches the expected
	  version and returns an error if it does not.

endif # SOC_FAMILY_SILABS_SIWX91X
```

## soc/silabs/silabs_siwx91x/Kconfig.soc
```kconfig
# Copyright (c) 2023 Antmicro
# SPDX-License-Identifier: Apache-2.0

config SOC_FAMILY_SILABS_SIWX91X
	bool

rsource "*/Kconfig.soc"
```

## soc/silabs/silabs_siwx91x/nwp/Kconfig
```kconfig
# Copyright (c) 2024 Silicon Laboratories Inc.
# SPDX-License-Identifier: Apache-2.0

config SILABS_SIWX91X_NWP
	bool "Silabs Network Coprocessor"
	depends on DT_HAS_SILABS_SIWX91X_NWP_ENABLED
	select SILABS_SIWX91X_NWP_WISECONNECT
	help
	  Add support for Network Coprocessor (also named NWP) presents on SiWx91x parts.

config SILABS_SIWX91X_NWP_WISECONNECT
	bool
	select CODE_DATA_RELOCATION_SRAM
	select CMSIS_RTOS_V2
	select POLL
	select DYNAMIC_THREAD
	select THREAD_NAME
	select THREAD_STACK_INFO
	select THREAD_MONITOR
	select INIT_STACKS

if SILABS_SIWX91X_NWP_WISECONNECT

config SIWX91X_NWP_INIT_PRIORITY
	int "SiWx91x Network Processor init priority"
	default 39
	help
	  Initialization priority of the SiWx91x Network Processor. NWP init must
	  have a higher priority than services that depend on it, such as Bluetooth,
	  Wi-Fi and crypto.

endif
```

## soc/silabs/silabs_siwx91x/siwg917/Kconfig
```kconfig
# Copyright (c) 2023 Antmicro
# Copyright (c) 2024 Silicon Laboratories Inc.
# SPDX-License-Identifier: Apache-2.0

config SOC_SERIES_SIWG917
	select SOC_EARLY_INIT_HOOK
```

## soc/silabs/silabs_siwx91x/siwg917/Kconfig.soc
```kconfig
# Copyright (c) 2024 Silicon Laboratories Inc.
# SPDX-License-Identifier: Apache-2.0

config SOC_SERIES_SIWG917
	bool
	select SOC_FAMILY_SILABS_SIWX91X
	help
	  SiWG917 Series MCU

config SOC_SIWG917M111MGTBA
	bool
	select SOC_SERIES_SIWG917

config SOC_SERIES
	default "siwg917" if SOC_SERIES_SIWG917

config SOC
	default "siwg917m111mgtba" if SOC_SIWG917M111MGTBA
```

## soc/snps/arc_iot/Kconfig
```kconfig
# Copyright (c) 2014 Wind River Systems, Inc.
# Copyright (c) 2018 Synopsys, Inc. All rights reserved.
# SPDX-License-Identifier: Apache-2.0

config SOC_ARC_IOT
	select ARC
	select CPU_HAS_MPU
	select CPU_HAS_FPU
	select SOC_EARLY_INIT_HOOK

config ARC_IOT_CUSTOM_CPU_IDLE
	bool "Use custom CPU idle that skips sleep"
	default n
	depends on SOC_ARC_IOT
	select ARCH_HAS_CUSTOM_CPU_IDLE
	select ARCH_HAS_CUSTOM_CPU_ATOMIC_IDLE
	help
	  The ARC IoT SoC has a hardware limitation where entering sleep mode
	  causes peripherals (e.g., UART) to lose power, preventing wake-up
	  from peripheral interrupts. Enable this option to use a custom idle
	  implementation that skips sleep, keeping peripherals powered.
	  Enable for tests that require continuous UART operation during idle.
```

## soc/snps/emsdp/Kconfig
```kconfig
# Copyright (c) 2019 Synopsys, Inc. All rights reserved.
# SPDX-License-Identifier: Apache-2.0

config SOC_ARC_EMSDP
	select ARC

config SOC_EMSDP_EM4
	select CPU_HAS_MPU

config SOC_EMSDP_EM5D
	select CPU_HAS_MPU
	select CPU_HAS_FPU

config SOC_EMSDP_EM6
	select CPU_HAS_MPU

config SOC_EMSDP_EM7D
	select CPU_HAS_MPU
	select CPU_HAS_FPU

config SOC_EMSDP_EM7D_ESP
	select CPU_HAS_MPU
	select CPU_HAS_FPU
	select ARC_HAS_SECURE

config SOC_EMSDP_EM9D
	select CPU_HAS_MPU
	select CPU_HAS_FPU

config SOC_EMSDP_EM11D
	select CPU_HAS_MPU
	select CPU_HAS_FPU
```

## soc/snps/emsdp/Kconfig.defconfig
```kconfig
# Copyright (c) 2019 Synopsys, Inc. All rights reserved.
# SPDX-License-Identifier: Apache-2.0

if SOC_ARC_EMSDP

config NUM_IRQ_PRIO_LEVELS
	# This processor supports 4 priority levels:
	# 0 for Fast Interrupts (FIRQs) and 1-3 for Regular Interrupts (IRQs).
	default 4

rsource "Kconfig.defconfig.*"

endif # SOC_ARC_EMSDP
```

## soc/snps/emsdp/Kconfig.soc
```kconfig
# Copyright (c) 2019 Synopsys, Inc. All rights reserved.
# SPDX-License-Identifier: Apache-2.0

config SOC_ARC_EMSDP
	bool

config SOC_EMSDP_EM4
	bool
	select SOC_ARC_EMSDP
	help
	  Synopsys ARC EM4 of EMSDP

config SOC_EMSDP_EM5D
	bool
	select SOC_ARC_EMSDP
	help
	  Synopsys ARC EM5D of EMSDP

config SOC_EMSDP_EM6
	bool
	select SOC_ARC_EMSDP
	help
	  Synopsys ARC EM6 of EMSDP

config SOC_EMSDP_EM7D
	bool
	select SOC_ARC_EMSDP
	help
	  Synopsys ARC EM7D of EMSDP

config SOC_EMSDP_EM7D_ESP
	bool
	select SOC_ARC_EMSDP
	help
	  Synopsys ARC EM7D+ESP of EMSDP

config SOC_EMSDP_EM9D
	bool
	select SOC_ARC_EMSDP
	help
	  Synopsys ARC EM9D of EMSDP

config SOC_EMSDP_EM11D
	bool
	select SOC_ARC_EMSDP
	help
	  Synopsys ARC EM11D of EMSDP

config SOC_SERIES
	default "emsdp" if SOC_ARC_EMSDP

config SOC
	default "emsdp_em4" if SOC_EMSDP_EM4
	default "emsdp_em5d" if SOC_EMSDP_EM5D
	default "emsdp_em6" if SOC_EMSDP_EM6
	default "emsdp_em7d" if SOC_EMSDP_EM7D
	default "emsdp_em7d_esp" if SOC_EMSDP_EM7D_ESP
	default "emsdp_em9d" if SOC_EMSDP_EM9D
	default "emsdp_em11d" if SOC_EMSDP_EM11D
```

## soc/snps/emsk/Kconfig
```kconfig
# Copyright (c) 2014 Wind River Systems, Inc.
# Copyright (c) 2018 Synopsys, Inc. All rights reserved.
# SPDX-License-Identifier: Apache-2.0

config SOC_EMSK
	select ARC
	select SOC_EARLY_INIT_HOOK

config SOC_EMSK_EM7D
	select CPU_HAS_MPU
	select SOC_EARLY_INIT_HOOK

config SOC_EMSK_EM9D
	select CPU_HAS_FPU
	select SOC_EARLY_INIT_HOOK

config SOC_EMSK_EM11D
	select CPU_HAS_FPU
	select SOC_EARLY_INIT_HOOK
```

## soc/snps/emsk/Kconfig.defconfig
```kconfig
# Copyright (c) 2014 Wind River Systems, Inc.
# Copyright (c) 2018 Synopsys, Inc. All rights reserved.
# SPDX-License-Identifier: Apache-2.0

if SOC_EMSK

rsource "Kconfig.defconfig.*"

endif # SOC_EMSK
```

## soc/snps/emsk/Kconfig.defconfig.em9d
```kconfig
# Copyright (c) 2014 Wind River Systems, Inc.
# Copyright (c) 2018 Synopsys, Inc. All rights reserved.
# SPDX-License-Identifier: Apache-2.0

if SOC_EMSK_EM9D

config CPU_EM4_FPUS
	default y

config NUM_IRQ_PRIO_LEVELS
	# This processor supports 4 priority levels:
	# 0 for Fast Interrupts (FIRQs) and 1-3 for Regular Interrupts (IRQs).
	default 4

config NUM_IRQS
	# must be > the highest interrupt number used
	default 38 if "$(BOARD_REVISION)" = "2.3"
	default 36 if "$(BOARD_REVISION)" = "2.2"

config RGF_NUM_BANKS
	default 2

config SYS_CLOCK_HW_CYCLES_PER_SEC
	default 20000000

config HARVARD
	default y

endif # SOC_EMSK_EM9D
```

## soc/snps/emsk/Kconfig.soc
```kconfig
# Copyright (c) 2014 Wind River Systems, Inc.
# Copyright (c) 2018 Synopsys, Inc. All rights reserved.
# SPDX-License-Identifier: Apache-2.0

config SOC_EMSK
	bool
	help
	  Synopsys ARC EM Starter Kit SoC

config SOC_EMSK_EM7D
	bool
	select SOC_EMSK
	help
	  Synopsys ARC EM7D of EMSK

config SOC_EMSK_EM9D
	bool
	select SOC_EMSK
	help
	  Synopsys ARC EM9D of EMSK

config SOC_EMSK_EM11D
	bool
	select SOC_EMSK
	help
	  Synopsys ARC EM11D of EMSK

config SOC_SERIES
	default "emsk" if SOC_EMSK

config SOC
	default "emsk_em7d" if SOC_EMSK_EM7D
	default "emsk_em9d" if SOC_EMSK_EM9D
	default "emsk_em11d" if SOC_EMSK_EM11D
```

## soc/snps/hsdk/Kconfig
```kconfig
# Copyright (c) 2019 Synopsys, Inc. All rights reserved.
# SPDX-License-Identifier: Apache-2.0

config SOC_ARC_HSDK
	select ARC
	select CPU_HAS_FPU
```

## soc/snps/nsim/arc_classic/Kconfig
```kconfig
# Copyright (c) 2024 Synopsys, Inc.
# SPDX-License-Identifier: Apache-2.0

if SOC_FAMILY_NSIM_ARC_CLASSIC

rsource "*/Kconfig"

endif # SOC_FAMILY_NSIM_ARC_CLASSIC
```

## soc/snps/nsim/arc_classic/Kconfig.soc
```kconfig
# Copyright (c) 2024 Synopsys, Inc.
# SPDX-License-Identifier: Apache-2.0

config SOC_FAMILY_NSIM_ARC_CLASSIC
	bool

config SOC_FAMILY
	default "nsim_arc_classic" if SOC_FAMILY_NSIM_ARC_CLASSIC

rsource "*/Kconfig.soc"
```

## soc/snps/nsim/arc_classic/em/Kconfig
```kconfig
# Copyright (c) 2024 Synopsys, Inc.
# SPDX-License-Identifier: Apache-2.0

config SOC_SERIES_NSIM_EM
	select ARC
	select CPU_HAS_MPU
```

## soc/snps/nsim/arc_classic/em/Kconfig.defconfig
```kconfig
# Copyright (c) 2024 Synopsys, Inc.
# SPDX-License-Identifier: Apache-2.0

if SOC_SERIES_NSIM_EM

rsource "Kconfig.defconfig.em*"

endif # SOC_SERIES_NSIM_EM
```

## soc/snps/nsim/arc_classic/em/Kconfig.soc
```kconfig
# Copyright (c) 2024 Synopsys, Inc.
# SPDX-License-Identifier: Apache-2.0

config SOC_SERIES_NSIM_EM
	bool
	select SOC_FAMILY_NSIM_ARC_CLASSIC

config SOC_SERIES
	default "nsim_em" if SOC_SERIES_NSIM_EM

config SOC_NSIM_EM
	bool
	select SOC_SERIES_NSIM_EM

config SOC_NSIM_EM7D_V22
	bool
	select SOC_SERIES_NSIM_EM

config SOC_NSIM_EM11D
	bool
	select SOC_SERIES_NSIM_EM

config SOC
	default "nsim_em" if SOC_NSIM_EM
	default "nsim_em7d_v22" if SOC_NSIM_EM7D_V22
	default "nsim_em11d" if SOC_NSIM_EM11D
```

## soc/snps/nsim/arc_classic/hs/Kconfig
```kconfig
# Copyright (c) 2024 Synopsys, Inc.
# SPDX-License-Identifier: Apache-2.0

config SOC_SERIES_NSIM_HS
	select ARC
	select CPU_HAS_FPU
	select CPU_HAS_MPU if !SMP
```
