## soc/silabs/silabs_s0/efm32tg/Kconfig
```kconfig
# Copyright (c) 2025 Lukas Woodtli
# SPDX-License-Identifier: Apache-2.0

config SOC_SERIES_EFM32TG
	select ARM
	select CPU_CORTEX_M3
	select CPU_CORTEX_M_HAS_DWT
	select HAS_SILABS_GECKO
	select SOC_GECKO_CMU
	select SOC_GECKO_GPIO
	select HAS_PM
```

## soc/silabs/silabs_s0/efm32tg/Kconfig.defconfig
```kconfig
# Copyright (c) 2025 Lukas Woodtli
# SPDX-License-Identifier: Apache-2.0

if SOC_SERIES_EFM32TG

config SYS_CLOCK_HW_CYCLES_PER_SEC
	default $(dt_node_int_prop_int,/cpus/cpu@0,clock-frequency)

config NUM_IRQS
	# must be >= the highest interrupt number used
	default 39

endif
```

## soc/silabs/silabs_s0/efm32tg/Kconfig.soc
```kconfig
# Copyright (c) 2025 Lukas Woodtli
# SPDX-License-Identifier: Apache-2.0

config SOC_SERIES_EFM32TG
	bool
	select SOC_FAMILY_SILABS_S0
	help
	  Silicon Labs EFM32TG (Tiny Gecko) Series MCU

config SOC_EFM32TG840F32
	bool
	select SOC_SERIES_EFM32TG

config SOC_SERIES
	default "efm32tg" if SOC_SERIES_EFM32TG

config SOC
	default "efm32tg840f32" if SOC_EFM32TG840F32
```

## soc/silabs/silabs_s0/efm32wg/Kconfig
```kconfig
# Copyright (c) 2017 Christian Taedcke
# SPDX-License-Identifier: Apache-2.0

config SOC_SERIES_EFM32WG
	select ARM
	select CPU_CORTEX_M4
	select CPU_CORTEX_M_HAS_DWT
	select CPU_HAS_FPU
	select CPU_HAS_ARM_MPU
	select HAS_SILABS_GECKO
	select SOC_GECKO_CMU
	select SOC_GECKO_GPIO
	select HAS_PM

config SOC_GECKO_SDID
	default 74 if SOC_SERIES_EFM32WG
```

## soc/silabs/silabs_s0/efm32wg/Kconfig.defconfig
```kconfig
# Copyright (c) 2017 Christian Taedcke
# SPDX-License-Identifier: Apache-2.0

if SOC_SERIES_EFM32WG

config NUM_IRQS
	# must be >= the highest interrupt number used
	default 39

endif
```

## soc/silabs/silabs_s0/efm32wg/Kconfig.soc
```kconfig
# Copyright (c) 2017 Christian Taedcke
# SPDX-License-Identifier: Apache-2.0

config SOC_SERIES_EFM32WG
	bool
	select SOC_FAMILY_SILABS_S0
	help
	  Silicon Labs EFM32WG (Wonder Gecko) Series MCU

config SOC_PART_NUMBER_EFM32WG990F256
	bool
	select SOC_SERIES_EFM32WG

config SOC_SERIES
	default "efm32wg" if SOC_SERIES_EFM32WG

config SOC
	default "efm32wg990f256" if SOC_PART_NUMBER_EFM32WG990F256

config SOC_PART_NUMBER
	default "EFM32WG990F256" if SOC_PART_NUMBER_EFM32WG990F256
```

## soc/silabs/silabs_s1/Kconfig
```kconfig
# Copyright (c) 2024 GARDENA GmbH
# SPDX-License-Identifier: Apache-2.0

if SOC_FAMILY_SILABS_S1

config SOC_FAMILY_SILABS_S1
	select HAS_SEGGER_RTT if ZEPHYR_SEGGER_MODULE
	select BUILD_OUTPUT_HEX
	select SOC_EARLY_INIT_HOOK
	select PM_STATE_SET_IRQ_UNLOCKED

rsource "*/Kconfig"

# Hardware capability flags (auto-detected from Device Tree)
# Bluetooth 5.0
config HAS_HW_EFR32_RADIO_BLE_2M
	def_bool $(dt_nodelabel_has_prop,radio,ble-2mbps-supported)

config HAS_HW_EFR32_RADIO_BLE_CODED
	def_bool $(dt_nodelabel_has_prop,radio,ble-coded-phy-supported)

# Bluetooth 5.1
config HAS_HW_EFR32_RADIO_CTE_TX
	def_bool $(dt_nodelabel_has_prop,radio,ble-cte-tx-supported)

config HAS_HW_EFR32_RADIO_CTE_RX
	def_bool $(dt_nodelabel_has_prop,radio,ble-cte-rx-supported) && HAS_HW_EFR32_RADIO_CTE_TX

# Vendor-specific
config HAS_HW_EFR32_RADIO_TX_HIGH_POWER
	def_bool $(dt_nodelabel_has_prop,radio,radio-tx-high-power-supported)

endif
```

## soc/silabs/silabs_s1/Kconfig.defconfig
```kconfig
# Copyright (c) 2024 Silicon Laboratories Inc.
# SPDX-License-Identifier: Apache-2.0

rsource "*/Kconfig.defconfig"

if SOC_FAMILY_SILABS_S1

configdefault SYS_CLOCK_HW_CYCLES_PER_SEC
	default $(dt_node_int_prop_int,/cpus/cpu@0,clock-frequency) if CORTEX_M_SYSTICK
	default 32768 if SILABS_SLEEPTIMER_TIMER

configdefault SYS_CLOCK_TICKS_PER_SEC
	default 128 if !TICKLESS_KERNEL && SILABS_SLEEPTIMER_TIMER
	default 32768 if SILABS_SLEEPTIMER_TIMER

configdefault SILABS_SLEEPTIMER_TIMER
	default y

configdefault CORTEX_M_SYSTICK
	default n if SILABS_SLEEPTIMER_TIMER

endif # SOC_FAMILY_SILABS_S1
```

## soc/silabs/silabs_s1/Kconfig.soc
```kconfig
# Copyright (c) 2017 Christian Taedcke
# SPDX-License-Identifier: Apache-2.0

config SOC_FAMILY_SILABS_S1
	bool

rsource "*/Kconfig.soc"
```

## soc/silabs/silabs_s1/efm32gg11b/Kconfig
```kconfig
# EFM32GG11B (Giant Gecko) MCU line
# Copyright (c) 2019 Interay Solutions B.V.
# Copyright (c) 2019 Oane Kingma
# SPDX-License-Identifier: Apache-2.0

config SOC_SERIES_EFM32GG11B
	select ARM
	select HAS_SILABS_GECKO
	select HAS_SWO
	select CPU_CORTEX_M4
	select CPU_HAS_FPU
	select CPU_HAS_ARM_MPU
	select SOC_GECKO_HAS_INDIVIDUAL_PIN_LOCATION
	select SOC_GECKO_HAS_HFRCO_FREQRANGE
	select SOC_GECKO_CMU
	select SOC_GECKO_EMU
	select SOC_GECKO_GPIO
	select SOC_GECKO_TRNG

config SOC_GECKO_SDID
	default 100 if SOC_SERIES_EFM32GG11B
```

## soc/silabs/silabs_s1/efm32gg11b/Kconfig.defconfig
```kconfig
# EFM32GG11B series configuration options
# Copyright (c) 2019 Interay Solutions B.V.
# Copyright (c) 2019 Oane Kingma
# SPDX-License-Identifier: Apache-2.0

if SOC_SERIES_EFM32GG11B

config NUM_IRQS
	int
	# must be >= the highest interrupt number used
	default 68

config GPIO_GECKO
	default y
	depends on GPIO || LOG_BACKEND_SWO

endif # SOC_SERIES_EFM32GG11B
```

## soc/silabs/silabs_s1/efm32gg11b/Kconfig.soc
```kconfig
# EFM32GG11B (Giant Gecko) MCU line
# Copyright (c) 2019 Interay Solutions B.V.
# Copyright (c) 2019 Oane Kingma
# SPDX-License-Identifier: Apache-2.0

config SOC_SERIES_EFM32GG11B
	bool
	select SOC_FAMILY_SILABS_S1
	help
	  EFM32GG11B Series MCU

config SOC_PART_NUMBER_EFM32GG11B820F2048GL192
	bool
	select SOC_SERIES_EFM32GG11B

config SOC_PART_NUMBER_EFM32GG11B820F2048GM64
	bool
	select SOC_SERIES_EFM32GG11B

config SOC_SERIES
	default "efm32gg11b" if SOC_SERIES_EFM32GG11B

config SOC
	default "efm32gg11b820f2048gl192" if SOC_PART_NUMBER_EFM32GG11B820F2048GL192
	default "efm32gg11b820f2048gm64" if SOC_PART_NUMBER_EFM32GG11B820F2048GM64

config SOC_PART_NUMBER
	default "EFM32GG11B820F2048GL192" if SOC_PART_NUMBER_EFM32GG11B820F2048GL192
	default "EFM32GG11B820F2048GM64" if SOC_PART_NUMBER_EFM32GG11B820F2048GM64
```

## soc/silabs/silabs_s1/efm32gg12b/Kconfig
```kconfig
# Copyright (c) 2023 Antmicro <www.antmicro.com>
# SPDX-License-Identifier: Apache-2.0

config SOC_SERIES_EFM32GG12B
	select ARM
	select HAS_SILABS_GECKO
	select HAS_SWO
	select CPU_CORTEX_M4
	select CPU_HAS_FPU
	select CPU_HAS_ARM_MPU
	select SOC_GECKO_HAS_INDIVIDUAL_PIN_LOCATION
	select SOC_GECKO_HAS_HFRCO_FREQRANGE
	select SOC_GECKO_CMU
	select SOC_GECKO_EMU
	select SOC_GECKO_GPIO
	select SOC_GECKO_TRNG

config SOC_GECKO_SDID
	default 106 if SOC_SERIES_EFM32GG12B
```

## soc/silabs/silabs_s1/efm32gg12b/Kconfig.defconfig
```kconfig
# Copyright (c) 2023 Antmicro <www.antmicro.com>
# SPDX-License-Identifier: Apache-2.0

if SOC_SERIES_EFM32GG12B

config NUM_IRQS
	# must be >= the highest interrupt number used
	default 68

config GPIO_GECKO
	default y
	depends on GPIO || LOG_BACKEND_SWO

endif
```

## soc/silabs/silabs_s1/efm32gg12b/Kconfig.soc
```kconfig
# Copyright (c) 2023 Antmicro <www.antmicro.com>
# SPDX-License-Identifier: Apache-2.0

config SOC_SERIES_EFM32GG12B
	bool
	select SOC_FAMILY_SILABS_S1
	help
	  Silicon Labs EFM32GG12 (Giant Gecko) Series MCU

config SOC_PART_NUMBER_EFM32GG12B810F1024GM64
	bool
	select SOC_SERIES_EFM32GG12B

config SOC_SERIES
	default "efm32gg12b" if SOC_SERIES_EFM32GG12B

config SOC
	default "efm32gg12b810f1024gm64" if SOC_PART_NUMBER_EFM32GG12B810F1024GM64

config SOC_PART_NUMBER
	default "EFM32GG12B810F1024GM64" if SOC_PART_NUMBER_EFM32GG12B810F1024GM64
```

## soc/silabs/silabs_s1/efm32jg12b/Kconfig
```kconfig
# Copyright (c) 2019 Lemonbeat GmbH
# SPDX-License-Identifier: Apache-2.0

config SOC_SERIES_EFM32JG12B
	select ARM
	select HAS_SILABS_GECKO
	select HAS_SWO
	select CPU_CORTEX_M3
	select CPU_HAS_ARM_MPU
	select SOC_GECKO_HAS_INDIVIDUAL_PIN_LOCATION
	select SOC_GECKO_HAS_HFRCO_FREQRANGE
	select SOC_GECKO_CMU
	select SOC_GECKO_EMU
	select SOC_GECKO_GPIO
	select SOC_GECKO_TRNG
	select HAS_PM

config SOC_GECKO_SDID
	default 84 if SOC_SERIES_EFM32JG12B
```

## soc/silabs/silabs_s1/efm32jg12b/Kconfig.defconfig
```kconfig
# Copyright (c) 2019 Lemonbeat GmbH
# SPDX-License-Identifier: Apache-2.0

if SOC_SERIES_EFM32JG12B

config NUM_IRQS
	# must be >= the highest interrupt number used
	default 50

endif
```

## soc/silabs/silabs_s1/efm32jg12b/Kconfig.soc
```kconfig
# Copyright (c) 2019 Lemonbeat GmbH
# SPDX-License-Identifier: Apache-2.0

config SOC_SERIES_EFM32JG12B
	bool
	select SOC_FAMILY_SILABS_S1
	help
	  Silicon Labs EFR32JG12B (Jade Gecko) Series MCU

config SOC_EFM32JG12B500F1024GL125
	bool
	select SOC_SERIES_EFM32JG12B

config SOC_SERIES
	default "efm32jg12b" if SOC_SERIES_EFM32JG12B

config SOC
	default "efm32jg12b500f1024gl125" if SOC_EFM32JG12B500F1024GL125
```

## soc/silabs/silabs_s1/efm32pg12b/Kconfig.defconfig
```kconfig
# EFM32PG12B series configuration options

# Copyright (c) 2018 Christian Taedcke
# SPDX-License-Identifier: Apache-2.0

if SOC_SERIES_EFM32PG12B

config NUM_IRQS
	# must be >= the highest interrupt number used
	default 50

endif # SOC_SERIES_EFM32PG12B
```

## soc/silabs/silabs_s1/efm32pg12b/Kconfig.soc
```kconfig
# Copyright (c) 2018 Christian Taedcke
# SPDX-License-Identifier: Apache-2.0

config SOC_SERIES_EFM32PG12B
	bool
	select SOC_FAMILY_SILABS_S1
	help
	  Silicon Labs EFR32PG12B (Pearl Gecko) Series MCU

config SOC_PART_NUMBER_EFM32PG12B500F1024GL125
	bool
	select SOC_SERIES_EFM32PG12B

config SOC_SERIES
	default "efm32pg12b" if SOC_SERIES_EFM32PG12B

config SOC
	default "efm32pg12b500f1024gl125" if SOC_PART_NUMBER_EFM32PG12B500F1024GL125

config SOC_PART_NUMBER
	default "EFM32PG12B500F1024GL125" if SOC_PART_NUMBER_EFM32PG12B500F1024GL125
```

## soc/silabs/silabs_s1/efm32pg1b/Kconfig
```kconfig
# EFM32PG1B (Pearl Gecko) MCU line

# Copyright (c) 2018 Christian Taedcke
# SPDX-License-Identifier: Apache-2.0

config SOC_SERIES_EFM32PG1B
	select ARM
	select HAS_SILABS_GECKO
	select HAS_SWO
	select CPU_CORTEX_M4
	select CPU_CORTEX_M_HAS_DWT
	select CPU_HAS_FPU
	select CPU_HAS_ARM_MPU
	select SOC_GECKO_HAS_INDIVIDUAL_PIN_LOCATION
	select SOC_GECKO_HAS_HFRCO_FREQRANGE
	select SOC_GECKO_CMU
	select SOC_GECKO_EMU
	select SOC_GECKO_GPIO
	select HAS_PM

config SOC_GECKO_SDID
	default 80 if SOC_SERIES_EFM32PG1B
```

## soc/silabs/silabs_s1/efm32pg1b/Kconfig.defconfig
```kconfig
# EFM32PG1B series configuration options

# Copyright (c) 2020 Rafael Dias Menezes <rdmeneze@gmail.com>
# SPDX-License-Identifier: Apache-2.0

if SOC_SERIES_EFM32PG1B

config NUM_IRQS
	# must be >= the highest interrupt number used
	default 34

endif # SOC_SERIES_EFM32PG1B
```

## soc/silabs/silabs_s1/efm32pg1b/Kconfig.soc
```kconfig
# Copyright (c) 2018 Christian Taedcke
# SPDX-License-Identifier: Apache-2.0

config SOC_SERIES_EFM32PG1B
	bool
	select SOC_FAMILY_SILABS_S1
	help
	  Silicon Labs EFR32PG1B (Pearl Gecko) Series MCU

config SOC_EFM32PG1B200F256GM48
	bool
	select SOC_SERIES_EFM32PG1B

config SOC_SERIES
	default "efm32pg1b" if SOC_SERIES_EFM32PG1B

config SOC
	default "efm32pg1b200f256gm48" if SOC_EFM32PG1B200F256GM48
```

## soc/silabs/silabs_s1/efr32bg13p/Kconfig
```kconfig
# Copyright (c) 2020 Piotr Mienkowski
# SPDX-License-Identifier: Apache-2.0

config SOC_SERIES_EFR32BG13P
	select ARM
	select CPU_CORTEX_M4
	select CPU_CORTEX_M_HAS_DWT
	select CPU_HAS_FPU
	select CPU_HAS_ARM_MPU
	select SOC_GECKO_HAS_RADIO
	select HAS_SILABS_GECKO
	select HAS_SWO
	select SOC_GECKO_HAS_INDIVIDUAL_PIN_LOCATION
	select SOC_GECKO_CMU
	select SOC_GECKO_EMU
	select SOC_GECKO_GPIO
	select HAS_PM

config SOC_GECKO_SDID
	default 89 if SOC_SERIES_EFR32BG13P
```

## soc/silabs/silabs_s1/efr32bg13p/Kconfig.defconfig
```kconfig
# Copyright (c) 2020 Piotr Mienkowski
# SPDX-License-Identifier: Apache-2.0

if SOC_SERIES_EFR32BG13P

config NUM_IRQS
	# must be >= the highest interrupt number used
	default 47

endif
```
