## soc/silabs/silabs_s2/efr32mg21/Kconfig
```kconfig
# Copyright (c) 2020 TriaGnoSys GmbH
# SPDX-License-Identifier: Apache-2.0

config SOC_SERIES_EFR32MG21
	select ARM
	select CPU_CORTEX_M33
	select CPU_CORTEX_M_HAS_DWT
	select ARMV8_M_DSP
	select ARM_TRUSTZONE_M
	select CPU_HAS_FPU
	select CPU_HAS_ARM_MPU
	select CPU_HAS_ARM_SAU
	select SOC_GECKO_HAS_RADIO
	select HAS_SILABS_GECKO
	select HAS_SWO
	select SOC_GECKO_CMU
	select SOC_GECKO_EMU
	select SOC_GECKO_GPIO
	select SOC_GECKO_DEV_INIT
	select SOC_GECKO_SE
	select HAS_PM

config SOC_GECKO_SDID
	default 200 if SOC_SERIES_EFR32MG21
```

## soc/silabs/silabs_s2/efr32mg21/Kconfig.defconfig
```kconfig
# Copyright (c) 2020 TriaGnoSys GmbH
# SPDX-License-Identifier: Apache-2.0

if SOC_SERIES_EFR32MG21

config NUM_IRQS
	# must be >= the highest interrupt number used
	default 61

config PM
	select COUNTER
	select UART_INTERRUPT_DRIVEN

endif
```

## soc/silabs/silabs_s2/efr32mg21/Kconfig.soc
```kconfig
# Copyright (c) 2020 TriaGnoSys GmbH
# SPDX-License-Identifier: Apache-2.0

config SOC_SERIES_EFR32MG21
	bool
	select SOC_FAMILY_SILABS_S2
	help
	  Silicon Labs EFR32MG21 (Mighty Gecko) Series MCU

config SOC_PART_NUMBER_EFR32MG21A020F1024IM32
	bool
	select SOC_SERIES_EFR32MG21

config SOC_SERIES
	default "efr32mg21" if SOC_SERIES_EFR32MG21

config SOC
	default "efr32mg21a020f1024im32" if SOC_PART_NUMBER_EFR32MG21A020F1024IM32

config SOC_PART_NUMBER
	default "EFR32MG21A020F1024IM32" if SOC_PART_NUMBER_EFR32MG21A020F1024IM32
```

## soc/silabs/silabs_s2/efr32mg24/Kconfig.defconfig
```kconfig
# Copyright (c) 2021 Sateesh Kotapati
# SPDX-License-Identifier: Apache-2.0

if SOC_SERIES_EFR32MG24

config NUM_IRQS
	# must be >= the highest interrupt number used
	default 75

config PM
	default n
	select UART_INTERRUPT_DRIVEN if SERIAL_SUPPORT_INTERRUPT

choice PM_POLICY
	default PM_POLICY_DEFAULT
	depends on PM
endchoice

endif
```
