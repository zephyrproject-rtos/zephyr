## soc/silabs/silabs_s1/efr32bg13p/Kconfig.soc
```kconfig
# Copyright (c) 2020 Piotr Mienkowski
# SPDX-License-Identifier: Apache-2.0

config SOC_SERIES_EFR32BG13P
	bool
	select SOC_FAMILY_SILABS_S1
	help
	  Silicon Labs EFR32BG13P (Blue Gecko) Series MCU

config SOC_EFR32BG13P632F512GM48
	bool
	select SOC_SERIES_EFR32BG13P

config SOC_SERIES
	default "efr32bg13p" if SOC_SERIES_EFR32BG13P

config SOC
	default "efr32bg13p632f512gm48" if SOC_EFR32BG13P632F512GM48
```

## soc/silabs/silabs_s1/efr32fg13p/Kconfig
```kconfig
# EFR32FG13P (Flex Gecko) MCU line

# Copyright (c) 2018 Christian Taedcke
# SPDX-License-Identifier: Apache-2.0

config SOC_SERIES_EFR32FG13P
	select ARM
	select HAS_SILABS_GECKO
	select HAS_SWO
	select CPU_CORTEX_M4
	select CPU_CORTEX_M_HAS_DWT
	select CPU_HAS_FPU
	select CPU_HAS_ARM_MPU
	select SOC_GECKO_HAS_RADIO
	select SOC_GECKO_HAS_INDIVIDUAL_PIN_LOCATION
	select SOC_GECKO_HAS_HFRCO_FREQRANGE
	select SOC_GECKO_CMU
	select SOC_GECKO_GPIO
	select SOC_GECKO_HAS_ERRATA_RTCC_E201
	select HAS_PM

config SOC_GECKO_SDID
	default 89 if SOC_SERIES_EFR32FG13P
```

## soc/silabs/silabs_s1/efr32fg13p/Kconfig.soc
```kconfig
# EFR32FG13P (Flex Gecko) MCU line

# Copyright (c) 2018 Christian Taedcke
# SPDX-License-Identifier: Apache-2.0

config SOC_SERIES_EFR32FG13P
	bool
	select SOC_FAMILY_SILABS_S1
	help
	  EFR32FG13P Series MCU

config SOC_PART_NUMBER_EFR32FG13P233F512GM48
	bool
	select SOC_SERIES_EFR32FG13P

config SOC_SERIES
	default "efr32fg13p" if SOC_SERIES_EFR32FG13P

config SOC
	default "efr32fg13p233f512gm48" if SOC_PART_NUMBER_EFR32FG13P233F512GM48

config SOC_PART_NUMBER
	default "EFR32FG13P233F512GM48" if SOC_PART_NUMBER_EFR32FG13P233F512GM48
```

## soc/silabs/silabs_s1/efr32fg1p/Kconfig.defconfig
```kconfig
# Copyright (c) 2018 Christian Taedcke
# SPDX-License-Identifier: Apache-2.0

if SOC_SERIES_EFR32FG1P

config SOC_GECKO_SDID
	default 80

config NUM_IRQS
	# must be >= the highest interrupt number used
	default 33

endif
```

## soc/silabs/silabs_s1/efr32fg1p/Kconfig.soc
```kconfig
# EFR32FG1P (Flex Gecko) MCU line

# Copyright (c) 2018 Christian Taedcke
# SPDX-License-Identifier: Apache-2.0

config SOC_SERIES_EFR32FG1P
	bool
	select SOC_FAMILY_SILABS_S1
	help
	  EFR32FG1P Series MCU

config SOC_PART_NUMBER_EFR32FG1P133F256GM48
	bool
	select SOC_SERIES_EFR32FG1P

config SOC_SERIES
	default "efr32fg1p" if SOC_SERIES_EFR32FG1P

config SOC
	default "efr32fg1p133f256gm48" if SOC_PART_NUMBER_EFR32FG1P133F256GM48

config SOC_PART_NUMBER
	default "EFR32FG1P133F256GM48" if SOC_PART_NUMBER_EFR32FG1P133F256GM48
```

## soc/silabs/silabs_s1/efr32mg12p/Kconfig.defconfig
```kconfig
# Copyright (c) 2018 Diego Sueiro
# SPDX-License-Identifier: Apache-2.0

if SOC_SERIES_EFR32MG12P

config NUM_IRQS
	# must be >= the highest interrupt number used
	default 49

endif
```

## soc/silabs/silabs_s1/efr32mg12p/Kconfig.soc
```kconfig
# Copyright (c) 2018 Diego Sueiro
# SPDX-License-Identifier: Apache-2.0

config SOC_SERIES_EFR32MG12P
	bool
	select SOC_FAMILY_SILABS_S1
	help
	  Silicon Labs EFR32MG12P (Mighty Gecko) Series MCU

config SOC_PART_NUMBER_EFR32MG12P332F1024GL125
	bool
	select SOC_SERIES_EFR32MG12P

config SOC_PART_NUMBER_EFR32MG12P433F1024GM68
	bool
	select SOC_SERIES_EFR32MG12P

config SOC_PART_NUMBER_EFR32MG12P432F1024GL125
	bool
	select SOC_SERIES_EFR32MG12P

config SOC_SERIES
	default "efr32mg12p" if SOC_SERIES_EFR32MG12P

config SOC
	default "efr32mg12p332f1024gl125" if SOC_PART_NUMBER_EFR32MG12P332F1024GL125
	default "efr32mg12p432f1024gl125" if SOC_PART_NUMBER_EFR32MG12P432F1024GL125
	default "efr32mg12p433f1024gm68" if SOC_PART_NUMBER_EFR32MG12P433F1024GM68

config SOC_PART_NUMBER
	default "EFR32MG12P332F1024GL125" if SOC_PART_NUMBER_EFR32MG12P332F1024GL125
	default "EFR32MG12P432F1024GL125" if SOC_PART_NUMBER_EFR32MG12P432F1024GL125
	default "EFR32MG12P433F1024GM68" if SOC_PART_NUMBER_EFR32MG12P433F1024GM68
```

## soc/silabs/silabs_s1/efr32mg13p/Kconfig
```kconfig
# Copyright (c) 2020 Piotr Mienkowski
# SPDX-License-Identifier: Apache-2.0

config SOC_SERIES_EFR32MG13P
	select ARM
	select CPU_CORTEX_M4
	select CPU_CORTEX_M_HAS_DWT
	select CPU_HAS_FPU
	select CPU_HAS_ARM_MPU
	select SOC_GECKO_HAS_RADIO
	select HAS_SILABS_GECKO
	select HAS_SWO
	select SOC_GECKO_HAS_INDIVIDUAL_PIN_LOCATION
	select SILABS_GECKO_CMU
	select SILABS_GECKO_EMU
	select SILABS_GECKO_GPIO
	select HAS_PM
```

## soc/silabs/silabs_s1/efr32mg13p/Kconfig.soc
```kconfig
# Copyright (c) 2020 Piotr Mienkowski
# SPDX-License-Identifier: Apache-2.0

config SOC_SERIES_EFR32MG13P
	bool
	select SOC_FAMILY_SILABS_S1
	help
	  Silicon Labs EFR32MG13P (Mighty Gecko) Series MCU

config SOC_EFR32MG13P732F512GM48
	bool
	select SOC_SERIES_EFR32MG13P

config SOC_SERIES
	default "efr32mg13p" if SOC_SERIES_EFR32MG13P

config SOC
	default "efr32mg13p732f512gm48" if SOC_EFR32MG13P732F512GM48
```

## soc/silabs/silabs_s2/Kconfig.defconfig
```kconfig
# Copyright (c) 2024 Silicon Laboratories Inc.
# SPDX-License-Identifier: Apache-2.0

rsource "*/Kconfig.defconfig"

if SOC_FAMILY_SILABS_S2

configdefault SYS_CLOCK_HW_CYCLES_PER_SEC
	default $(dt_node_int_prop_int,/cpus/cpu@0,clock-frequency) if CORTEX_M_SYSTICK
	default 32768

configdefault SYS_CLOCK_TICKS_PER_SEC
	default 128 if !TICKLESS_KERNEL && (SILABS_SLEEPTIMER_TIMER || GECKO_BURTC_TIMER)
	default 32768 if SILABS_SLEEPTIMER_TIMER
	default 1024 if GECKO_BURTC_TIMER

configdefault SILABS_SLEEPTIMER_TIMER
	default y

configdefault CORTEX_M_SYSTICK
	default n if SILABS_SLEEPTIMER_TIMER || GECKO_BURTC_TIMER

configdefault CLOCK_CONTROL
	default y

# silabs_s2 uses simplicity_sdk hal library, which already have by default a zero latency
# IRQs mechanism with a hardcoded value. In order to be aligned with simplicity_sdk, we
# need to activate Zero Latency IRQ in Zephyr by default. The level (2) depends on the
# hardcoded value in simplicity_sdk (CORE_ATOMIC_BASE_PRIORITY_LEVEL). Without this config,
# if you use an IRQ with a priority of 0 or 1, irq_lock() and irq_unlock() have no effect
# over this IRQ.

configdefault ZERO_LATENCY_IRQS
	default y

configdefault ZERO_LATENCY_LEVELS
	default 2

configdefault SILABS_SISDK_HFXO_MANAGER
	default y if PM && $(dt_nodelabel_enabled,sysrtc0) && $(dt_nodelabel_enabled,hfxo)

configdefault SILABS_SISDK_POWER_MANAGER
	default y if PM

# With sl_power_manager, pm_state_set()'s stack footprint is noticeably
# large, especially with logs enabled. Since it is called from IDLE task,
# its stack size has to be increased
configdefault IDLE_STACK_SIZE
	default 512 if PM

configdefault NUM_METAIRQ_PRIORITIES
	default 1 if BT_SILABS_EFR32

if BT_LONG_WQ
configdefault BT_LONG_WQ_STACK_SIZE
	# Hidden config item. We require a slightly larger stack than the
	# default values are. As of this writing, we have a bit less than
	# 200 bytes of headroom for future increases here, before we hit
	# the limit again.
	default 1600 if BT_ECC
endif

configdefault SILABS_SISDK_RAIL_MULTIPROTOCOL
	default y if BT_SILABS_EFR32 && IEEE802154_SILABS_EFR32

if NET_L2_PHY_IEEE802154
configdefault NET_PKT_RX_COUNT
	default 16

configdefault NET_PKT_TX_COUNT
	default 16

configdefault NET_BUF_RX_COUNT
	default 64

configdefault NET_BUF_TX_COUNT
	default 64

endif

if OPENTHREAD
choice OPENTHREAD_IMPLEMENTATION
	default OPENTHREAD_SOURCES
endchoice

choice OPENTHREAD_STACK_VERSION
	default OPENTHREAD_THREAD_VERSION_1_4
endchoice

configdefault OPENTHREAD_MANUAL_START
	default y

configdefault OPENTHREAD_RADIO_WORKQUEUE_STACK_SIZE
	default 2048

configdefault OPENTHREAD_MAC_SOFTWARE_CSMA_BACKOFF_ENABLE
	default n

configdefault OPENTHREAD_MIN_RECEIVE_ON_AFTER
	default 0

configdefault OPENTHREAD_MAC_SOFTWARE_TX_SECURITY_ENABLE
	default n

configdefault OPENTHREAD_IP6_MAX_EXT_MCAST_ADDRS
	default 4

configdefault OPENTHREAD_DNS_CLIENT
	default y

configdefault OPENTHREAD_DUA
	default y

configdefault OPENTHREAD_EXTERNAL_HEAP
	default y

configdefault OPENTHREAD_LINK_METRICS_INITIATOR
	default y

configdefault OPENTHREAD_LINK_METRICS_SUBJECT
	default y

configdefault OPENTHREAD_MAC_BEACON_PAYLOAD_PARSING
	default y

configdefault OPENTHREAD_MLR
	default y

configdefault OPENTHREAD_MULTIPLE_INSTANCE_NUM
	default 2

configdefault OPENTHREAD_NETDIAG_CLIENT
	default y

configdefault OPENTHREAD_PING_SENDER
	default y

configdefault OPENTHREAD_SLAAC
	default y

configdefault OPENTHREAD_SRP_CLIENT
	default y

configdefault OPENTHREAD_UPTIME
	default y if OPENTHREAD_FTD || OPENTHREAD_MTD

if OPENTHREAD_COMMISSIONER
configdefault MBEDTLS_HEAP_SIZE
	default 16384

endif

endif

endif
```

## soc/silabs/silabs_s2/bgm24/Kconfig.defconfig
```kconfig
# Silicon Labs BGM24 (Mighty Gecko) BLE module configuration options

# Copyright (c) 2021 Sateesh Kotapati
# Copyright (c) 2024 Jonny Gellhaar
# SPDX-License-Identifier: Apache-2.0

if SOC_SERIES_BGM24

config CMU_NEED_LFXO
	default n

# Required for librail memory management
config BT
	depends on KERNEL_MEM_POOL

config HEAP_MEM_POOL_SIZE
	default 16384 if BT

config NUM_IRQS
	# must be >= the highest interrupt number used
	default 75

config PM
	default n
	select COUNTER
	select UART_INTERRUPT_DRIVEN if SERIAL_SUPPORT_INTERRUPT

choice PM_POLICY
	default PM_POLICY_DEFAULT
	depends on PM
endchoice

endif # SOC_SERIES_BGM24
```

## soc/silabs/silabs_s2/bgm24/Kconfig.soc
```kconfig
# Copyright (c) 2020 TriaGnoSys GmbH
# Copyright (c) 2025 Jonny Gellhaar
# SPDX-License-Identifier: Apache-2.0

config SOC_SERIES_BGM24
	bool
	select SOC_FAMILY_SILABS_S2
	help
	  Silicon Labs BGM24 (Mighty Gecko) Series MCU

config SOC_PART_NUMBER_BGM240PA22VNA
	bool
	select SOC_SERIES_BGM24

config SOC_PART_NUMBER_BGM240PA32VNA
	bool
	select SOC_SERIES_BGM24

config SOC_PART_NUMBER_BGM240PA32VNN
	bool
	select SOC_SERIES_BGM24

config SOC_PART_NUMBER_BGM240PB22VNA
	bool
	select SOC_SERIES_BGM24

config SOC_PART_NUMBER_BGM240PB32VNA
	bool
	select SOC_SERIES_BGM24

config SOC_PART_NUMBER_BGM240PB32VNN
	bool
	select SOC_SERIES_BGM24

config SOC_PART_NUMBER_BGM240SA22VNA
	bool
	select SOC_SERIES_BGM24

config SOC_PART_NUMBER_BGM240SB22VNA
	bool
	select SOC_SERIES_BGM24

config SOC_PART_NUMBER_BGM241SB22VNA
	bool
	select SOC_SERIES_BGM24

config SOC_PART_NUMBER_BGM241SD22VNA
	bool
	select SOC_SERIES_BGM24

config SOC_SERIES
	default "bgm24" if SOC_SERIES_BGM24

config SOC
	default "bgm240pa22vna" if SOC_PART_NUMBER_BGM240PA22VNA
	default "bgm240pa32vna" if SOC_PART_NUMBER_BGM240PA32VNA
	default "bgm240pa32vnn" if SOC_PART_NUMBER_BGM240PA32VNN
	default "bgm240pb22vna" if SOC_PART_NUMBER_BGM240PB22VNA
	default "bgm240pb32vna" if SOC_PART_NUMBER_BGM240PB32VNA
	default "bgm240pb32vnn" if SOC_PART_NUMBER_BGM240PB32VNN
	default "bgm240sa22vna" if SOC_PART_NUMBER_BGM240SA22VNA
	default "bgm240sb22vna" if SOC_PART_NUMBER_BGM240SB22VNA
	default "bgm241sb22vna" if SOC_PART_NUMBER_BGM241SB22VNA
	default "bgm241sd22vna" if SOC_PART_NUMBER_BGM241SD22VNA

config SOC_PART_NUMBER
	default "BGM240PA22VNA" if SOC_PART_NUMBER_BGM240PA22VNA
	default "BGM240PA32VNA" if SOC_PART_NUMBER_BGM240PA32VNA
	default "BGM240PA32VNN" if SOC_PART_NUMBER_BGM240PA32VNN
	default "BGM240PB22VNA" if SOC_PART_NUMBER_BGM240PB22VNA
	default "BGM240PB32VNA" if SOC_PART_NUMBER_BGM240PB32VNA
	default "BGM240PB32VNN" if SOC_PART_NUMBER_BGM240PB32VNN
	default "BGM240SA22VNA" if SOC_PART_NUMBER_BGM240SA22VNA
	default "BGM240SB22VNA" if SOC_PART_NUMBER_BGM240SB22VNA
	default "BGM241SB22VNA" if SOC_PART_NUMBER_BGM241SB22VNA
	default "BGM241SD22VNA" if SOC_PART_NUMBER_BGM241SD22VNA
```

## soc/silabs/silabs_s2/efm32pg23/Kconfig.defconfig
```kconfig
# Copyright (c) 2025 Christoph Jans
# SPDX-License-Identifier: Apache-2.0

if SOC_SERIES_EFM32PG23

config NUM_IRQS
	# must be >= the highest interrupt number used
	default 75

endif
```

## soc/silabs/silabs_s2/efm32pg23/Kconfig.soc
```kconfig
# Copyright (c) 2025 Christoph Jans
# SPDX-License-Identifier: Apache-2.0

config SOC_SERIES_EFM32PG23
	bool
	select SOC_FAMILY_SILABS_S2
	help
	  Silicon Labs EFM32PG23 Series MCU

config SOC_PART_NUMBER_EFM32PG23B310F512IM48
	bool
	select SOC_SERIES_EFM32PG23
	help
	  Silicon Labs PG23 Pro Kit PK2504A EFM32PG23 Series MCU Revision A02

config SOC_SERIES
	default "efm32pg23" if SOC_SERIES_EFM32PG23

config SOC
	default "efm32pg23b310f512im48" if SOC_PART_NUMBER_EFM32PG23B310F512IM48

config SOC_PART_NUMBER
	default "EFM32PG23B310F512IM48" if SOC_PART_NUMBER_EFM32PG23B310F512IM48
```

## soc/silabs/silabs_s2/efm32pg28/Kconfig.defconfig
```kconfig
# Copyright (c) 2025 Christoph Jans
# SPDX-License-Identifier: Apache-2.0

if SOC_SERIES_EFM32PG28

config NUM_IRQS
	# must be >= the highest interrupt number used
	default 75

endif
```

## soc/silabs/silabs_s2/efm32pg28/Kconfig.soc
```kconfig
# Copyright (c) 2025 Christoph Jans
# SPDX-License-Identifier: Apache-2.0

config SOC_SERIES_EFM32PG28
	bool
	select SOC_FAMILY_SILABS_S2
	help
	  Silicon Labs EFM32PG28 Series MCU

config SOC_PART_NUMBER_EFM32PG28B310F1024IM68
	bool
	select SOC_SERIES_EFM32PG28

config SOC_SERIES
	default "efm32pg28" if SOC_SERIES_EFM32PG28

config SOC
	default "efm32pg28b310f1024im68" if SOC_PART_NUMBER_EFM32PG28B310F1024IM68

config SOC_PART_NUMBER
	default "EFM32PG28B310F1024IM68" if SOC_PART_NUMBER_EFM32PG28B310F1024IM68
```

## soc/silabs/silabs_s2/efr32bg22/Kconfig
```kconfig
# Copyright (c) 2021 Sateesh Kotapati
# SPDX-License-Identifier: Apache-2.0

config SOC_SERIES_EFR32BG22
	select ARM
	select ARMV8_M_DSP
	select ARM_TRUSTZONE_M
	select CPU_CORTEX_M33
	select CPU_HAS_ARM_MPU
	select CPU_HAS_ARM_SAU
	select CPU_HAS_FPU
	select HAS_SILABS_GECKO
	select HAS_SWO
	select SOC_GECKO_HAS_RADIO
	select SOC_GECKO_GPIO
	select SOC_GECKO_CMU
	select SOC_GECKO_CORE
	select SOC_GECKO_DEV_INIT
	select SOC_GECKO_SE
	select HAS_PM

config SOC_GECKO_SDID
	default 205 if SOC_SERIES_EFR32BG22
```

## soc/silabs/silabs_s2/efr32bg22/Kconfig.defconfig
```kconfig
# Copyright (c) 2021 Sateesh Kotapati
# SPDX-License-Identifier: Apache-2.0

if SOC_SERIES_EFR32BG22

config NUM_IRQS
	# must be >= the highest interrupt number used
	default 60

config PM
	select UART_INTERRUPT_DRIVEN

config GPIO_GECKO
	default y

endif
```

## soc/silabs/silabs_s2/efr32bg22/Kconfig.soc
```kconfig
# Silicon Labs EFR32BG22 (Blue Gecko) MCU series

# Copyright (c) 2021 Sateesh Kotapati
# SPDX-License-Identifier: Apache-2.0

config SOC_SERIES_EFR32BG22
	bool
	select SOC_FAMILY_SILABS_S2
	help
	  EFR32BG22P Series MCU

config SOC_PART_NUMBER_EFR32BG22C224F512IM40
	bool
	select SOC_SERIES_EFR32BG22

config SOC_SERIES
	default "efr32bg22" if SOC_SERIES_EFR32BG22

config SOC
	default "efr32bg22c224f512im40" if SOC_PART_NUMBER_EFR32BG22C224F512IM40

config SOC_PART_NUMBER
	default "EFR32BG22C224F512IM40" if SOC_PART_NUMBER_EFR32BG22C224F512IM40
```

## soc/silabs/silabs_s2/efr32bg27/Kconfig.defconfig
```kconfig
# Copyright (c) 2023 Antmicro <www.antmicro.com>
# SPDX-License-Identifier: Apache-2.0

if SOC_SERIES_EFR32BG27

config NUM_IRQS
	# must be >= the highest interrupt number used
	default 66

config PM
	select COUNTER

config GPIO_GECKO
	default y

endif
```

## soc/silabs/silabs_s2/efr32bg27/Kconfig.soc
```kconfig
# Copyright (c) 2023 Antmicro <www.antmicro.com>
# SPDX-License-Identifier: Apache-2.0

config SOC_SERIES_EFR32BG27
	bool
	select SOC_FAMILY_SILABS_S2
	help
	  Silicon Labs EFR32BG27 (Blue Gecko) Series MCU

config SOC_PART_NUMBER_EFR32BG27C140F768IM40
	bool
	select SOC_SERIES_EFR32BG27

config SOC_SERIES
	default "efr32bg27" if SOC_SERIES_EFR32BG27

config SOC
	default "efr32bg27c140f768im40" if SOC_PART_NUMBER_EFR32BG27C140F768IM40

config SOC_PART_NUMBER
	default "EFR32BG27C140F768IM40" if SOC_PART_NUMBER_EFR32BG27C140F768IM40
```
