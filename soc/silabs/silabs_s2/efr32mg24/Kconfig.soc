## soc/silabs/silabs_s2/efr32mg24/Kconfig.soc
```kconfig
# Copyright (c) 2020 TriaGnoSys GmbH
# SPDX-License-Identifier: Apache-2.0

config SOC_SERIES_EFR32MG24
	bool
	select SOC_FAMILY_SILABS_S2
	help
	  Silicon Labs EFR32MG24 (Mighty Gecko) Series MCU

config SOC_PART_NUMBER_EFR32MG24B020F1536IM40
	bool
	select SOC_SERIES_EFR32MG24

config SOC_PART_NUMBER_EFR32MG24B220F1536IM48
	bool
	select SOC_SERIES_EFR32MG24

config SOC_PART_NUMBER_EFR32MG24B310F1536IM48
	bool
	select SOC_SERIES_EFR32MG24

config SOC_SERIES
	default "efr32mg24" if SOC_SERIES_EFR32MG24

config SOC
	default "efr32mg24b220f1536im48" if SOC_PART_NUMBER_EFR32MG24B220F1536IM48
	default "efr32mg24b310f1536im48" if SOC_PART_NUMBER_EFR32MG24B310F1536IM48
	default "efr32mg24b020f1536im40" if SOC_PART_NUMBER_EFR32MG24B020F1536IM40

config SOC_PART_NUMBER
	default "EFR32MG24B220F1536IM48" if SOC_PART_NUMBER_EFR32MG24B220F1536IM48
	default "EFR32MG24B310F1536IM48" if SOC_PART_NUMBER_EFR32MG24B310F1536IM48
	default "EFR32MG24B020F1536IM40" if SOC_PART_NUMBER_EFR32MG24B020F1536IM40
```

## soc/silabs/silabs_s2/efr32zg23/Kconfig
```kconfig
# Copyright (c) 2024 Yishai Jaffe
# SPDX-License-Identifier: Apache-2.0

config SOC_SERIES_EFR32ZG23
	select ARM
	select ARMV8_M_DSP
	select ARM_TRUSTZONE_M
	select CPU_CORTEX_M33
	select CPU_CORTEX_M_HAS_DWT
	select CPU_HAS_ARM_MPU
	select CPU_HAS_ARM_SAU
	select CPU_HAS_FPU
	select HAS_PM
	select HAS_SILABS_GECKO
	select HAS_SWO
	select SOC_GECKO_CMU
	select SOC_GECKO_CORE
	select SOC_GECKO_DEV_INIT
	select SOC_GECKO_EMU
	select SOC_GECKO_GPIO
	select SOC_GECKO_HAS_RADIO
	select SOC_GECKO_SE

config SOC_GECKO_SDID
	default 210 if SOC_SERIES_EFR32ZG23
```

## soc/silabs/silabs_s2/efr32zg23/Kconfig.defconfig
```kconfig
# Copyright (c) 2024 Yishai Jaffe
# SPDX-License-Identifier: Apache-2.0

if SOC_SERIES_EFR32ZG23

config NUM_IRQS
	# must be >= the highest interrupt number used
	default 75

config PM
	select UART_INTERRUPT_DRIVEN

config GPIO_GECKO
	default y

endif
```

## soc/silabs/silabs_s2/efr32zg23/Kconfig.soc
```kconfig
# Copyright (c) 2024 Yishai Jaffe
# SPDX-License-Identifier: Apache-2.0

config SOC_SERIES_EFR32ZG23
	bool
	select SOC_FAMILY_SILABS_S2
	help
	  Silicon Labs EFR32ZG23 Series MCU

config SOC_PART_NUMBER_EFR32ZG23B020F512IM48
	bool
	select SOC_SERIES_EFR32ZG23

config SOC_SERIES
	default "efr32zg23" if SOC_SERIES_EFR32ZG23

config SOC
	default "efr32zg23b020f512im48" if SOC_PART_NUMBER_EFR32ZG23B020F512IM48

config SOC_PART_NUMBER
	default "EFR32ZG23B020F512IM48" if SOC_PART_NUMBER_EFR32ZG23B020F512IM48
```

## soc/silabs/silabs_s2/efr32zg28/Kconfig.defconfig
```kconfig
# Copyright (c) 2025 Shontal Biton
# SPDX-License-Identifier: Apache-2.0

if SOC_SERIES_EFR32ZG28

config NUM_IRQS
	# must be >= the highest interrupt number used
	default 78

config PM
	select UART_INTERRUPT_DRIVEN

config GPIO_GECKO
	default y

config SOC_GECKO_SDID
	default 235 if SOC_SERIES_EFR32ZG28

endif
```

## soc/silabs/silabs_s2/efr32zg28/Kconfig.soc
```kconfig
# Copyright (c) 2025 Shontal Biton
# SPDX-License-Identifier: Apache-2.0

config SOC_SERIES_EFR32ZG28
	bool
	select SOC_FAMILY_SILABS_S2
	help
	  Silicon Labs EFR32ZG28 Series MCU

config SOC_PART_NUMBER_EFR32ZG28B322F1024IM68
	bool
	select SOC_SERIES_EFR32ZG28

config SOC_SERIES
	default "efr32zg28" if SOC_SERIES_EFR32ZG28

config SOC
	default "efr32zg28b322f1024im68" if SOC_PART_NUMBER_EFR32ZG28B322F1024IM68

config SOC_PART_NUMBER
	default "EFR32ZG28B322F1024IM68" if SOC_PART_NUMBER_EFR32ZG28B322F1024IM68
```

## soc/silabs/silabs_s2/xg21/Kconfig
```kconfig
# Copyright (c) 2020 TriaGnoSys GmbH
# SPDX-License-Identifier: Apache-2.0

config SOC_SILABS_XG21
	select ARM
	select CPU_CORTEX_M_HAS_DWT
	select CPU_CORTEX_M33
	select CPU_HAS_ARM_MPU
	select CPU_HAS_ARM_SAU
	select CPU_HAS_FPU
	select HAS_PM
	select HAS_SWO
	select SILABS_SISDK_CLOCK_MANAGER
	select SILABS_SISDK_DEVICE_INIT
	select SOC_GECKO_EMU
	select SOC_GECKO_GPIO

config SOC_SERIES_EFR32MG21
	select SOC_GECKO_HAS_RADIO
```

## soc/silabs/silabs_s2/xg21/Kconfig.defconfig
```kconfig
# Copyright (c) 2020 TriaGnoSys GmbH
# SPDX-License-Identifier: Apache-2.0

if SOC_SILABS_XG21

config NUM_IRQS
	# must be >= the highest interrupt number used
	default 61

config PM
	select COUNTER
	select UART_INTERRUPT_DRIVEN

endif
```

## soc/silabs/silabs_s2/xg21/Kconfig.soc
```kconfig
# Copyright (c) 2020 TriaGnoSys GmbH
# SPDX-License-Identifier: Apache-2.0

config SOC_SILABS_XG21
	bool
	select SOC_FAMILY_SILABS_S2
	help
	  Silicon Labs XG21 Generic Family SoC and modules

config SOC_SERIES_EFR32MG21
	bool
	select SOC_SILABS_XG21
	help
	  Silicon Labs EFR32MG21 (Mighty Gecko) Series MCU

config SOC_EFR32MG21A020F1024IM32
	bool
	select SOC_SERIES_EFR32MG21

config SOC_SERIES
	default "efr32mg21" if SOC_SERIES_EFR32MG21

config SOC
	default "efr32mg21a020f1024im32" if SOC_EFR32MG21A020F1024IM32
```

## soc/silabs/silabs_s2/xg22/Kconfig
```kconfig
# Copyright (c) 2021 Sateesh Kotapati
# SPDX-License-Identifier: Apache-2.0

config SOC_SILABS_XG22
	select ARM
	select ARM_TRUSTZONE_M
	select ARMV8_M_DSP
	select CPU_CORTEX_M33
	select CPU_HAS_ARM_MPU
	select CPU_HAS_ARM_SAU
	select CPU_HAS_FPU
	select HAS_PM
	select HAS_SWO
	select SILABS_SISDK_CLOCK_MANAGER
	select SILABS_SISDK_CORE
	select SILABS_SISDK_DEVICE_INIT
	select SILABS_SISDK_GPIO

config SOC_SERIES_EFR32BG22
	select SOC_GECKO_HAS_RADIO

config SOC_SERIES_EFR32MG22
	select SOC_GECKO_HAS_RADIO

config SOC_SERIES_BGM22
	select SILABS_DEVICE_IS_MODULE
	select SOC_GECKO_HAS_RADIO
```

## soc/silabs/silabs_s2/xg22/Kconfig.soc
```kconfig
# Copyright (c) 2021 Sateesh Kotapati
# Copyright (c) 2025 Glassboard
# SPDX-License-Identifier: Apache-2.0

config SOC_SILABS_XG22
	bool
	select SOC_FAMILY_SILABS_S2
	help
	  Silicon Labs XG22 Series SoC and modules

config SOC_SERIES_EFR32BG22
	bool
	select SOC_SILABS_XG22
	help
	  Silicon Labs EFR32BG22 (Blue Gecko) Series MCU

config SOC_SERIES_EFR32MG22
	bool
	select SOC_SILABS_XG22
	help
	  Silicon Labs EFR32MG22 (Mighty Gecko) Series MCU

config SOC_SERIES_BGM22
	bool
	select SOC_SILABS_XG22
	help
	  Silicon Labs BGM220 Series MCU modules

config SOC_EFR32BG22C224F512IM40
	bool
	select SOC_SERIES_EFR32BG22

config SOC_EFR32BG22C224F512IM32
	bool
	select SOC_SERIES_EFR32BG22

config SOC_EFR32BG22C224F512GN32
	bool
	select SOC_SERIES_EFR32BG22

config SOC_EFR32BG22C224F512GM40
	bool
	select SOC_SERIES_EFR32BG22

config SOC_EFR32BG22C224F512GM32
	bool
	select SOC_SERIES_EFR32BG22

config SOC_EFR32BG22C222F352GN32
	bool
	select SOC_SERIES_EFR32BG22

config SOC_EFR32BG22C222F352GM40
	bool
	select SOC_SERIES_EFR32BG22

config SOC_EFR32BG22C222F352GM32
	bool
	select SOC_SERIES_EFR32BG22

config SOC_EFR32MG22C224F512IM40
	bool
	select SOC_SERIES_EFR32MG22

config SOC_EFR32MG22C224F512IM32
	bool
	select SOC_SERIES_EFR32MG22

config SOC_EFR32MG22C224F512GN32
	bool
	select SOC_SERIES_EFR32MG22

config SOC_EFR32MG22E224F512IM40
	bool
	select SOC_SERIES_EFR32MG22

config SOC_EFR32MG22E224F512IM32
	bool
	select SOC_SERIES_EFR32MG22

config SOC_BGM220PC22HNA
	bool
	select SOC_SERIES_BGM22

config SOC_BGM220PC22WGA
	bool
	select SOC_SERIES_BGM22

config SOC_BGM220SC22HNA
	bool
	select SOC_SERIES_BGM22

config SOC_SERIES
	default "efr32bg22" if SOC_SERIES_EFR32BG22
	default "efr32mg22" if SOC_SERIES_EFR32MG22
	default "bgm22" if SOC_SERIES_BGM22

config SOC
	default "efr32bg22c224f512im40" if SOC_EFR32BG22C224F512IM40
	default "efr32bg22c224f512im32" if SOC_EFR32BG22C224F512IM32
	default "efr32bg22c224f512gn32" if SOC_EFR32BG22C224F512GN32
	default "efr32bg22c224f512gm40" if SOC_EFR32BG22C224F512GM40
	default "efr32bg22c224f512gm32" if SOC_EFR32BG22C224F512GM32
	default "efr32bg22c222f352gn32" if SOC_EFR32BG22C222F352GN32
	default "efr32bg22c222f352gm40" if SOC_EFR32BG22C222F352GM40
	default "efr32bg22c222f352gm32" if SOC_EFR32BG22C222F352GM32
	default "efr32mg22c224f512im40" if SOC_EFR32MG22C224F512IM40
	default "efr32mg22c224f512im32" if SOC_EFR32MG22C224F512IM32
	default "efr32mg22c224f512gn32" if SOC_EFR32MG22C224F512GN32
	default "efr32mg22e224f512im40" if SOC_EFR32MG22E224F512IM40
	default "efr32mg22e224f512im32" if SOC_EFR32MG22E224F512IM32
	default "bgm220pc22hna" if SOC_BGM220PC22HNA
	default "bgm220pc22wga" if SOC_BGM220PC22WGA
	default "bgm220sc22hna" if SOC_BGM220SC22HNA
```

## soc/silabs/silabs_s2/xg23/Kconfig.soc
```kconfig
# Copyright (c) 2024 Yishai Jaffe
# Copyright (c) 2025 Christoph Jans
# SPDX-License-Identifier: Apache-2.0

config SOC_SILABS_XG23
	bool
	select SOC_FAMILY_SILABS_S2
	help
	  Silicon Labs XG23 Series SoC and modules

config SOC_SERIES_EFR32ZG23
	bool
	select SOC_SILABS_XG23
	help
	  Silicon Labs EFR32ZG23 Series MCU

config SOC_SERIES_EFM32PG23
	bool
	select SOC_SILABS_XG23
	help
	  Silicon Labs EFM32PG23 Series MCU

config SOC_EFR32ZG23B020F512IM48
	bool
	select SOC_SERIES_EFR32ZG23

config SOC_EFM32PG23B310F512IM48
	bool
	select SOC_SERIES_EFM32PG23

config SOC_SERIES
	default "efr32zg23" if SOC_SERIES_EFR32ZG23
	default "efm32pg23" if SOC_SERIES_EFM32PG23

config SOC
	default "efr32zg23b020f512im48" if SOC_EFR32ZG23B020F512IM48
	default "efm32pg23b310f512im48" if SOC_EFM32PG23B310F512IM48
```

## soc/silabs/silabs_s2/xg24/Kconfig
```kconfig
# Copyright (c) 2020 TriaGnoSys GmbH
# Copyright (c) 2025 Silicon Laboratories Inc.
# Copyright (c) 2025 Ephraim Westenberger
# SPDX-License-Identifier: Apache-2.0

config SOC_SILABS_XG24
	select ARM
	select CPU_CORTEX_M33
	select CPU_HAS_FPU
	select CPU_HAS_ARM_MPU
	select CPU_HAS_ARM_SAU
	select CPU_CORTEX_M_HAS_DWT
	select ARMV8_M_DSP
	select ARM_TRUSTZONE_M
	select HAS_SWO
	select SOC_GECKO_CMU
	select SOC_GECKO_EMU
	select SOC_GECKO_GPIO
	select SOC_GECKO_DEV_INIT
	select SOC_GECKO_SE
	select HAS_PM

config SOC_SERIES_EFR32MG24
	select SOC_GECKO_HAS_RADIO

config SOC_SERIES_MGM24
	select SILABS_DEVICE_IS_MODULE
	select SOC_GECKO_HAS_RADIO

config SOC_SERIES_BGM24
	select SILABS_DEVICE_IS_MODULE
	select SOC_GECKO_HAS_RADIO
```

## soc/silabs/silabs_s2/xg24/Kconfig.defconfig
```kconfig
# Copyright (c) 2021 Sateesh Kotapati
# Copyright (c) 2025 Silicon Laboratories Inc.
# SPDX-License-Identifier: Apache-2.0

if SOC_SILABS_XG24

config NUM_IRQS
	# must be >= the highest interrupt number used
	default 75

config PM
	default n
	select UART_INTERRUPT_DRIVEN if SERIAL_SUPPORT_INTERRUPT

choice PM_POLICY
	default PM_POLICY_DEFAULT
	depends on PM
endchoice

endif
```

## soc/silabs/silabs_s2/xg24/Kconfig.soc
```kconfig
# Copyright (c) 2020 TriaGnoSys GmbH
# Copyright (c) 2025 Silicon Laboratories Inc.
# Copyright (c) 2025 Ephraim Westenberger
# SPDX-License-Identifier: Apache-2.0

config SOC_SILABS_XG24
	bool
	select SOC_FAMILY_SILABS_S2
	help
	  Silicon Labs XG24 Series SoC and modules

config SOC_SERIES_EFR32MG24
	bool
	select SOC_SILABS_XG24
	help
	  Silicon Labs EFR32MG24 (Mighty Gecko) Series MCU

config SOC_SERIES_MGM24
	bool
	select SOC_SILABS_XG24
	help
	  Silicon Labs MGM240 (Mighty Gecko) Series MCU modules

config SOC_SERIES_BGM24
	bool
	select SOC_SILABS_XG24
	help
	  Silicon Labs BGM240 Series MCU modules

config SOC_EFR32MG24B020F1536IM40
	bool
	select SOC_SERIES_EFR32MG24

config SOC_EFR32MG24B220F1536IM48
	bool
	select SOC_SERIES_EFR32MG24

config SOC_EFR32MG24B310F1536IM48
	bool
	select SOC_SERIES_EFR32MG24

config SOC_EFR32MG24B210F1536IM48
	bool
	select SOC_SERIES_EFR32MG24

config SOC_BGM240PA22VNA
	bool
	select SOC_SERIES_BGM24

config SOC_BGM240PA32VNA
	bool
	select SOC_SERIES_BGM24

config SOC_BGM240PA32VNN
	bool
	select SOC_SERIES_BGM24

config SOC_BGM240PB22VNA
	bool
	select SOC_SERIES_BGM24

config SOC_BGM240PB32VNA
	bool
	select SOC_SERIES_BGM24

config SOC_BGM240PB32VNN
	bool
	select SOC_SERIES_BGM24

config SOC_BGM240SA22VNA
	bool
	select SOC_SERIES_BGM24

config SOC_BGM240SB22VNA
	bool
	select SOC_SERIES_BGM24

config SOC_MGM240PA22VNA
	bool
	select SOC_SERIES_MGM24

config SOC_MGM240PA32VNA
	bool
	select SOC_SERIES_MGM24

config SOC_MGM240PA32VNN
	bool
	select SOC_SERIES_MGM24

config SOC_MGM240PB22VNA
	bool
	select SOC_SERIES_MGM24

config SOC_MGM240PB32VNA
	bool
	select SOC_SERIES_MGM24

config SOC_MGM240PB32VNN
	bool
	select SOC_SERIES_MGM24

config SOC_MGM240SA22VNA
	bool
	select SOC_SERIES_MGM24

config SOC_MGM240SD22VNA
	bool
	select SOC_SERIES_MGM24

config SOC_SERIES
	default "efr32mg24" if SOC_SERIES_EFR32MG24
	default "mgm24" if SOC_SERIES_MGM24
	default "bgm24" if SOC_SERIES_BGM24

config SOC
	default "efr32mg24b220f1536im48" if SOC_EFR32MG24B220F1536IM48
	default "efr32mg24b310f1536im48" if SOC_EFR32MG24B310F1536IM48
	default "efr32mg24b210f1536im48" if SOC_EFR32MG24B210F1536IM48
	default "efr32mg24b020f1536im40" if SOC_EFR32MG24B020F1536IM40
	default "bgm240pa22vna" if SOC_BGM240PA22VNA
	default "bgm240pa32vna" if SOC_BGM240PA32VNA
	default "bgm240pa32vnn" if SOC_BGM240PA32VNN
	default "bgm240pb22vna" if SOC_BGM240PB22VNA
	default "bgm240pb32vna" if SOC_BGM240PB32VNA
	default "bgm240pb32vnn" if SOC_BGM240PB32VNN
	default "bgm240sa22vna" if SOC_BGM240SA22VNA
	default "bgm240sb22vna" if SOC_BGM240SB22VNA
	default "mgm240pa22vna" if SOC_MGM240PA22VNA
	default "mgm240pa32vna" if SOC_MGM240PA32VNA
	default "mgm240pa32vnn" if SOC_MGM240PA32VNN
	default "mgm240pb22vna" if SOC_MGM240PB22VNA
	default "mgm240pb32vna" if SOC_MGM240PB32VNA
	default "mgm240pb32vnn" if SOC_MGM240PB32VNN
	default "mgm240sa22vna" if SOC_MGM240SA22VNA
	default "mgm240sd22vna" if SOC_MGM240SD22VNA
```

## soc/silabs/silabs_s2/xg26/Kconfig.defconfig
```kconfig
# Copyright (c) 2025 Silicon Laboratories Inc.
# SPDX-License-Identifier: Apache-2.0

if SOC_SILABS_XG26

config NUM_IRQS
	# must be >= the highest interrupt number used
	default 93

config PM
	default n
	select UART_INTERRUPT_DRIVEN if SERIAL_SUPPORT_INTERRUPT

choice PM_POLICY
	default PM_POLICY_DEFAULT
	depends on PM
endchoice

endif
```
