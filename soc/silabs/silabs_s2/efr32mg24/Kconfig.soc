## soc/silabs/silabs_s2/xg26/Kconfig.soc
```kconfig
# Copyright (c) 2025 Silicon Laboratories Inc.
# SPDX-License-Identifier: Apache-2.0

config SOC_SILABS_XG26
	bool
	select SOC_FAMILY_SILABS_S2
	help
	  Silicon Labs XG26 Series SoC and modules

config SOC_SERIES_EFM32PG26
	bool
	select SOC_SILABS_XG26
	help
	  Silicon Labs EFM32PG26 (Pearl Gecko) Series MCU

config SOC_SERIES_EFR32BG26
	bool
	select SOC_SILABS_XG26
	help
	  Silicon Labs EFR32BG26 (Blue Gecko) Series MCU

config SOC_SERIES_BGM26
	bool
	select SOC_SILABS_XG26
	help
	  Silicon Labs BGM260 (Blue Gecko) Series MCU modules

config SOC_SERIES_EFR32MG26
	bool
	select SOC_SILABS_XG26
	help
	  Silicon Labs EFR32MG26 (Mighty Gecko) Series MCU

config SOC_SERIES_MGM26
	bool
	select SOC_SILABS_XG26
	help
	  Silicon Labs MGM260 (Mighty Gecko) Series MCU modules

# EFM32PG26

config SOC_EFM32PG26B101F512IL136
	bool
	select SOC_SERIES_EFM32PG26

config SOC_EFM32PG26B101F512IM68
	bool
	select SOC_SERIES_EFM32PG26

config SOC_EFM32PG26B301F1024IL136
	bool
	select SOC_SERIES_EFM32PG26

config SOC_EFM32PG26B301F1024IM68
	bool
	select SOC_SERIES_EFM32PG26

config SOC_EFM32PG26B301F2048IL136
	bool
	select SOC_SERIES_EFM32PG26

config SOC_EFM32PG26B301F2048IM68
	bool
	select SOC_SERIES_EFM32PG26

config SOC_EFM32PG26B500F3200IL136
	bool
	select SOC_SERIES_EFM32PG26

config SOC_EFM32PG26B500F3200IM48
	bool
	select SOC_SERIES_EFM32PG26

config SOC_EFM32PG26B500F3200IM68
	bool
	select SOC_SERIES_EFM32PG26

config SOC_EFM32PG26B501F3200IL136
	bool
	select SOC_SERIES_EFM32PG26

config SOC_EFM32PG26B501F3200IM48
	bool
	select SOC_SERIES_EFM32PG26

config SOC_EFM32PG26B501F3200IM68
	bool
	select SOC_SERIES_EFM32PG26

# EFR32MG26

config SOC_EFR32MG26B521F3200IM68
	bool
	select SOC_SERIES_EFR32MG26

config SOC_EFR32MG26B521F3200IM48
	bool
	select SOC_SERIES_EFR32MG26

config SOC_EFR32MG26B520F3200IM68
	bool
	select SOC_SERIES_EFR32MG26

config SOC_EFR32MG26B520F3200IM48
	bool
	select SOC_SERIES_EFR32MG26

config SOC_EFR32MG26B511F3200IM68
	bool
	select SOC_SERIES_EFR32MG26

config SOC_EFR32MG26B511F3200IM48
	bool
	select SOC_SERIES_EFR32MG26

config SOC_EFR32MG26B511F3200IL136
	bool
	select SOC_SERIES_EFR32MG26

config SOC_EFR32MG26B510F3200IM68
	bool
	select SOC_SERIES_EFR32MG26

config SOC_EFR32MG26B510F3200IM48
	bool
	select SOC_SERIES_EFR32MG26

config SOC_EFR32MG26B510F3200IL136
	bool
	select SOC_SERIES_EFR32MG26

config SOC_EFR32MG26B421F3200IM68
	bool
	select SOC_SERIES_EFR32MG26

config SOC_EFR32MG26B421F3200IM48
	bool
	select SOC_SERIES_EFR32MG26

config SOC_EFR32MG26B420F3200IM68
	bool
	select SOC_SERIES_EFR32MG26

config SOC_EFR32MG26B420F3200IM48
	bool
	select SOC_SERIES_EFR32MG26

config SOC_EFR32MG26B411F3200IM68
	bool
	select SOC_SERIES_EFR32MG26

config SOC_EFR32MG26B411F3200IM48
	bool
	select SOC_SERIES_EFR32MG26

config SOC_EFR32MG26B410F3200IM68
	bool
	select SOC_SERIES_EFR32MG26

config SOC_EFR32MG26B410F3200IM48
	bool
	select SOC_SERIES_EFR32MG26

config SOC_EFR32MG26B311F3200IL136
	bool
	select SOC_SERIES_EFR32MG26

config SOC_EFR32MG26B221F3200IM48
	bool
	select SOC_SERIES_EFR32MG26

config SOC_EFR32MG26B221F2048IM68
	bool
	select SOC_SERIES_EFR32MG26

config SOC_EFR32MG26B211F3200IM48
	bool
	select SOC_SERIES_EFR32MG26

config SOC_EFR32MG26B211F2048IM68
	bool
	select SOC_SERIES_EFR32MG26

# EFR32BG26

config SOC_EFR32BG26B311F1024IL136
	bool
	select SOC_SERIES_EFR32BG26

config SOC_EFR32BG26B311F1024IM68
	bool
	select SOC_SERIES_EFR32BG26

config SOC_EFR32BG26B311F2048IL136
	bool
	select SOC_SERIES_EFR32BG26

config SOC_EFR32BG26B311F2048IM48
	bool
	select SOC_SERIES_EFR32BG26

config SOC_EFR32BG26B311F2048IM68
	bool
	select SOC_SERIES_EFR32BG26

config SOC_EFR32BG26B321F1024IM68
	bool
	select SOC_SERIES_EFR32BG26

config SOC_EFR32BG26B321F2048IM48
	bool
	select SOC_SERIES_EFR32BG26

config SOC_EFR32BG26B321F2048IM68
	bool
	select SOC_SERIES_EFR32BG26

config SOC_EFR32BG26B410F3200IM48
	bool
	select SOC_SERIES_EFR32BG26

config SOC_EFR32BG26B411F3200IM48
	bool
	select SOC_SERIES_EFR32BG26

config SOC_EFR32BG26B420F3200IM48
	bool
	select SOC_SERIES_EFR32BG26

config SOC_EFR32BG26B421F3200IM48
	bool
	select SOC_SERIES_EFR32BG26

config SOC_EFR32BG26B510F3200IL136
	bool
	select SOC_SERIES_EFR32BG26

config SOC_EFR32BG26B510F3200IM48
	bool
	select SOC_SERIES_EFR32BG26

config SOC_EFR32BG26B510F3200IM68
	bool
	select SOC_SERIES_EFR32BG26

config SOC_EFR32BG26B511F3200IL136
	bool
	select SOC_SERIES_EFR32BG26

config SOC_EFR32BG26B511F3200IM48
	bool
	select SOC_SERIES_EFR32BG26

config SOC_EFR32BG26B511F3200IM68
	bool
	select SOC_SERIES_EFR32BG26

# BGM26

config SOC_BGM260PB22VNA
	bool
	select SOC_SERIES_BGM26

config SOC_BGM260PB32VNA
	bool
	select SOC_SERIES_BGM26

# MGM26

config SOC_MGM260PB22VNA
	bool
	select SOC_SERIES_MGM26

config SOC_MGM260PB32VNA
	bool
	select SOC_SERIES_MGM26

config SOC_MGM260PB32VNN
	bool
	select SOC_SERIES_MGM26

config SOC_MGM260PD22VNA
	bool
	select SOC_SERIES_MGM26

config SOC_MGM260PD32VNA
	bool
	select SOC_SERIES_MGM26

config SOC_MGM260PD32VNN
	bool
	select SOC_SERIES_MGM26

config SOC_SERIES
	default "efm32pg26" if SOC_SERIES_EFM32PG26
	default "efr32bg26" if SOC_SERIES_EFR32BG26
	default "efr32mg26" if SOC_SERIES_EFR32MG26
	default "bgm26" if SOC_SERIES_BGM26
	default "mgm26" if SOC_SERIES_MGM26

config SOC
	default "efm32pg26b101f512il136" if SOC_EFM32PG26B101F512IL136
	default "efm32pg26b101f512im68" if SOC_EFM32PG26B101F512IM68
	default "efm32pg26b301f1024il136" if SOC_EFM32PG26B301F1024IL136
	default "efm32pg26b301f1024im68" if SOC_EFM32PG26B301F1024IM68
	default "efm32pg26b301f2048il136" if SOC_EFM32PG26B301F2048IL136
	default "efm32pg26b301f2048im68" if SOC_EFM32PG26B301F2048IM68
	default "efm32pg26b500f3200il136" if SOC_EFM32PG26B500F3200IL136
	default "efm32pg26b500f3200im48" if SOC_EFM32PG26B500F3200IM48
	default "efm32pg26b500f3200im68" if SOC_EFM32PG26B500F3200IM68
	default "efm32pg26b501f3200il136" if SOC_EFM32PG26B501F3200IL136
	default "efm32pg26b501f3200im48" if SOC_EFM32PG26B501F3200IM48
	default "efm32pg26b501f3200im68" if SOC_EFM32PG26B501F3200IM68
	default "efr32mg26b211f2048im68" if SOC_EFR32MG26B211F2048IM68
	default "efr32mg26b211f3200im48" if SOC_EFR32MG26B211F3200IM48
	default "efr32mg26b221f2048im68" if SOC_EFR32MG26B221F2048IM68
	default "efr32mg26b221f3200im48" if SOC_EFR32MG26B221F3200IM48
	default "efr32mg26b311f3200il136" if SOC_EFR32MG26B311F3200IL136
	default "efr32mg26b410f3200im48" if SOC_EFR32MG26B410F3200IM48
	default "efr32mg26b410f3200im68" if SOC_EFR32MG26B410F3200IM68
	default "efr32mg26b411f3200im48" if SOC_EFR32MG26B411F3200IM48
	default "efr32mg26b411f3200im68" if SOC_EFR32MG26B411F3200IM68
	default "efr32mg26b420f3200im48" if SOC_EFR32MG26B420F3200IM48
	default "efr32mg26b420f3200im68" if SOC_EFR32MG26B420F3200IM68
	default "efr32mg26b421f3200im48" if SOC_EFR32MG26B421F3200IM48
	default "efr32mg26b421f3200im68" if SOC_EFR32MG26B421F3200IM68
	default "efr32mg26b510f3200il136" if SOC_EFR32MG26B510F3200IL136
	default "efr32mg26b510f3200im48" if SOC_EFR32MG26B510F3200IM48
	default "efr32mg26b510f3200im68" if SOC_EFR32MG26B510F3200IM68
	default "efr32mg26b511f3200il136" if SOC_EFR32MG26B511F3200IL136
	default "efr32mg26b511f3200im48" if SOC_EFR32MG26B511F3200IM48
	default "efr32mg26b511f3200im68" if SOC_EFR32MG26B511F3200IM68
	default "efr32mg26b520f3200im48" if SOC_EFR32MG26B520F3200IM48
	default "efr32mg26b520f3200im68" if SOC_EFR32MG26B520F3200IM68
	default "efr32mg26b521f3200im48" if SOC_EFR32MG26B521F3200IM48
	default "efr32mg26b521f3200im68" if SOC_EFR32MG26B521F3200IM68
	default "efr32bg26b311f1024il136" if SOC_EFR32BG26B311F1024IL136
	default "efr32bg26b311f1024im68" if SOC_EFR32BG26B311F1024IM68
	default "efr32bg26b311f2048il136" if SOC_EFR32BG26B311F2048IL136
	default "efr32bg26b311f2048im48" if SOC_EFR32BG26B311F2048IM48
	default "efr32bg26b311f2048im68" if SOC_EFR32BG26B311F2048IM68
	default "efr32bg26b321f1024im68" if SOC_EFR32BG26B321F1024IM68
	default "efr32bg26b321f2048im48" if SOC_EFR32BG26B321F2048IM48
	default "efr32bg26b321f2048im68" if SOC_EFR32BG26B321F2048IM68
	default "efr32bg26b410f3200im48" if SOC_EFR32BG26B410F3200IM48
	default "efr32bg26b411f3200im48" if SOC_EFR32BG26B411F3200IM48
	default "efr32bg26b420f3200im48" if SOC_EFR32BG26B420F3200IM48
	default "efr32bg26b421f3200im48" if SOC_EFR32BG26B421F3200IM48
	default "efr32bg26b510f3200il136" if SOC_EFR32BG26B510F3200IL136
	default "efr32bg26b510f3200im48" if SOC_EFR32BG26B510F3200IM48
	default "efr32bg26b510f3200im68" if SOC_EFR32BG26B510F3200IM68
	default "efr32bg26b511f3200il136" if SOC_EFR32BG26B511F3200IL136
	default "efr32bg26b511f3200im48" if SOC_EFR32BG26B511F3200IM48
	default "efr32bg26b511f3200im68" if SOC_EFR32BG26B511F3200IM68
	default "bgm260pb22vna" if SOC_BGM260PB22VNA
	default "bgm260pb32vna" if SOC_BGM260PB32VNA
	default "mgm260pb22vna" if SOC_MGM260PB22VNA
	default "mgm260pb32vna" if SOC_MGM260PB32VNA
	default "mgm260pb32vnn" if SOC_MGM260PB32VNN
	default "mgm260pd22vna" if SOC_MGM260PD22VNA
	default "mgm260pd32vna" if SOC_MGM260PD32VNA
	default "mgm260pd32vnn" if SOC_MGM260PD32VNN
```

## soc/silabs/silabs_s2/xg27/Kconfig
```kconfig
# Copyright (c) 2023 Antmicro <www.antmicro.com>
# SPDX-License-Identifier: Apache-2.0

config SOC_SILABS_XG27
	select ARM
	select ARM_TRUSTZONE_M
	select ARMV8_M_DSP
	select CPU_CORTEX_M33
	select CPU_HAS_ARM_MPU
	select CPU_HAS_ARM_SAU
	select CPU_HAS_FPU
	select HAS_PM
	select HAS_SWO
	select SILABS_SISDK_CLOCK_MANAGER
	select SILABS_SISDK_CORE
	select SILABS_SISDK_DEVICE_INIT
	select SILABS_SISDK_GPIO

config SOC_SERIES_EFR32BG27
	select SOC_GECKO_HAS_RADIO

config SOC_SERIES_EFR32MG27
	select SOC_GECKO_HAS_RADIO
```

## soc/silabs/silabs_s2/xg27/Kconfig.defconfig
```kconfig
# Copyright (c) 2023 Antmicro <www.antmicro.com>
# SPDX-License-Identifier: Apache-2.0

if SOC_SILABS_XG27

config NUM_IRQS
	# must be >= the highest interrupt number used
	default 66

endif
```

## soc/silabs/silabs_s2/xg27/Kconfig.soc
```kconfig
# Copyright (c) 2023 Antmicro <www.antmicro.com>
# SPDX-License-Identifier: Apache-2.0

config SOC_SILABS_XG27
	bool
	select SOC_FAMILY_SILABS_S2
	help
	  Silicon Labs XG27 Series SoC and modules

config SOC_SERIES_EFR32BG27
	bool
	select SOC_SILABS_XG27
	help
	  Silicon Labs EFR32BG27 (Blue Gecko) Series MCU

config SOC_SERIES_EFR32MG27
	bool
	select SOC_SILABS_XG27
	help
	  Silicon Labs EFR32MG27 (Mighty Gecko) Series MCU

config SOC_EFR32BG27C140F768IM32
	bool
	select SOC_SERIES_EFR32BG27

config SOC_EFR32BG27C140F768IM40
	bool
	select SOC_SERIES_EFR32BG27

config SOC_EFR32BG27C230F768IM32
	bool
	select SOC_SERIES_EFR32BG27

config SOC_EFR32BG27C230F768IM40
	bool
	select SOC_SERIES_EFR32BG27

config SOC_EFR32BG27C320F768GJ39
	bool
	select SOC_SERIES_EFR32BG27

config SOC_EFR32BG27C320F768IJ39
	bool
	select SOC_SERIES_EFR32BG27

config SOC_EFR32MG27C140F768IM32
	bool
	select SOC_SERIES_EFR32MG27

config SOC_EFR32MG27C140F768IM40
	bool
	select SOC_SERIES_EFR32MG27

config SOC_EFR32MG27C230F768IM32
	bool
	select SOC_SERIES_EFR32MG27

config SOC_EFR32MG27C230F768IM40
	bool
	select SOC_SERIES_EFR32MG27

config SOC_SERIES
	default "efr32bg27" if SOC_SERIES_EFR32BG27
	default "efr32mg27" if SOC_SERIES_EFR32MG27

config SOC
	default "efr32bg27c140f768im32" if SOC_EFR32BG27C140F768IM32
	default "efr32bg27c140f768im40" if SOC_EFR32BG27C140F768IM40
	default "efr32bg27c230f768im32" if SOC_EFR32BG27C230F768IM32
	default "efr32bg27c230f768im40" if SOC_EFR32BG27C230F768IM40
	default "efr32bg27c320f768gj39" if SOC_EFR32BG27C320F768GJ39
	default "efr32bg27c320f768ij39" if SOC_EFR32BG27C320F768IJ39
	default "efr32mg27c140f768im32" if SOC_EFR32MG27C140F768IM32
	default "efr32mg27c140f768im40" if SOC_EFR32MG27C140F768IM40
	default "efr32mg27c230f768im32" if SOC_EFR32MG27C230F768IM32
	default "efr32mg27c230f768im40" if SOC_EFR32MG27C230F768IM40
```

## soc/silabs/silabs_s2/xg28/Kconfig
```kconfig
# Copyright (c) 2025 Christoph Jans
# SPDX-License-Identifier: Apache-2.0

config SOC_SILABS_XG28
	select ARM
	select ARMV8_M_DSP
	select ARM_TRUSTZONE_M
	select CPU_CORTEX_M33
	select CPU_CORTEX_M_HAS_DWT
	select CPU_HAS_ARM_MPU
	select CPU_HAS_ARM_SAU
	select CPU_HAS_FPU
	select HAS_PM
	select HAS_SWO
	select SOC_GECKO_CMU
	select SOC_GECKO_CORE
	select SOC_GECKO_DEV_INIT
	select SOC_GECKO_EMU
	select SOC_GECKO_GPIO
	select SOC_GECKO_SE

config SOC_SERIES_EFR32ZG28
	select SOC_GECKO_HAS_RADIO
```
