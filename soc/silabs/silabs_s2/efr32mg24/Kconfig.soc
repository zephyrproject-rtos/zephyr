## soc/silabs/silabs_s2/xg28/Kconfig.soc
```kconfig
# Copyright (c) 2025 Christoph Jans
# Copyright (c) 2025 Shontal Biton
# SPDX-License-Identifier: Apache-2.0

config SOC_SILABS_XG28
	bool
	select SOC_FAMILY_SILABS_S2
	help
	  Silicon Labs XG28 Series SoC and modules

config SOC_SERIES_EFM32PG28
	bool
	select SOC_SILABS_XG28
	help
	  Silicon Labs EFM32PG28 Series MCU

config SOC_SERIES_EFR32FG28
	bool
	select SOC_SILABS_XG28
	help
	  Silicon Labs EFR32FG28 Series MCU

config SOC_SERIES_EFR32ZG28
	bool
	select SOC_SILABS_XG28
	help
	  Silicon Labs EFR32ZG28 Series MCU

config SOC_EFM32PG28B200F512IM68
	bool
	select SOC_SERIES_EFM32PG28

config SOC_EFM32PG28B210F1024IM68
	bool
	select SOC_SERIES_EFM32PG28

config SOC_EFM32PG28B300F512IM68
	bool
	select SOC_SERIES_EFM32PG28

config SOC_EFM32PG28B310F1024IM68
	bool
	select SOC_SERIES_EFM32PG28

config SOC_EFR32FG28A010F1024GM48
	bool
	select SOC_SERIES_EFR32FG28

config SOC_EFR32FG28A010F1024GM68
	bool
	select SOC_SERIES_EFR32FG28

config SOC_EFR32FG28A110F1024GM48
	bool
	select SOC_SERIES_EFR32FG28

config SOC_EFR32FG28A110F1024GM68
	bool
	select SOC_SERIES_EFR32FG28

config SOC_EFR32FG28A112F1024GM48
	bool
	select SOC_SERIES_EFR32FG28

config SOC_EFR32FG28A112F1024GM68
	bool
	select SOC_SERIES_EFR32FG28

config SOC_EFR32FG28A120F1024GM48
	bool
	select SOC_SERIES_EFR32FG28

config SOC_EFR32FG28A120F1024GM68
	bool
	select SOC_SERIES_EFR32FG28

config SOC_EFR32FG28A122F1024GM48
	bool
	select SOC_SERIES_EFR32FG28

config SOC_EFR32FG28A122F1024GM68
	bool
	select SOC_SERIES_EFR32FG28

config SOC_EFR32FG28B310F1024IM48
	bool
	select SOC_SERIES_EFR32FG28

config SOC_EFR32FG28B310F1024IM68
	bool
	select SOC_SERIES_EFR32FG28

config SOC_EFR32FG28B312F1024IM48
	bool
	select SOC_SERIES_EFR32FG28

config SOC_EFR32FG28B312F1024IM68
	bool
	select SOC_SERIES_EFR32FG28

config SOC_EFR32FG28B320F1024IM48
	bool
	select SOC_SERIES_EFR32FG28

config SOC_EFR32FG28B320F1024IM68
	bool
	select SOC_SERIES_EFR32FG28

config SOC_EFR32FG28B322F1024IM48
	bool
	select SOC_SERIES_EFR32FG28

config SOC_EFR32FG28B322F1024IM68
	bool
	select SOC_SERIES_EFR32FG28


config SOC_EFR32ZG28A110F1024GM48
	bool
	select SOC_SERIES_EFR32ZG28

config SOC_EFR32ZG28A110F1024GM68
	bool
	select SOC_SERIES_EFR32ZG28

config SOC_EFR32ZG28A112F1024GM48
	bool
	select SOC_SERIES_EFR32ZG28

config SOC_EFR32ZG28A112F1024GM68
	bool
	select SOC_SERIES_EFR32ZG28

config SOC_EFR32ZG28A120F1024GM48
	bool
	select SOC_SERIES_EFR32ZG28

config SOC_EFR32ZG28A120F1024GM68
	bool
	select SOC_SERIES_EFR32ZG28

config SOC_EFR32ZG28A122F1024GM48
	bool
	select SOC_SERIES_EFR32ZG28

config SOC_EFR32ZG28A122F1024GM68
	bool
	select SOC_SERIES_EFR32ZG28

config SOC_EFR32ZG28B310F1024IM48
	bool
	select SOC_SERIES_EFR32ZG28

config SOC_EFR32ZG28B310F1024IM68
	bool
	select SOC_SERIES_EFR32ZG28

config SOC_EFR32ZG28B312F1024IM48
	bool
	select SOC_SERIES_EFR32ZG28

config SOC_EFR32ZG28B312F1024IM68
	bool
	select SOC_SERIES_EFR32ZG28

config SOC_EFR32ZG28B320F1024IM48
	bool
	select SOC_SERIES_EFR32ZG28

config SOC_EFR32ZG28B320F1024IM68
	bool
	select SOC_SERIES_EFR32ZG28

config SOC_EFR32ZG28B322F1024IM48
	bool
	select SOC_SERIES_EFR32ZG28

config SOC_EFR32ZG28B322F1024IM68
	bool
	select SOC_SERIES_EFR32ZG28

config SOC_SERIES
	default "efm32pg28" if SOC_SERIES_EFM32PG28
	default "efr32fg28" if SOC_SERIES_EFR32FG28
	default "efr32zg28" if SOC_SERIES_EFR32ZG28

config SOC
	default "efm32pg28b200f512im68" if SOC_EFM32PG28B200F512IM68
	default "efm32pg28b210f1024im68" if SOC_EFM32PG28B210F1024IM68
	default "efm32pg28b300f512im68" if SOC_EFM32PG28B300F512IM68
	default "efm32pg28b310f1024im68" if SOC_EFM32PG28B310F1024IM68
	default "efr32fg28a010f1024gm48" if SOC_EFR32FG28A010F1024GM48
	default "efr32fg28a010f1024gm68" if SOC_EFR32FG28A010F1024GM68
	default "efr32fg28a110f1024gm48" if SOC_EFR32FG28A110F1024GM48
	default "efr32fg28a110f1024gm68" if SOC_EFR32FG28A110F1024GM68
	default "efr32fg28a112f1024gm48" if SOC_EFR32FG28A112F1024GM48
	default "efr32fg28a112f1024gm68" if SOC_EFR32FG28A112F1024GM68
	default "efr32fg28a120f1024gm48" if SOC_EFR32FG28A120F1024GM48
	default "efr32fg28a120f1024gm68" if SOC_EFR32FG28A120F1024GM68
	default "efr32fg28a122f1024gm48" if SOC_EFR32FG28A122F1024GM48
	default "efr32fg28a122f1024gm68" if SOC_EFR32FG28A122F1024GM68
	default "efr32fg28b310f1024im48" if SOC_EFR32FG28B310F1024IM48
	default "efr32fg28b310f1024im68" if SOC_EFR32FG28B310F1024IM68
	default "efr32fg28b312f1024im48" if SOC_EFR32FG28B312F1024IM48
	default "efr32fg28b312f1024im68" if SOC_EFR32FG28B312F1024IM68
	default "efr32fg28b320f1024im48" if SOC_EFR32FG28B320F1024IM48
	default "efr32fg28b320f1024im68" if SOC_EFR32FG28B320F1024IM68
	default "efr32fg28b322f1024im48" if SOC_EFR32FG28B322F1024IM48
	default "efr32fg28b322f1024im68" if SOC_EFR32FG28B322F1024IM68
	default "efr32zg28a110f1024gm48" if SOC_EFR32ZG28A110F1024GM48
	default "efr32zg28a110f1024gm68" if SOC_EFR32ZG28A110F1024GM68
	default "efr32zg28a112f1024gm48" if SOC_EFR32ZG28A112F1024GM48
	default "efr32zg28a112f1024gm68" if SOC_EFR32ZG28A112F1024GM68
	default "efr32zg28a120f1024gm48" if SOC_EFR32ZG28A120F1024GM48
	default "efr32zg28a120f1024gm68" if SOC_EFR32ZG28A120F1024GM68
	default "efr32zg28a122f1024gm48" if SOC_EFR32ZG28A122F1024GM48
	default "efr32zg28a122f1024gm68" if SOC_EFR32ZG28A122F1024GM68
	default "efr32zg28b310f1024im48" if SOC_EFR32ZG28B310F1024IM48
	default "efr32zg28b310f1024im68" if SOC_EFR32ZG28B310F1024IM68
	default "efr32zg28b312f1024im48" if SOC_EFR32ZG28B312F1024IM48
	default "efr32zg28b312f1024im68" if SOC_EFR32ZG28B312F1024IM68
	default "efr32zg28b320f1024im48" if SOC_EFR32ZG28B320F1024IM48
	default "efr32zg28b320f1024im68" if SOC_EFR32ZG28B320F1024IM68
	default "efr32zg28b322f1024im48" if SOC_EFR32ZG28B322F1024IM48
	default "efr32zg28b322f1024im68" if SOC_EFR32ZG28B322F1024IM68
```

## soc/silabs/silabs_s2/xg29/Kconfig
```kconfig
# Copyright (c) 2025 Silicon Laboratories Inc.
# SPDX-License-Identifier: Apache-2.0

config SOC_SILABS_XG29
	select ARM
	select ARM_TRUSTZONE_M
	select ARMV8_M_DSP
	select CPU_CORTEX_M_HAS_DWT
	select CPU_CORTEX_M33
	select CPU_HAS_ARM_MPU
	select CPU_HAS_ARM_SAU
	select CPU_HAS_FPU
	select HAS_PM
	select HAS_SWO
	select SILABS_SISDK_CLOCK_MANAGER
	select SILABS_SISDK_CORE
	select SILABS_SISDK_DEVICE_INIT
	select SILABS_SISDK_GPIO

config SOC_SERIES_EFR32BG29
	select SOC_GECKO_HAS_RADIO

config SOC_SERIES_EFR32MG29
	select SOC_GECKO_HAS_RADIO
```

## soc/silabs/silabs_s2/xg29/Kconfig.defconfig
```kconfig
# Copyright (c) 2025 Silicon Laboratories Inc.
# SPDX-License-Identifier: Apache-2.0

if SOC_SERIES_EFR32BG29 || SOC_SERIES_EFR32MG29

config NUM_IRQS
	# must be >= the highest interrupt number used
	default 70

config PM
	default n
	select UART_INTERRUPT_DRIVEN if SERIAL_SUPPORT_INTERRUPT

choice PM_POLICY
	default PM_POLICY_DEFAULT
	depends on PM
endchoice

endif
```

## soc/silabs/silabs_s2/xg29/Kconfig.soc
```kconfig
# Copyright (c) 2025 Silicon Laboratories Inc.
# SPDX-License-Identifier: Apache-2.0

config SOC_SILABS_XG29
	bool
	select SOC_FAMILY_SILABS_S2
	help
	  Silicon Labs XG29 Series SoC and modules

config SOC_SERIES_EFR32BG29
	bool
	select SOC_SILABS_XG29
	help
	  Silicon Labs EFR32BG29 (Blue Gecko) Series MCU

config SOC_SERIES_EFR32MG29
	bool
	select SOC_SILABS_XG29
	help
	  Silicon Labs EFR32MG29 (Mighty Gecko) Series MCU

config SOC_EFR32BG29B140F1024IM40
	bool
	select SOC_SERIES_EFR32BG29

config SOC_EFR32BG29B220F1024CJ45
	bool
	select SOC_SERIES_EFR32BG29

config SOC_EFR32BG29B221F1024CJ45
	bool
	select SOC_SERIES_EFR32BG29

config SOC_EFR32BG29B230F1024CM40
	bool
	select SOC_SERIES_EFR32BG29

config SOC_EFR32MG29B140F1024IM40
	bool
	select SOC_SERIES_EFR32MG29

config SOC_EFR32MG29B230F1024CM40
	bool
	select SOC_SERIES_EFR32MG29

config SOC_SERIES
	default "efr32bg29" if SOC_SERIES_EFR32BG29
	default "efr32mg29" if SOC_SERIES_EFR32MG29

config SOC
	default "efr32bg29b140f1024im40" if SOC_EFR32BG29B140F1024IM40
	default "efr32bg29b220f1024cj45" if SOC_EFR32BG29B220F1024CJ45
	default "efr32bg29b221f1024cj45" if SOC_EFR32BG29B221F1024CJ45
	default "efr32bg29b230f1024cm40" if SOC_EFR32BG29B230F1024CM40
	default "efr32mg29b140f1024im40" if SOC_EFR32MG29B140F1024IM40
	default "efr32mg29b230f1024cm40" if SOC_EFR32MG29B230F1024CM40
```
