## usb/class/Kconfig
```kconfig
# Kconfig - USB class drivers configuration options

#
# Copyright (c) 2016 Wind River Systems, Inc.
#
# Licensed under the Apache License, Version 2.0 (the "License");
# you may not use this file except in compliance with the License.
# You may obtain a copy of the License at
#
#     http://www.apache.org/licenses/LICENSE-2.0
#
# Unless required by applicable law or agreed to in writing, software
# distributed under the License is distributed on an "AS IS" BASIS,
# WITHOUT WARRANTIES OR CONDITIONS OF ANY KIND, either express or implied.
# See the License for the specific language governing permissions and
# limitations under the License.
#

if USB_DEVICE_STACK

config USB_CDC_ACM
	bool
	prompt "USB CDC ACM Device Class Driver"
	default n
	help
	USB CDC ACM device class driver

config CDC_ACM_PORT_NAME
	string "CDC ACM class device driver port name"
	depends on USB_CDC_ACM
	default "CDC_ACM"
	help
	Port name through which CDC ACM class device driver is accessed

config USB_CDC_ACM_DEBUG
	bool
	prompt "Enable debug options for USB CDC ACM device class driver"
	default n
	depends on USB_CDC_ACM
	help
	This option enables the debug features for USB CDC ACM device class driver

endif # CONFIG_USB_DEVICE_STACK
```

## west.yml
```yaml
# The west manifest file for upstream Zephyr.
#
# The per-installation west configuration file, .west/config, sets the
# path to the project containing this file in the [manifest] section's
# "path" variable.
#
# You are free to create your own manifest files and put them in any
# repository you want, to create your own custom Zephyr installations.
# For example, you could create a manifest file in your own out of
# tree application directory, which would pull this zephyr repository
# in as an ordinary project.
#
# You can pass your manifest repositories to west init when creating a
# new Zephyr installation. See the west documentation for more
# information.

manifest:
  defaults:
    remote: upstream

  remotes:
    - name: upstream
      url-base: https://github.com/zephyrproject-rtos
    - name: babblesim
      url-base: https://github.com/BabbleSim

  group-filter: [-babblesim, -optional, -testing]

  #
  # Please add items below based on alphabetical order
  # zephyr-keep-sorted-start re(^\s+\- name:)
  projects:
    - name: acpica
      revision: 8d24867bc9c9d81c81eeac59391cda59333affd4
      path: modules/lib/acpica
    - name: babblesim_base
      remote: babblesim
      repo-path: base
      path: tools/bsim/components
      revision: 122b0d6fc1b23b3d678bfbaedb68c53d64b3f3bd
      groups:
        - babblesim
    - name: babblesim_ext_2G4_channel_NtNcable
      remote: babblesim
      repo-path: ext_2G4_channel_NtNcable
      path: tools/bsim/components/ext_2G4_channel_NtNcable
      revision: 20a38c997f507b0aa53817aab3d73a462fff7af1
      groups:
        - babblesim
    - name: babblesim_ext_2G4_channel_multiatt
      remote: babblesim
      repo-path: ext_2G4_channel_multiatt
      path: tools/bsim/components/ext_2G4_channel_multiatt
      revision: bde72a57384dde7a4310bcf3843469401be93074
      groups:
        - babblesim
    - name: babblesim_ext_2G4_device_WLAN_actmod
      remote: babblesim
      repo-path: ext_2G4_device_WLAN_actmod
      path: tools/bsim/components/ext_2G4_device_WLAN_actmod
      revision: 9cb6d8e72695f6b785e57443f0629a18069d6ce4
      groups:
        - babblesim
    - name: babblesim_ext_2G4_device_burst_interferer
      remote: babblesim
      repo-path: ext_2G4_device_burst_interferer
      path: tools/bsim/components/ext_2G4_device_burst_interferer
      revision: 5b5339351d6e6a2368c686c734dc8b2fc65698fc
      groups:
        - babblesim
    - name: babblesim_ext_2G4_device_playback
      remote: babblesim
      repo-path: ext_2G4_device_playback
      path: tools/bsim/components/ext_2G4_device_playback
      revision: abb48cd71ddd4e2a9022f4bf49b2712524c483e8
      groups:
        - babblesim
    - name: babblesim_ext_2G4_libPhyComv1
      remote: babblesim
      repo-path: ext_2G4_libPhyComv1
      path: tools/bsim/components/ext_2G4_libPhyComv1
      revision: 23e7a84f5bc452a361ab30acf3abb9dbdb57e9a8
      groups:
        - babblesim
    - name: babblesim_ext_2G4_modem_BLE_simple
      remote: babblesim
      repo-path: ext_2G4_modem_BLE_simple
      path: tools/bsim/components/ext_2G4_modem_BLE_simple
      revision: 6fdae81d5b5e348bd130c038d049b233ce983a74
      groups:
        - babblesim
    - name: babblesim_ext_2G4_modem_magic
      remote: babblesim
      repo-path: ext_2G4_modem_magic
      path: tools/bsim/components/ext_2G4_modem_magic
      revision: d8281acb634895c8a769489c27146bdfe1a54938
      groups:
        - babblesim
    - name: babblesim_ext_2G4_phy_v1
      remote: babblesim
      repo-path: ext_2G4_phy_v1
      path: tools/bsim/components/ext_2G4_phy_v1
      revision: b0e49ae3dd4d6d0f2286fd1392cee1b5206f5bbc
      groups:
        - babblesim
    - name: babblesim_ext_libCryptov1
      remote: babblesim
      repo-path: ext_libCryptov1
      path: tools/bsim/components/ext_libCryptov1
      revision: da246018ebe031e4fe4a8228187fb459e9f3b2fa
      groups:
        - babblesim
    - name: bsim
      repo-path: babblesim-manifest
      revision: 9fce3723520edcdfddcfa0f1162b45c80d3da527
      path: tools/bsim
      groups:
        - babblesim
    - name: cmsis
      revision: 512cc7e895e8491696b61f7ba8066b4a182569b8
      path: modules/hal/cmsis
      groups:
        - hal
    - name: cmsis-dsp
      revision: 97512610ec92058f0119450b9e743eeb7e95b5c8
      path: modules/lib/cmsis-dsp
    - name: cmsis-nn
      revision: d20117c9e88cf9018d6fa06744dddac700c3e3a1
      path: modules/lib/cmsis-nn
    - name: cmsis_6
      repo-path: CMSIS_6
      revision: b2dfbe1a20bbd49c2d2c605073799671074bbb30
      path: modules/hal/cmsis_6
      groups:
        - hal
    - name: dhara
      revision: 6f163ca05e174b168b4d148160b50eeaeeb561fc
      path: modules/lib/dhara
    - name: edtt
      revision: c282625e694f0b53ea53e13231ea6d2f49411768
      path: tools/edtt
      groups:
        - tools
    - name: fatfs
      revision: f4ead3bf4a6dab3a07d7b5f5315795c073db568d
      path: modules/fs/fatfs
      groups:
        - fs
    - name: hal_adi
      revision: 35d874ccfb8fb062ca8bdf096764b8d34c6d608e
      path: modules/hal/adi
      groups:
        - hal
    - name: hal_afbr
      revision: 1abf6947457380934e27f92508ec5532ddedfc6d
      path: modules/hal/afbr
      groups:
        - hal
    - name: hal_ambiq
      revision: 3d7044ea240fc8dcb7b4c843b76f70cae5db736b
      path: modules/hal/ambiq
      groups:
        - hal
    - name: hal_atmel
      revision: 8f95c79f2a80427ef446563cc9addefa959e92a9
      path: modules/hal/atmel
      groups:
        - hal
    - name: hal_bouffalolab
      path: modules/hal/bouffalolab
      revision: 5d80bd5e43936dc0a8530dbfff94abe3a8e10e0d
      groups:
        - hal
    - name: hal_espressif
      revision: aa20ec213be90548a9318d3cd678bb608ce427af
      path: modules/hal/espressif
      west-commands: west/west-commands.yml
      groups:
        - hal
    - name: hal_ethos_u
      revision: 03567073fe2b9802c0bd73f9534da6f8a03924d1
      path: modules/hal/ethos_u
      groups:
        - hal
    - name: hal_gigadevice
      revision: 44bc5a6aec1d70c74e58a7369e5152a6b6a1f989
      path: modules/hal/gigadevice
      groups:
        - hal
    - name: hal_infineon
      revision: 60a4220d896a67319e9e4e29420d4ea4bb3114f3
      path: modules/hal/infineon
      groups:
        - hal
    - name: hal_intel
      revision: 7c8942c1ecb38b53dae0a02aeb4ab08371f4d4bf
      path: modules/hal/intel
      groups:
        - hal
    - name: hal_microchip
      revision: c0890ac01eaebdd19cb70a5475ed7b4f4ecc8911
      path: modules/hal/microchip
      groups:
        - hal
    - name: hal_nordic
      revision: 06cad097864278160b167a65c800c4cef69d5ce3
      path: modules/hal/nordic
      groups:
        - hal
    - name: hal_nuvoton
      revision: 6e993ab4d923575a69c91fa40897d87c5d779708
      path: modules/hal/nuvoton
      groups:
        - hal
    - name: hal_nxp
      revision: f7937d3cdb178e29bd29fe97fbe15a3a932f939a
      path: modules/hal/nxp
      groups:
        - hal
    - name: hal_openisa
      revision: eabd530a64d71de91d907bad257cd61aacf607bc
      path: modules/hal/openisa
      groups:
        - hal
    - name: hal_quicklogic
      revision: bad894440fe72c814864798c8e3a76d13edffb6c
      path: modules/hal/quicklogic
      groups:
        - hal
    - name: hal_realtek
      path: modules/hal/realtek
      revision: b106aa7cbbb78cee74c0d8063f19eecc575a80b2
      groups:
        - hal
    - name: hal_renesas
      path: modules/hal/renesas
      revision: 29d0d3b9c7f9e3929839c74a6cb10c487c24994f
      groups:
        - hal
    - name: hal_rpi_pico
      path: modules/hal/rpi_pico
      revision: 562b41e10a1d8b1a761b253b107c5c6a84cf4535
      groups:
        - hal
    - name: hal_sifli
      revision: 86fa0e9433fda1a760e0077c19b8407ecceea2f9
      path: modules/hal/sifli
      groups:
        - hal
    - name: hal_silabs
      revision: 002a16ca1f63f8875cfc949130e6ff26cf949c34
      path: modules/hal/silabs
      groups:
        - hal
    - name: hal_st
      revision: e9f0468ade3c06d5e3961e3821543dd67c7ea7f0
      path: modules/hal/st
      groups:
        - hal
    - name: hal_stm32
      revision: 1cf7a28fc71e4b99bd0d9a44c0b780e2ff28d82b
      path: modules/hal/stm32
      groups:
        - hal
    - name: hal_tdk
      revision: fa54cb65535b0ed69564423c9e0bf4e7ee47dcb1
      path: modules/hal/tdk
      groups:
        - hal
    - name: hal_telink
      revision: 4226c7fc17d5a34e557d026d428fc766191a0800
      path: modules/hal/telink
      groups:
        - hal
    - name: hal_ti
      revision: 063b2a62d6e9c5db2978eacaf574155747b59f76
      path: modules/hal/ti
      groups:
        - hal
    - name: hal_wch
      revision: dd3855ea624b05de7e6e95584789615d2058a0f3
      path: modules/hal/wch
      groups:
        - hal
    - name: hal_wurthelektronik
      revision: 7c1297ea071d03289112eb24e789c89c7095c0a2
      path: modules/hal/wurthelektronik
      groups:
        - hal
    - name: hal_xtensa
      revision: 614d7dd1cdb4dd61b8fda5a504d63297497b05ac
      path: modules/hal/xtensa
      groups:
        - hal
    - name: hostap
      path: modules/lib/hostap
      revision: e97765d250aad14e0d2495a3fd5d4d9354a408df
    - name: liblc3
      revision: 48bbd3eacd36e99a57317a0a4867002e0b09e183
      path: modules/lib/liblc3
    - name: libmctp
      revision: b6be45dfc5c67c43c3a5e12589ae3845ea00ab5e
      path: modules/lib/libmctp
    - name: libmetal
      revision: c41f476ba425663cadf7e456b6432e4b21591278
      path: modules/hal/libmetal
      groups:
        - hal
    - name: libsbc
      revision: 8e1beda02acb8972e29e6edbb423f7cafe16e445
      path: modules/lib/libsbc
    - name: littlefs
      path: modules/fs/littlefs
      groups:
        - fs
      revision: 8f5ca347843363882619d8f96c00d8dbd88a8e79
    - name: lora-basics-modem
      revision: a8ddc544043e72807cf7db532478e1dda734ae7c
      path: modules/lib/lora-basics-modem
    - name: loramac-node
      revision: fb00b383072518c918e2258b0916c996f2d4eebe
      path: modules/lib/loramac-node
    - name: lvgl
      revision: bbedf2656086a93a8468a1c98168a6b36631ce9a
      path: modules/lib/gui/lvgl
    - name: mbedtls
      revision: 554163f6f7b2ec71fed9b423e81f2217a8615d29
      path: modules/crypto/mbedtls
      groups:
        - crypto
    - name: mcuboot
      revision: 0fae8920c4e5acb792b3fe766c89c668f42be6ee
      path: bootloader/mcuboot
      groups:
        - bootloader
    - name: mipi-sys-t
      path: modules/debug/mipi-sys-t
      groups:
        - debug
      revision: 5a9d6055b62edc54566d6d0034d9daec91749b98
    - name: mldsa-native
      revision: 3fc19982839305d305071f0de0c540bc9c9bea8a
      path: modules/crypto/mldsa-native
      groups:
        - crypto
    - name: nanopb
      revision: 5499fd4c9a478f8139eeb07a82c3b4468d6067f7
      path: modules/lib/nanopb
    - name: net-tools
      revision: c3431f482ea8a7b570fa4573aa5d35875b7f2a23
      path: tools/net-tools
      groups:
        - tools
    - name: nrf_hw_models
      revision: 253d42e4c124aecd7b51afa4782140270e890a7d
      path: modules/bsim_hw_models/nrf_hw_models
    - name: nrf_wifi
      revision: 21184a8f89f101538ad54c3b64a1d9c4da23bdb8
      path: modules/lib/nrf_wifi
    - name: open-amp
      revision: 01032a8a7bdfdd541686f5dfa3671e602b9fcbff
      path: modules/lib/open-amp
    - name: openthread
      revision: e4d97681c53ec1cc34af1404ad2960adda4ba691
      path: modules/lib/openthread
    - name: percepio
      path: modules/debug/percepio
      revision: 57358a359d95fa7239d0dccd768f587ffc8f71bb
      groups:
        - debug
    - name: picolibc
      path: modules/lib/picolibc
      revision: 01254932e8e81085817ed61fd858648584ffe37c
    - name: psa-arch-tests
      revision: 588572c0ebd835c7e0929eaf3007d4fbadb47b5b
      path: modules/tee/tf-m/psa-arch-tests
      groups:
        - testing
        - tee
    - name: segger
      revision: 50892fdbcf2f570e67baa72b8894a66b16946f72
      path: modules/debug/segger
      groups:
        - debug
    - name: tf-m-tests
      revision: 2f9d323198329cc3df0d6145ec924222cf4ae440
      path: modules/tee/tf-m/tf-m-tests
      groups:
        - testing
        - tee
    - name: tf-psa-crypto
      revision: 2d881593696aec687ca2246c53de207c2b9bf782
      path: modules/crypto/tf-psa-crypto
      groups:
        - crypto
    - name: trusted-firmware-a
      revision: b7025fb97b53370ac4a2c216698e0784916fa135
      path: modules/tee/tf-a/trusted-firmware-a
      groups:
        - tee
    - name: trusted-firmware-m
      revision: 47b9f07b9ec2c879acc38709e9e7ba3202143a38
      path: modules/tee/tf-m/trusted-firmware-m
      groups:
        - tee
    - name: uoscore-uedhoc
      revision: dc0ab6345450668de3f9597320a48c5a2d409bb6
      path: modules/lib/uoscore-uedhoc
    - name: zcbor
      revision: 9164bd18dcd88ff9d9ef98279501fc1093571017
      path: modules/lib/zcbor
  # zephyr-keep-sorted-stop

  self:
    path: zephyr
    west-commands: scripts/west-commands.yml
    import: submanifests
```

## zephyr/Kconfig
```kconfig
# General configuration options

# Copyright (c) 2022 Legrand North America, LLC.
# SPDX-License-Identifier: Apache-2.0


source "boards/Kconfig"
source "soc/Kconfig"
source "arch/Kconfig"
source "kernel/Kconfig"
source "dts/Kconfig"
source "drivers/Kconfig"
source "lib/Kconfig"
source "subsys/Kconfig"
```
