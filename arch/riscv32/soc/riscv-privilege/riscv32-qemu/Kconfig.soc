## arch/x86/bsp/Kconfig
```kconfig
# Kconfig - x86 BSPs configuration options

#
# Copyright (c) 2014-2015 Wind River Systems, Inc.
#
# Redistribution and use in source and binary forms, with or without
# modification, are permitted provided that the following conditions are met:
#
# 1) Redistributions of source code must retain the above copyright notice,
# this list of conditions and the following disclaimer.
#
# 2) Redistributions in binary form must reproduce the above copyright notice,
# this list of conditions and the following disclaimer in the documentation
# and/or other materials provided with the distribution.
#
# 3) Neither the name of Wind River Systems nor the names of its contributors
# may be used to endorse or promote products derived from this software without
# specific prior written permission.
#
# THIS SOFTWARE IS PROVIDED BY THE COPYRIGHT HOLDERS AND CONTRIBUTORS "AS IS"
# AND ANY EXPRESS OR IMPLIED WARRANTIES, INCLUDING, BUT NOT LIMITED TO, THE
# IMPLIED WARRANTIES OF MERCHANTABILITY AND FITNESS FOR A PARTICULAR PURPOSE
# ARE DISCLAIMED. IN NO EVENT SHALL THE COPYRIGHT HOLDER OR CONTRIBUTORS BE
# LIABLE FOR ANY DIRECT, INDIRECT, INCIDENTAL, SPECIAL, EXEMPLARY, OR
# CONSEQUENTIAL DAMAGES (INCLUDING, BUT NOT LIMITED TO, PROCUREMENT OF
# SUBSTITUTE GOODS OR SERVICES; LOSS OF USE, DATA, OR PROFITS; OR BUSINESS
# INTERRUPTION) HOWEVER CAUSED AND ON ANY THEORY OF LIABILITY, WHETHER IN
# CONTRACT, STRICT LIABILITY, OR TORT (INCLUDING NEGLIGENCE OR OTHERWISE)
# ARISING IN ANY WAY OUT OF THE USE OF THIS SOFTWARE, EVEN IF ADVISED OF THE
# POSSIBILITY OF SUCH DAMAGE.
#

menu "BSP General Configuration"

choice
prompt "BSP Configuration"
default BSP_PCPENTIUM4

config BSP_ATOM_N28XX
	bool "Minimum configuration for ATOM N28XX BSP"
	select CPU_PENTIUM4
	select SHUTOFF_PIC
	select IOAPIC
	select LOAPIC
	select LOAPIC_TIMER
	select EOI_HANDLER_SUPPORTED
	select BOOTLOADER_UNKNOWN
	select EXTRA_SERIAL_PORT
	select SERIAL_INTERRUPT_LEVEL
	select CUSTOM_RANDOM_GENERATOR
	select BSP_GENERIC_PC

config BSP_PCMINUTEIA
	bool "Minimum configuration for MINUTE IA BSP"
	select CPU_MINUTEIA
	select PIC
	select PIT
	select BOI_HANDLER_SUPPORTED
	select EOI_HANDLER_SUPPORTED
	select BOOTLOADER_UNKNOWN
	select EXTRA_SERIAL_PORT
	select BSP_GENERIC_PC

config BSP_PCPENTIUM4
	bool "Minimum configuration for PENTIUM 4 BSP"
	select CPU_PENTIUM4
	select PIC
	select PIT
	select BOI_HANDLER_SUPPORTED
	select EOI_HANDLER_SUPPORTED
	select BOOTLOADER_UNKNOWN
	select EXTRA_SERIAL_PORT
	select BSP_GENERIC_PC

config BSP_QUARK
	bool "Minimum configuration for QUARK BSP"
	select CPU_MINUTEIA
	select IOAPIC
	select HPET_TIMER
	select EOI_HANDLER_SUPPORTED
	select BOOTLOADER_UNKNOWN
	select EXTRA_SERIAL_PORT
	select LINK_AUX_COMPILER_LIBS
	select DRV_NS16550
	select DRV_SERIAL
	select DRV_PCI

endchoice

config BSP_GENERIC_PC
	bool
	default n
	select DRV_TIMER
	select DRV_INTCTL
	select DRV_NS16550
	select DRV_SERIAL


menu "Intel Processor"

config CPU_MINUTEIA
	bool "Minute IA"
	help
	This option signifies the use of a CPU from the Minute IA family.

config CPU_PENTIUM4
	bool "Pentium 4"
	help
	This option signifies the use of a CPU from the Pentium 4 family.
endmenu

config ADVANCED_IDLE
	bool
	prompt "Advanced idle state"
	default n
	depends on ADVANCED_POWER_MANAGEMENT && ADVANCED_IDLE_SUPPORTED
	help
	This option enables the kernel to interface to a custom advanced idle
	power saving manager. This permits the system to enter a custom
	power saving state when the kernel becomes idle for extended periods,
	and then to restore the system to its previous state (rather than
	booting up from scratch) when the kernel is re-activated.

config ADV_IDLE_STACK_SIZE
	int
	prompt "Advanced idle state stack size"
	default 16
	depends on ADVANCED_IDLE
	help
	This option defines the size of the separate stack used during the
	system state check while the booting up. A separate stack is used
	to avoid memory corruption on the system re-activation from power
	down mode. The stack size must be large enough to hold the return
	address (4 bytes) and the _AdvIdleCheckSleep() stack frame.

config CPU_MIGHT_SUPPORT_CLFLUSH
	bool
	default n
	help
	If a BSP uses a processor that possibly implements CLFLUSH, change
	the default in that BSP's config file.

#FIXME This options is not being used in the current code base.
config CLFLUSH_INSTRUCTION_SUPPORTED
	bool
	prompt "CLFLUSH instruction supported" if CPU_MIGHT_SUPPORT_CLFLUSH
	depends on CPU_MIGHT_SUPPORT_CLFLUSH
	default n
	help
	Only enable this if the CLFLUSH instruction is supported, so that
	an implementation of _SysCacheFlush() that uses CLFLUSH is made
	available, instead of the one using WBINVD.

menu "Specific CPU Capability Support"

config ISA_IA32
	bool
	default y if CPU_MINUTEIA || CPU_PENTIUM4
	default n
	help
	This option signifies the use of a CPU based on the Intel IA-32
	instruction set architecture.

config HARDWARE_BP_SUPPORTED
	bool "Hardware BP supported"
	default y if ISA_IA32
	default n
	help
	This option signifies that the target supports hardware-based
	instruction breakpoints and/or data watchpoints.

config TICKLESS_IDLE_UNSUPPORTED
	prompt "Tickless Idle Unsupported"
	bool
	default n
	help
	This option signifies the use of an Intel CPU that lacks
	support for tickless idle.

config CMOV_UNSUPPORTED
	bool "CMOV Unsupported"
	default y if CPU_MINUTEIA
	default n
	help
	This option signifies the use of an Intel CPU that lacks support
	for the CMOV instruction.

config CPU_FLOAT_UNSUPPORTED
	bool "CPU float unsupported"
	default y if CPU_MINUTEIA
	default n
	select CPU_SSE_UNSUPPORTED
	help
	This option signifies the use of an Intel CPU that lacks support
	for floating point operations.

config CPU_SSE_UNSUPPORTED
	bool "CPU SSE unsupported"
	default n
	help
	This option signifies the use of an Intel CPU that lacks support
	for SSEx instructions (i.e. those which pre-date Pentium III).

config CACHE_LINE_SIZE
	int "Cache line size"
	default 64 if CPU_PENTIUM4
	default 0
	help
	Size in bytes of a CPU cache line.

endmenu

menu "Specific BSP Capability Support"
config DYNAMIC_INT_STUBS
	bool "Dynamic INT stubs"
	default n
	help
	This option allows a BSP's drivers to install interrupt handlers
	at run time, if desired. If not enabled, interrupt handlers can only
	be installed statically when the image is created.

config PROT_MODE_SWITCH_PROMPT
	bool "Prot Mode switch prompt"
	default n
	help
	This option allows users to select the value of the PROT_MODE_SWITCH
	configuration option.

config ADVANCED_IDLE_SUPPORTED
	bool "Advanced idle supported"
	default n
	help
	This option signifies that the target supports the ADVANCED_IDLE
	configuration option.

endmenu

config BOOTLOADER_UNKNOWN
	bool
	default n
	help
	This option signifies that the target has an unknown bootloader
	or that it supports multiple ways of booting and it isn't clear
	at build time which method is to be used. When this option is enabled
	the BSP may have to do extra work to ensure a propert startup.

menu "Boot Sequence Options"
depends on PROT_MODE_SWITCH_PROMPT

config PROT_MODE_SWITCH
	bool
	prompt "Switch to 32-bit protected mode when booting"
	default n
	depends on PROT_MODE_SWITCH_PROMPT
	help
	This option causes the kernel to transition from real mode (16-bit)
	to protected mode (32-bit) during its initial booting sequence.

config BOOT_A20_ENABLE
	bool "Boot A20 enable"
	depends on PROT_MODE_SWITCH
	default n
	help
	This option causes the A20 line to be enabled during the transition
	from real mode (16-bit) to protected mode (32-bit) during its initial
	booting sequence.

endmenu

config PIC
	bool "PIC (i8259)"
	default n
	depends on BSP_GENERIC_PC
	help
	This option selects legacy i8259 as the interrupt controller.

config SHUTOFF_PIC
	bool "Shutoff PIC"
	depends on !PIC
	default n
	help
	This option disables all interrupts on the PIC

endmenu
```

## arch/x86/configs/galileo_defconfig
```kconfig
CONFIG_X86_32=y
CONFIG_MICROKERNEL=y
CONFIG_PLATFORM_IA32_PCI=y
CONFIG_CPU_MINUTEIA=y
CONFIG_CONSOLE=y
CONFIG_SERIAL=y
CONFIG_NS16550=y
CONFIG_UART_CONSOLE=y
CONFIG_HPET_TIMER_LEVEL_LOW=y
CONFIG_SERIAL_INTERRUPT_LOW=y
CONFIG_SYS_CLOCK_HW_CYCLES_PER_SEC=25000000
CONFIG_NS16550_PCI=y
```

## arch/x86/configs/micro_galileo_defconfig
```kconfig
CONFIG_MICROKERNEL=y
CONFIG_X86_32=y
CONFIG_PLATFORM_GALILEO=y
CONFIG_CPU_MINUTEIA=y
CONFIG_CONSOLE=y
CONFIG_SERIAL=y
CONFIG_NS16550=y
CONFIG_NS16550_PCI=y
CONFIG_UART_CONSOLE=y
CONFIG_HPET_TIMER_LEVEL_LOW=y
CONFIG_SERIAL_INTERRUPT_LOW=y
CONFIG_SYS_CLOCK_HW_CYCLES_PER_SEC=25000000
CONFIG_GPIO=y
CONFIG_GPIO_PCAL9535A=y
CONFIG_GPIO_PCAL9535A_DEBUG=y
CONFIG_GPIO_PCAL9535A_0=y
CONFIG_GPIO_PCAL9535A_0_DEV_NAME="GPIO_P0"
CONFIG_GPIO_PCAL9535A_0_I2C_ADDR=0x25
CONFIG_GPIO_PCAL9535A_0_I2C_MASTER_DEV_NAME="I2C0"
CONFIG_GPIO_PCAL9535A_1=y
CONFIG_GPIO_PCAL9535A_1_DEV_NAME="GPIO_P1"
CONFIG_GPIO_PCAL9535A_1_I2C_ADDR=0x26
CONFIG_GPIO_PCAL9535A_1_I2C_MASTER_DEV_NAME="I2C0"
CONFIG_GPIO_PCAL9535A_2=y
CONFIG_GPIO_PCAL9535A_2_DEV_NAME="GPIO_P2"
CONFIG_GPIO_PCAL9535A_2_I2C_ADDR=0x27
CONFIG_GPIO_PCAL9535A_2_I2C_MASTER_DEV_NAME="I2C0"
CONFIG_GPIO_MMIO=y
CONFIG_GPIO_MMIO_0=y
CONFIG_GPIO_MMIO_0_DEV_NAME="GPIO_M0"
CONFIG_GPIO_MMIO_0_CFG=0x0
CONFIG_GPIO_MMIO_0_EN=0x1080
CONFIG_GPIO_MMIO_0_DIR=0x1084
CONFIG_GPIO_MMIO_0_INPUT=0x1088
CONFIG_GPIO_MMIO_0_OUTPUT=0x1088
CONFIG_GPIO_MMIO_1=y
CONFIG_GPIO_MMIO_1_DEV_NAME="GPIO_M1"
CONFIG_GPIO_MMIO_1_CFG=0x0
CONFIG_GPIO_MMIO_1_EN=0x10A0
CONFIG_GPIO_MMIO_1_DIR=0x10A4
CONFIG_GPIO_MMIO_1_INPUT=0x10A8
CONFIG_GPIO_MMIO_1_OUTPUT=0x10A8
```

## arch/x86/configs/nano_galileo_defconfig
```kconfig
CONFIG_NANOKERNEL=y
CONFIG_NANO_TIMERS=y
CONFIG_NANO_TIMEOUTS=y
CONFIG_X86_32=y
CONFIG_PLATFORM_GALILEO=y
CONFIG_CPU_MINUTEIA=y
CONFIG_PCI_LEGACY_BRIDGE=y
CONFIG_CONSOLE=y
CONFIG_SERIAL=y
CONFIG_NS16550=y
CONFIG_NS16550_PCI=y
CONFIG_UART_CONSOLE=y
CONFIG_HPET_TIMER_LEVEL_LOW=y
CONFIG_SERIAL_INTERRUPT_LOW=y
CONFIG_SYS_CLOCK_HW_CYCLES_PER_SEC=25000000
CONFIG_I2C=y
CONFIG_I2C_DW=y
CONFIG_I2C_DW_0=y
CONFIG_I2C_DW_0_IRQ_SHARED=y
CONFIG_GPIO=y
CONFIG_GPIO_DW_0_IRQ_SHARED=y
CONFIG_GPIO_PCAL9535A=y
CONFIG_GPIO_PCAL9535A_0=y
CONFIG_GPIO_PCAL9535A_1=y
CONFIG_GPIO_PCAL9535A_2=y
CONFIG_GPIO_MMIO=y
CONFIG_GPIO_MMIO_0=y
CONFIG_GPIO_MMIO_0_ACCESS_IO=y
CONFIG_GPIO_MMIO_1=y
CONFIG_GPIO_MMIO_1_ACCESS_IO=y
CONFIG_I2C_DW_IRQ_LEVEL_LOW=y
CONFIG_SHARED_IRQ=y
CONFIG_SHARED_IRQ_0_LEVEL_LOW=y
CONFIG_SPI_INTEL_LEVEL_LOW=y
```

## arch/x86/configs/quark_d2000_defconfig
```kconfig
CONFIG_X86_32=y
CONFIG_PLATFORM_QUARK_D2000=y
CONFIG_CPU_MINUTEIA=y
CONFIG_IDT_NUM_VECTORS=64
CONFIG_LOAPIC_TIMER_DIVIDER_UNSUPPORTED=y
CONFIG_NS16550=y
CONFIG_UART_CONSOLE=y
CONFIG_CONSOLE=y
CONFIG_SERIAL=y
CONFIG_SERIAL_HAS_DRIVER=y
CONFIG_PRINTK=y
CONFIG_ISR_STACK_SIZE=256
CONFIG_MAIN_STACK_SIZE=512
```

## arch/x86/core/Kconfig
```kconfig
# Kconfig - x86 core configuration options

#
# Copyright (c) 2014-2015 Wind River Systems, Inc.
#
# SPDX-License-Identifier: Apache-2.0
#

config NESTED_INTERRUPTS
	bool "Enable nested interrupts"
	default y
	help
	  This option enables support for nested interrupts.

config EXCEPTION_DEBUG
	bool "Unhandled exception debugging"
	default y
	depends on PRINTK
	help
	  Install handlers for various CPU exception/trap vectors to
	  make debugging them easier, at a small expense in code size.
	  This prints out the specific exception vector and any associated
	  error codes.

menu "Memory Layout Options"

config IDT_NUM_VECTORS
	int "Number of IDT vectors"
	default 256
	range 32 256
	help
	  This option specifies the number of interrupt vector entries in the
	  Interrupt Descriptor Table (IDT). By default all 256 vectors are
	  supported in an IDT requiring 2048 bytes of memory.

config MAX_IRQ_LINES
	int "Number of IRQ lines"
	default 128
	range 0 256
	help
	  This option specifies the number of IRQ lines in the system.
	  It can be tuned to save some bytes in ROM, as it determines the
	  size of the _irq_to_interrupt_vector_table, which is used at runtime
	  to program to the PIC the association between vectors and
	  interrupts.

config SET_GDT
	bool "Setup GDT as part of boot process"
	default y
	help
	  This option sets up the GDT as part of the boot process. However,
	  this may conflict with some security scenarios where the GDT is
	  already appropriately set by an earlier bootloader stage, in which
	  case this should be disabled. If disabled, the global _gdt pointer
	  will not be available.

config GDT_DYNAMIC
	bool "Store GDT in RAM so that it can be modified"
	depends on SET_GDT
	help
	  This option stores the GDT in RAM instead of ROM, so that it may
	  be modified at runtime at the expense of some memory.

endmenu

config DISABLE_SSBD
	bool "Disable Speculative Store Bypass"
	depends on USERSPACE
	default y if !X86_NO_SPECTRE_V4
	help
	  This option will disable Speculative Store Bypass in order to
	  mitigate against certain kinds of side channel attacks.  Quoting
	  the "Speculative Execution Side Channels" document, version 2.0:

	      When SSBD is set, loads will not execute speculatively
	      until the addresses of all older stores are known.  This
	      ensure s that a load does not speculatively consume stale
	      data values due to bypassing an older store on the same
	      logical processor.

	  If enabled, this applies to all threads in the system.

	  Even if enabled, will have no effect on CPUs that do not
	  require this feature.
```
