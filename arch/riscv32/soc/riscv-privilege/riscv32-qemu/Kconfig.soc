## arch/riscv32/soc/riscv-privilege/riscv32-qemu/Kconfig.soc
```kconfig
# Kconfig - RISCV32_QEMU SOC configuration options
#
# Copyright (c) 2017 Jean-Paul Etienne <fractalclone@gmail.com>
#
# SPDX-License-Identifier: Apache-2.0
#

choice
prompt "riscv32_qemu SOC implementation"
depends on SOC_SERIES_RISCV32_QEMU

config SOC_RISCV32_QEMU
	bool "riscv32_qemu SOC implementation"
	select ATOMIC_OPERATIONS_C

endchoice
```

## arch/riscv32/soc/riscv-privilege/sifive-freedom/Kconfig.defconfig.series
```kconfig
if SOC_SERIES_RISCV32_SIFIVE_FREEDOM

config SOC_SERIES
	string
	default "sifive-freedom"

config SYS_CLOCK_HW_CYCLES_PER_SEC
	int
	default 32768

config RISCV_SOC_INTERRUPT_INIT
	bool
	default y

config RISCV_HAS_CPU_IDLE
	bool
	default y

config RISCV_HAS_PLIC
	bool
	default y

config NUM_IRQS
	int
	default 64

config XIP
	bool
	default y

config RISCV_ROM_BASE_ADDR
	hex
	default 0x20400000

config RISCV_ROM_SIZE
	hex
	default 0xC00000

config RISCV_RAM_BASE_ADDR
	hex
	default	0x80000000

config RISCV_RAM_SIZE
	hex
	default 0x4000

endif # SOC_SERIES_RISCV32_SIFIVE_FREEDOM
```

## arch/riscv32/soc/riscv32-qemu/Kconfig.defconfig
```kconfig
if SOC_RISCV32_QEMU

config SOC
	string
	default "riscv32-qemu"

config SYS_CLOCK_HW_CYCLES_PER_SEC
	int
	default 10000000

config RISCV_SOC_INTERRUPT_INIT
	bool
	default y

config INCLUDE_RESET_VECTOR
	bool
	default y

config NUM_IRQS
	int
	default 32

config RISCV_ROM_BASE_ADDR
	hex
	default 0x00001000

config RISCV_ROM_SIZE
	hex
	default 0x100000

config RISCV_RAM_BASE_ADDR
	hex
	default	0x80000000

config RISCV_RAM_SIZE_MB
	int
	default 32

endif # SOC_RISCV32_QEMU
```

## arch/riscv32/soc/riscv32-qemu/Kconfig.soc
```kconfig
config SOC_RISCV32_QEMU
	bool "riscv32_qemu SOC implementation"
	select ATOMIC_OPERATIONS_C
```

## arch/rx/Kconfig
```kconfig
# Renesas RX architecture configuration options

# Copyright (c) 2020 KT-Elektronik, Klaucke und Partner GmbH
# Copyright (c) 2024 Renesas Electronics Corporation
# SPDX-License-Identifier: Apache-2.0

menu "Renesas RX Options"
	depends on RX

config ARCH
	string
	default "rx"

config HAS_EXCEPT_VECTOR_TABLE
	bool
	help
	  Set if the processor has the exception vector table.

config CPU_RXV1
	bool
	help
	  Set if the processor supports the Renesas RXv1 instruction set.

config CPU_RXV2
	bool
	select HAS_EXCEPT_VECTOR_TABLE
	help
	  Set if the processor supports the Renesas RXv2 instruction set.

config CPU_RXV3
	bool
	select HAS_EXCEPT_VECTOR_TABLE
	help
	  Set if the processor supports the Renesas RXv3 instruction set.

config XIP
	default y

config NUM_IRQ_PRIO_LEVELS
	int "Number of supported interrupt priority levels"
	range 1 16
	default 16
	help
	  Interrupt priorities available will be 0 to NUM_IRQ_PRIO_LEVELS-1. The
	  minimum value is 1. The BSP must provide a valid default for proper
	  operation.

config NUM_IRQS
	int
	default 256

config GEN_ISR_TABLES
	default y

config GEN_SW_ISR_TABLE
	default y

config GEN_IRQ_VECTOR_TABLE
	default n

config GEN_IRQ_START_VECTOR
	default 16

config DYNAMIC_INTERRUPTS
	default y

config MAIN_STACK_SIZE
	default 1024

config INITIALIZATION_STACK_SIZE
	int "Initialization stack size (in bytes)"
	default 512
	help
	  Stack size for initialization process of kernel (in bytes)

endmenu
```

## arch/sparc/Kconfig
```kconfig
# Copyright (c) 2019-2020 Cobham Gaisler AB
# SPDX-License-Identifier: Apache-2.0

menu "SPARC Options"
	depends on SPARC

config ARCH
	default "sparc"

config SPARC_NWIN
	int "Number of register windows"
	default 8
	help
	  Number of implemented register windows.

config GEN_ISR_TABLES
	default y

config GEN_IRQ_VECTOR_TABLE
	default n

config GEN_SW_ISR_TABLE
	default y

config NUM_IRQS
	int
	default 32

config SPARC_SVT
	bool "Single-vector trapping"
	help
	  Use Single-vector trapping (SVT). Defined by SPARC-V8 Embedded (V8E)
	  Architecture Specification and available in some LEON processors.

config SPARC_CASA
	bool "CASA instructions"
	help
	  Use CASA atomic instructions. Defined by SPARC V9 and available
	  in some LEON processors.

# The SPARC V8 ABI allocates a stack frame of minimum 96 byte for each SAVE
# instruction so we bump the kernel default values.
config MAIN_STACK_SIZE
	default 4096 if COVERAGE_GCOV
	default 2048

config IDLE_STACK_SIZE
	default 1024

config ISR_STACK_SIZE
	default 4096

config TEST_EXTRA_STACK_SIZE
	default 4096 if COVERAGE_GCOV
	default 2048

config IPM_CONSOLE_STACK_SIZE
	default 4096 if COVERAGE_GCOV
	default 1024

config NET_TX_STACK_SIZE
	default 2048

config NET_RX_STACK_SIZE
	default 2048

endmenu
```
