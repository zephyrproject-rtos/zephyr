## arch/riscv/Kconfig.isa
```kconfig
# Copyright (c) 2022 Carlo Caione <ccaione@baylibre.com>
# SPDX-License-Identifier: Apache-2.0

RISCV_ISA_BASE_PROP := riscv,isa-base
RISCV_ISA_EXT_PROP  := riscv,isa-extensions

config RISCV_ISA_RV32I
	bool
	default y if $(dt_compat_all_has_prop,riscv,$(RISCV_ISA_BASE_PROP),rv32i)
	help
	  RV32I Base Integer Instruction Set - 32bit

config RISCV_ISA_RV32E
	bool
	default y if $(dt_compat_all_has_prop,riscv,$(RISCV_ISA_BASE_PROP),rv32e)
	help
	  RV32E Base Integer Instruction Set (Embedded) - 32bit

config RISCV_ISA_RV64I
	bool
	default y if $(dt_compat_all_has_prop,riscv,$(RISCV_ISA_BASE_PROP),rv64i)
	select 64BIT
	help
	  RV64I Base Integer Instruction Set - 64bit

config RISCV_ISA_RV128I
	bool
	default y if $(dt_compat_all_has_prop,riscv,$(RISCV_ISA_BASE_PROP),rv128i)
	help
	  RV128I Base Integer Instruction Set - 128bit

config RISCV_ISA_EXT_M
	bool
	default y if $(dt_compat_all_has_prop,riscv,$(RISCV_ISA_EXT_PROP),m)
	help
	  (M) - Standard Extension for Integer Multiplication and Division

	  Standard integer multiplication and division instruction extension,
	  which is named "M" and contains instructions that multiply or divide
	  values held in two integer registers.

config RISCV_ISA_EXT_A
	bool
	default y if $(dt_compat_all_has_prop,riscv,$(RISCV_ISA_EXT_PROP),a)
	imply RISCV_ISA_EXT_ZAAMO
	imply RISCV_ISA_EXT_ZALRSC
	help
	  (A) - Standard Extension for Atomic Instructions

	  The standard atomic instruction extension is denoted by instruction
	  subset name "A", and contains instructions that atomically
	  read-modify-write memory to support synchronization between multiple
	  RISC-V threads running in the same memory space.

config RISCV_ISA_EXT_F
	bool
	default y if $(dt_compat_all_has_prop,riscv,$(RISCV_ISA_EXT_PROP),f)
	select CPU_HAS_FPU
	help
	  (F) - Standard Extension for Single-Precision Floating-Point

	  Standard instruction-set extension for single-precision
	  floating-point, which is named "F" and adds single-precision
	  floating-point computational instructions compliant with the IEEE
	  754-2008 arithmetic standard.

config RISCV_ISA_EXT_D
	bool
	default y if $(dt_compat_all_has_prop,riscv,$(RISCV_ISA_EXT_PROP),d)
	depends on RISCV_ISA_EXT_F
	select CPU_HAS_FPU_DOUBLE_PRECISION
	help
	  (D) - Standard Extension for Double-Precision Floating-Point

	  Standard double-precision floating-point instruction-set extension,
	  which is named "D" and adds double-precision floating-point
	  computational instructions compliant with the IEEE 754-2008
	  arithmetic standard.

config RISCV_ISA_EXT_G
	bool
	select RISCV_ISA_EXT_M
	select RISCV_ISA_EXT_A
	select RISCV_ISA_EXT_F
	select RISCV_ISA_EXT_D
	select RISCV_ISA_EXT_ZICSR
	select RISCV_ISA_EXT_ZIFENCEI
	help
	  (IMAFDZicsr_Zifencei) IMAFDZicsr_Zifencei extensions

config RISCV_ISA_EXT_Q
	bool
	default y if $(dt_compat_all_has_prop,riscv,$(RISCV_ISA_EXT_PROP),q)
	depends on RISCV_ISA_RV64I
	depends on RISCV_ISA_EXT_F
	depends on RISCV_ISA_EXT_D
	help
	  (Q) - Standard Extension for Quad-Precision Floating-Point

	  Standard extension for 128-bit binary floating-point instructions
	  compliant with the IEEE 754-2008 arithmetic standard. The 128-bit or
	  quad-precision binary floatingpoint instruction subset is named "Q".

config RISCV_ISA_EXT_C
	bool
	default y if $(dt_compat_all_has_prop,riscv,$(RISCV_ISA_EXT_PROP),c)
	select RISCV_ISA_EXT_ZCA
	select RISCV_ISA_EXT_ZCD if RISCV_ISA_EXT_D
	select RISCV_ISA_EXT_ZCF if RISCV_ISA_EXT_F && (RISCV_ISA_RV32I || RISCV_ISA_RV32E)
	help
	  (C) - Standard Extension for Compressed Instructions

	  RISC-V standard compressed instruction set extension, named "C",
	  which reduces static and dynamic code size by adding short 16-bit
	  instruction encodings for common operations.

config RISCV_ISA_EXT_ZICNTR
	bool
	default y if $(dt_compat_all_has_prop,riscv,$(RISCV_ISA_EXT_PROP),zicntr)
	depends on RISCV_ISA_EXT_ZICSR
	help
	  (Zicntr) - Standard Extension for Base Counters and Timers

	  The Zicntr standard extension comprises the three counters (CYCLE, TIME, and INSTRET),
	  which have dedicated functions (cycle count, real-time clock and instructions retired,
	  respectively).

config RISCV_ISA_EXT_ZICSR
	bool
	default y if $(dt_compat_all_has_prop,riscv,$(RISCV_ISA_EXT_PROP),zicsr)
	help
	  (Zicsr) - Standard Extension for Control and Status Register (CSR) Instructions

	  The "Zicsr" extension introduces support for the full set of CSR
	  instructions that operate on CSRs registers.

config RISCV_ISA_EXT_SMCSRIND
	bool
	default y if $(dt_compat_all_has_prop,riscv,$(RISCV_ISA_EXT_PROP),smcsrind)
	depends on RISCV_ISA_EXT_ZICSR
	help
	  (Smcsrind) - Standard Extension for Indirect CSR Access

	  The Smcsrind extension provides indirect access to CSRs through
	  the MISELECT and MIREG registers.

config RISCV_ISA_EXT_ZIFENCEI
	bool
	default y if $(dt_compat_all_has_prop,riscv,$(RISCV_ISA_EXT_PROP),zifencei)
	help
	  (Zifencei) - Standard Extension for Instruction-Fetch Fence

	  The "Zifencei" extension includes the FENCE.I instruction that
	  provides explicit synchronization between writes to instruction
	  memory and instruction fetches on the same hart.

config RISCV_ISA_EXT_ZAAMO
	bool
	default y if $(dt_compat_all_has_prop,riscv,$(RISCV_ISA_EXT_PROP),zaamo)
	help
	  (Zaamo) - Atomic memory operation subset of the A extension

	  The Zaamo extension enables support for AMO*.W/D-style instructions.

config RISCV_ISA_EXT_ZALRSC
	bool
	default y if $(dt_compat_all_has_prop,riscv,$(RISCV_ISA_EXT_PROP),zalrsc)
	help
	  (Zalrsc) - Load-Reserved/Store-Conditional subset of the A extension

	  The Zalrsc extension enables support for LR.W/D and SC.W/D-style instructions.

config RISCV_ISA_EXT_ZCA
	bool
	default y if $(dt_compat_all_has_prop,riscv,$(RISCV_ISA_EXT_PROP),zca)
	help
	  (Zca) - Zba Extension for Compressed Instructions

	  The Zca extension is a subset of the C extension that does not include
	  the floating-point load and store instructions.

config RISCV_ISA_EXT_ZCB
	bool
	default y if $(dt_compat_all_has_prop,riscv,$(RISCV_ISA_EXT_PROP),zcb)
	depends on RISCV_ISA_EXT_ZCA
	help
	  (Zcb) - Zcb Extension for Simple Compressed Instructions

	  The Zcb extension is a set of simple code-size saving instructions
	  which are easy to implement on all CPUs.

config RISCV_ISA_EXT_ZCD
	bool
	default y if $(dt_compat_all_has_prop,riscv,$(RISCV_ISA_EXT_PROP),zcd)
	depends on RISCV_ISA_EXT_D
	depends on RISCV_ISA_EXT_ZCA
	help
	  (Zcd) - Zcd Extension for Double-Precision FP Compressed Instructions

	  The Zcd extension consists of compressed double-precision
	  floating-point load and store instructions.

config RISCV_ISA_EXT_ZCF
	bool
	default y if $(dt_compat_all_has_prop,riscv,$(RISCV_ISA_EXT_PROP),zcf)
	depends on RISCV_ISA_RV32I || RISCV_ISA_RV32E
	depends on RISCV_ISA_EXT_F
	depends on RISCV_ISA_EXT_ZCA
	help
	  (Zcf) - Zcf Extension for Single-Precision FP Compressed Instructions

	  The Zcf extension consists of compressed single-precision
	  floating-point load and store instructions.

config RISCV_ISA_EXT_ZCMP
	bool
	default y if $(dt_compat_all_has_prop,riscv,$(RISCV_ISA_EXT_PROP),zcmp)
	depends on RISCV_ISA_EXT_ZCA
	depends on !RISCV_ISA_EXT_ZCD
	help
	  (Zcmp) - Zcmp Extension for Complex Compressed Instructions

	  The Zcmp extension consists of complex operations intended for
	  embedded CPUs.

config RISCV_ISA_EXT_ZCMT
	bool
	default y if $(dt_compat_all_has_prop,riscv,$(RISCV_ISA_EXT_PROP),zcmt)
	depends on RISCV_ISA_EXT_ZICSR
	depends on RISCV_ISA_EXT_ZCA
	depends on !RISCV_ISA_EXT_ZCD
	help
	  (Zcmt) - Zcmt Extension for Compressed Table Jump Instructions

	  The Zcmt extension consists of compressed table jump instructions for
	  embedded CPUs.

config RISCV_ISA_EXT_ZBA
	bool
	default y if $(dt_compat_all_has_prop,riscv,$(RISCV_ISA_EXT_PROP),zba)
	help
	  (Zba) - Zba BitManip Extension

	  The Zba instructions can be used to accelerate the generation of
	  addresses that index into arrays of basic types (halfword, word,
	  doubleword) using both unsigned word-sized and XLEN-sized indices: a
	  shifted index is added to a base address.

config RISCV_ISA_EXT_ZBB
	bool
	default y if $(dt_compat_all_has_prop,riscv,$(RISCV_ISA_EXT_PROP),zbb)
	help
	  (Zbb) - Zbb BitManip Extension (Basic bit-manipulation)

	  The Zbb instructions can be used for basic bit-manipulation (logical
	  with negate, count leading / trailing zero bits, count population,
	  etc...).

config RISCV_ISA_EXT_ZBC
	bool
	default y if $(dt_compat_all_has_prop,riscv,$(RISCV_ISA_EXT_PROP),zbc)
	help
	  (Zbc) - Zbc BitManip Extension (Carry-less multiplication)

	  The Zbc instructions can be used for carry-less multiplication that
	  is the multiplication in the polynomial ring over GF(2).

config RISCV_ISA_EXT_ZBKB
	bool
	default y if $(dt_compat_all_has_prop,riscv,$(RISCV_ISA_EXT_PROP),zbkb)
	help
	  (Zbkb) - Zbkb BitManip Extension (Bit-manipulation for Cryptography)

	  The Zbkb instructions can be used for accelerating cryptography workloads
	  and contain rotation, reversion, packing and some advanced bit-manipulation.

config RISCV_ISA_EXT_ZBS
	bool
	default y if $(dt_compat_all_has_prop,riscv,$(RISCV_ISA_EXT_PROP),zbs)
	help
	  (Zbs) - Zbs BitManip Extension (Single-bit instructions)

	  The Zbs instructions can be used for single-bit instructions that
	  provide a mechanism to set, clear, invert, or extract a single bit in
	  a register.

config RISCV_ISA_EXT_ZMMUL
	bool
	default y if $(dt_compat_all_has_prop,riscv,$(RISCV_ISA_EXT_PROP),zmmul)
	help
	  (Zmmul) - Zmmul Extension for Integer Multiplication

	  The Zmmul extension implements the multiplication subset of the M
	  extension.
```

## arch/riscv/core/Kconfig
```kconfig
# RISC-V cores configuration options

# Copyright (c) 2025 MASSDRIVER EI (massdriver.space)
# SPDX-License-Identifier: Apache-2.0

config XUANTIE
	bool
	help
	  This option signifies the use of a CPU of the XuanTie RISC-V family

rsource "xuantie/Kconfig"
```

## arch/riscv/core/pmp/Kconfig
```kconfig
# Physical Memory Protection (PMP) configuration options

# Copyright (c) 2020 BayLibre, SAS
# SPDX-License-Identifier: Apache-2.0

config PMP_SLOT
	int "Number of PMP slot"
	default 8
	help
	  Depend of the arch/board. Take care to don't put value higher
	  than the Hardware allow you.
```

## arch/riscv/core/xuantie/Kconfig
```kconfig
# Copyright (c) 2025 MASSDRIVER EI (massdriver.space)
# SPDX-License-Identifier: Apache-2.0

config XUANTIE_E907
	bool
	select XUANTIE
	select GEN_IRQ_VECTOR_TABLE
	select INCLUDE_RESET_VECTOR
	select RISCV_HAS_CLIC
	select RISCV_MACHINE_TIMER
	select RISCV_PRIVILEGED
	select RISCV_ISA_RV32I
	select RISCV_ISA_EXT_M
	select RISCV_ISA_EXT_A
	select RISCV_ISA_EXT_C
	select RISCV_ISA_EXT_ZICSR
	select RISCV_ISA_EXT_ZIFENCEI
	select RISCV_VECTORED_MODE

if XUANTIE

config CACHE_XTHEADCMO
	bool
	default y
	select CACHE_MANAGEMENT
	select CPU_HAS_ICACHE
	help
	  This option enables cache support for XuanTie family of CPUs using the XTHeadCmo extension

if CACHE_XTHEADCMO

config DCACHE_LINE_SIZE
	default 32

config ICACHE_LINE_SIZE
	default 32

config CACHE_XTHEADCMO_E907
	bool
	default y
	depends on XUANTIE_E907
	select CPU_HAS_DCACHE
	help
	  This option enables the additional XTHeadCmo cache functions for the E907 cores

endif # CACHE_XTHEADCMO

endif # XUANTIE
```

## arch/riscv/custom/Kconfig
```kconfig
# Copyright (c) 2025 Andes Technology Corporation
# SPDX-License-Identifier: Apache-2.0

if DT_HAS_ANDESTECH_ANDESCORE_V5_ENABLED

rsource "andes/Kconfig"

endif # DT_HAS_ANDESTECH_ANDESCORE_V5_ENABLED

if DT_HAS_SPINALHDL_VEXRISCV_ENABLED

rsource "vexriscv/Kconfig"

endif # DT_HAS_SPINALHDL_VEXRISCV_ENABLED

if DT_HAS_XUANTIE_E907_ENABLED

rsource "thead/Kconfig"
rsource "thead/Kconfig.core"

endif # DT_HAS_XUANTIE_E907_ENABLED
```

## arch/riscv/custom/thead/Kconfig
```kconfig
# Copyright (c) 2025 MASSDRIVER EI (massdriver.space)
# SPDX-License-Identifier: Apache-2.0

config RISCV_ISA_EXT_XTHEAD_BA
	bool
	default y if $(dt_compat_all_has_prop,riscv,$(RISCV_ISA_EXT_PROP),xtheadba)
	help
	  T-head address calculation extension

config RISCV_ISA_EXT_XTHEAD_BB
	bool
	default y if $(dt_compat_all_has_prop,riscv,$(RISCV_ISA_EXT_PROP),xtheadbb)
	help
	  T-head basic bit-manipulation extension

config RISCV_ISA_EXT_XTHEAD_BS
	bool
	default y if $(dt_compat_all_has_prop,riscv,$(RISCV_ISA_EXT_PROP),xtheadbs)
	help
	  T-head single-bit instructions extension

config RISCV_ISA_EXT_XTHEAD_CMO
	bool
	default y if $(dt_compat_all_has_prop,riscv,$(RISCV_ISA_EXT_PROP),xtheadcmo)
	help
	  T-head cache management operations extension

config RISCV_ISA_EXT_XTHEAD_CONDMOV
	bool
	default y if $(dt_compat_all_has_prop,riscv,$(RISCV_ISA_EXT_PROP),xtheadcondmov)
	help
	  T-head conditional move extension

config RISCV_ISA_EXT_XTHEAD_FMEMIDX
	bool
	default y if $(dt_compat_all_has_prop,riscv,$(RISCV_ISA_EXT_PROP),xtheadfmemidx)
	depends on RISCV_ISA_EXT_F
	help
	  T-head indexed memory operations for floating-point registers extension

config RISCV_ISA_EXT_XTHEAD_FMV
	bool
	default y if $(dt_compat_all_has_prop,riscv,$(RISCV_ISA_EXT_PROP),xtheadfmv)
	depends on RISCV_ISA_EXT_D
	help
	  T-head double floating-point high-bit data transmission extension

config RISCV_ISA_EXT_XTHEAD_INT
	bool
	default y if $(dt_compat_all_has_prop,riscv,$(RISCV_ISA_EXT_PROP),xtheadint)
	help
	  T-head acceleration interruption extension

config RISCV_ISA_EXT_XTHEAD_MAC
	bool
	default y if $(dt_compat_all_has_prop,riscv,$(RISCV_ISA_EXT_PROP),xtheadmac)
	help
	  T-head multiply-accumulate extension

config RISCV_ISA_EXT_XTHEAD_MEMIDX
	bool
	default y if $(dt_compat_all_has_prop,riscv,$(RISCV_ISA_EXT_PROP),xtheadmemidx)
	help
	  T-head indexed memory operation extension

config RISCV_ISA_EXT_XTHEAD_MEMPAIR
	bool
	default y if $(dt_compat_all_has_prop,riscv,$(RISCV_ISA_EXT_PROP),xtheadmempair)
	help
	  T-head two-GPR memory operation extension

config RISCV_ISA_EXT_XTHEAD_SYNC
	bool
	default y if $(dt_compat_all_has_prop,riscv,$(RISCV_ISA_EXT_PROP),xtheadsync)
	help
	  T-head multi-core synchronization extension

config RISCV_ISA_EXT_XTHEAD_VECTOR
	bool
	default y if $(dt_compat_all_has_prop,riscv,$(RISCV_ISA_EXT_PROP),xtheadvector)
	help
	  T-head vector extension

config RISCV_CUSTOM_CSR_THEAD_CMO
	bool
	depends on RISCV_ISA_EXT_XTHEAD_CMO
	default y if CACHE_MANAGEMENT
	help
	  This option enables the cache operation for XuanTie family of CPUs.

config RISCV_CUSTOM_CSR_THEAD_CMO_E907
	bool
	depends on RISCV_ISA_EXT_XTHEAD_CMO
	depends on DT_HAS_XUANTIE_E907_ENABLED
	default y if CACHE_MANAGEMENT
	help
	  This option enables the additional cache operation for XuanTie E907 cores.
```

## arch/riscv/custom/thead/Kconfig.core
```kconfig
# Copyright (c) 2025 MASSDRIVER EI (massdriver.space)
# SPDX-License-Identifier: Apache-2.0

config CPU_XUANTIE_E907
	bool
	select GEN_IRQ_VECTOR_TABLE
	select INCLUDE_RESET_VECTOR
	select RISCV_HAS_CLIC
	select RISCV_MACHINE_TIMER
	select RISCV_PRIVILEGED
	select RISCV_VECTORED_MODE
	select CPU_HAS_ICACHE
	select CPU_HAS_DCACHE
	select CPU_HAS_THEAD_CMO
```

## arch/riscv/custom/vexriscv/Kconfig
```kconfig
# SPDX-FileCopyrightText: Copyright The Zephyr Project Contributors
# SPDX-License-Identifier: Apache-2.0

config RISCV_CUSTOM_CSR_VEXRISCV_CACHE
	bool
	default y
	depends on ARCH_CACHE
	help
	  This option enables cache support for VexRiscv family of CPUs.
```

## arch/riscv/custom/xuantie/Kconfig
```kconfig
#
# Copyright (C) 2017-2024 Alibaba Group Holding Limited
#
# SPDX-License-Identifier: Apache-2.0
#

config ARCH_RISCV_HAS_CUSTOM
	bool
	default y if DT_HAS_XUANTIE_RISCV_ENABLED
	help
	  Automatically enabled when the devicetree contains a 'xuantie,riscv'
	  compatible node. Used to conditionally compile Xuantie-specific code.
```
