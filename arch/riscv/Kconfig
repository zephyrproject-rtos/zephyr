## arch/riscv32/Kconfig
```kconfig
#
# Copyright (c) 2016 Jean-Paul Etienne <fractalclone@gmail.com>
#
# SPDX-License-Identifier: Apache-2.0
#

choice
	prompt "RISCV32 configuration selection"
	depends on RISCV32
	source "arch/riscv32/soc/*/Kconfig.soc"
endchoice

menu "RISCV32 Options"
	depends on RISCV32

config ARCH
	string
	default "riscv32"

config ARCH_DEFCONFIG
	string
	default "arch/riscv32/defconfig"

menu "RISCV32 Processor Options"

config INCLUDE_RESET_VECTOR
	bool "Include Reset vector"
	default n
	help
	  Include the reset vector stub that inits CPU and then jumps to __start

config RISCV_SOC_CONTEXT_SAVE
	bool "Enable SOC-based context saving in IRQ handler"
	default n
	help
	  Enable SOC-based context saving, for SOCS which require saving of
	  extra registers when entering an interrupt/exception

config RISCV_SOC_INTERRUPT_INIT
	bool "Enable SOC-based interrupt initialization"
	default n
	help
	  Enable SOC-based interrupt initialization
	  (call soc_interrupt_init, within _IntLibInit when enabled)

config RISCV_GENERIC_TOOLCHAIN
	bool "Compile using generic riscv32 toolchain"
	default y
	help
	  Compile using generic riscv32 toolchain.
	  Allow SOCs that have custom extended riscv ISA to still
	  compile with generic riscv32 toolchain.

config RISCV_HAS_CPU_IDLE
	bool "Does SOC has CPU IDLE instruction"
	default n
	help
	  Does SOC has CPU IDLE instruction

config GEN_ISR_TABLES
	default y

config GEN_IRQ_VECTOR_TABLE
	default n

endmenu

source "arch/riscv32/soc/*/Kconfig"

endmenu
```

## arch/riscv32/soc/pulpino/Kconfig.defconfig
```kconfig
if SOC_RISCV32_PULPINO

config SOC
	string
	default "pulpino"

config SYS_CLOCK_HW_CYCLES_PER_SEC
	int
	default 5000000

config RISCV_SOC_CONTEXT_SAVE
	bool
	default y

config RISCV_SOC_INTERRUPT_INIT
	bool
	default y

config RISCV_HAS_CPU_IDLE
	bool
	default y

config INCLUDE_RESET_VECTOR
	bool
	default y

config NUM_IRQS
	int
	default 32

config ITCM_BASE_ADDRESS
	hex
	default	0x00000000

config ITCM_SIZE
	hex
	default 0x8000

config DTCM_BASE_ADDRESS
	hex
	default 0x00100000

config DTCM_SIZE
	hex
	default 0x8000

if UART_NS16550

config UART_NS16550_PCI
	bool
	default n

config UART_NS16750
	bool
	default y

config UART_NS16550_PORT_0
	bool
	default y

if UART_NS16550_PORT_0

config UART_NS16550_PORT_0_NAME
	string
	default "UART_0"

config UART_NS16550_PORT_0_IRQ_PRI
	int
	default 0

config UART_NS16550_PORT_0_BAUD_RATE
	int
	default 115200

config UART_NS16550_PORT_0_OPTIONS
	int
	default 0

endif # UART_NS16550_PORT_0

endif # UART_NS16550

endif # SOC_RISCV32_PULPINO
```

## arch/riscv32/soc/riscv-privilege/Kconfig
```kconfig
# Kconfig - configuration options for riscv SOCs supporting
#           the riscv privileged architecture specification
#
# Copyright (c) 2017 Jean-Paul Etienne <fractalclone@gmail.com>
#
# SPDX-License-Identifier: Apache-2.0
#

config SOC_FAMILY_RISCV_PRIVILEGE
	bool
	# omit prompt to signify a "hidden" option
	default n

config SOC_FAMILY
	string
	default "riscv-privilege"
	depends on SOC_FAMILY_RISCV_PRIVILEGE

config RISCV_HAS_PLIC
	bool "Does the SOC provide support for a Platform Level Interrupt Controller"
	default n
	depends on SOC_FAMILY_RISCV_PRIVILEGE
	help
	  Does the SOC provide support for a Platform Level Interrupt Controller


source "arch/riscv32/soc/riscv-privilege/*/Kconfig.soc"
```

## arch/riscv32/soc/riscv-privilege/Kconfig.defconfig
```kconfig
# Kconfig - riscv SOC family supporting the riscv privileged architecture spec
#
# Copyright (c) 2017 Jean-Paul Etienne <fractalclone@gmail.com>
#
# SPDX-License-Identifier: Apache-2.0
#
source "arch/riscv32/soc/riscv-privilege/*/Kconfig.defconfig.series"
```

## arch/riscv32/soc/riscv-privilege/Kconfig.soc
```kconfig
# Kconfig - riscv SOC series supporting the riscv privileged architecture spec
#
# Copyright (c) 2017 Jean-Paul Etienne <fractalclone@gmail.com>
#
# SPDX-License-Identifier: Apache-2.0
#

source "arch/riscv32/soc/riscv-privilege/*/Kconfig.series"
```

## arch/riscv32/soc/riscv-privilege/fe310/Kconfig.series
```kconfig
# Kconfig - RISCV32_FE310 SOC implementation
#
# Copyright (c) 2017 Jean-Paul Etienne <fractalclone@gmail.com>
#
# SPDX-License-Identifier: Apache-2.0
#

config SOC_SERIES_RISCV32_FE310
	bool "SiFive Freedom E310 SOC implementation"
	depends on RISCV32
	select SOC_FAMILY_RISCV_PRIVILEGE
	help
	Enable support for SiFive Freedom E310 SOC
```

## arch/riscv32/soc/riscv-privilege/fe310/Kconfig.soc
```kconfig
# Kconfig - RISCV32_FE310 SOC configuration options
#
# Copyright (c) 2017 Jean-Paul Etienne <fractalclone@gmail.com>
#
# SPDX-License-Identifier: Apache-2.0
#

choice
prompt "SiFive Freedom E310 SOC implementation"
depends on SOC_SERIES_RISCV32_FE310

config SOC_RISCV32_FE310
	bool "SiFive Freedom E310 SOC implementation"
	select ATOMIC_OPERATIONS_C

endchoice
```

## arch/riscv32/soc/riscv-privilege/gotham/Kconfig.defconfig.series
```kconfig
if SOC_SERIES_RISCV32_GOTHAM

config SOC_SERIES
	string
	default "gotham"

config SYS_CLOCK_HW_CYCLES_PER_SEC
	int
	default 32768

config RISCV_SOC_INTERRUPT_INIT
	bool
	default y

config RISCV_HAS_CPU_IDLE
	bool
	default y

config RISCV_HAS_PLIC
	bool
	default y

config RISCV_MACHINE_TIMER
	bool
	default y

config NUM_IRQS
	int
	default 15

config XIP
	bool
	default y

config RISCV_ROM_BASE_ADDR
	hex
	default 0x20001000

config RISCV_ROM_SIZE
	hex
	default 0x8000

config RISCV_RAM_BASE_ADDR
	hex
	default	0x80000000

config RISCV_RAM_SIZE
	hex
	default 0x8000

config BUILD_OUTPUT_HEX
	default y

endif # SOC_SERIES_RISCV32_GOTHAM
```

## arch/riscv32/soc/riscv-privilege/gotham/Kconfig.series
```kconfig
# Kconfig - RISCV32_GOTHAM SOC implementation
#
#
# SPDX-License-Identifier: Apache-2.0
#

config SOC_SERIES_RISCV32_GOTHAM
	bool "GOTHAM SoC implementation"
	depends on RISCV32
	select SOC_FAMILY_RISCV_PRIVILEGE
	help
	Enable support for GOTHAM SoC
```

## arch/riscv32/soc/riscv-privilege/gotham/Kconfig.soc
```kconfig
# Kconfig - RISCV32_GOTHAM SOC configuration options
#
#
# SPDX-License-Identifier: Apache-2.0
#

choice
prompt "Gotham SOC implementation"
depends on SOC_SERIES_RISCV32_GOTHAM

config SOC_RISCV32_GOTHAM
	bool "GOTHAM SoC implementation"
	select ATOMIC_OPERATIONS_C

endchoice
```

## arch/riscv32/soc/riscv-privilege/miv/Kconfig.series
```kconfig
# Kconfig - RISCV32_MIV SOC implementation
#
# Copyright (c) 2018 Antmicro <www.antmicro.com>
#

config SOC_SERIES_RISCV32_MIV
	bool "Microsemi Mi-V SOC implementation"
	depends on RISCV32
	select SOC_FAMILY_RISCV_PRIVILEGE
	help
	Enable support for Microsemi Mi-V SOC
```

## arch/riscv32/soc/riscv-privilege/miv/Kconfig.soc
```kconfig
# Kconfig - RISCV32_MIV SOC configuration options
#
# Copyright (c) 2018 Antmicro <www.antmicro.com>
#

choice
prompt "Microsemi Mi-V SOC implementation"
depends on SOC_SERIES_RISCV32_MIV

config SOC_RISCV32_MIV
	bool "Microsemi Mi-V SOC implementation"
	select ATOMIC_OPERATIONS_C

endchoice
```

## arch/riscv32/soc/riscv-privilege/riscv32-qemu/Kconfig.defconfig.series
```kconfig
if SOC_SERIES_RISCV32_QEMU

config SOC_SERIES
	string
	default "riscv32-qemu"

config SYS_CLOCK_HW_CYCLES_PER_SEC
	int
	default 10000000

config RISCV_SOC_INTERRUPT_INIT
	bool
	default y

config INCLUDE_RESET_VECTOR
	bool
	default y

config NUM_IRQS
	int
	default 32

config RISCV_RAM_SIZE_MB
	int
	default 32

endif # SOC_SERIES_RISCV32_QEMU
```
