## arch/arc/soc/quark_se_c1000_ss/Kconfig.defconfig
```kconfig
#
# Copyright (c) 2014 Wind River Systems, Inc.
# Copyright (c) 2015-2016 Intel Corporation
#
# SPDX-License-Identifier: Apache-2.0
#

if SOC_QUARK_SE_C1000_SS

config SOC
	default "quark_se_c1000_ss"

config NUM_IRQ_PRIO_LEVELS
	# This processor supports only 2 priority levels:
	# 0 for Fast Interrupts (FIRQs) and 1 for Regular Interrupts (IRQs).
	default 2

config NUM_IRQS
	# must be > the highest interrupt number used
	default 68

config RGF_NUM_BANKS
	default 2

config SYS_CLOCK_HW_CYCLES_PER_SEC
	default 32000000

config HARVARD
	def_bool n

config QMSI
	def_bool y

config QMSI_BUILTIN
	def_bool y

if RTC

config RTC_QMSI
	def_bool y

endif # RTC

if PWM
config PWM_QMSI
	def_bool y
endif # PWM

if PINMUX
config PINMUX_QMSI
	def_bool y
endif

if GPIO

config GPIO_QMSI
	def_bool n

if GPIO_QMSI

config GPIO_QMSI_0
	def_bool y

config GPIO_QMSI_1
	def_bool y

endif # GPIO_QMSI

config GPIO_QMSI_SS
	def_bool y

if GPIO_QMSI_SS

config GPIO_QMSI_SS_0
	def_bool y

config GPIO_QMSI_SS_1
	def_bool y

endif # GPIO_QMSI_SS

endif # GPIO


if I2C

config I2C_QMSI
	def_bool n

if I2C_QMSI
config I2C_0
	def_bool y

config I2C_1
	def_bool y

config I2C_SDA_SETUP
	default 2

config I2C_SDA_TX_HOLD
	default 16

config I2C_SDA_RX_HOLD
	default 24

endif

config I2C_QMSI_SS
	def_bool y

if I2C_QMSI_SS
config I2C_SS_0
	def_bool y

config I2C_SS_1
	def_bool y

config I2C_SS_SDA_SETUP
	default 2

config I2C_SS_SDA_HOLD
	default 10

endif

endif # I2C

if ADC
config ADC_DW
	def_bool y
endif

if BT_H4

config UART_QMSI_0
	def_bool y

config UART_QMSI_0_HW_FC
	def_bool y

endif # BT_H4

if UART_QMSI

config UART_QMSI_1
	def_bool y

endif # UART_QMSI

if SPI

config SPI_DW
	def_bool y

if SPI_DW

config SPI_DW_FIFO_DEPTH
	default 7

config CLOCK_CONTROL
	def_bool y

config CLOCK_CONTROL_QUARK_SE
	def_bool y

config CLOCK_CONTROL_QUARK_SE_SENSOR
	def_bool y

config SPI_0
	def_bool y

config SPI_DW_PORT_0_INTERRUPT_SINGLE_LINE
	def_bool n

config SPI_DW_PORT_0_CLOCK_GATE
	def_bool y

config SPI_DW_PORT_0_CLOCK_GATE_DRV_NAME
	default CLOCK_CONTROL_QUARK_SE_SENSOR_DRV_NAME

config SPI_DW_PORT_0_CLOCK_GATE_SUBSYS
	default 3

config SPI_0_IRQ_PRI
	default 1

config SPI_1
	def_bool y

config SPI_DW_PORT_1_INTERRUPT_SINGLE_LINE
	def_bool n

config SPI_DW_PORT_1_CLOCK_GATE
	def_bool y

config SPI_DW_PORT_1_CLOCK_GATE_DRV_NAME
	default CLOCK_CONTROL_QUARK_SE_SENSOR_DRV_NAME

config SPI_DW_PORT_1_CLOCK_GATE_SUBSYS
	default 4

config SPI_1_IRQ_PRI
	default 1

endif # SPI_DW
endif # SPI

if AIO_COMPARATOR

config AIO_COMPARATOR_QMSI
	def_bool y

endif # AIO_COMPARATOR

if WATCHDOG

config WDT_QMSI
	def_bool y

config WDT_0_IRQ_PRI
	default 0

endif # WATCHDOG

if DMA

config DMA_QMSI
	def_bool y

endif # DMA

if COUNTER

config AON_COUNTER_QMSI
	def_bool y

config AON_TIMER_QMSI
	def_bool y

config AON_TIMER_IRQ_PRI
	default 0

endif # COUNTER

endif #SOC_QUARK_SE_C1000_SS
```

## arch/arc/soc/quark_se_ss/Kconfig.defconfig
```kconfig
#
# Copyright (c) 2014 Wind River Systems, Inc.
# Copyright (c) 2015-2016 Intel Corporation
#
# Licensed under the Apache License, Version 2.0 (the "License");
# you may not use this file except in compliance with the License.
# You may obtain a copy of the License at
#
#     http://www.apache.org/licenses/LICENSE-2.0
#
# Unless required by applicable law or agreed to in writing, software
# distributed under the License is distributed on an "AS IS" BASIS,
# WITHOUT WARRANTIES OR CONDITIONS OF ANY KIND, either express or implied.
# See the License for the specific language governing permissions and
# limitations under the License.
#

if SOC_QUARK_SE_SS

config SOC
	default quark_se_ss

config NUM_IRQ_PRIO_LEVELS
	# This processor supports only 2 priority levels:
	# 0 for Fast Interrupts (FIRQs) and 1 for Regular Interrupts (IRQs).
	default 2

config NUM_REGULAR_IRQ_PRIO_LEVELS
	# This processor supports only 1 Regular Interrupt priority level (1).
	default 1

config  NUM_IRQS
	# must be > the highest interrupt number used
	default 68


config SYS_CLOCK_HW_CYCLES_PER_SEC
	default 32000000

config FLASH_BASE_ADDRESS
	default 0x40000000

config FLASH_SIZE
	default 152

config SRAM_BASE_ADDRESS
	default 0x4000 if NSIM
	default 0xa8000400

config SRAM_SIZE
	default 16 if NSIM
	default 24

config ICCM_BASE_ADDRESS
	default 0xFFFFFFFF

config ICCM_SIZE
	default 0

config DCCM_BASE_ADDRESS
	default 0x80000000

config DCCM_SIZE
	default 8

if GPIO

config GPIO_DW
	def_bool y

if GPIO_DW

config GPIO_DW_BOTHEDGES_SUPPORT
	default n

config GPIO_DW_0
	def_bool y

if GPIO_DW_0

config GPIO_DW_0_PRI
	default 2

endif # GPIO_DW_0

config GPIO_DW_1
	def_bool y

if GPIO_DW_1

config GPIO_DW_1_PRI
	default 2

endif # GPIO_DW_1

endif # GPIO_DW

endif # GPIO

if I2C

config I2C_QUARK_SE_SS
	def_bool y

if I2C_QUARK_SE_SS

config I2C_QUARK_SE_SS_0
	def_bool y

if I2C_QUARK_SE_SS_0

config I2C_QUARK_SE_SS_0_NAME
	default "I2C_0"

config I2C_QUARK_SE_SS_0_DEFAULT_CFG
	default 0x12

endif # I2C_QUARK_SE_SS_0

if I2C_QUARK_SE_SS_1

config I2C_QUARK_SE_SS_1_NAME
	default "I2C_1"

config I2C_QUARK_SE_SS_1_DEFAULT_CFG
	default 0x12

endif # I2C_QUARK_SE_SS_1

endif # I2C_QUARK_SE_SS

endif # I2C

if UART_NS16550

config UART_NS16550_PORT_0
        def_bool y

if UART_NS16550_PORT_0

config UART_NS16550_PORT_0_NAME
        default "UART_0"
config UART_NS16550_PORT_0_IRQ_PRI
        default 1
config UART_NS16550_PORT_0_BAUD_RATE
        default 115200
config UART_NS16550_PORT_0_OPTIONS
        default 0

endif # UART_NS16550_PORT_0

config UART_NS16550_PORT_1
        def_bool y

if UART_NS16550_PORT_1

config UART_NS16550_PORT_1_NAME
        default "UART_1"
config UART_NS16550_PORT_1_IRQ_PRI
        default 1
config UART_NS16550_PORT_1_BAUD_RATE
        default 115200
config UART_NS16550_PORT_1_OPTIONS
        default 0

endif # UART_NS16550_PORT_1

endif # UART_NS16550

if UART_CONSOLE

config UART_CONSOLE_ON_DEV_NAME
        default "UART_1"

endif

if SPI

config SPI_DW
	def_bool y

if SPI_DW

config SPI_DW_CLOCK_GATE
	def_bool n

config SPI_DW_PORT_0
	def_bool y

if SPI_DW_PORT_0

config SPI_DW_PORT_0_PRI
	default 1
config SPI_DW_PORT_0_REGS
	default 0x80010000
config SPI_DW_PORT_0_ERROR_IRQ
	default 30
config SPI_DW_PORT_0_RX_IRQ
	default 31
config SPI_DW_PORT_0_TX_IRQ
	default 32

endif # SPI_DW_PORT_0

config SPI_DW_PORT_1
	def_bool y

if SPI_DW_PORT_1

config SPI_DW_PORT_1_PRI
	default 1
config SPI_DW_PORT_1_REGS
	default 0x80010100
config SPI_DW_PORT_1_ERROR_IRQ
	default 33
config SPI_DW_PORT_1_RX_IRQ
	default 34
config SPI_DW_PORT_1_TX_IRQ
	default 35

endif # SPI_DW_PORT_1

endif # SPI_DW

endif # SPI

endif #SOC_QUARK_SE_ARC
```

## arch/arc/soc/quark_se_ss/Kconfig.soc
```kconfig
config SOC_QUARK_SE_SS
        bool "Intel Quark SE - Sensor Sub System"
	select SYS_POWER_LOW_POWER_STATE_SUPPORTED
```

## arch/arc/soc/snps_emsk/Kconfig.defconfig
```kconfig
#
# Copyright (c) 2014 Wind River Systems, Inc.
# Copyright (c) 2018 Synopsys, Inc. All rights reserved.
#
# SPDX-License-Identifier: Apache-2.0
#

if SOC_EMSK

config SOC
	string
	default snps_emsk

source "arch/arc/soc/snps_emsk/Kconfig.defconfig.em*"

endif #SOC_EMSK
```

## arch/arc/soc/snps_nsim/Kconfig.soc
```kconfig
#
# Copyright (c) 2018 Synopsys, Inc. All rights reserved.
#
# SPDX-License-Identifier: Apache-2.0
#

config SOC_NSIM
	bool "Synopsys NSIM simulator for ARC EM"
```

## arch/arm/Kconfig
```kconfig
# ARM architecture configuration options

# Copyright (c) 2014-2015 Wind River Systems, Inc.
# SPDX-License-Identifier: Apache-2.0

menu "ARM Options"
	depends on ARM

config ARCH
	default "arm"

config CPU_CORTEX
	bool
	help
	  This option signifies the use of a CPU of the Cortex family.

config ARM_CUSTOM_INTERRUPT_CONTROLLER
	bool
	help
	  This option indicates that the ARM CPU is connected to a custom (i.e.
	  non-GIC or NVIC) interrupt controller.

	  A number of Cortex-A and Cortex-R cores (Cortex-A5, Cortex-R4/5, ...)
	  allow interfacing to a custom external interrupt controller and this
	  option must be selected when such cores are connected to an interrupt
	  controller that is not the ARM Generic Interrupt Controller (GIC) or
	  the Cortex-M ARM Nested Vectored Interrupt Controller (NVIC).

	  When this option is selected, the architecture interrupt control
	  functions are mapped to the SoC interrupt control interface, which is
	  implemented at the SoC level.

	  N.B. Since all Cortex-M cores have a NVIC, if this option is selected it
	  is assumed that the custom interrupt control interface implementation
	  assumes responsibility for handling the NVIC.

config ROMSTART_RELOCATION_ROM
	bool "Relocate rom_start region"
	default n
	help
	  Relocates the rom_start region containing the boot-vector data and
	  irq vectors to the region specified by configurations:
	  ROMSTART_REGION_ADDRESS and ROMSTART_REGION_SIZE

	  This is useful for the Linux Remoteproc framework that uses the elf-loader
	  such that it is able to load the correct boot-vector (contained in rom_start)
	  into the correct memory location independent of the chosen zephyr,flash
	  ROM region.

	  Most SOCs include an alias for the boot-vector at address 0x00000000
	  so a default which might be supported by the corresponding Linux rproc driver.
	  If it is not, additionnal options allows to specify the addresses.

	  In general this option should be chosen if the zephyr,flash chosen node
	  is not placed into the boot-vector memory area.

	  While this aims at generating a correct zephyr.elf file, it has the side
	  effect of enlarging the bin file. If the zephyr.bin file is used to boot the
	  secondary core, this option should be disabled.

	  Example:
		on IMX7D, the chosen zephyr,flash can be OCRAM/OCRAM_S/TCM/DDR memories
		for code location. But the boot-vector must be placed into OCRAM_S for the
		CORTEX-M to boot (alias 0, real 0x00180000/32K available).

if ROMSTART_RELOCATION_ROM

	config ROMSTART_REGION_ADDRESS
		hex "Base address of the rom_start region"
		default 0x00000000
		help
		  Start address of the rom_start region.
		  This setting can be derived from a DT node reg property or specified directly.

		  A default value of 0x00000000 might work in most cases as SOCs have an alias
		  to the right memory region of the boot-vector.

		  Examples:
		  -IMX7D the boot-vector is OCRAM_S (0x00180000, aliased at 0x0).
		  -IMX6SX the boot-vector is TCML (0x007F8000, aliased at 0x0).
		  -IMX8MQ the boot-vector is TCML (0x007E0000, aliased at 0x0).
		  -IMX8MN the boot-vector is ITCM (0x007E0000, aliased at 0x0).

		  Example of DT definition:
		  $(dt_nodelabel_reg_addr_hex,ocram_s_sys)

	config ROMSTART_REGION_SIZE
		hex "Size of the rom_start region"
		default 1
		help
		  Size of the rom_start region in KB.

		  Default is 1KB which is enough to store the boot and irq vectors.

		  This setting can be derived from a DT node reg property or specified directly.

		  Example for IMX7D that needs the boot-vector into OCRAM_S (0x00180000):
		  $(dt_nodelabel_reg_size_hex,ocram_s_sys,0,K)

endif

config CODE_DATA_RELOCATION_SRAM
	bool "Relocate code/data sections to SRAM"
	depends on CPU_CORTEX_M
	select CODE_DATA_RELOCATION
	help
	  When selected this will relocate .text, data and .bss sections from
	  the specified files and places it in SRAM. The files should be specified
	  in the CMakeList.txt file with a cmake API zephyr_code_relocate(). This
	  config is used to create an MPU entry for the SRAM space used for code
	  relocation.

config ARM_ON_ENTER_CPU_IDLE_HOOK
	bool
	help
	  Enables a hook (z_arm_on_enter_cpu_idle()) that is called when
	  the CPU is made idle (by k_cpu_idle() or k_cpu_atomic_idle()).
	  If needed, this hook can be used to prevent the CPU from actually
	  entering sleep by skipping the WFE/WFI instruction.

config ARM_ON_ENTER_CPU_IDLE_PREPARE_HOOK
	bool
	help
	  Enables a hook (z_arm_on_enter_cpu_idle_prepare()) that is called when
	  the CPU is made idle (by k_cpu_idle() or k_cpu_atomic_idle()).
	  If needed, this hook can prepare data to upcoming call to
	  z_arm_on_enter_cpu_idle(). The z_arm_on_enter_cpu_idle_prepare differs
	  from z_arm_on_enter_cpu_idle because it is called before interrupts are
	  disabled.

config ARM_ON_EXIT_CPU_IDLE
	bool
	help
	  Enables a possibility to inject SoC-specific code just after WFI/WFE
	  instructions of the cpu idle implementation.

	  Enabling this option requires that the SoC provides a soc_cpu_idle.h
	  header file which defines SOC_ON_EXIT_CPU_IDLE macro guarded by
	  _ASMLANGUAGE.

	  The SOC_ON_EXIT_CPU_IDLE macro is expanded just after
	  WFI/WFE instructions before any memory access is performed. The purpose
	  of the SOC_ON_EXIT_CPU_IDLE is to perform an action that mitigate issues
	  observed on some SoCs caused by a memory access following WFI/WFE
	  instructions.

rsource "core/Kconfig"
rsource "core/Kconfig.vfp"

# General options signifying CPU capabilities of ARM SoCs
config CPU_HAS_ARM_MPU
	bool
	select CPU_HAS_MPU
	help
	  This option is enabled when the CPU has a Memory Protection Unit (MPU)
	  in ARM flavor.

config CPU_HAS_NXP_MPU
	bool
	select CPU_HAS_MPU
	help
	  This option is enabled when the CPU has a Memory Protection Unit (MPU)
	  in NXP flavor.

config CPU_HAS_CUSTOM_FIXED_SOC_MPU_REGIONS
	bool "Custom fixed SoC MPU region definition"
	help
	  If enabled, this option signifies that the SoC will
	  define and configure its own fixed MPU regions in the
	  SoC definition. These fixed MPU regions are currently
	  used to set Flash and SRAM default access policies and
	  they are programmed at boot time.

config CPU_HAS_ARM_SAU
	bool
	select CPU_HAS_TEE
	help
	  MCU implements the ARM Security Attribution Unit (SAU).

config CPU_HAS_NRF_IDAU
	bool
	select CPU_HAS_TEE
	help
	  MCU implements the nRF (vendor-specific) Security Attribution Unit.
	  (IDAU: "Implementation-Defined Attribution Unit", in accordance with
	  ARM terminology).

config HAS_SWO
	bool
	help
	  When enabled, indicates that SoC has an SWO output

endmenu
```
