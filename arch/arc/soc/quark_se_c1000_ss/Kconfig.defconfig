## arch/arm/core/cortex_r/Kconfig
```kconfig
# Kconfig - ARM Cortex-R platform configuration options

#
# Copyright (c) 2018 Marvell
# Copyright (c) 2018 Lexmark International, Inc.
#
# SPDX-License-Identifier: Apache-2.0
#

# NOTE: We have the specific core implementations first and outside of the
# if CPU_CORTEX_R block so that SoCs can select which core they are using
# without having to select all the options related to that core.  Everything
# else is captured inside the if CPU_CORTEX_R block so they are not exposed
# if one selects a different ARM Cortex Family (Cortex-A or Cortex-M)


config CPU_CORTEX_R4
	bool
	select CPU_CORTEX_R
	select ARMV7_R
	select ARMV7_R_FP if CPU_HAS_FPU
	help
	  This option signifies the use of a Cortex-R4 CPU

config CPU_CORTEX_R5
	bool
	select CPU_CORTEX_R
	select ARMV7_R
	select ARMV7_R_FP if CPU_HAS_FPU
	help
	  This option signifies the use of a Cortex-R5 CPU

if CPU_CORTEX_R

config ARMV7_R
	bool
	select ATOMIC_OPERATIONS_BUILTIN
	select ISA_ARM
	help
	  This option signifies the use of an ARMv7-R processor
	  implementation.

	  From https://developer.arm.com/products/architecture/cpu-architecture/r-profile:
	  The Armv7-R architecture implements a traditional Arm architecture with
	  multiple modes and supports a Protected Memory System Architecture
	  (PMSA) based on a Memory Protection Unit (MPU). It supports the Arm (32)
	  and Thumb (T32) instruction sets.

config ARMV7_R_FP
	bool
	depends on ARMV7_R
	help
	  This option signifies the use of an ARMv7-R processor
	  implementation supporting the Floating-Point Extension.

config ARMV7_EXCEPTION_STACK_SIZE
	int "Undefined Instruction and Abort stack size (in bytes)"
	default 256
	help
	  This option specifies the size of the stack used by the undefined
	  instruction and data abort exception handlers.

config ARMV7_FIQ_STACK_SIZE
	int "FIQ stack size (in bytes)"
	default 256
	help
	  This option specifies the size of the stack used by the FIQ handler.

config ARMV7_SVC_STACK_SIZE
	int "SVC stack size (in bytes)"
	default 512
	help
	  This option specifies the size of the stack used by the SVC handler.

config ARMV7_SYS_STACK_SIZE
	int "SYS stack size (in bytes)"
	default 1024
	help
	  This option specifies the size of the stack used by the system mode.

if CPU_CORTEX_R

config RUNTIME_NMI
	default y

config GEN_ISR_TABLES
	default y

config GEN_IRQ_VECTOR_TABLE
	default n

endif # CPU_CORTEX_R

endif # CPU_CORTEX_R
```

## arch/arm/core/mmu/Kconfig
```kconfig
#
# ARMv7 Memory Management Unit (MMU) configuration options
#
# Copyright (c) 2021 Weidmueller Interface GmbH & Co. KG
# SPDX-License-Identifier: Apache-2.0
#

if CPU_HAS_MMU

config ARM_AARCH32_MMU
	bool "ARM MMU Support"
	select MMU
	select SRAM_REGION_PERMISSIONS
	select THREAD_STACK_INFO
	select ARCH_HAS_EXECUTABLE_PAGE_BIT
	help
	  The current CPU has either an ARMv5 or ARMv7 Memory Management Unit.

config ARM_AARCH32_MMU_VMSA_V5
	bool "ARMv5 MMU Support"
	default y if CPU_AARCH32_ARM9
	select ARM_AARCH32_MMU
	help
	  The current CPU has an ARMv5 Memory Management Unit.

config ARM_AARCH32_MMU_VMSA_V7
	bool "ARMv7 Cortex-A MMU Support"
	default y if CPU_AARCH32_CORTEX_A
	select ARM_AARCH32_MMU
	help
	  The current CPU has an ARMv7 Memory Management Unit.

config ARM_MMU_NUM_L2_TABLES
	depends on ARM_AARCH32_MMU
	int "Number of L2 translation tables available to the MMU"
	default 64
	help
	  Number of level 2 translation tables. Each level 2 table
	  covers 1 MB of address space.

config ARM_MMU_REGION_MIN_ALIGN_AND_SIZE
	int
	default 4096
	help
	  Minimum size (and alignment) of an ARM MMU page.
	  This value should not be modified.

endif # CPU_HAS_MMU
```

## arch/arm/core/mpu/Kconfig
```kconfig
# Memory Protection Unit (MPU) configuration options

# Copyright (c) 2017 Linaro Limited
# Copyright 2025 Arm Limited and/or its affiliates <open-source-office@arm.com>
# SPDX-License-Identifier: Apache-2.0

if CPU_HAS_MPU

config ARM_MPU_REGION_MIN_ALIGN_AND_SIZE
	int
	default 256 if ARM_MPU && ARMV6_M_ARMV8_M_BASELINE && !ARMV8_M_BASELINE
	default 128 if ARM_MPU && FPU_SHARING && MPU_STACK_GUARD
	default 64 if ARM_MPU && AARCH32_ARMV8_R
	default 32 if ARM_MPU
	default 4
	help
	  Minimum size (and alignment) of an ARM MPU region. Use this
	  symbol to guarantee minimum size and alignment of MPU regions.
	  A minimum 4-byte alignment is enforced in ARM builds without
	  support for Memory Protection.

if ARM_MPU

config MPU_STACK_GUARD
	bool "Thread Stack Guards"
	help
	  Enable Thread Stack Guards via MPU

config MPU_STACK_GUARD_MIN_SIZE_FLOAT
	int
	depends on MPU_STACK_GUARD
	depends on FPU_SHARING
	default 128
	help
	  Minimum size (and alignment when applicable) of an ARM MPU
	  region, which guards the stack of a thread that is using the
	  Floating Point (FP) context. The width of the guard is set to
	  128, to accommodate the length of a Cortex-M exception stack
	  frame when the floating point context is active. The FP context
	  is only stacked in sharing FP registers mode, therefore, the
	  option is applicable only when FPU_SHARING is selected.

config MPU_ALLOW_FLASH_WRITE
	bool "Add MPU access to write to flash"
	help
	  Enable this to allow MPU RWX access to flash memory

config MPU_DISABLE_BACKGROUND_MAP
	bool "Disables the default background address map"
	help
	  Enable this to turn off the default background MPU address map. Your
	  SoC definition should likely provide its own custom MPU regions.

config CUSTOM_SECTION_ALIGN
	bool "Custom Section Align"
	help
	  MPU_REQUIRES_POWER_OF_TWO_ALIGNMENT(ARMv7-M) sometimes cause memory
	  wasting in linker scripts defined memory sections. Use this symbol
	  to guarantee user custom section align size to avoid more memory used
	  for respect alignment. But that needs carefully configure MPU region
	  and sub-regions(ARMv7-M) to cover this feature.

config CUSTOM_SECTION_MIN_ALIGN_SIZE
	int "Custom Section Align Size"
	default 32
	help
	  Custom align size of memory section in linker scripts. Usually
	  it should consume less alignment memory. Although this alignment
	  size is configured by users, it must also respect the power of
	  two regulation if hardware requires.

config ARM_MPU_PXN
	bool
	depends on ARMV8_1_M_MAINLINE
	help
	  Enable support for Armv8.1-m MPU's Privileged Execute Never (PXN) attr.
	  An MPU region marked with PXN attribute can only be executed from an
	  unprivileged mode and executing such region from privileged mode will
	  result in a Memory Management fault.

endif # ARM_MPU

endif # CPU_HAS_MPU
```
