## arch/arm/core/aarch32/mmu/Kconfig
```kconfig
#
# ARMv7 Memory Management Unit (MMU) configuration options
#
# Copyright (c) 2021 Weidmueller Interface GmbH & Co. KG
# SPDX-License-Identifier: Apache-2.0
#

if CPU_HAS_MMU

config ARM_AARCH32_MMU
	bool "ARMv7 Cortex-A MMU Support"
	default y if CPU_AARCH32_CORTEX_A
	select MMU
	select SRAM_REGION_PERMISSIONS
	select THREAD_STACK_INFO
	select ARCH_HAS_EXECUTABLE_PAGE_BIT
	help
	  The current CPU has an ARMv7 Memory Management Unit.

config ARM_MMU_NUM_L2_TABLES
	depends on ARM_AARCH32_MMU
	int "Number of L2 translation tables available to the MMU"
	default 64
	help
	  Number of level 2 translation tables. Each level 2 table
	  covers 1 MB of address space.

config ARM_MMU_REGION_MIN_ALIGN_AND_SIZE
	int
	default 4096
	help
	  Minimum size (and alignment) of an ARM MMU page.
	  This value should not be modified.

endif # CPU_HAS_MMU
```

## arch/arm/core/aarch64/Kconfig
```kconfig
# ARM64 core configuration options

# Copyright (c) 2019 Carlo Caione <ccaione@baylibre.com>
# SPDX-License-Identifier: Apache-2.0

config CPU_CORTEX_A
	bool
	select CPU_CORTEX
	select HAS_FLASH_LOAD_OFFSET
	select USE_SWITCH
	select USE_SWITCH_SUPPORTED
	help
	  This option signifies the use of a CPU of the Cortex-A family.

config CPU_CORTEX_A53
	bool
	select CPU_CORTEX_A
	select ARMV8_A
	help
	  This option signifies the use of a Cortex-A53 CPU

config CPU_CORTEX_A72
	bool
	select CPU_CORTEX_A
	select ARMV8_A
	help
	  This option signifies the use of a Cortex-A72 CPU

config SWITCH_TO_EL1
	bool "Switch to EL1 at boot"
	default y
	help
	  This option indicates that we want to switch to EL1 at boot. Only
	  switching to EL1 from EL3 is supported.

config NUM_IRQS
	int

config MAIN_STACK_SIZE
	default 4096

config IDLE_STACK_SIZE
	default 4096

config ISR_STACK_SIZE
	default 4096

config TEST_EXTRA_STACKSIZE
	default 2048

config SYSTEM_WORKQUEUE_STACK_SIZE
	default 4096

config CMSIS_THREAD_MAX_STACK_SIZE
	default 4096

config CMSIS_V2_THREAD_MAX_STACK_SIZE
	default 4096

config CMSIS_V2_THREAD_DYNAMIC_STACK_SIZE
	default 4096

config IPM_CONSOLE_STACK_SIZE
	default 2048

if CPU_CORTEX_A

config ARMV8_A
	bool
	select ATOMIC_OPERATIONS_BUILTIN
	select CPU_HAS_MMU
	help
	  This option signifies the use of an ARMv8-A processor
	  implementation.

	  From https://developer.arm.com/products/architecture/cpu-architecture/a-profile:
	  The Armv8-A architecture introduces the ability to use 64-bit and
	  32-bit Execution states, known as AArch64 and AArch32 respectively.
	  The AArch64 Execution state supports the A64 instruction set, holds
	  addresses in 64-bit registers and allows instructions in the base
	  instruction set to use 64-bit registers for their processing. The AArch32
	  Execution state is a 32-bit Execution state that preserves backwards
	  compatibility with the Armv7-A architecture and enhances that profile
	  so that it can support some features included in the AArch64 state.
	  It supports the T32 and A32 instruction sets.

config GEN_ISR_TABLES
	default y

config GEN_IRQ_VECTOR_TABLE
	default n

config ARM_MMU
	bool "ARM MMU Support"
	default y
	help
	  Memory Management Unit support.

if ARM_MMU

config MAX_XLAT_TABLES
	int "Maximum numbers of translation tables"
	default 7
	help
	  This option specifies the maximum numbers of translation tables
	  excluding the base translation table. Based on this, translation
	  tables are allocated at compile time and used at runtime as needed.
	  If the runtime need exceeds preallocated numbers of translation
	  tables, it will result in assert. Number of translation tables
	  required is decided based on how many discrete memory regions
	  (both normal and device memory) are present on given platform and
	  how much granularity is required while assigning attributes
	  to these memory regions.

choice
	prompt "Virtual address space size"
	default ARM64_VA_BITS_32
	help
	  Allows choosing one of multiple possible virtual address
	  space sizes. The level of translation table is determined by
	  a combination of page size and virtual address space size.

config ARM64_VA_BITS_32
	bool "32-bit"

config ARM64_VA_BITS_36
	bool "36-bit"

config ARM64_VA_BITS_42
	bool "42-bit"

config ARM64_VA_BITS_48
	bool "48-bit"
endchoice

config ARM64_VA_BITS
	int
	default 32 if ARM64_VA_BITS_32
	default 36 if ARM64_VA_BITS_36
	default 42 if ARM64_VA_BITS_42
	default 48 if ARM64_VA_BITS_48

choice
	prompt "Physical address space size"
	default ARM64_PA_BITS_32
	help
	  Choose the maximum physical address range that the kernel will
	  support.

config ARM64_PA_BITS_32
	bool "32-bit"

config ARM64_PA_BITS_36
	bool "36-bit"

config ARM64_PA_BITS_42
	bool "42-bit"

config ARM64_PA_BITS_48
	bool "48-bit"
endchoice

config ARM64_PA_BITS
	int
	default 32 if ARM64_PA_BITS_32
	default 36 if ARM64_PA_BITS_36
	default 42 if ARM64_PA_BITS_42
	default 48 if ARM64_PA_BITS_48

endif # ARM_MMU

endif # CPU_CORTEX_A
```

## arch/arm/core/armv6/Kconfig
```kconfig
# ARMv6 (classic ARM11) platform configuration options

# Copyright (c) 2026 Jonathan Elliot Peace <jep@alphabetiq.com>
# SPDX-License-Identifier: Apache-2.0

config CPU_ARM1176JZF_S
	bool
	select ARMV6KZ
	select CPU_AARCH32_ARMV6
	help
	  This option signifies the use of an ARM1176JZF-S CPU (ARMv6KZ),
	  as found in the Broadcom BCM2835 (Raspberry Pi Zero / Zero W).

config ARMV6KZ
	bool
	select ARMV6K
	help
	  ARMv6KZ: ARMv6K plus the Security Extensions (TrustZone, "Z").

config ARMV6K
	bool
	select ARMV6
	help
	  ARMv6K: ARMv6 plus the multiprocessing/synchronization extensions
	  (ldrex/strex byte/half/dword, clrex, wfe/sev, TPIDRURO).

config ARMV6
	bool
	help
	  This option signifies the use of a classic ARMv6 CPU.

if ARMV6

config ARMV6_EXCEPTION_STACK_SIZE
	int "Undefined Instruction and Abort stack size (in bytes)"
	default 256

config ARMV6_FIQ_STACK_SIZE
	int "FIQ stack size (in bytes)"
	default 256

config ARMV6_SVC_STACK_SIZE
	int "SVC stack size (in bytes)"
	default 512

config ARMV6_SYS_STACK_SIZE
	int "SYS mode stack size (in bytes)"
	default 1024

config GEN_ISR_TABLES
	default y

config GEN_IRQ_VECTOR_TABLE
	default n

config DCACHE_LINE_SIZE
	depends on CPU_HAS_DCACHE
	default 32

config ICACHE_LINE_SIZE
	depends on CPU_HAS_ICACHE
	default 32

endif # ARMV6
```

## arch/arm/core/cortex_a_r/Kconfig
```kconfig
# ARM Cortex-A and Cortex-R platform configuration options

# Copyright (c) 2018 Marvell
# Copyright (c) 2018 Lexmark International, Inc.
# Copyright (c) 2021 Weidmueller Interface GmbH & Co. KG
#
# SPDX-License-Identifier: Apache-2.0

# NOTE: We have the specific core implementations first and outside of the
# if CPU_AARCH32_CORTEX_A / if CPU_AARCH32_CORTEX_R block so that SoCs can
# select which core they are using without having to select all the options
# related to that core. Everything else is captured inside the if
# CPU_AARCH32_CORTEX_A / if CPU_AARCH32_CORTEX_R blocks so they are not
# exposed if one selects a different ARM Cortex Family (Cortex-M).

config CPU_CORTEX_A7
	bool
	select CPU_AARCH32_CORTEX_A
	select ARMV7_A
	select CPU_HAS_ICACHE
	select CPU_HAS_DCACHE
	help
	  This option signifies the use of a Cortex-A7 CPU.

config CPU_CORTEX_A9
	bool
	select CPU_AARCH32_CORTEX_A
	select ARMV7_A
	select CPU_HAS_ICACHE
	select CPU_HAS_DCACHE
	help
	  This option signifies the use of a Cortex-A9 CPU.

config CPU_CORTEX_A32
	bool
	select CPU_AARCH32_CORTEX_A
	select AARCH32_ARMV8_A
	select CPU_HAS_ICACHE
	select CPU_HAS_DCACHE
	help
	  This option signifies the use of a Cortex-A32 CPU.

if CPU_AARCH32_CORTEX_A

config ARMV7_A
	bool
	select ATOMIC_OPERATIONS_BUILTIN
	select ISA_ARM

config AARCH32_ARMV8_A
	bool
	select ATOMIC_OPERATIONS_BUILTIN
	select ISA_ARM
	help
	  This option signifies the use of an ARMv8-A processor running in
	  the AArch32 execution state.

	  From https://developer.arm.com/products/architecture/cpu-architecture/a-profile:
	  The Armv8-A architecture targets the Applications profile and introduces
	  a 64-bit execution state (AArch64) alongside the 32-bit AArch32 state.
	  In AArch32 state, it provides a Virtual Memory System Architecture (VMSA)
	  based on a Memory Management Unit (MMU) and supports the A32 and T32
	  instruction sets.

config AARCH32_ARMV8_A_MONITOR_INIT
	bool "Perform Monitor mode initialization at reset"
	depends on AARCH32_ARMV8_A
	help
	  Enable early Monitor mode (EL3 AArch32) initialization at reset,
	  analogous to the EL3 initialization performed in the arm64 port
	  (z_arm64_el3_init).

	  On ARMv8-A AArch32 platforms booting bare-metal without Trusted
	  Firmware-A, the core resets into Secure SVC mode. Certain system
	  registers are only accessible from Monitor mode, such as ICC_MSRE
	  (enables GICv3 CPU interface system register access). This option
	  briefly switches to Monitor mode at reset to configure such
	  registers before returning to SVC.

	  Enable when booting bare-metal in AArch32 Secure state with EL3
	  implemented in AArch32 (Monitor mode available).

	  Leave disabled when EL3 is AArch64-only, when Trusted Firmware-A
	  has already performed this initialization, or when booting in
	  Non-Secure state.

config ARMV7_EXCEPTION_STACK_SIZE
	int "Undefined Instruction and Abort stack size (in bytes)"
	default 256
	help
	  This option specifies the size of the stack used by the undefined
	  instruction and data abort exception handlers.

config ARMV7_FIQ_STACK_SIZE
	int "FIQ stack size (in bytes)"
	default 256
	help
	  This option specifies the size of the stack used by the FIQ handler.

config ARMV7_SVC_STACK_SIZE
	int "SVC stack size (in bytes)"
	default 512
	help
	  This option specifies the size of the stack used by the SVC handler.

config ARMV7_SYS_STACK_SIZE
	int "SYS stack size (in bytes)"
	default 1024
	help
	  This option specifies the size of the stack used by the system mode.

config RUNTIME_NMI
	default y

config GEN_ISR_TABLES
	default y

config GEN_IRQ_VECTOR_TABLE
	default n

config DCACHE_LINE_SIZE
	default 32

config ICACHE_LINE_SIZE
	default 32

endif # CPU_AARCH32_CORTEX_A

config CPU_CORTEX_R4
	bool
	select CPU_AARCH32_CORTEX_R
	select ARMV7_R
	select ARMV7_R_FP if CPU_HAS_FPU
	help
	  This option signifies the use of a Cortex-R4 CPU

config CPU_CORTEX_R5
	bool
	select CPU_AARCH32_CORTEX_R
	select ARMV7_R
	select ARMV7_R_FP if CPU_HAS_FPU
	select CPU_HAS_ICACHE
	select CPU_HAS_DCACHE
	help
	  This option signifies the use of a Cortex-R5 CPU

config CPU_CORTEX_R7
	bool
	select CPU_AARCH32_CORTEX_R
	select ARMV7_R
	select ARMV7_R_FP if CPU_HAS_FPU
	help
	  This option signifies the use of a Cortex-R7 CPU

config CPU_CORTEX_R8
	bool
	select CPU_AARCH32_CORTEX_R
	select ARMV7_R
	select ARMV7_R_FP if CPU_HAS_FPU
	help
	  This option signifies the use of a Cortex-R8 CPU

config CPU_CORTEX_R52
	bool
	select CPU_AARCH32_CORTEX_R
	select AARCH32_ARMV8_R
	select CPU_HAS_ICACHE
	select CPU_HAS_DCACHE
	select VFP_SP_D16 if !USE_SWITCH
	help
	  This option signifies the use of a Cortex-R52 CPU

config CPU_CORTEX_R52_CACHE_SEGREGATION
	bool "Control segregation of L1 I/D-Cache ways between Flash and AXIM"
	depends on CPU_CORTEX_R52
	help
	  Control segregation of L1 I/D-Cache ways between Flash and AXIM.
	  Updates to the cache segregation controls are only permitted before the caches
	  have ever been enabled, following a system reset, otherwise the update is ignored.

config CPU_CORTEX_R52_ICACHE_FLASH_WAY
	int "L1 I-Cache Flash way"
	depends on CPU_CORTEX_R52_CACHE_SEGREGATION
	range 0 4
	default 0
	help
	  Configure L1 I-Cache ways for Flash interface. Default is reset value, all
	  I-Cache ways are allocated for AXIM interface.

config CPU_CORTEX_R52_DCACHE_FLASH_WAY
	int "L1 D-Cache Flash way"
	depends on CPU_CORTEX_R52_CACHE_SEGREGATION
	range 0 4
	default 0
	help
	  Configure L1 D-Cache ways for Flash interface. Default is reset value,
	  all D-Cache ways are allocated for AXIM interface.

if CPU_AARCH32_CORTEX_R

config ARMV7_R
	bool
	select ATOMIC_OPERATIONS_BUILTIN
	select ISA_ARM
	select ISA_THUMB2
	help
	  This option signifies the use of an ARMv7-R processor
	  implementation.

	  From https://developer.arm.com/products/architecture/cpu-architecture/r-profile:
	  The Armv7-R architecture implements a traditional Arm architecture with
	  multiple modes and supports a Protected Memory System Architecture
	  (PMSA) based on a Memory Protection Unit (MPU). It supports the Arm (32)
	  and Thumb (T32) instruction sets.

config ARMV7_R_FP
	bool
	depends on ARMV7_R
	help
	  This option signifies the use of an ARMv7-R processor
	  implementation supporting the Floating-Point Extension.

config AARCH32_ARMV8_R
	bool
	select ATOMIC_OPERATIONS_BUILTIN
	select SCHED_IPI_SUPPORTED if SMP
	select ARCH_HAS_DIRECTED_IPIS
	help
	  This option signifies the use of an ARMv8-R AArch32 processor
	  implementation.

	  From https://developer.arm.com/products/architecture/cpu-architecture/r-profile:
	  The Armv8-R architecture targets at the Real-time profile. It introduces
	  virtualization at the highest security level while retaining the
	  Protected Memory System Architecture (PMSA) based on a Memory Protection
	  Unit (MPU). It supports the A32 and T32 instruction sets.

config ARMV7_EXCEPTION_STACK_SIZE
	int "Undefined Instruction and Abort stack size (in bytes)"
	default 256
	help
	  This option specifies the size of the stack used by the undefined
	  instruction and data abort exception handlers.

config ARMV7_FIQ_STACK_SIZE
	int "FIQ stack size (in bytes)"
	default 256
	help
	  This option specifies the size of the stack used by the FIQ handler.

config ARMV7_SVC_STACK_SIZE
	int "SVC stack size (in bytes)"
	default 512
	help
	  This option specifies the size of the stack used by the SVC handler.

config ARMV7_SYS_STACK_SIZE
	int "SYS stack size (in bytes)"
	default 1024
	help
	  This option specifies the size of the stack used by the system mode.

config RUNTIME_NMI
	default y

config GEN_ISR_TABLES
	default y

config GEN_IRQ_VECTOR_TABLE
	default n

config DISABLE_TCM_ECC
	bool "Disable ECC on TCM"
	help
	  This option disables ECC checks on Tightly Coupled Memory.

config DCACHE_LINE_SIZE
	default 64 if CPU_CORTEX_R52
	default 32

config ICACHE_LINE_SIZE
	default 64 if CPU_CORTEX_R52
	default 32

endif # CPU_AARCH32_CORTEX_R

config TEST_EXTRA_STACK_SIZE
	default 1024 if SMP
```
