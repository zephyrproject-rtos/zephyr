## arch/x86/soc/quark_d2000/Kconfig.defconfig
```kconfig
#
# Copyright (c) 2015-2016 Intel Corporation
#
# Licensed under the Apache License, Version 2.0 (the "License");
# you may not use this file except in compliance with the License.
# You may obtain a copy of the License at
#
#     http://www.apache.org/licenses/LICENSE-2.0
#
# Unless required by applicable law or agreed to in writing, software
# distributed under the License is distributed on an "AS IS" BASIS,
# WITHOUT WARRANTIES OR CONDITIONS OF ANY KIND, either express or implied.
# See the License for the specific language governing permissions and
# limitations under the License.
#

if SOC_QUARK_D2000

config SOC
	default quark_d2000

config  SYS_CLOCK_HW_CYCLES_PER_SEC
	default 32000000

config  PHYS_LOAD_ADDR
	default 0x00180000 if XIP
	default 0x00280000 if !XIP

config RAM_SIZE
        default 8

config ROM_SIZE
        default 32

config IDT_NUM_VECTORS
	default 64

config IOAPIC_NUM_RTES
	default 32

config LOAPIC_TIMER_IRQ
	default 0

config LOAPIC_TIMER_IRQ_PRIORITY
	default 2

config PHYS_RAM_ADDR
	default 0x00280000
	help
	This option specifies the physical SRAM address of this Soc.

config TOOLCHAIN_VARIANT
        default "iamcu"

if UART_NS16550

config UART_NS16550_DLF
	def_bool y

config UART_NS16550_PORT_0
	def_bool y

if UART_NS16550_PORT_0

config UART_NS16550_PORT_0_NAME
	default "UART_0"
config UART_NS16550_PORT_0_IRQ_PRI
	default 3
config UART_NS16550_PORT_0_BAUD_RATE
	default 115200
config UART_NS16550_PORT_0_OPTIONS
	default 0
config UART_NS16550_PORT_0_DLF
	default 0x06

endif # UART_NS16550_PORT_0

config UART_NS16550_PORT_1
	def_bool y

if UART_NS16550_PORT_1

config UART_NS16550_PORT_1_NAME
	default "UART_1"
config UART_NS16550_PORT_1_IRQ_PRI
	default 3
config UART_NS16550_PORT_1_BAUD_RATE
	default 115200
config UART_NS16550_PORT_1_OPTIONS
	default 0
config UART_NS16550_PORT_1_DLF
	default 0x06

endif # UART_NS16550_PORT_1

endif # UART_NS16550

if UART_QMSI
config UART_QMSI_0
	def_bool y
config UART_QMSI_0_IRQ
	default 8
config UART_QMSI_0_IRQ_PRI
	default 0
config UART_QMSI_1
	def_bool y
config UART_QMSI_1_IRQ
	default 6
config UART_QMSI_1_IRQ_PRI
	default 0
endif # UART_QMSI

if BLUETOOTH_UART

config BLUETOOTH_UART_ON_DEV_NAME
	default "UART_1"

endif

if UART_PIPE

config UART_PIPE_ON_DEV_NAME
	default "UART_1"

endif

if WATCHDOG
config WDT_DW
	def_bool y

if WDT_DW
config WDT_DW_IRQ_PRI
	default 0
endif # WDT_DW

if WDT_QMSI
config WDT_QMSI_IRQ
	default 16
config WDT_QMSI_IRQ_PRI
	default 0
endif # WDT_QMSI
endif # WATCHDOG

if RTC

if RTC_QMSI
config RTC_QMSI_IRQ
	default 2
config RTC_QMSI_IRQ_PRI
	default 0
endif # RTC_QMSI

config RTC_DW
	def_bool y
config RTC_DW_IRQ_PRI
	default 0 if RTC_DW

endif # RTC

if I2C

config I2C_DW
	def_bool y

if I2C_DW

config I2C_DW_0
        def_bool y

if I2C_DW_0

config I2C_DW_0_NAME
        default "I2C0"

config I2C_DW_0_IRQ_PRI
        default 0

config I2C_DW_0_DEFAULT_CFG
        default 0x12

config I2C_CLOCK_SPEED
        default 32

endif # I2C_DW_0

endif # I2C_DW

if GPIO

config GPIO_DW
	def_bool y

if GPIO_DW

config GPIO_DW_0
	def_bool y

if GPIO_DW_0

config GPIO_DW_0_PRI
	default 2

endif # GPIO_DW_0

endif # GPIO_DW

endif # GPIO

if I2C_QMSI
config I2C_QMSI_0
	def_bool y
config I2C_QMSI_0_IRQ
	default 4
config I2C_QMSI_0_IRQ_PRI
	default 0
config I2C_QMSI_0_DEFAULT_CFG
	default 0x12
endif # I2C_QMSI
endif # I2C

if GPIO_QMSI
config GPIO_QMSI_0
	def_bool y
config GPIO_QMSI_0_IRQ
	default 15
config GPIO_QMSI_0_PRI
	default 0
endif # GPIO_QMSI

if SPI_QMSI
config SPI_QMSI_PORT_0
	def_bool y
config SPI_QMSI_PORT_0_IRQ
	default 7
config SPI_QMSI_PORT_0_PRI
	default 0
endif # SPI_QMSI

if AON_TIMER_QMSI
config AON_TIMER_IRQ
	default 3
config AON_TIMER_IRQ_PRI
	default 0
endif # AON_TIMER_QMSI

if SOC_FLASH_QMSI
config SOC_FLASH_QMSI_SYS_SIZE
	default 0x8000
endif # SOC_FLASH_QMSI

endif # SOC_QUARK_D2000
```

## arch/x86/soc/quark_d2000/Kconfig.soc
```kconfig
config  SOC_QUARK_D2000
        bool "Quark D2000"
        select CPU_MINUTEIA
        select LOAPIC_TIMER
        select EOI_HANDLER_SUPPORTED
        select BOOTLOADER_UNKNOWN
        select XIP
        select MVIC
```

## arch/x86/soc/quark_se/Kconfig
```kconfig
# Kconfig - Quark SE configuration options

#
# Copyright (c) 2016 Intel Corporation
#
# Licensed under the Apache License, Version 2.0 (the "License");
# you may not use this file except in compliance with the License.
# You may obtain a copy of the License at
#
#     http://www.apache.org/licenses/LICENSE-2.0
#
# Unless required by applicable law or agreed to in writing, software
# distributed under the License is distributed on an "AS IS" BASIS,
# WITHOUT WARRANTIES OR CONDITIONS OF ANY KIND, either express or implied.
# See the License for the specific language governing permissions and
# limitations under the License.
#

if X86 && SOC_QUARK_SE

config EOI_FORWARDING_BUG
	bool
	default y
	help
	Quark SE LOAPIC has issues with forwarding EOI to the IOAPIC for level
	triggered interrupts, this is a SW workaround.

config ARC_INIT
	bool "Quark SE ARC Kickoff"
	default n
	help
	Allows x86 processor to kickoff the ARC slave processor.

config ARC_INIT_DEBUG
	bool "Allows the usage of GDB with the ARC processor."
	depends on ARC_INIT
	default n
	help
	This option will stop the master processor from boot-strapping
	the ARC slave processor. This will allow GDB to halt and
	engage the ARC processor to proceed step by step execution.

if IPM_CONSOLE_RECEIVER
config QUARK_SE_IPM_CONSOLE_RING_BUF_SIZE32
	int "IPM Console Ring Buffer Size"
	default 256
	help
	Size of the buffer for the console reciever, for incoming
	console messages from the ARC side. Must be a power of 2.
endif

endif #SOC_QUARK_SE_X86
```

## arch/x86/soc/quark_se/Kconfig.defconfig
```kconfig
# Kconfig - Quark SE configuration options

#
# Copyright (c) 2015-2016 Intel Corporation
#
# Licensed under the Apache License, Version 2.0 (the "License");
# you may not use this file except in compliance with the License.
# You may obtain a copy of the License at
#
#     http://www.apache.org/licenses/LICENSE-2.0
#
# Unless required by applicable law or agreed to in writing, software
# distributed under the License is distributed on an "AS IS" BASIS,
# WITHOUT WARRANTIES OR CONDITIONS OF ANY KIND, either express or implied.
# See the License for the specific language governing permissions and
# limitations under the License.
#

if SOC_QUARK_SE

config SOC
        default quark_se

config  PHYS_RAM_ADDR
	default 0xA8006400

config  PHYS_LOAD_ADDR
	default 0x40030000 if XIP

config RAM_SIZE
        default 55

config ROM_SIZE
        default 144

config	SYS_CLOCK_HW_CYCLES_PER_SEC
	default 32000000

config IOAPIC_NUM_RTES
	default 64 if IOAPIC

config LOAPIC_TIMER_IRQ
	default 64 if LOAPIC_TIMER

config TOOLCHAIN_VARIANT
	default "iamcu"

config QMSI
	def_bool y

config QMSI_BUILTIN
	def_bool y

if PWM
config PWM_QMSI
	def_bool y
endif

if GPIO

config GPIO_DW
	def_bool y

if GPIO_DW

config GPIO_DW_BOTHEDGES_SUPPORT
	def_bool y

config GPIO_DW_CLOCK_GATE
	def_bool n

if GPIO_DW_CLOCK_GATE

config GPIO_DW_CLOCK_GATE_DRV_NAME
	default CLOCK_CONTROL_QUARK_SE_PERIPHERAL_DRV_NAME

endif # GPIO_DW_CLOCK_GATE

config GPIO_DW_0
	def_bool y

if GPIO_DW_0

config GPIO_DW_0_PRI
	default 2
config GPIO_DW_0_CLOCK_GATE_SUBSYS
	default 13
	depends on GPIO_DW_CLOCK_GATE

endif # GPIO_DW_0

config GPIO_DW_1
	def_bool y

if GPIO_DW_1

config GPIO_DW_1_PRI
	default 2

endif # GPIO_DW_1

endif # GPIO_DW

if QMSI_DRIVERS

config GPIO_QMSI
	def_bool n

if GPIO_QMSI

config GPIO_QMSI_0
	def_bool n

if GPIO_QMSI_0

config GPIO_QMSI_0_IRQ
	default 8
config GPIO_QMSI_0_PRI
	default 2

endif # GPIO_QMSI_0

config GPIO_QMSI_AON
	def_bool n
config GPIO_QMSI_AON_NAME
	default "gpio_aon"
config GPIO_QMSI_AON_IRQ
	default 31
config GPIO_QMSI_AON_PRI
	default 2

endif # GPIO_QMSI

endif # QMSI_DRIVERS

endif # GPIO

if I2C
config I2C_QMSI
	def_bool y

config I2C_QMSI_0
	def_bool y

if I2C_QMSI_0

config I2C_QMSI_0_IRQ_PRI
	default 2
config I2C_QMSI_0_DEFAULT_CFG
	default 0x12

endif # I2C_QMSI_0

config I2C_QMSI_1
	def_bool y

if I2C_QMSI_1
config I2C_QMSI_1_IRQ_PRI
	default 2
config I2C_QMSI_1_DEFAULT_CFG
	default 0x12

endif # I2C_QMSI_1

endif # I2C


if CLOCK_CONTROL

config CLOCK_CONTROL_QUARK_SE
	def_bool y

if CLOCK_CONTROL_QUARK_SE

config CLOCK_CONTROL_QUARK_SE_PERIPHERAL
	def_bool y
config CLOCK_CONTROL_QUARK_SE_PERIPHERAL_DRV_NAME
	default "clk_peripheral"

config  CLOCK_CONTROL_QUARK_SE_EXTERNAL
       def_bool y
config CLOCK_CONTROL_QUARK_SE_EXTERNAL_DRV_NAME
	default "clk_external"

config  CLOCK_CONTROL_QUARK_SE_SENSOR
       def_bool y
config CLOCK_CONTROL_QUARK_SE_SENSOR_DRV_NAME
	default "clk_sensor"

endif # CLOCK_CONTROL_QUARK_SE

endif # CLOCK_CONTROL

if SPI

config SPI_DW
	def_bool y

if SPI_DW

config SPI_DW_CLOCK_GATE
	def_bool n

if SPI_DW_CLOCK_GATE

config SPI_DW_CLOCK_GATE_DRV_NAME
	default CLOCK_CONTROL_QUARK_SE_PERIPHERAL_DRV_NAME

endif # SPI_DW_CLOCK_GATE

config SPI_DW_PORT_0
	def_bool y

if SPI_DW_PORT_0

config SPI_DW_PORT_0_CLOCK_GATE_SUBSYS
	default 14
	depends on SPI_DW_CLOCK_GATE
config SPI_DW_PORT_0_REGS
	default 0xb0001000
config SPI_DW_PORT_0_IRQ
	default 2
config SPI_DW_PORT_0_PRI
	default 2

endif # SPI_DW_PORT_0

config SPI_DW_PORT_1
	def_bool y

if SPI_DW_PORT_1

config SPI_DW_PORT_1_CLOCK_GATE_SUBSYS
	default 15
	depends on SPI_DW_CLOCK_GATE
config SPI_DW_PORT_1_REGS
	default 0xb0001400
config SPI_DW_PORT_1_IRQ
	default 3
config SPI_DW_PORT_1_PRI
	default 2

endif # SPI_DW_PORT_1

endif # SPI_DW

config SPI_QMSI
       def_bool n

if SPI_QMSI

config SPI_QMSI_PORT_0
	def_bool y

if SPI_QMSI_PORT_0

config SPI_QMSI_PORT_0_IRQ
	default 2
config SPI_QMSI_PORT_0_PRI
	default 2

endif # SPI_QMSI_PORT_0

config SPI_QMSI_PORT_1
	def_bool y

if SPI_QMSI_PORT_1

config SPI_QMSI_PORT_1_IRQ
	default 3
config SPI_QMSI_PORT_1_PRI
	default 2

endif # SPI_QMSI_PORT_1

endif # SPI_QMSI

endif # SPI


if AIO_COMPARATOR
config AIO_QMSI_COMPARATOR
        def_bool y
endif


if WATCHDOG
config WDT_QMSI
	def_bool y

config WDT_QMSI_IRQ_PRI
	default 2
endif # WATCHDOG

if RTC
config RTC_QMSI
	def_bool y
config RTC_QMSI_IRQ_PRI
	default 2
endif # RTC

if UART_NS16550

config UART_NS16550_PORT_0
	def_bool y

if UART_NS16550_PORT_0

config UART_NS16550_PORT_0_NAME
	default "UART_0"
config UART_NS16550_PORT_0_IRQ_PRI
	default 3
config UART_NS16550_PORT_0_BAUD_RATE
	default 115200
config UART_NS16550_PORT_0_OPTIONS
	default 0

endif # UART_NS16550_PORT_0

config UART_NS16550_PORT_1
	def_bool y

if UART_NS16550_PORT_1

config UART_NS16550_PORT_1_NAME
	default "UART_1"
config UART_NS16550_PORT_1_IRQ_PRI
	default 3
config UART_NS16550_PORT_1_BAUD_RATE
	default 115200
config UART_NS16550_PORT_1_OPTIONS
	default 0

endif # UART_NS16550_PORT_1

endif # UART_NS16550

if UART_QMSI

config UART_QMSI_0
	def_bool y

if UART_QMSI_0

config UART_QMSI_0_IRQ
	default 5
config UART_QMSI_0_IRQ_PRI
	default 3

endif # UART_QMSI_0

config UART_QMSI_1
	def_bool y

if UART_QMSI_1

config UART_QMSI_1_IRQ
	default 6
config UART_QMSI_1_IRQ_PRI
	default 3

endif # UART_QMSI_1

endif # UART_QMSI

if UART_CONSOLE

config UART_CONSOLE_ON_DEV_NAME
	default "UART_1"

endif

if AON_TIMER_QMSI

config AON_TIMER_IRQ
	default 28
config AON_TIMER_IRQ_PRI
	default 2

endif # AON_TIMER_QMSI

if SOC_FLASH_QMSI
config SOC_FLASH_QMSI_SYS_SIZE
       default 0x60000
endif # SOC_FLASH_QMSI

endif # SOC_QUARK_SE
```

## arch/x86/soc/quark_se/Kconfig.soc
```kconfig
config SOC_QUARK_SE_C1000
	bool "Intel Quark SE"
	select CPU_MINUTEIA
	select IOAPIC
	select LOAPIC
	select LOAPIC_TIMER
	select XIP
	select X86_IAMCU
	select SYS_POWER_LOW_POWER_STATE_SUPPORTED
	select SYS_POWER_DEEP_SLEEP_SUPPORTED
	select HAS_QMSI
```
