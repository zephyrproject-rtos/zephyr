## arch/x86/soc/intel_quark/quark_d2000/Kconfig.soc
```kconfig
config SOC_QUARK_D2000
	bool "Intel Quark D2000"
	depends on SOC_SERIES_QUARK_D2000
```

## arch/x86/soc/intel_quark/quark_se/Kconfig
```kconfig
# Kconfig - Quark SE configuration options

#
# Copyright (c) 2016 Intel Corporation
#
# Licensed under the Apache License, Version 2.0 (the "License");
# you may not use this file except in compliance with the License.
# You may obtain a copy of the License at
#
#     http://www.apache.org/licenses/LICENSE-2.0
#
# Unless required by applicable law or agreed to in writing, software
# distributed under the License is distributed on an "AS IS" BASIS,
# WITHOUT WARRANTIES OR CONDITIONS OF ANY KIND, either express or implied.
# See the License for the specific language governing permissions and
# limitations under the License.
#

if X86 && SOC_QUARK_SE_C1000

config EOI_FORWARDING_BUG
	bool
	default y
	help
	Quark SE LOAPIC has issues with forwarding EOI to the IOAPIC for level
	triggered interrupts, this is a SW workaround.

config SS_RESET_VECTOR
	hex "Sensor Subsystem Reset Vector"
	default 0x40000000
	help
	Sensor subsystem reset vector. This value is needed to init the ARC
	system on the SoC.

config ARC_INIT
	bool "Quark SE ARC Kickoff"
	default n
	help
	Allows x86 processor to kickoff the ARC slave processor.

config SYS_LOG_ARC_INIT_LEVEL
	int
	prompt "Quark SE Sensor Subsystem log level"
	default 0
	help
	Sets log level for the boot initialization and boot process of the sensor
	sub-system.

	Levels are:

	- 0 OFF, do not write

	- 1 ERROR, only write SYS_LOG_ERR

	- 2 WARNING, write SYS_LOG_WRN in adition to previous level

	- 3 INFO, write SYS_LOG_INF in adition to previous levels

	- 4 DEBUG, write SYS_LOG_DBG in adition to previous levels

config ARC_GDB_ENABLE
	bool "Allows the usage of GDB with the ARC processor."
	depends on ARC_INIT
	default n
	help
	This option will stop the master processor from boot-strapping
	the ARC slave processor. This will allow GDB to halt and
	engage the ARC processor to proceed step by step execution.

if IPM
config QUARK_SE_IPM_IRQ_PRI
	int "IPM interrupt priority"
	default 2
	help
	Priority level for interrupts coming in from the inter-processor
	mailboxes.

if IPM_CONSOLE_RECEIVER
config QUARK_SE_IPM_CONSOLE_RING_BUF_SIZE32
	int "IPM Console Ring Buffer Size"
	default 256
	help
	Size of the buffer for the console reciever, for incoming
	console messages from the ARC side. Must be a power of 2.
endif
endif

config BSP_SHARED_RAM_ADDR
	hex "Address of the shared RAM with the QMSI Bootloader"
	depends on SYS_POWER_DEEP_SLEEP
	default 0xA8013FFC
	help
	Address of the memory shared between the BSP and the Bootloader in order
	to store restore information.

config BSP_SHARED_RAM_SIZE
	hex "Size of the shared RAM with the QMSI Bootloader"
	depends on SYS_POWER_DEEP_SLEEP
	default 0x4
	help
	Size of the memory shared between the BSP and the Bootloader in order
	to store restore information.

endif #SOC_QUARK_SE_C1000_X86
```

## arch/x86/soc/intel_quark/quark_se/Kconfig.defconfig.quark_se_c1000
```kconfig
# Kconfig - Quark SE configuration options

#
# Copyright (c) 2015-2016 Intel Corporation
#
# SPDX-License-Identifier: Apache-2.0
#

if SOC_QUARK_SE_C1000

config SOC
	default "quark_se_c1000"

if IEEE802154 && NET_CONFIG_SETTINGS

config IEEE802154_CC2520
	def_bool y

config NET_CONFIG_IEEE802154_DEV_NAME
	default IEEE802154_CC2520_DRV_NAME

endif # IEEE802154 && NET_CONFIG_SETTINGS

endif
```

## arch/x86/soc/intel_quark/quark_se/Kconfig.defconfig.series
```kconfig
#
# Copyright (c) 2016 Intel Corporation Inc.
#
# SPDX-License-Identifier: Apache-2.0
#

if SOC_SERIES_QUARK_SE

config SOC_SERIES
	default quark_se

config X86_IAMCU
	def_bool y

config TOOLCHAIN_VARIANT
	default "iamcu" if X86_IAMCU
	default "" if !X86_IAMCU

if !HAS_DTS
config PHYS_RAM_ADDR
	default 0xA8006400
endif

if !HAS_DTS
config PHYS_LOAD_ADDR
	default 0x40030000 if XIP
endif

config RAM_SIZE
	default 52

config ROM_SIZE
	default 144

config	SYS_CLOCK_HW_CYCLES_PER_SEC
	default 32000000

config IOAPIC_NUM_RTES
	default 64 if IOAPIC

config LOAPIC_TIMER_IRQ
	default 64 if LOAPIC_TIMER

config QMSI
	def_bool y

config QMSI_BUILTIN
	def_bool y

if PWM
config PWM_QMSI
	def_bool y
endif

if PINMUX
config PINMUX_QMSI
	def_bool y
endif

if GPIO
config GPIO_QMSI
	def_bool y

config GPIO_QMSI_0
	def_bool y

config GPIO_QMSI_0_IRQ_PRI
	default 2

config GPIO_QMSI_1
	def_bool y
config GPIO_QMSI_1_IRQ_PRI
	default 2
endif # GPIO

if I2C
config I2C_QMSI
	def_bool y

config I2C_0
	def_bool y

if I2C_0

config I2C_0_IRQ_PRI
	default 2
config I2C_0_DEFAULT_CFG
	default 0x12

endif # I2C_0

config I2C_1
	def_bool y

if I2C_1
config I2C_1_IRQ_PRI
	default 2
config I2C_1_DEFAULT_CFG
	default 0x12

endif # I2C_1

config I2C_SDA_SETUP
	default 2

config I2C_SDA_TX_HOLD
	default 16

config I2C_SDA_RX_HOLD
	default 24

endif # I2C


if CLOCK_CONTROL

config CLOCK_CONTROL_QUARK_SE
	def_bool y

if CLOCK_CONTROL_QUARK_SE

config CLOCK_CONTROL_QUARK_SE_PERIPHERAL
	def_bool y
config CLOCK_CONTROL_QUARK_SE_PERIPHERAL_DRV_NAME
	default "clk_peripheral"

config CLOCK_CONTROL_QUARK_SE_EXTERNAL
	def_bool y
config CLOCK_CONTROL_QUARK_SE_EXTERNAL_DRV_NAME
	default "clk_external"

config CLOCK_CONTROL_QUARK_SE_SENSOR
	def_bool y
config CLOCK_CONTROL_QUARK_SE_SENSOR_DRV_NAME
	default "clk_sensor"

endif # CLOCK_CONTROL_QUARK_SE

endif # CLOCK_CONTROL


if COUNTER
config AON_COUNTER_QMSI
	def_bool y
config AON_TIMER_QMSI
	def_bool y
config AON_TIMER_IRQ_PRI
	default 2

endif


if SPI
config SPI_QMSI
	def_bool y

config SPI_0
	def_bool y

config SPI_0_IRQ_PRI
	default 2

config SPI_1
	def_bool y

config SPI_1_IRQ_PRI
	default 2

config SPI_DW
	def_bool n

config SPI_DW_FIFO_DEPTH
	default 7

endif # SPI


if AIO_COMPARATOR
config AIO_COMPARATOR_QMSI
	def_bool y
endif


if WATCHDOG
config WDT_QMSI
	def_bool y

config WDT_0_IRQ_PRI
	default 2
endif # WATCHDOG

if RTC
config RTC_QMSI
	def_bool y
config RTC_0_IRQ_PRI
	default 2
endif # RTC

if BT_H4

if !HAS_DTS
config BT_UART_ON_DEV_NAME
	default UART_QMSI_0_NAME
endif

config UART_QMSI_0
	def_bool y

if !HAS_DTS
config UART_QMSI_0_BAUDRATE
	default 1000000
endif

config UART_QMSI_0_HW_FC
	def_bool y

endif # BT_H4

if UART_QMSI

if UART_QMSI_0

config UART_QMSI_0_IRQ_PRI
	default 3

endif # UART_QMSI_0

config UART_QMSI_1
	def_bool y

if UART_QMSI_1

config UART_QMSI_1_IRQ_PRI
	default 3

endif # UART_QMSI_1

endif # UART_QMSI

if UART_CONSOLE && !HAS_DTS

config UART_CONSOLE_ON_DEV_NAME
	default "UART_1"  if USB_UART_CONSOLE = n
	default "CDC_ACM" if USB_UART_CONSOLE

endif

if SOC_FLASH_QMSI
config SOC_FLASH_QMSI_SYS_SIZE
	default 0x60000
endif # SOC_FLASH_QMSI

if DMA
config DMA_QMSI
	def_bool y
endif

if USB
config USB_DW
	def_bool y
config GPIO
	def_bool y
config USB_DW_IRQ_PRI
	default 3
endif # USB

source "arch/x86/soc/intel_quark/quark_se/Kconfig.defconfig.quark_se*"
source "arch/x86/soc/intel_quark/quark_se/Kconfig.defconfig.curie*"

endif # SOC_SERIES_QUARK_SE
```

## arch/x86/soc/intel_quark/quark_se/Kconfig.series
```kconfig
# Copyright (c) 2016 Intel Corporation Inc.
#
# Licensed under the Apache License, Version 2.0 (the "License");
# you may not use this file except in compliance with the License.
# You may obtain a copy of the License at
#
#     http://www.apache.org/licenses/LICENSE-2.0
#
# Unless required by applicable law or agreed to in writing, software
# distributed under the License is distributed on an "AS IS" BASIS,
# WITHOUT WARRANTIES OR CONDITIONS OF ANY KIND, either express or implied.
# See the License for the specific language governing permissions and
# limitations under the License.
#

config SOC_SERIES_QUARK_SE
	bool "Quark SE Series MCU"
	select SOC_FAMILY_QUARK
	select CPU_MINUTEIA
	select IOAPIC
	select LOAPIC
	select LOAPIC_TIMER
	select XIP
	select SYS_POWER_LOW_POWER_STATE_SUPPORTED
	select SYS_POWER_DEEP_SLEEP_SUPPORTED
	select BOOTLOADER_CONTEXT_RESTORE_SUPPORTED
	select HAS_QMSI
	help
	 Enable support for Quark SE
```

## arch/x86/soc/intel_quark/quark_se/Kconfig.soc
```kconfig
# Copyright (c) 2016 Intel Corporation Inc.
#
# SPDX-License-Identifier: Apache-2.0
#
choice
	prompt "Quark SE Selection"
	depends on SOC_SERIES_QUARK_SE

config SOC_QUARK_SE_C1000
	bool "Intel Quark SE C1000"

config SOC_QUARK_SE_CURIE
	bool "Intel Curie"

endchoice
```

## arch/x86/soc/intel_quark/quark_x1000/Kconfig.defconfig.quark_x1000
```kconfig
# Kconfig - Quark X1000 configuration options

#
# Copyright (c) 2015-2016 Intel Corporation
#
# SPDX-License-Identifier: Apache-2.0
#

if SOC_QUARK_X1000

config SOC
	default "quark_x1000"

endif # SOC_QUARK_X1000
```

## arch/x86/soc/intel_quark/quark_x1000/Kconfig.defconfig.series
```kconfig
# Kconfig - Quark X1000 SoC configuration options

#
# Copyright (c) 2014-2015 Wind River Systems, Inc.
# Copyright (c) 2015-2016 Intel Corporation
#
# SPDX-License-Identifier: Apache-2.0
#

if SOC_SERIES_QUARK_X1000

config SOC_SERIES
	default quark_x1000

if !HAS_DTS
config PHYS_LOAD_ADDR
	default 0x00100000

config PHYS_RAM_ADDR
	default 0x00400000
endif

config RAM_SIZE
	default 32768

config ROM_SIZE
	default 1024 if XIP

config SYS_CLOCK_HW_CYCLES_PER_SEC
	default 25000000  if HPET_TIMER

config CLFLUSH_DETECT
	def_bool y if CACHE_FLUSHING

if SHARED_IRQ

config SHARED_IRQ_0
	def_bool y

if SHARED_IRQ_0

config SHARED_IRQ_0_NAME
	default "SHARED_IRQ0"
config SHARED_IRQ_0_IRQ
	default 18
config SHARED_IRQ_0_PRI
	default 2

endif # SHARED_IRQ_0

endif # SHARED_IRQ

if PCI_LEGACY_BRIDGE

config PCI_LEGACY_BRIDGE_BUS
	default 0
config PCI_LEGACY_BRIDGE_DEV
	default 31
config PCI_LEGACY_BRIDGE_VENDOR_ID
	default 0x8086
config PCI_LEGACY_BRIDGE_DEVICE_ID
	default 0x095e

endif # PCI_LEGACY_BRIDGE

if I2C

config I2C_DW
	def_bool y

if I2C_DW

config I2C_DW_CLOCK_SPEED
	default 25

config I2C_0
	def_bool y

if I2C_0

config I2C_0_NAME
	default "I2C_0"
config I2C_0_DEFAULT_CFG
	default 0x12
config I2C_0_IRQ_PRI
	default 2
config I2C_DW_0_IRQ_SHARED_NAME
	default SHARED_IRQ_0_NAME if SHARED_IRQ

endif # I2C_0

endif # I2C_DW

endif # I2C


if GPIO

config GPIO_SCH
	def_bool y

if GPIO_SCH

config GPIO_SCH_0
	def_bool y

config GPIO_SCH_1
	def_bool y

if GPIO_SCH_0

config GPIO_SCH_0_DEV_NAME
	default "GPIO_CW"

endif # GPIO_SCH_0

if GPIO_SCH_1

config GPIO_SCH_1_DEV_NAME
	default "GPIO_RW"

endif # GPIO_SCH_1

endif # GPIO_SCH

config GPIO_DW
	def_bool y

if GPIO_DW

config GPIO_DW_0
	def_bool y
	select GPIO_DW_0_IRQ_SHARED if SHARED_IRQ

if GPIO_DW_0

config GPIO_DW_0_NAME
	default "GPIO_0"
config GPIO_DW_0_IRQ_PRI
	default 2
config GPIO_DW_0_IRQ_SHARED_NAME
	default SHARED_IRQ_0_NAME if SHARED_IRQ

endif # GPIO_DW_0

endif # GPIO_DW

endif # GPIO


if SPI

config SPI_INTEL
	def_bool y

if SPI_INTEL

config SPI_CS_GPIO
	def_bool y

config SPI_0
	def_bool y

if SPI_0

config SPI_0_IRQ_PRI
	default 2
config SPI_0_CS_GPIO_PORT
	default "GPIO_0"
config SPI_0_CS_GPIO_PIN
	default 0

endif # SPI_0

config SPI_1
	def_bool n

if SPI_1

config SPI_1_NAME
	default "SPI_1"
config SPI_1_IRQ_PRI
	default 2
config SPI_1_CS_GPIO_PORT
	default "GPIO_0"
config SPI_1_CS_GPIO_PIN
	default 2

endif # SPI_1

endif # SPI_INTEL

endif # SPI

if UART_NS16550

config UART_NS16550_PCI
	def_bool y if PCI

config UART_NS16550_PORT_0
	def_bool y

if UART_NS16550_PORT_0

if !HAS_DTS
config UART_NS16550_PORT_0_NAME
	default "UART_0"
endif
config UART_NS16550_PORT_0_IRQ_PRI
	default 0
if !HAS_DTS
config UART_NS16550_PORT_0_BAUD_RATE
	default 115200
endif
config UART_NS16550_PORT_0_OPTIONS
	default 0
config UART_NS16550_PORT_0_PCI
	def_bool y if UART_NS16550_PCI

endif # UART_NS16550_PORT_0

config UART_NS16550_PORT_1
	def_bool y if PCI

if UART_NS16550_PORT_1

if !HAS_DTS
config UART_NS16550_PORT_1_NAME
	default "UART_1"
endif
config UART_NS16550_PORT_1_IRQ_PRI
	default 3
if !HAS_DTS
config UART_NS16550_PORT_1_BAUD_RATE
	default 115200
endif
config UART_NS16550_PORT_1_OPTIONS
	default 0
config UART_NS16550_PORT_1_PCI
	def_bool y if UART_NS16550_PCI

endif # UART_NS16550_PORT_1

endif # UART_NS16550


if ETHERNET
config ETH_DW
	def_bool y

if ETH_DW

config ETH_DW_0
	def_bool y

if ETH_DW_0

config ETH_DW_0_IRQ_SHARED_NAME
	default SHARED_IRQ_0_NAME if SHARED_IRQ

endif # ETH_DW_0

endif # ETH_DW

endif # ETHERNET

# Pin multiplexer uses PCAL9535A, needs to be initialized after it
config PINMUX_INIT_PRIORITY
	default 80 if PINMUX

if UART_CONSOLE

if !HAS_DTS
config UART_CONSOLE_ON_DEV_NAME
	default "UART_1"
endif

endif

if BT_UART

config BT_UART_ON_DEV_NAME
	default "UART_1"

endif

source "arch/x86/soc/intel_quark/quark_x1000/Kconfig.defconfig.quark_x1000"
endif # SOC_SERIES_QUARK_X1000
```

## arch/x86/soc/intel_quark/quark_x1000/Kconfig.soc
```kconfig
config SOC_QUARK_X1000
	bool "Quark X1000"
	select CPU_MINUTEIA
	select CPU_HAS_FPU
	select HPET_TIMER
	select BOOTLOADER_UNKNOWN
	select PCI
	select SYS_POWER_LOW_POWER_STATE_SUPPORTED
	select SYS_POWER_DEEP_SLEEP_SUPPORTED
	depends on SOC_SERIES_QUARK_X1000
	help
	  Intel Quark X1000 SoC.
```
