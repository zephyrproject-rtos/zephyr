## arch/x86/platforms/quark_d2000/Kconfig
```kconfig
#
# Copyright (c) 2015 Intel Corp.
#
# Licensed under the Apache License, Version 2.0 (the "License");
# you may not use this file except in compliance with the License.
# You may obtain a copy of the License at
#
#     http://www.apache.org/licenses/LICENSE-2.0
#
# Unless required by applicable law or agreed to in writing, software
# distributed under the License is distributed on an "AS IS" BASIS,
# WITHOUT WARRANTIES OR CONDITIONS OF ANY KIND, either express or implied.
# See the License for the specific language governing permissions and
# limitations under the License.
#

if PLATFORM_QUARK_D2000
config PLATFORM
	default quark_d2000

config  SYS_CLOCK_HW_CYCLES_PER_SEC
	default 32000000

config  PHYS_LOAD_ADDR
	default 0x00180000 if XIP
	default 0x00280000 if !XIP

config RAM_SIZE
        default 8

config ROM_SIZE
        default 32

config IDT_NUM_VECTORS
	default 64

config IOAPIC_NUM_RTES
	default 32

config LOAPIC_TIMER_IRQ
	default 0

config LOAPIC_TIMER_IRQ_PRIORITY
	default 2

config PHYS_RAM_ADDR
	default 0x00280000
	help
	This option specifies the physical SRAM address of this Soc.

config KERNEL_INIT_PRIORITY_DEFAULT
	default 40

config KERNEL_INIT_PRIORITY_DEVICE
	default 50

config UART_CONSOLE_PRIORITY
	default 60

if PINMUX
config PINMUX_BASE
        default 0xb0800900

config PINMUX_NUM_PINS
        default 25
endif # PINMUX

if UART_NS16550

config UART_NS16550_PORT_0
	def_bool y

if UART_NS16550_PORT_0

config UART_NS16550_PORT_0_NAME
	default "UART_0"
config UART_NS16550_PORT_0_BASE_ADDR
	default 0xB0002000
config UART_NS16550_PORT_0_IRQ
	default 8
config UART_NS16550_PORT_0_IRQ_PRI
	default 3
config UART_NS16550_PORT_0_BAUD_RATE
	default 115200
config UART_NS16550_PORT_0_CLK_FREQ
	default 32000000
config UART_NS16550_PORT_0_OPTIONS
	default 0

endif # UART_NS16550_PORT_0

config UART_NS16550_PORT_1
	def_bool y

if UART_NS16550_PORT_1

config UART_NS16550_PORT_1_NAME
	default "UART_1"
config UART_NS16550_PORT_1_BASE_ADDR
	default 0xB0002400
config UART_NS16550_PORT_1_IRQ
	default 6
config UART_NS16550_PORT_1_IRQ_PRI
	default 3
config UART_NS16550_PORT_1_BAUD_RATE
	default 115200
config UART_NS16550_PORT_1_CLK_FREQ
	default 32000000
config UART_NS16550_PORT_1_OPTIONS
	default 0

endif # UART_NS16550_PORT_1

endif # UART_NS16550

if UART_CONSOLE

config UART_CONSOLE_ON_DEV_NAME
	default "UART_0"
config UART_CONSOLE_IRQ
	default 8
config UART_CONSOLE_IRQ_PRI
	default 3

endif

if BLUETOOTH_UART

config BLUETOOTH_UART_ON_DEV_NAME
	default "UART_1"
config BLUETOOTH_UART_IRQ
	default 6
config BLUETOOTH_UART_IRQ_PRI
	default 3

endif

if UART_PIPE

config UART_PIPE_ON_DEV_NAME
	default "UART_1"
config UART_PIPE_IRQ
	default 6
config UART_PIPE_IRQ_PRI
	default 3

endif

if WATCHDOG

if WDT_DW
config WDT_DW_BASE_ADDR
	default 0xB0000000
config WDT_DW_IRQ
	default 16
endif

endif

if RTC

if RTC_DW
config RTC_DW_BASE_ADDR
	default 0xB0000400
config RTC_DW_IRQ
	default 2
endif

endif

endif # PLATFORM_QUARK_D2000
```

## arch/x86/platforms/quark_d2000/Kconfig.platform
```kconfig
config  PLATFORM_QUARK_D2000
        bool "Minimum configuration for Quark D2000"
        select CPU_MINUTEIA
        select LOAPIC_TIMER
        select EOI_HANDLER_SUPPORTED
        select BOOTLOADER_UNKNOWN
        select XIP
        select MVIC
```

## arch/x86/platforms/quark_se/Kconfig.platform
```kconfig
config  PLATFORM_QUARK_SE
        bool "Minimum configuration for Quark SE"
        select CPU_MINUTEIA
        select IOAPIC
        select LOAPIC
        select LOAPIC_TIMER
        select EOI_HANDLER_SUPPORTED
        select BOOTLOADER_UNKNOWN
        select XIP
```

## arch/x86/platforms/quark_x1000/Kconfig.platform
```kconfig
config PLATFORM_QUARK_X1000
	bool "Quark X1000"
	select HPET_TIMER
	select BOOTLOADER_UNKNOWN
	select PCI
	help
	Intel Quark X1000 SoC.
```

## arch/x86/quark/Kconfig
```kconfig
# Kconfig - quark BSP configuration options

#
# Copyright (c) 2014-2015 Wind River Systems, Inc.
#
# Redistribution and use in source and binary forms, with or without
# modification, are permitted provided that the following conditions are met:
#
# 1) Redistributions of source code must retain the above copyright notice,
# this list of conditions and the following disclaimer.
#
# 2) Redistributions in binary form must reproduce the above copyright notice,
# this list of conditions and the following disclaimer in the documentation
# and/or other materials provided with the distribution.
#
# 3) Neither the name of Wind River Systems nor the names of its contributors
# may be used to endorse or promote products derived from this software without
# specific prior written permission.
#
# THIS SOFTWARE IS PROVIDED BY THE COPYRIGHT HOLDERS AND CONTRIBUTORS "AS IS"
# AND ANY EXPRESS OR IMPLIED WARRANTIES, INCLUDING, BUT NOT LIMITED TO, THE
# IMPLIED WARRANTIES OF MERCHANTABILITY AND FITNESS FOR A PARTICULAR PURPOSE
# ARE DISCLAIMED. IN NO EVENT SHALL THE COPYRIGHT HOLDER OR CONTRIBUTORS BE
# LIABLE FOR ANY DIRECT, INDIRECT, INCIDENTAL, SPECIAL, EXEMPLARY, OR
# CONSEQUENTIAL DAMAGES (INCLUDING, BUT NOT LIMITED TO, PROCUREMENT OF
# SUBSTITUTE GOODS OR SERVICES; LOSS OF USE, DATA, OR PROFITS; OR BUSINESS
# INTERRUPTION) HOWEVER CAUSED AND ON ANY THEORY OF LIABILITY, WHETHER IN
# CONTRACT, STRICT LIABILITY, OR TORT (INCLUDING NEGLIGENCE OR OTHERWISE)
# ARISING IN ANY WAY OUT OF THE USE OF THIS SOFTWARE, EVEN IF ADVISED OF THE
# POSSIBILITY OF SUCH DAMAGE.
#


config BSP_DIR
	string
	default quark
	help
	This option holds the directory name used by sysgen to identify
	the location of the config1p.mdef file and is used by the build system
	to locate the correct linker file.

config MAX_PCI_DEVS
	int
	prompt "Maximum number of PCI devices"
	default 8
	help
	This option sets the maximum number of PCI devices the BSP supports.

config BOOTLOADER_KEXEC
	bool
	prompt "Boot using Linux kexec() system call"
	default n
	help
	This option signifies that Linux boots the kernel using kexec system call
	and utility. This method is used to boot the kernel over the network.

config BOOTLOADER_GRUB
	bool
	prompt "Boot using GRUB 2.0"
	default y
	depends on !BOOTLOADER_KEXEC
	help
	This option signifies that GRUB 2.0 is used to boot the kernel. GRUB 2.0
	is used to boot the kernel from SD card.

config PHYS_LOAD_ADDR
	default 0x00100000

config SYS_CLOCK_HW_CYCLES_PER_SEC
	default 25000000

menu "Serial Ports"

config EXTRA_SERIAL_PORT
	bool "Extra serial port"
	default n
	help
	This option signifies the number of serial ports the target has.

config SERIAL_INTERRUPT_LEVEL
	bool "Serial interrupt level"
	depends on IOAPIC && EXTRA_SERIAL_PORT
	default y
	help
	Option signifies that the serial controller uses level interrupts
	instead of edge

config SERIAL_INTERRUPT_LOW
	bool "Serial interrupt low"
	depends on IOAPIC && EXTRA_SERIAL_PORT
	default n
	help
	Option signifies that the serial controller uses low level interrupts
	instead of high

endmenu
```

## arch/x86/soc/apollo_lake/Kconfig.defconfig
```kconfig
#
# Kconfig - Apollo Lake SoC configuration options
#
# Copyright (c) 2018 Intel Corporation
# Copyright (c) 2014-2015 Wind River Systems, Inc.
#
# SPDX-License-Identifier: Apache-2.0
#

if SOC_APOLLO_LAKE

config SOC
	default "apollo_lake"

config SYS_CLOCK_HW_CYCLES_PER_SEC
	default 150000000 if LOAPIC_TIMER
	default 25000000  if HPET_TIMER

config CLFLUSH_DETECT
	def_bool y if CACHE_FLUSHING

if UART_NS16550

config UART_NS16550_PCI
	def_bool y if PCI

config UART_NS16550_PORT_0
	def_bool y

if UART_NS16550_PORT_0

config UART_NS16550_PORT_0_OPTIONS
	default 0

config UART_NS16550_PORT_0_PCI
	def_bool y if PCI

endif # UART_NS16550_PORT_0

config UART_NS16550_PORT_1
	def_bool y

if UART_NS16550_PORT_1

config UART_NS16550_PORT_1_OPTIONS
	default 0

config UART_NS16550_PORT_1_PCI
	def_bool y if PCI

endif # UART_NS16550_PORT_1

if UART_NS16550_PORT_2

config UART_NS16550_PORT_2_OPTIONS
	default 0

config UART_NS16550_PORT_2_PCI
	def_bool y if PCI

endif # UART_NS16550_PORT_2

if UART_NS16550_PORT_3

config UART_NS16550_PORT_3_OPTIONS
	default 0

config UART_NS16550_PORT_3_PCI
	def_bool y if PCI

endif # UART_NS16550_PORT_3

endif # UART_NS16550

endif # SOC_APOLLO_LAKE
```

## arch/x86/soc/atom/Kconfig.defconfig
```kconfig
# Kconfig - ATOM SoC configuration options

#
# Copyright (c) 2014-2015 Wind River Systems, Inc.
#
# SPDX-License-Identifier: Apache-2.0
#

if SOC_ATOM

config SOC
	default atom

if !HAS_DTS
config PHYS_LOAD_ADDR
	default 0x00100000

config PHYS_RAM_ADDR
	default 0x00400000
endif

config RAM_SIZE
	default 128 if XIP
	default 256

config ROM_SIZE
	default 72 if XIP

config SYS_CLOCK_HW_CYCLES_PER_SEC
	default 150000000 if LOAPIC_TIMER
	default 25000000  if HPET_TIMER

config CLFLUSH_DETECT
	def_bool y if CACHE_FLUSHING

if UART_NS16550

config UART_NS16550_PCI
	def_bool n

config UART_NS16550_PORT_0
	def_bool y

if UART_NS16550_PORT_0

if !HAS_DTS
config UART_NS16550_PORT_0_NAME
	default "UART_0"
endif
config UART_NS16550_PORT_0_IRQ_PRI
	default 3
if !HAS_DTS
config UART_NS16550_PORT_0_BAUD_RATE
	default 115200
endif
config UART_NS16550_PORT_0_OPTIONS
	default 0

endif # UART_NS16550_PORT_0

config UART_NS16550_PORT_1
	def_bool y

if UART_NS16550_PORT_1

if !HAS_DTS
config UART_NS16550_PORT_1_NAME
	default "UART_1"
endif
config UART_NS16550_PORT_1_IRQ_PRI
	default 3
if !HAS_DTS
config UART_NS16550_PORT_1_BAUD_RATE
	default 115200
endif
config UART_NS16550_PORT_1_OPTIONS
	default 0

endif # UART_NS16550_PORT_1

endif # UART_NS16550

if BT_UART

if !HAS_DTS
config BT_UART_ON_DEV_NAME
	default "UART_1"

endif

if UART_PIPE

config UART_PIPE_ON_DEV_NAME
	default "UART_1"

endif

config BT_MONITOR_ON_DEV_NAME
	default "UART_1" if BT_DEBUG_MONITOR
endif

endif
```

## arch/x86/soc/atom/Kconfig.soc
```kconfig
config SOC_ATOM
	bool "Intel ATOM SoC"
	select CPU_ATOM
	select BOOTLOADER_UNKNOWN
```

## arch/x86/soc/ia32/Kconfig.defconfig
```kconfig
# Kconfig - generic PC platform configuration options

#
# Copyright (c) 2014-2015 Wind River Systems, Inc.
#
# SPDX-License-Identifier: Apache-2.0
#

if SOC_IA32

config SOC
	default ia32

config PHYS_LOAD_ADDR
	default 0x00100000

config PHYS_RAM_ADDR
	default 0x00400000

config RAM_SIZE
	default 128 if XIP
	default 256

config ROM_SIZE
	default 72 if XIP

config SYS_CLOCK_HW_CYCLES_PER_SEC
	default 150000000 if LOAPIC_TIMER
	default 25000000  if HPET_TIMER

config CLFLUSH_DETECT
	def_bool y if CACHE_FLUSHING

if UART_NS16550

config UART_NS16550_PCI
	def_bool n

config UART_NS16550_PORT_0
	def_bool y

if UART_NS16550_PORT_0

config UART_NS16550_PORT_0_NAME
	default "UART_0"
config UART_NS16550_PORT_0_IRQ_PRI
	default 3
config UART_NS16550_PORT_0_BAUD_RATE
	default 115200
config UART_NS16550_PORT_0_OPTIONS
	default 0

endif # UART_NS16550_PORT_0

config UART_NS16550_PORT_1
	def_bool y

if UART_NS16550_PORT_1

config UART_NS16550_PORT_1_NAME
	default "UART_1"
config UART_NS16550_PORT_1_IRQ_PRI
	default 3
config UART_NS16550_PORT_1_BAUD_RATE
	default 115200
config UART_NS16550_PORT_1_OPTIONS
	default 0

endif # UART_NS16550_PORT_1

endif # UART_NS16550

if BLUETOOTH_UART

config BLUETOOTH_UART_ON_DEV_NAME
	default "UART_1"

endif

if UART_PIPE

config UART_PIPE_ON_DEV_NAME
	default "UART_1"

endif

config BLUETOOTH_MONITOR_ON_DEV_NAME
	default "UART_1" if BLUETOOTH_DEBUG_MONITOR

endif
```

## arch/x86/soc/ia32_pci/Kconfig.soc
```kconfig
config SOC_IA32_PCI
	bool "Generic IA32 SoC with PCI"
	select HPET_TIMER
	select BOOTLOADER_UNKNOWN
	select PCI
```

## arch/x86/soc/intel_quark/Kconfig
```kconfig
#
# Copyright (c) 2016 Intel Corporation
#
# SPDX-License-Identifier: Apache-2.0
#

config SOC_FAMILY_QUARK
	bool
	default n

if SOC_FAMILY_QUARK
config SOC_FAMILY
	string
	default "intel_quark"
endif

source "arch/x86/soc/intel_quark/*/Kconfig.soc"

source "arch/x86/soc/intel_quark/*/Kconfig"
```

## arch/x86/soc/intel_quark/Kconfig.soc
```kconfig
#
# Copyright (c) 2016 Intel Corporation
#
# SPDX-License-Identifier: Apache-2.0
#

source "arch/x86/soc/intel_quark/*/Kconfig.series"
```

## arch/x86/soc/intel_quark/quark_d2000/Kconfig
```kconfig
# Kconfig - Quark D2000 configuration options

#
# Copyright (c) 2016 Intel Corporation
#
# SPDX-License-Identifier: Apache-2.0
#

if X86 && SOC_QUARK_D2000

config BSP_SHARED_GDT_RAM_ADDR
	hex "Address of the shared RAM with the QMSI Bootloader"
	default 0x00281FE0
	help
	  Address of the memory shared between the BSP and the Bootloader in order
	  to store the GDT.

config BSP_SHARED_GDT_RAM_SIZE
	hex "Size of the shared RAM with the QMSI Bootloader"
	depends on !SET_GDT
	default 0x20
	help
	  Size of the memory shared between the BSP and the Bootloader in order
	  to store the GDT.

endif #SOC_QUARK_D2000_X86
```

## arch/x86/soc/intel_quark/quark_d2000/Kconfig.defconfig.series
```kconfig
#
# Copyright (c) 2015-2016 Intel Corporation
#
# SPDX-License-Identifier: Apache-2.0
#

if SOC_SERIES_QUARK_D2000

config SOC_SERIES
	default quark_d2000

config X86_IAMCU
        def_bool y

config TOOLCHAIN_VARIANT
        default "iamcu" if X86_IAMCU
        default "" if !X86_IAMCU

config SYS_CLOCK_HW_CYCLES_PER_SEC
	default 32000000

if !HAS_DTS
config PHYS_LOAD_ADDR
	default 0x00180000 if XIP
	default 0x00280000 if !XIP
endif

config RAM_SIZE
	default 8

config ROM_SIZE
	default 32

config IDT_NUM_VECTORS
	default 64

config IOAPIC_NUM_RTES
	default 32

config LOAPIC_TIMER_IRQ
	default 10

config LOAPIC_TIMER_IRQ_PRIORITY
	default 2

if !HAS_DTS
config PHYS_RAM_ADDR
	default 0x00280000
	help
	This option specifies the physical SRAM address of this Soc.
endif

config QMSI
	def_bool y

config QMSI_BUILTIN
	def_bool y

if PINMUX
config PINMUX_QMSI
	def_bool y
endif

if UART_QMSI
config UART_QMSI_0
	def_bool y
config UART_QMSI_0_IRQ_PRI
	default 0
config UART_QMSI_1
	def_bool y
config UART_QMSI_1_IRQ_PRI
	default 0
endif # UART_QMSI

if WATCHDOG
config WDT_QMSI
	def_bool y

config WDT_0_IRQ_PRI
	default 0
endif # WATCHDOG

if RTC
config RTC_QMSI
	def_bool y

config RTC_0_IRQ_PRI
	default 0

endif # RTC

if GPIO

config GPIO_QMSI
	def_bool y
config GPIO_QMSI_0
	def_bool y
config GPIO_QMSI_0_IRQ_PRI
	default 0

endif # GPIO

if PWM
config PWM_QMSI
	def_bool y
endif

if I2C
config I2C_QMSI
	def_bool y

if I2C_QMSI
config I2C_0
	def_bool y
config I2C_0_IRQ_PRI
	default 0
config I2C_0_DEFAULT_CFG
	default 0x12
endif # I2C_QMSI

config I2C_SDA_SETUP
	default 2

config I2C_SDA_TX_HOLD
	default 16

config I2C_SDA_RX_HOLD
	default 24

endif # I2C


if AIO_COMPARATOR
config AIO_COMPARATOR_QMSI
	def_bool y
endif

if COUNTER
config AON_COUNTER_QMSI
	def_bool y
config AON_TIMER_QMSI
	def_bool y
config AON_TIMER_IRQ_PRI
	default 0
endif

if ADC
config ADC_QMSI
	def_bool y
endif

if DMA
config DMA_QMSI
	def_bool y
endif

if SPI
config SPI_QMSI
	def_bool y
config SPI_0
	def_bool y
config SPI_0_IRQ_PRI
	default 0
endif # SPI

if SOC_FLASH_QMSI
config SOC_FLASH_QMSI_SYS_SIZE
	default 0x8000
endif # SOC_FLASH_QMSI


source "arch/x86/soc/intel_quark/quark_d2000/Kconfig.defconfig.quark_d2000"

endif # SOC_SERIES_QUARK_D2000
```
