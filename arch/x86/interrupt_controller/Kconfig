## arch/x86/interrupt_controller/Kconfig
```kconfig
menu "Interrupt Controller Configuration"

config  IOAPIC
	bool "IOAPIC"
	default n
	help
	This option signifies that the target has an IO-APIC device. This
	capability allows IO-APIC-dependent code to be included.

config LOAPIC
	bool "LOAPIC"
	default n
	help
	This option selects local APIC as the interrupt controller.

endmenu
```

## arch/x86/platforms/atom/Kconfig.platform
```kconfig
config PLATFORM_ATOM
	bool "Intel ATOM SoC"
	select CPU_ATOM
	select BOOTLOADER_UNKNOWN
```

## arch/x86/platforms/galileo/Kconfig
```kconfig
# Kconfig - galileo platform configuration options

#
# Copyright (c) 2014-2015 Wind River Systems, Inc.
#
# Licensed under the Apache License, Version 2.0 (the "License");
# you may not use this file except in compliance with the License.
# You may obtain a copy of the License at
#
#     http://www.apache.org/licenses/LICENSE-2.0
#
# Unless required by applicable law or agreed to in writing, software
# distributed under the License is distributed on an "AS IS" BASIS,
# WITHOUT WARRANTIES OR CONDITIONS OF ANY KIND, either express or implied.
# See the License for the specific language governing permissions and
# limitations under the License.
#

if PLATFORM_GALILEO
config PLATFORM
	default galileo

config PHYS_LOAD_ADDR
	default 0x00100000

config PHYS_RAM_ADDR
       default 0x00400000

config RAM_SIZE
	default 32768

config ROM_SIZE
	default 1024 if XIP

config SYS_CLOCK_HW_CYCLES_PER_SEC
	default 25000000  if HPET_TIMER

config PINMUX
        def_bool y

config I2C
	def_bool y

config GPIO
	def_bool y

config PWM
	def_bool y

config SPI
	def_bool y

config ADC
	def_bool y

config SHARED_IRQ
	def_bool y

if SHARED_IRQ
config SHARED_IRQ_0
	def_bool y
config SHARED_IRQ_0_NAME
	default "SHARED_IRQ0"
config SHARED_IRQ_0_IRQ
	default 18
config SHARED_IRQ_0_PRI
	default 2
endif

if PCI_LEGACY_BRIDGE
config PCI_LEGACY_BRIDGE_BUS
	default 0
config PCI_LEGACY_BRIDGE_DEV
	default 31
config PCI_LEGACY_BRIDGE_VENDOR_ID
	default 0x8086
config PCI_LEGACY_BRIDGE_DEVICE_ID
	default 0x095e
endif

if I2C
config I2C_CLOCK_SPEED
	default 25
config I2C_DW
        def_bool y
config I2C_DW_VENDOR_ID
        default 0x8086
config I2C_DW_DEVICE_ID
        default 0x934
config I2C_DW_CLASS
        default 0x0C
config I2C_DW_0
        def_bool y
config I2C_DW_0_NAME
        default "I2C0"
config I2C_DW_0_DEFAULT_CFG
        default 0x12
config I2C_DW_0_BASE
	default 0x90007000
config I2C_DW_0_IRQ
	default 18
config I2C_DW_0_INT_PRIORITY
	default 2
config I2C_DW_0_BUS
	default 0
config I2C_DW_0_DEV
	default 21
config I2C_DW_0_FUNCTION
	default 2
config I2C_DW_0_BAR
	default 0
config I2C_DW_0_IRQ_SHARED_NAME
	default SHARED_IRQ_0_NAME if SHARED_IRQ
endif

if GPIO && I2C

config GPIO_PCAL9535A
	def_bool y

config GPIO_PCAL9535A_0
	def_bool y
config GPIO_PCAL9535A_0_DEV_NAME
	default "EXP0"
config GPIO_PCAL9535A_0_I2C_ADDR
	default 0x25
config GPIO_PCAL9535A_0_I2C_MASTER_DEV_NAME
	default I2C_DW_0_NAME

config GPIO_PCAL9535A_1
	def_bool y
config GPIO_PCAL9535A_1_DEV_NAME
	default "EXP1"
config GPIO_PCAL9535A_1_I2C_ADDR
	default 0x26
config GPIO_PCAL9535A_1_I2C_MASTER_DEV_NAME
	default I2C_DW_0_NAME

config GPIO_PCAL9535A_2
	def_bool y
config GPIO_PCAL9535A_2_DEV_NAME
	default "EXP2"
config GPIO_PCAL9535A_2_I2C_ADDR
	default 0x27
config GPIO_PCAL9535A_2_I2C_MASTER_DEV_NAME
	default I2C_DW_0_NAME
endif

if GPIO

config GPIO_SCH
	def_bool y
config GPIO_SCH_0
	def_bool y
config GPIO_SCH_1
	def_bool y

config GPIO_DW
	def_bool y
config GPIO_DW_0
	def_bool y

if GPIO_SCH_0
config GPIO_SCH_0_DEV_NAME
	default "GPIO_CW"
config GPIO_SCH_0_BASE_ADDR
	default 0x1080
config GPIO_SCH_0_BITS
	default 2
endif
if GPIO_SCH_1
config GPIO_SCH_1_DEV_NAME
	default "GPIO_RW"
config GPIO_SCH_1_BASE_ADDR
	default 0x10A0
config GPIO_SCH_1_BITS
	default 6
endif

if GPIO_DW
config GPIO_DW_0
	def_bool y
	select GPIO_DW_0_IRQ_SHARED if SHARED_IRQ
config GPIO_DW_0_NAME
	default "GPIO_0"
config GPIO_DW_0_BUS
	default 0
config GPIO_DW_0_DEV
	default 21
config GPIO_DW_0_FUNCTION
	default 2
config GPIO_DW_0_BAR
	default 1
config GPIO_DW_0_BITS
	default 8
config GPIO_DW_0_BASE_ADDR
	default 0x90006000
config GPIO_DW_0_IRQ
	default 18
config GPIO_DW_0_PRI
	default 2
config GPIO_DW_0_IRQ_SHARED_NAME
	default SHARED_IRQ_0_NAME if SHARED_IRQ
endif
endif

if PINMUX
config PINMUX_BASE
	default 0x00000000
config PINMUX_NUM_PINS
        default 20
config PINMUX_BASE
        default 0x00000000
config PINMUX_GALILEO_EXP0_NAME
        default GPIO_PCAL9535A_0_DEV_NAME
config PINMUX_GALILEO_EXP1_NAME
        default GPIO_PCAL9535A_1_DEV_NAME
config PINMUX_GALILEO_EXP2_NAME
        default GPIO_PCAL9535A_2_DEV_NAME
config PINMUX_GALILEO_PWM0_NAME
        default PWM_PCA9685_0_DEV_NAME
config PINMUX_GALILEO_GPIO_DW_NAME
	default GPIO_DW_0_NAME
config PINMUX_GALILEO_GPIO_INTEL_CW_NAME
	default GPIO_SCH_0_DEV_NAME
config PINMUX_GALILEO_GPIO_INTEL_RW_NAME
	default GPIO_SCH_1_DEV_NAME
endif

if PWM

config PWM_PCA9685
	def_bool y

config PWM_PCA9685_0
	def_bool y

if PWM_PCA9685_0

config PWM_PCA9685_0_DEV_NAME
	default "PWM0"
config PWM_PCA9685_0_I2C_ADDR
	default 0x47
config PWM_PCA9685_0_I2C_MASTER_DEV_NAME
	default I2C_DW_0_NAME

endif
endif

if SPI
config SPI_INTEL
	def_bool y
config SPI_INTEL_CS_GPIO
	def_bool y

config SPI_INTEL_PORT_0
	def_bool y
config SPI_INTEL_PORT_0_DRV_NAME
	default "SPI0"
config SPI_INTEL_PORT_0_BUS
	default 0
config SPI_INTEL_PORT_0_DEV
	default 21
config SPI_INTEL_PORT_0_FUNCTION
	default 0
config SPI_INTEL_PORT_0_REGS
	default 0x90009000
config SPI_INTEL_PORT_0_IRQ
	default 16
config SPI_INTEL_PORT_0_PRI
	default 2
config SPI_INTEL_PORT_0_CS_GPIO_PORT
	default GPIO_DW_0_NAME
config SPI_INTEL_PORT_0_CS_GPIO_PIN
	default 0

config SPI_INTEL_PORT_1
	def_bool n
config SPI_INTEL_PORT_1_DRV_NAME
	default "SPI1"
config SPI_INTEL_PORT_1_BUS
	default 0
config SPI_INTEL_PORT_1_DEV
	default 21
config SPI_INTEL_PORT_1_FUNCTION
	default 1
config SPI_INTEL_PORT_1_REGS
	default 0x90008000
config SPI_INTEL_PORT_1_IRQ
	default 17
config SPI_INTEL_PORT_1_PRI
	default 2
config SPI_INTEL_PORT_1_CS_GPIO_PORT
	default GPIO_DW_0_NAME
config SPI_INTEL_PORT_1_CS_GPIO_PIN
	default 2
endif # SPI

if UART_NS16550

config UART_NS16550_PCI
	def_bool y

config UART_NS16550_PORT_0
	def_bool y

if UART_NS16550_PORT_0

config UART_NS16550_PORT_0_NAME
	default "UART_0"
config UART_NS16550_PORT_0_BASE_ADDR
	default 0x9000f000
config UART_NS16550_PORT_0_IRQ
	default 0
config UART_NS16550_PORT_0_IRQ_PRI
	default 0
config UART_NS16550_PORT_0_BAUD_RATE
	default 115200
config UART_NS16550_PORT_0_CLK_FREQ
	default 44236800
config UART_NS16550_PORT_0_OPTIONS
	default 0
config UART_NS16550_PORT_0_PCI
	def_bool y if UART_NS16550_PCI
config UART_NS16550_PORT_0_PCI_CLASS
	default 0x07
config UART_NS16550_PORT_0_PCI_BUS
	default 0
config UART_NS16550_PORT_0_PCI_DEV
	default 20
config UART_NS16550_PORT_0_PCI_VENDOR_ID
	default 0x8086
config UART_NS16550_PORT_0_PCI_DEVICE_ID
	default 0x0936
config UART_NS16550_PORT_0_PCI_FUNC
	default 1
config UART_NS16550_PORT_0_PCI_BAR
	default 0

endif # UART_NS16550_PORT_0

config UART_NS16550_PORT_1
	def_bool y

if UART_NS16550_PORT_1

config UART_NS16550_PORT_1_NAME
	default "UART_1"
config UART_NS16550_PORT_1_BASE_ADDR
	default 0x9000b000
config UART_NS16550_PORT_1_IRQ
	default 17
config UART_NS16550_PORT_1_IRQ_PRI
	default 3
config UART_NS16550_PORT_1_BAUD_RATE
	default 115200
config UART_NS16550_PORT_1_CLK_FREQ
	default 44236800
config UART_NS16550_PORT_1_OPTIONS
	default 0
config UART_NS16550_PORT_1_PCI
	def_bool y if UART_NS16550_PCI
config UART_NS16550_PORT_1_PCI_CLASS
	default 0x07
config UART_NS16550_PORT_1_PCI_BUS
	default 0
config UART_NS16550_PORT_1_PCI_DEV
	default 20
config UART_NS16550_PORT_1_PCI_VENDOR_ID
	default 0x8086
config UART_NS16550_PORT_1_PCI_DEVICE_ID
	default 0x0936
config UART_NS16550_PORT_1_PCI_FUNC
	default 5
config UART_NS16550_PORT_1_PCI_BAR
	default 0

endif # UART_NS16550_PORT_1

endif # UART_NS16550

if ADC
config ADC_TI_ADC108S102
	def_bool y
config ADC_TI_ADC108S102_0
	def_bool y
config ADC_TI_ADC108S102_0_SPI_PORT_NAME
	default "SPI0"
config ADC_TI_ADC108S102_0_SPI_CONFIGURATION
	default 0x81
config ADC_TI_ADC108S102_0_SPI_MAX_FREQ
	default 0x20000000
endif

if ETH_DW
config ETH_DW_0
	def_bool y
config ETH_DW_0_BASE_ADDR
	default 0x90002000
config ETH_DW_0_IRQ
	default 18
config ETH_DW_0_IRQ_SHARED_NAME
	default SHARED_IRQ_0_NAME if SHARED_IRQ
endif

config KERNEL_INIT_PRIORITY_DEFAULT
	default 40

config SHARED_IRQ_INIT_PRIORITY
	default 50

# Any device driver should be initialized after
# shared IRQ driver, as it may use it
config KERNEL_INIT_PRIORITY_DEVICE
	default 60

config GPIO_MMIO_INIT_PRIORITY
	default 60

config GPIO_SCH_INIT_PRIORITY
	default 60

config GPIO_DW_INIT_PRIORITY
	default 60

# SPI uses GPIO pin, so it needs to be initialized after
# GPIO driver
config SPI_INTEL_INIT_PRIORITY
	default 70

# TI ADC108S102 uses SPI bus, thus
# initialized after SPI driver
config ADC_TI_ADC108S102_INIT_PRIORITY
	default 80

config I2C_INIT_PRIORITY
	default 60

# PCAL9535A uses I2C, thus initialized after it
config GPIO_PCAL9535A_INIT_PRIORITY
	default 70

# PCA9685 uses I2C, thus initialized after it
config PWM_PCA9685_INIT_PRIORITY
	default 70

# Grove RGB LCD uses I2C, thus initialized after it
config GROVE_LCD_RGB_INIT_PRIORITY
	default 70

# Pin multiplexer uses PCAL9535A, needs to be initialized after it
config PINMUX_INIT_PRIORITY
	default 80

# Console driver has to be initialized after UART, that it uses
config UART_CONSOLE_PRIORITY
	default 70

if UART_CONSOLE

config UART_CONSOLE_ON_DEV_NAME
	default "UART_1"
config UART_CONSOLE_IRQ
	default 17
config UART_CONSOLE_IRQ_PRI
	default 3

endif

if BLUETOOTH_UART

config BLUETOOTH_UART_ON_DEV_NAME
	default "UART_1"
config BLUETOOTH_UART_IRQ
	default 17
config BLUETOOTH_UART_IRQ_PRI
	default 3

endif

endif # PLATFORM_GALILEO
```

## arch/x86/platforms/galileo/Kconfig.platform
```kconfig
config PLATFORM_GALILEO
	bool "Galileo Gen2"
	select HPET_TIMER
	select BOOTLOADER_UNKNOWN
	select PCI
	help
	The Intel Galileo Gen 2 development board is a microcontroller board
	based on the Intel Quark SoC X1000 application processor, a 32-bit
	Intel® Pentium® brand system on a chip (SoC). It is the first board
	based on Intel architecture designed to be hardware and software
	pin-compatible with shields designed for the Arduino Uno* R3.
```

## arch/x86/platforms/ia32_pci/Kconfig
```kconfig
# Kconfig - ia32_pci platform configuration options

#
# Copyright (c) 2014-2015 Wind River Systems, Inc.
#
# Licensed under the Apache License, Version 2.0 (the "License");
# you may not use this file except in compliance with the License.
# You may obtain a copy of the License at
#
#     http://www.apache.org/licenses/LICENSE-2.0
#
# Unless required by applicable law or agreed to in writing, software
# distributed under the License is distributed on an "AS IS" BASIS,
# WITHOUT WARRANTIES OR CONDITIONS OF ANY KIND, either express or implied.
# See the License for the specific language governing permissions and
# limitations under the License.
#


config PLATFORM
	string
	default ia32_pci
	help
	This option holds the directory name used by the build system to locate
	the correct linker file.

config PHYS_LOAD_ADDR
	default 0x00100000

config RAM_SIZE
	default 128 if XIP
	default 192

config ROM_SIZE
	default 72 if XIP

config SYS_CLOCK_HW_CYCLES_PER_SEC
	default 150000000 if LOAPIC_TIMER
	default 25000000  if HPET_TIMER

config UART_CONSOLE_INDEX
	default 1
```

## arch/x86/platforms/ia32_pci/Kconfig.platform
```kconfig
config PLATFORM_IA32_PCI
	bool "IA32 with PCI"
	select HPET_TIMER
	select BOOTLOADER_UNKNOWN
	select PCI
```

## arch/x86/platforms/qemu_x86/Kconfig
```kconfig
#
# Copyright (c) 2015 Intel Corporation
#
# Licensed under the Apache License, Version 2.0 (the "License");
# you may not use this file except in compliance with the License.
# You may obtain a copy of the License at
#
#     http://www.apache.org/licenses/LICENSE-2.0
#
# Unless required by applicable law or agreed to in writing, software
# distributed under the License is distributed on an "AS IS" BASIS,
# WITHOUT WARRANTIES OR CONDITIONS OF ANY KIND, either express or implied.
# See the License for the specific language governing permissions and
# limitations under the License.
#

if PLATFORM_QEMU_X86

config PLATFORM
	default qemu_x86

config PHYS_LOAD_ADDR
	default 0x00100000

config PHYS_RAM_ADDR
	default 0x00400000

config RAM_SIZE
	default 128 if XIP
	default 192

config ROM_SIZE
	default 72 if XIP

config SYS_CLOCK_HW_CYCLES_PER_SEC
	default 150000000 if LOAPIC_TIMER
	default 25000000  if HPET_TIMER

config KERNEL_INIT_PRIORITY_DEFAULT
	default 40

config KERNEL_INIT_PRIORITY_DEVICE
	default 50

config UART_CONSOLE_PRIORITY
	default 60

config IPI_CONSOLE_PRIORITY
	default 60

if UART_NS16550

config UART_NS16550_PCI
	def_bool n

config UART_NS16550_PORT_0
	def_bool y

if UART_NS16550_PORT_0

config UART_NS16550_PORT_0_NAME
	default "UART_0"
config UART_NS16550_PORT_0_BASE_ADDR
	default 0x03F8
config UART_NS16550_PORT_0_IRQ
	default 4
config UART_NS16550_PORT_0_IRQ_PRI
	default 3
config UART_NS16550_PORT_0_BAUD_RATE
	default 115200
config UART_NS16550_PORT_0_CLK_FREQ
	default 1843200
config UART_NS16550_PORT_0_OPTIONS
	default 0

endif # UART_NS16550_PORT_0

config UART_NS16550_PORT_1
	def_bool y

if UART_NS16550_PORT_1

config UART_NS16550_PORT_1_NAME
	default "UART_1"
config UART_NS16550_PORT_1_BASE_ADDR
	default 0x02F8
config UART_NS16550_PORT_1_IRQ
	default 3
config UART_NS16550_PORT_1_IRQ_PRI
	default 3
config UART_NS16550_PORT_1_BAUD_RATE
	default 115200
config UART_NS16550_PORT_1_CLK_FREQ
	default 1843200
config UART_NS16550_PORT_1_OPTIONS
	default 0

endif # UART_NS16550_PORT_1

endif # UART_NS16550

if UART_CONSOLE

config UART_CONSOLE_ON_DEV_NAME
	default "UART_0"
config UART_CONSOLE_IRQ
	default 4
config UART_CONSOLE_IRQ_PRI
	default 3

endif

if BLUETOOTH_UART

config BLUETOOTH_UART_ON_DEV_NAME
	default "UART_1"
config BLUETOOTH_UART_IRQ
	default 3
config BLUETOOTH_UART_IRQ_PRI
	default 3

endif

if UART_PIPE

config UART_PIPE_ON_DEV_NAME
	default "UART_1"
config UART_PIPE_IRQ
	default 3
config UART_PIPE_IRQ_PRI
	default 3

endif

endif
```
