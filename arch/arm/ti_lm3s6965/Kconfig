## arch/nios2/Kconfig
```kconfig
#
# Copyright (c) 2016 Intel Corporation
#
# SPDX-License-Identifier: Apache-2.0
#

menu "Nios II Options"
	depends on NIOS2

config ARCH
	string
	default "nios2"

config ARCH_DEFCONFIG
	string
	default "arch/nios2/defconfig"

menu "Nios II Gen 2 Processor Options"

config CPU_NIOS2_GEN2
	bool
	default y
	select BUILD_OUTPUT_HEX
	help
	  This option signifies the use of a Nios II Gen 2 CPU

endmenu

menu "Nios II Family Options"

config XIP
	bool
	default y

config GEN_ISR_TABLES
	default y

config GEN_IRQ_VECTOR_TABLE
	default n

config NUM_IRQS
	int
	default 32

config HAS_MUL_INSTRUCTION
	bool

config HAS_DIV_INSTRUCTION
	bool

config HAS_MULX_INSTRUCTION
	bool

config INCLUDE_RESET_VECTOR
	bool "Include Reset vector"
	default y
	help
	  Include the reset vector stub, which enables instruction/data caches
	  and then jumps to __start. This code is typically located at the very
	  beginning of flash memory. You may need to omit this if using the
	  nios2-download tool since it refuses to load data anywhere other than
	  RAM.

config EXTRA_EXCEPTION_INFO
	bool "Extra exception debug information"
	help
	  Have exceptions print additional useful debugging information in
	  human-readable form, at the expense of code size. For example,
	  the cause code for an exception will be supplemented by a string
	  describing what that cause code means.

choice
prompt "Global Pointer options"
default GP_GLOBAL

config GP_NONE
	bool "No global pointer"
	help
	  Do not use global pointer relative offsets at all

config GP_LOCAL
	bool "Local data global pointer references"
	help
	  Use global pointer relative offsets for small globals declared in the
	  same C file as the code that uses it.

config GP_GLOBAL
	bool "Global data global pointer references"
	help
	  Use global pointer relative offsets for small globals declared
	  anywhere in the executable. Note that if any small globals that are put
	  in alternate sections (such as _k_task_list_ptr) they must be declared
	  in headers with proper __attribute__((section)) or the linker will
	  error out.

config GP_ALL_DATA
	bool "All data global pointer references"
	help
	  Use GP relative access for all data in the program, not just
	  small data. Use this if your board has 64K or less of RAM.

endchoice

endmenu

endmenu
```

## arch/nios2/soc/nios2-qemu/Kconfig.soc
```kconfig
config SOC_NIOS2_QEMU
	bool "Nios II - QEMU emulation"
	depends on EXPERIMENTAL
	select HAS_MUL_INSTRUCTION
	select HAS_DIV_INSTRUCTION
	select HAS_MULX_INSTRUCTION
```

## arch/nios2/soc/nios2e-zephyr/Kconfig.defconfig
```kconfig
if SOC_NIOS2E_ZEPHYR

config SOC
	string
	default nios2e-zephyr

config SYS_CLOCK_HW_CYCLES_PER_SEC
	int
	default 1000000

endif
```

## arch/nios2/soc/nios2f-zephyr/Kconfig.defconfig
```kconfig
if SOC_NIOS2F_ZEPHYR

config SOC
	string
	default "nios2f-zephyr"

config SYS_CLOCK_HW_CYCLES_PER_SEC
	int
	default 50000000

config ALTERA_AVALON_SYSID
	def_bool y

if GPIO_ALTERA_NIOS2

config ALTERA_AVALON_PIO
	def_bool y

endif # GPIO_ALTERA_NIOS2

if SOC_FLASH_NIOS2_QSPI

config ALTERA_AVALON_QSPI
	def_bool y

endif #SOC_FLASH_NIOS2_QSPI

if I2C_NIOS2

config ALTERA_AVALON_I2C
	def_bool y

endif # I2C_NIOS2

if DMA_NIOS2_MSGDMA

config ALTERA_AVALON_MSGDMA
	def_bool y

endif # DMA_NIOS2_MSGDMA

if UART_NS16550

config UART_NS16550_PCI
	def_bool n

config UART_NS16550_PORT_0
	def_bool y

if UART_NS16550_PORT_0

config UART_NS16550_PORT_0_IRQ_PRI
	default 3
config UART_NS16550_PORT_0_OPTIONS
	default 0

endif # UART_NS16550_PORT_0

endif # UART_NS16550

endif # SOC_NIOS2F_ZEPHYR
```

## arch/nios2/soc/nios2f-zephyr/Kconfig.soc
```kconfig
config SOC_NIOS2F_ZEPHYR
	bool "Nios IIf - Zephyr Golden Configuration"
	select HAS_MUL_INSTRUCTION
	select HAS_DIV_INSTRUCTION
```

## arch/posix/Kconfig
```kconfig
# General configuration options

# Copyright (c) 2017 Intel Corporation
# SPDX-License-Identifier: Apache-2.0

menu "Native (POSIX) Architecture Options"
	depends on ARCH_POSIX

config ARCH
	default "posix"

config ARCH_POSIX_UPDATE_STACK_INFO
	bool "Update thread stack info with real pthread stack bounds"
	depends on THREAD_STACK_INFO
	help
	  When enabled, the POSIX architecture will update each thread's
	  stack_info to reflect the actual pthread stack instead of the
	  Zephyr-allocated stack. This is useful for applications that
	  perform their own stack overflow checking against the real
	  stack bounds.

config ARCH_POSIX_RECOMMENDED_STACK_SIZE
	int
	default 60 if 64BIT && ARCH_POSIX_UPDATE_STACK_INFO && STACK_SENTINEL
	default 56 if 64BIT && ARCH_POSIX_UPDATE_STACK_INFO
	default 44 if 64BIT && STACK_SENTINEL
	default 40 if 64BIT
	default 36 if ARCH_POSIX_UPDATE_STACK_INFO && STACK_SENTINEL
	default 32 if ARCH_POSIX_UPDATE_STACK_INFO
	default 28 if STACK_SENTINEL
	default 24
	help
	  In bytes, stack size for Zephyr threads meant only for the POSIX
	  architecture.
	  (In this architecture only part of the thread status is kept in the Zephyr
	  thread stack, the real stack is the native underlying pthread stack.
	  Therefore the allocated stack can be limited to this size)

config ARCH_POSIX_LIBFUZZER
	bool "Build fuzz test target"
	help
	  Build as an LLVM libfuzzer target. Requires
	  support from the toolchain (currently only clang works, and
	  only on native_sim[//64]), and should normally be used in
	  concert with some of CONFIG_ASAN/UBSAN/MSAN for validation.
	  The application needs to implement the
	  LLVMFuzzerTestOneInput() entry point, which runs in the host
	  environment "outside" the OS.  See Zephyr documentation and
	  sample and https://llvm.org/docs/LibFuzzer.html for more
	  information.

config ARCH_POSIX_TRAP_ON_FATAL
	bool "Raise a SIGTRAP on fatal error"
	help
	  Raise a SIGTRAP signal on fatal error before exiting.
	  This automatically suspends the target if a debugger is attached.

rsource "Kconfig.natsim_optional"

endmenu
```

## arch/posix/Kconfig.natsim_optional
```kconfig
# Copyright (c) 2025 Nordic Semiconductor ASA
# SPDX-License-Identifier: Apache-2.0

config NATIVE_USE_NSI_ERRNO
	bool
	help
	  Build the native simulator nsi_errno component with the Zephyr embedded code.
	  This component allows translating errno values from/to the embedded libC to/from the host libC.

config NATIVE_USE_NSI_FCNTL
	bool
	help
	  Build the native simulator nsi_fcntl component with the Zephyr embedded code.
	  This component allows translating Zephyr's ZVFS fcntl-like flags (e.g. zvfs_open() flags)
	  from/to the embedded code to/from the host libC.
	  When the POSIX compatibility layer is enabled in Zephyr, the embedded fcntl.h constants
	  match the Zephyr VFS equivalent and can therefore also be translated with this component.
```

## arch/posix/Kconfig.sysbuild
```kconfig
# Copyright (c) 2023 Nordic Semiconductor
#
# SPDX-License-Identifier: Apache-2.0

config NATIVE_BUILD
	default y
```

## arch/posix/soc/inf_clock/Kconfig.defconfig
```kconfig
# Kconfig - generic PC platform configuration options

#
# Copyright (c) 2014-2015 Wind River Systems, Inc.
#
# SPDX-License-Identifier: Apache-2.0
#

if SOC_POSIX

config SOC
	default inf_clock

endif
```
