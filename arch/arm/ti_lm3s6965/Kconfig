## arch/common/Kconfig
```kconfig
# Common architecture configuration options

# Copyright (c) 2022, CSIRO.
# Copyright 2025 Arm Limited and/or its affiliates <open-source-office@arm.com>
# SPDX-License-Identifier: Apache-2.0

config SEMIHOST
	bool "Semihosting support for ARM, RISC-V and Xtensa targets"
	depends on ARM || ARM64 || RISCV || (XTENSA && !SIMULATOR_XTENSA)
	help
	  Semihosting is a mechanism that enables code running on an ARM, RISC-V
	  or Xtensa target to communicate and use the Input/Output facilities on
	  a host computer that is running a debugger.
	  Additional information can be found in:
	  https://developer.arm.com/documentation/dui0471/m/what-is-semihosting-
	  https://github.com/riscv-non-isa/riscv-semihosting/blob/main/riscv-semihosting.adoc
	  This option is compatible with hardware and with QEMU, through the
	  (automatic) use of the -semihosting-config switch when invoking it.

config ISR_TABLE_SHELL
	bool "Shell command to dump the ISR tables"
	depends on GEN_SW_ISR_TABLE
	depends on SHELL
	help
	  This option enables a shell command to dump the ISR tables.

config ARCH_SUPPORTS_ROM_OFFSET
	bool
	default y
	depends on  (ARM || X86 || ARM64 || RISCV || ARC)
	help
	  Hidden option to enable support for ROM offset within the linker
	  script, which will place a block of 0x0 of size
	  CONFIG_ROM_START_OFFSET at the start of the ROM region.

config ARM_MPU
	bool "ARM MPU Support"
	select MPU
	select SRAM_REGION_PERMISSIONS
	select THREAD_STACK_INFO
	select ARCH_HAS_EXECUTABLE_PAGE_BIT if (CPU_AARCH32_CORTEX_R || CPU_CORTEX_M)
	select MPU_REQUIRES_POWER_OF_TWO_ALIGNMENT if !(CPU_HAS_NXP_SYSMPU || ARMV8_M_BASELINE || ARMV8_M_MAINLINE || AARCH32_ARMV8_R)
	select MPU_REQUIRES_NON_OVERLAPPING_REGIONS if CPU_HAS_ARM_MPU && (ARMV8_M_BASELINE || ARMV8_M_MAINLINE || AARCH32_ARMV8_R)
	select MPU_GAP_FILLING if AARCH32_ARMV8_R
	select ARCH_MEM_DOMAIN_SUPPORTS_ISOLATED_STACKS if (CPU_AARCH32_CORTEX_R || CPU_CORTEX_M)
	select ARCH_MEM_DOMAIN_SYNCHRONOUS_API if USERSPACE && CPU_AARCH64_CORTEX_R
	default y if CPU_AARCH64_CORTEX_R
	depends on CPU_HAS_MPU
	help
	  MCU implements Memory Protection Unit.

	  Notes:
	  The ARMv6-M, ARMv7-M, and ARMv8-R MPU MPU architecture requires a power-of-two
	  alignment of MPU region base address and size.

	  The NXP MPU as well as the ARMv8-M MPU do not require MPU regions
	  to have power-of-two alignment for base address and region size.

	  The ARMv8-M and ARMv8-R MPU requires the active MPU regions be non-overlapping.
	  As a result of this, both respective MPUs needs to fully partition the
	  memory map when programming dynamic memory regions (e.g. PRIV stack
	  guard, user thread stack, and application memory domains), if the
	  system requires PRIV access policy different from the access policy
	  of the ARMv8-M or ARMv8-R background memory map. The application developer may
	  enforce full PRIV (kernel) memory partition by enabling the
	  MPU_GAP_FILLING option.
	  By not enforcing full partition, MPU may leave part of kernel
	  SRAM area covered only by the default ARMv8-M or ARMv8-R memory map. This
	  is fine for User Mode, since the background ARM map does not
	  allow nPRIV access at all. However, since the background map
	  policy allows instruction fetches by privileged code, forcing
	  this Kconfig option off prevents the system from directly
	  triggering MemManage exceptions upon accidental attempts to
	  execute code from SRAM in XIP builds.
	  Since this does not compromise User Mode, we make the skipping
	  of full partitioning the default behavior for the ARMv8-M and ARMv8-R MPU
	  driver.

config ARM_PAC_PER_THREAD
	bool "Set cryptographically secure PAC key per thread"
	depends on ARM_PAC
	depends on ENTROPY_DEVICE_RANDOM_GENERATOR || TIMER_RANDOM_GENERATOR
	help
	  Select this option to generate and use unique keys per thread to generate Pointer
	  Authentication Code.
	  Internally, sys_csrand_get() is used as part of arch_new_thread() to generate
	  cryptographically secure random keys, which are saved in the thread's
	  architecture-specific context. These keys are then loaded into the PAC key registers
	  before switching to the thread during context switches.
	  Applications can chose to have hardware based random keys generator by selecting the right
	  generator from RNG_GENERATOR_CHOICE or by selecting TIMER_RANDOM_GENERATOR for testing
	  with pseudo random keys.
	  Note: GCC version 14.3 or higher is needed to support this option.

config ARM_PAC
	bool
	help
	  This option signifies that Pointer Authentication Code is enabled.

config ARM_BTI
	bool
	help
	  This option signifies that Branch Target Identification is enabled.

choice ARM_PACBTI
	prompt "Pointer Authentication and Branch Target Identification (PACBTI)"
	default ARM_PACBTI_NONE
	depends on ARMV8_1_M_MAINLINE
	help
	  Select a PACBTI configuration to enable the compiler to insert the required
	  Pointer Authentication and Branch Target Identification (PACBTI) instructions.
	  This also sets the necessary configuration options to enable PACBTI bits
	  in hardware.

config ARM_PACBTI_STANDARD
	bool "Standard (PACRET + LEAF + BTI)"
	select ARM_PAC
	select ARM_BTI
	help
	  This option instructs the compiler to generate code with all branch protection features
	  enabled at their standard level.

config ARM_PACBTI_PACRET
	bool "PACRET only"
	select ARM_PAC
	help
	  This option instructs the compiler to generate code with return address signing for
	  all functions that save the return address to memory.

config ARM_PACBTI_PACRET_LEAF
	bool "PACRET + Leaf"
	select ARM_PAC
	help
	  This option instructs the compiler to generate code with return address signing for
	  all functions that save the return address to memory and,
	  also sign leaf functions even if they do not write the return address to memory.

config ARM_PACBTI_BTI
	bool "BTI only"
	select ARM_BTI
	help
	  This option enables Branch Target Identification (BTI), which inserts special landing
	  pad instructions at valid indirect branch targets. This option does not enable Pointer
	  Authentication (PAC).

config ARM_PACBTI_PACRET_BTI
	bool "PACRET + BTI"
	select ARM_PAC
	select ARM_BTI
	help
	  This option instructs the compiler to generate code with return address signing for
	  all functions that save the return address to memory and,
	  add landing-pad instructions at the permitted targets of indirect branch instructions

config ARM_PACBTI_PACRET_LEAF_BTI
	bool "PACRET + Leaf + BTI"
	select ARM_PAC
	select ARM_BTI
	help
	  This option instructs the compiler to generate code with return address signing for
	  all functions that save the return address to memory and,
	  also sign leaf functions even if they do not write the return address to memory and,
	  add landing-pad instructions at the permitted targets of indirect branch instructions

config ARM_PACBTI_NONE
	bool "None"
	help
	This option instructs the compiler to generate code without branch protection or return
	address signing
endchoice
```

## arch/dspic/Kconfig
```kconfig
# Copyright (c) 2025, Microchip Technology Inc.
# SPDX-License-Identifier: Apache-2.0

menu "DSPIC Options"
	depends on DSPIC

config ARCH
	string
	default "dspic"

config GEN_ISR_TABLES
	default y

config DYNAMIC_INTERRUPTS
	default n

config NUM_IRQS
	default 279

config GEN_IRQ_START_VECTOR
	default 0

endmenu
```

## arch/microblaze/Kconfig
```kconfig
# Copyright (c) 2023 Advanced Micro Devices, Inc. (AMD)
# Copyright (c) 2023 Alp Sayin <alpsayin@gmail.com>
# SPDX-License-Identifier: Apache-2.0


menu "MicroBlaze Options"
	depends on MICROBLAZE

config ARCH
	string
	default "microblaze"

config CPU_MICROBLAZE
	bool
	default y
	help
		This option signifies the use of a MicroBlaze CPU

config CPU_VERSION
	prompt "MicroBlaze CPU Version"
	string
	default "v9.00.a"
	help
		Use features of, and schedule code for, the given CPU.
		Supported values are in the format "vX.YY.Z",
		where X is a major version, YY is the minor version, and Z is compatibility code.
		Example values are "v3.00.a", "v4.00.b", "v5.00.a", "v5.00.b", "v6.00.a".
		Taken from https://gcc.gnu.org/onlinedocs/gcc/MicroBlaze-Options.html

config GEN_IRQ_VECTOR_TABLE
	bool
	default n if MICROBLAZE
	help
		MicroBlaze has a single interrupt and therefore doesn't have an IRQ vector table.

config BIG_ENDIAN
	bool
	default n if MICROBLAZE
	help
		Our current default endianness is Little-endian.

config ARCH_SW_ISR_TABLE_ALIGN
	prompt "SW_ISR Table Align Size"
	default 4

config NUM_IRQS
	int
	default 1
	help
		This isn't really a choice either because a barebones MicroBlaze offers
		only 1 external interrupt pin (which is usually connected to an Xlnx Intc
		or probably a single peripheral which a user wants IRQs from).

choice
	prompt "Idle Sleep Option"
	default MICROBLAZE_IDLE_NOP

	config MICROBLAZE_IDLE_NOP
		bool "NOP (no power saving)"
		help
			Executes pseudo-assembly instruction nop in idle.
			Reset_Mode[0:1] is set to 10

	config MICROBLAZE_IDLE_SLEEP
		bool "Sleep"
		help
			Executes pseudo-assembly instruction sleep in idle.
			Reset_Mode[0:1] is set to 10

	config MICROBLAZE_IDLE_HIBERNATE
		bool "Hibernate"
		help
			Executes pseudo-assembly instruction hibernate in idle.

	config MICROBLAZE_IDLE_SUSPEND
		bool "Suspend"
		help
			Executes pseudo-assembly instruction suspend in idle.
endchoice

config MICROBLAZE_DUMP_ON_EXCEPTION
	bool "Dump core on exceptions"
	default y

config EXTRA_EXCEPTION_INFO
	bool "Extra exception debug information"
	default y
	help
	  Have exceptions print additional useful debugging information in
	  human-readable form, at the expense of code size. For example,
	  the cause code for an exception will be supplemented by a string
	  describing what that cause code means.

# Bump the kernel default stack size values.
config MAIN_STACK_SIZE
	default 4096 if COVERAGE_GCOV
	default 2048

config IDLE_STACK_SIZE
	default 1024

config ISR_STACK_SIZE
	default 4096

config TEST_EXTRA_STACK_SIZE
	default 4096 if COVERAGE_GCOV
	default 2048

config SYSTEM_WORKQUEUE_STACK_SIZE
	default 4096

source "arch/microblaze/Kconfig.features"

endmenu
```

## arch/microblaze/Kconfig.features
```kconfig
# Copyright (c) 2023 Advanced Micro Devices, Inc. (AMD)
# Copyright (c) 2023 Alp Sayin <alpsayin@gmail.com>
# SPDX-License-Identifier: Apache-2.0


menu "HW Feature Options"
	depends on MICROBLAZE

# Picolibc with C++ support in Zephyr SDK is handled by Zephyr SDK's own Kconfig.
config PICOLIBC_SUPPORTED
	bool
	default n
	help
		Microblaze doesn't have picolibc support yet

config MICROBLAZE_USE_MSR_INSTR
	prompt "Use msrset & msrclr instructions"
	def_bool y
	help
		This depends on CPU supporting msrset/msrclr instructions.
		xparameters would define this as MICROBLAZE_USE_MSR_INSTR = 1.

config MICROBLAZE_USE_BARREL_SHIFT_INSTR
	prompt "Use barrel shift instructions"
	def_bool y
	help
		This depends on CPU supporting barrel shift instructions.
		xparameters would define this as USE_BARREL = 1.

config MICROBLAZE_USE_PATTERN_COMPARE_INSTR
	prompt "Use pattern compare instructions"
	def_bool y
	help
		This depends on CPU supporting pattern compare instructions.
		xparameters would define this as USE_PCMP = 1.

config MICROBLAZE_USE_DIV_INSTR
	prompt "Use division instructions"
	def_bool y
	help
		This depends on CPU supporting hardware division instructions.
		xparameters would define this as USE_DIV = 1.

config MICROBLAZE_USE_MUL_INSTR
	prompt "Use multiplication instructions"
	def_bool y
	help
		This depends on CPU supporting hardware multiplication instructions.
		xparameters would define this as USE_HW_MUL >= 1.

config MICROBLAZE_USE_MULHI_INSTR
	prompt "Use mulhi for multiplication of higher bits"
	def_bool y
	depends on MICROBLAZE_USE_MUL_INSTR
	help
		Use multiply high instructions for high part of 32x32 multiply.
		This depends on CPU supporting hardware high multiplication instructions.
		xparameters would define this as USE_HW_MUL = 2.

config MICROBLAZE_USE_HARDWARE_FLOAT_INSTR
	def_bool n
	depends on CPU_HAS_FPU
	help
		This depends on CPU supporting hardware float instructions.
		xparameters would define this as USE_FPU = 1.

config MICROBLAZE_DATA_IS_TEXT_RELATIVE
	bool "Assume data & text segment distance is static"
	default y
	help
		Assume that the displacement between the text and data segments is fixed at
		static link time. This allows data to be referenced by offset from start of
		text address instead of GOT (r20) since PC-relative addressing is not supported.
		Injects -mpic-data-is-text-relative

endmenu
```

## arch/mips/Kconfig
```kconfig
#
# Copyright (c) 2020 Antony Pavlov <antonynpavlov@gmail.com>
#
# based on arch/riscv/Kconfig
#
# SPDX-License-Identifier: Apache-2.0
#

menu "MIPS Options"
	depends on MIPS

config ARCH
	string
	default "mips"

config GEN_ISR_TABLES
	default y

config GEN_IRQ_VECTOR_TABLE
	default n

config GEN_SW_ISR_TABLE
	default y

config NUM_IRQS
	int

# Bump the kernel default stack size values.
config MAIN_STACK_SIZE
	default 4096 if COVERAGE_GCOV
	default 2048

config IDLE_STACK_SIZE
	default 1024

config ISR_STACK_SIZE
	default 4096

config TEST_EXTRA_STACK_SIZE
	default 4096 if COVERAGE_GCOV
	default 2048

config SYSTEM_WORKQUEUE_STACK_SIZE
	default 4096

config CMSIS_THREAD_MAX_STACK_SIZE
	default 2048

config CMSIS_V2_THREAD_MAX_STACK_SIZE
	default 2048

config CMSIS_V2_THREAD_DYNAMIC_STACK_SIZE
	default 2048

config IPM_CONSOLE_STACK_SIZE
	default 4096 if COVERAGE
	default 1024

endmenu
```

## arch/mips/soc/danube/Kconfig.defconfig
```kconfig
if SOC_DANUBE

config SOC
	string
	default "danube"

config SYS_CLOCK_HW_CYCLES_PER_SEC
	int
	default 550000000

config SOC_FAMILY_MIPS
	bool
	default y

config MIPS_CORE_TIMER
	bool
	default y

config MIPS_SOC_CONTEXT_SAVE
	bool
	default y

config MIPS_SOC_INTERRUPT_INIT
	bool
	default y

config MIPS_HAS_CPU_IDLE
	bool
	default n

config GEN_SW_ISR_TABLE
	bool
	default y

config GEN_IRQ_VECTOR_TABLE
	bool
	default n

config GEN_ISR_TABLES
	bool
	default y

config NUM_IRQS
	int
	default 8

if UART

config UART_DANUBE
	bool
	default y

config UART_DANUBE_PORT_0
	bool
	default y

config UART_DANUBE_PORT_1
	bool
	default n

if UART_DANUBE_PORT_0

config UART_DANUBE_PORT_0_NAME
	string
	default "UART_0"

config UART_DANUBE_PORT_0_IRQ_PRI
	int
	default 0

config UART_DANUBE_PORT_0_BAUD_RATE
	int
	default 115200

config UART_DANUBE_PORT_0_BASE_ADDRESS
	hex
	default 0xb8101400

config UART_DANUBE_PORT_0_OPTIONS
	int
	default 0

endif # UART_DANUBE_PORT_0


if UART_DANUBE_PORT_1

config UART_DANUBE_PORT_1_NAME
	string
	default "UART_1"

config UART_DANUBE_PORT_1_IRQ_PRI
	int
	default 0

config UART_DANUBE_PORT_1_BAUD_RATE
	int
	default 115200

config UART_DANUBE_PORT_1_BASE_ADDRESS
	hex
	default 0xb8101500

config UART_DANUBE_PORT_1_OPTIONS
	int
	default 0

endif # UART_DANUBE_PORT_1

endif # UART

endif # SOC_DANUBE
```
