## arch/arm/soc/atmel_sam0/samd21/Kconfig.series
```kconfig
# Kconfig - Atmel SAMD21 MCU series
#
# Copyright (c) 2017 Google LLC.
# SPDX-License-Identifier: Apache-2.0

config SOC_SERIES_SAMD21
	bool "Atmel SAMD21 MCU"
	select CPU_CORTEX_M0PLUS
	select SOC_FAMILY_SAM0
	select SYS_POWER_LOW_POWER_STATE_SUPPORTED
	select CPU_HAS_SYSTICK
	select ASF
	help
	  Enable support for Atmel SAMD21 Cortex-M0+ microcontrollers.
```

## arch/arm/soc/atmel_sam0/samd21/Kconfig.soc
```kconfig
# Kconfig - Atmel SAMD MCU series
#
# Copyright (c) 2017 Google LLC.
# SPDX-License-Identifier: Apache-2.0

choice
prompt "Atmel SAMD21 MCU Selection"
depends on SOC_SERIES_SAMD21

config SOC_PART_NUMBER_SAMD21E15A
	bool "SAMD21E15A"

config SOC_PART_NUMBER_SAMD21E16A
	bool "SAMD21E16A"

config SOC_PART_NUMBER_SAMD21E17A
	bool "SAMD21E17A"

config SOC_PART_NUMBER_SAMD21E18A
	bool "SAMD21E18A"

config SOC_PART_NUMBER_SAMD21G15A
	bool "SAMD21G15A"

config SOC_PART_NUMBER_SAMD21G16A
	bool "SAMD21G16A"

config SOC_PART_NUMBER_SAMD21G17A
	bool "SAMD21G17A"

config SOC_PART_NUMBER_SAMD21G17AU
	bool "SAMD21G17AU"

config SOC_PART_NUMBER_SAMD21G18A
	bool "SAMD21G18A"

config SOC_PART_NUMBER_SAMD21G18AU
	bool "SAMD21G18AU"

config SOC_PART_NUMBER_SAMD21J15A
	bool "SAMD21J15A"

config SOC_PART_NUMBER_SAMD21J16A
	bool "SAMD21J16A"

config SOC_PART_NUMBER_SAMD21J17A
	bool "SAMD21J17A"

config SOC_PART_NUMBER_SAMD21J18A
	bool "SAMD21J18A"

endchoice

if SOC_SERIES_SAMD21

config SOC_ATMEL_SAMD_XOSC32K
	bool "Enable the external 32 kHz crystal oscillator"
	help
	  Say y to enable the external 32 kHZ crystal oscillator at
	  startup.  This can then be selected as the main clock source
	  for the SOC.

config SOC_ATMEL_SAMD_XOSC
	bool "Enable the external crystal oscillator"
	help
	  Say y to enable the external crystal oscillator at startup.

choice
	prompt "Main clock source"
	help
	  Selects the clock that the main clocks, such as the CPU
	  clock and AHB clock, will be derived from.

config SOC_ATMEL_SAMD_XOSC32K_AS_MAIN
	depends on SOC_ATMEL_SAMD_XOSC32K
	bool "XOSC32K"

config SOC_ATMEL_SAMD_XOSC_AS_MAIN
	depends on SOC_ATMEL_SAMD_XOSC
	bool "XOSC"

config SOC_ATMEL_SAMD_OSC8M_AS_MAIN
	bool "OSC8M"

endchoice

endif # SOC_SERIES_SAMD21
```
