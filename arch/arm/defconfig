## arch/arm/defconfig
```kconfig
CONFIG_ARM=y
CONFIG_SYS_CLOCK_HW_CYCLES_PER_SEC=12000000
CONFIG_CONSOLE=y
CONFIG_UART_CONSOLE=y
CONFIG_SERIAL=y
CONFIG_CORTEX_M_SYSTICK=y
CONFIG_FLASH_SIZE=256
CONFIG_SRAM_SIZE=64
```

## arch/arm/fsl_frdm_k64f/Kconfig
```kconfig
# Kconfig - FSL FRDM K64F BSP configuration options

#
# Copyright (c) 2014-2015 Wind River Systems, Inc.
#
# Redistribution and use in source and binary forms, with or without
# modification, are permitted provided that the following conditions are met:
#
# 1) Redistributions of source code must retain the above copyright notice,
# this list of conditions and the following disclaimer.
#
# 2) Redistributions in binary form must reproduce the above copyright notice,
# this list of conditions and the following disclaimer in the documentation
# and/or other materials provided with the distribution.
#
# 3) Neither the name of Wind River Systems nor the names of its contributors
# may be used to endorse or promote products derived from this software without
# specific prior written permission.
#
# THIS SOFTWARE IS PROVIDED BY THE COPYRIGHT HOLDERS AND CONTRIBUTORS "AS IS"
# AND ANY EXPRESS OR IMPLIED WARRANTIES, INCLUDING, BUT NOT LIMITED TO, THE
# IMPLIED WARRANTIES OF MERCHANTABILITY AND FITNESS FOR A PARTICULAR PURPOSE
# ARE DISCLAIMED. IN NO EVENT SHALL THE COPYRIGHT HOLDER OR CONTRIBUTORS BE
# LIABLE FOR ANY DIRECT, INDIRECT, INCIDENTAL, SPECIAL, EXEMPLARY, OR
# CONSEQUENTIAL DAMAGES (INCLUDING, BUT NOT LIMITED TO, PROCUREMENT OF
# SUBSTITUTE GOODS OR SERVICES; LOSS OF USE, DATA, OR PROFITS; OR BUSINESS
# INTERRUPTION) HOWEVER CAUSED AND ON ANY THEORY OF LIABILITY, WHETHER IN
# CONTRACT, STRICT LIABILITY, OR TORT (INCLUDING NEGLIGENCE OR OTHERWISE)
# ARISING IN ANY WAY OUT OF THE USE OF THIS SOFTWARE, EVEN IF ADVISED OF THE
# POSSIBILITY OF SUCH DAMAGE.
#

config PLATFORM
	string
	default fsl_frdm_k64f
	help
	This option holds the directory name used by sysgen to identify
	the location of the config1p.mdef file and is used by the build system
	to locate the correct linker file.

config NUM_IRQ_PRIO_BITS
	int
	default 4

config NUM_IRQS
	int
	# must be >= the highest interrupt number used
	default 34

config SYS_CLOCK_HW_CYCLES_PER_SEC
	int
	default 25000000

config WDOG_INIT
	def_bool y
	# omit prompt to signify a "hidden" option
	help
	This processor enables the watchdog timer with a short timeout
	upon reset. Therefore, this requires that the watchdog be configured
	during reset handling.
```

## arch/arm/platforms/fsl_frdm_k64f/Kconfig
```kconfig
# Kconfig - FSL FRDM K64F platform configuration options

#
# Copyright (c) 2014-2015 Wind River Systems, Inc.
#
# Licensed under the Apache License, Version 2.0 (the "License");
# you may not use this file except in compliance with the License.
# You may obtain a copy of the License at
#
#     http://www.apache.org/licenses/LICENSE-2.0
#
# Unless required by applicable law or agreed to in writing, software
# distributed under the License is distributed on an "AS IS" BASIS,
# WITHOUT WARRANTIES OR CONDITIONS OF ANY KIND, either express or implied.
# See the License for the specific language governing permissions and
# limitations under the License.
#

if PLATFORM_FSL_FRDM_K64F
config PLATFORM
	default fsl_frdm_k64f

config NUM_IRQ_PRIO_BITS
	int
	default 4

config NUM_IRQS
	int
	# must be >= the highest interrupt number used
	default 86

config SYS_CLOCK_HW_CYCLES_PER_SEC
	int
	default 25000000

config WDOG_INIT
	def_bool y
	# omit prompt to signify a "hidden" option
	help
	This processor enables the watchdog timer with a short timeout
	upon reset. Therefore, this requires that the watchdog be configured
	during reset handling.

config KERNEL_INIT_PRIORITY_DEFAULT
	default 40

config KERNEL_INIT_PRIORITY_DEVICE
	default 50

config UART_CONSOLE_PRIORITY
	default 60

if UART_K20

config UART_K20_PORT_0
	def_bool y

if UART_K20_PORT_0
config UART_K20_PORT_0_BASE_ADDR
	default 0x4006A000
config UART_K20_PORT_0_IRQ
	default 31
config UART_K20_PORT_0_IRQ_PRI
	default 3
config UART_K20_PORT_0_BAUD_RATE
	default 115200
config UART_K20_PORT_0_CLK_FREQ
	default 120000000
endif

config UART_K20_PORT_1
	def_bool y

if UART_K20_PORT_1
config UART_K20_PORT_1_BASE_ADDR
	default 0x4006B000
config UART_K20_PORT_1_IRQ
	default 33
config UART_K20_PORT_1_IRQ_PRI
	default 3
config UART_K20_PORT_1_BAUD_RATE
	default 115200
config UART_K20_PORT_1_CLK_FREQ
	default 120000000
endif

config UART_K20_PORT_2
	def_bool y
if UART_K20_PORT_2
config UART_K20_PORT_2_BASE_ADDR
	default 0x4006C000
config UART_K20_PORT_2_IRQ
	default 35
config UART_K20_PORT_2_IRQ_PRI
	default 3
config UART_K20_PORT_2_BAUD_RATE
	default 115200
config UART_K20_PORT_2_CLK_FREQ
	default 120000000
endif

config UART_K20_PORT_3
	def_bool y
if UART_K20_PORT_3
config UART_K20_PORT_3_BASE_ADDR
	default 0x4006D000
config UART_K20_PORT_3_IRQ
	default 37
config UART_K20_PORT_3_IRQ_PRI
	default 3
config UART_K20_PORT_3_BAUD_RATE
	default 115200
config UART_K20_PORT_3_CLK_FREQ
	default 120000000
endif

config UART_K20_PORT_4
	def_bool y
if UART_K20_PORT_4
config UART_K20_PORT_4_BASE_ADDR
	default 0x400EA000
config UART_K20_PORT_4_IRQ
	default 66
config UART_K20_PORT_4_IRQ_PRI
	default 3
config UART_K20_PORT_4_BAUD_RATE
	default 115200
config UART_K20_PORT_4_CLK_FREQ
	default 120000000
endif

endif # UART_K20

if UART_CONSOLE

config UART_CONSOLE_ON_DEV_NAME
	default "UART_0"
config UART_CONSOLE_IRQ
	default 31
config UART_CONSOLE_IRQ_PRI
	default 3

endif

if BLUETOOTH_UART

config BLUETOOTH_UART_ON_DEV_NAME
	default "UART_1"
config BLUETOOTH_UART_IRQ
	default 33
config BLUETOOTH_UART_IRQ_PRI
	default 3

endif

endif
```

## arch/arm/platforms/fsl_frdm_k64f/Kconfig.platform
```kconfig
config  PLATFORM_FSL_FRDM_K64F
	bool "FSL FRDM K64F"
	select CPU_CORTEX_M
	select CPU_CORTEX_M4
```

## arch/arm/platforms/qemu_arm/Kconfig.platform
```kconfig
config  PLATFORM_QEMU_ARM
	bool "QEMU for ARM"
	select CPU_CORTEX_M
	select CPU_CORTEX_M3
```

## arch/arm/platforms/ti_lm3s6965/Kconfig
```kconfig
# Kconfig - TI LM3S6965 platform configuration options

#
# Copyright (c) 2014-2015 Wind River Systems, Inc.
#
# Licensed under the Apache License, Version 2.0 (the "License");
# you may not use this file except in compliance with the License.
# You may obtain a copy of the License at
#
#     http://www.apache.org/licenses/LICENSE-2.0
#
# Unless required by applicable law or agreed to in writing, software
# distributed under the License is distributed on an "AS IS" BASIS,
# WITHOUT WARRANTIES OR CONDITIONS OF ANY KIND, either express or implied.
# See the License for the specific language governing permissions and
# limitations under the License.
#

if PLATFORM_TI_LM3S6965
config PLATFORM
	string
	default ti_lm3s6965
	help
	This option holds the directory name used by the build system to locate
	the correct linker file.

config NUM_IRQ_PRIO_BITS
	int
	default 3

config NUM_IRQS
	int
	# must be >= the highest interrupt number used
	# - include the UART interrupts
	default 34

config PLATFORM_TI_LM3S6965_QEMU
	def_bool y
	# Platform has only been tested on QEMU, not on real hardware, so always
	# assume it is used for a QEMU target.

config SYS_CLOCK_HW_CYCLES_PER_SEC
	int
	default 12000000

config KERNEL_INIT_PRIORITY_DEFAULT
	default 40

config KERNEL_INIT_PRIORITY_DEVICE
	default 50

config UART_CONSOLE_PRIORITY
	default 60

config IPI_CONSOLE_PRIORITY
	default 60

if UART_STELLARIS

config UART_STELLARIS_PORT_0
	def_bool y

if UART_STELLARIS_PORT_0
config UART_STELLARIS_PORT_0_BASE_ADDR
	default 0x4000C000
config UART_STELLARIS_PORT_0_IRQ
	default 6
config UART_STELLARIS_PORT_0_BAUD_RATE
	default 115200
config UART_STELLARIS_PORT_0_CLK_FREQ
	default 12000000
endif

config UART_STELLARIS_PORT_1
	def_bool y

if UART_STELLARIS_PORT_1
config UART_STELLARIS_PORT_1_BASE_ADDR
	default 0x4000D000
config UART_STELLARIS_PORT_1_IRQ
	default 6
config UART_STELLARIS_PORT_1_BAUD_RATE
	default 115200
config UART_STELLARIS_PORT_1_CLK_FREQ
	default 12000000
endif

config UART_STELLARIS_PORT_2
	def_bool y
if UART_STELLARIS_PORT_2
config UART_STELLARIS_PORT_2_BASE_ADDR
	default 0x4000E000
config UART_STELLARIS_PORT_2_IRQ
	default 33
config UART_STELLARIS_PORT_2_BAUD_RATE
	default 115200
config UART_STELLARIS_PORT_2_CLK_FREQ
	default 12000000
endif

endif # UART_STELLARIS

endif
```

## arch/arm/soc/arm/Kconfig
```kconfig
# Kconfig - ARM LTD SoC configuration options
#
# Copyright (c) 2016 Linaro Limited
#
# SPDX-License-Identifier: Apache-2.0
#

config SOC_FAMILY_ARM
	bool
	# omit prompt to signify a "hidden" option
	default n

if SOC_FAMILY_ARM
config SOC_FAMILY
	string
	default arm
endif

source "arch/arm/soc/arm/*/Kconfig.soc"
```

## arch/arm/soc/arm/Kconfig.soc
```kconfig
# Kconfig - ARM LTD SoC configuration options
#
# Copyright (c) 2016 Linaro Limited
#
# SPDX-License-Identifier: Apache-2.0
#

source "arch/arm/soc/arm/*/Kconfig.series"
```

## arch/arm/soc/arm/beetle/Kconfig.defconfig.beetle_r0
```kconfig
# Kconfig - ARM LTD Beetle SoC configuration options

#
# Copyright (c) 2016 Linaro Limited
#
# SPDX-License-Identifier: Apache-2.0
#

if SOC_BEETLE_R0

config SOC
	default "beetle_r0"

endif # SOC_BEETLE_R0
```

## arch/arm/soc/arm/beetle/Kconfig.defconfig.series
```kconfig
# Kconfig - ARM LTD Beetle SoC configuration options

#
# Copyright (c) 2016 Linaro Limited
#
# SPDX-License-Identifier: Apache-2.0
#

if SOC_SERIES_BEETLE

source "arch/arm/soc/arm/beetle/Kconfig.defconfig.beetle*"

config SOC_SERIES
	default beetle

if !HAS_DTS

config NUM_IRQ_PRIO_BITS
	int
	default 3

config NUM_IRQS
	int
	default 45

config SRAM_BASE_ADDRESS
	default 0x20000000

config FLASH_BASE_ADDRESS
	default 0x00000000

endif # !HAS_DTS

config SYS_CLOCK_HW_CYCLES_PER_SEC
	int
	default 24000000

endif # SOC_SERIES_BEETLE
```

## arch/arm/soc/arm/beetle/Kconfig.soc
```kconfig
# Kconfig - ARM LTD Beetle SoC configuration options

#
# Copyright (c) 2016 Linaro Limited
#
# SPDX-License-Identifier: Apache-2.0
#

choice
prompt "ARM Beetle SoC"
depends on SOC_SERIES_BEETLE

config SOC_BEETLE_R0
	bool "ARM BEETLE R0"

endchoice

config ARM_MPU_ENABLE
	bool "Enable MPU on ARM Beetle"
	depends on CPU_HAS_MPU
	select ARM_MPU
	help
	  Enable MPU support on ARM Beetle SoCs
```

## arch/arm/soc/arm/mps2/Kconfig.defconfig.mps2_an385
```kconfig
#
# Copyright (c) 2017 Linaro Limited
#
# SPDX-License-Identifier: Apache-2.0
#

if SOC_MPS2_AN385

config SOC
	default mps2_an385

config NUM_IRQS
	int
	default 32

endif
```

## arch/arm/soc/arm/mps2/Kconfig.defconfig.series
```kconfig
#
# Copyright (c) 2017 Linaro Limited
#
# SPDX-License-Identifier: Apache-2.0
#

if SOC_SERIES_MPS2

config SOC_SERIES
	default mps2

config NUM_IRQ_PRIO_BITS
	int
	default 3

config SYS_CLOCK_HW_CYCLES_PER_SEC
	int
	default 25000000

config SRAM_BASE_ADDRESS
	default 0x20000000

config SRAM_SIZE
	default 4096

config FLASH_BASE_ADDRESS
	default 0x00000000

config FLASH_SIZE
	default 4096

source "arch/arm/soc/arm/mps2/Kconfig.defconfig.mps2*"

endif # SOC_SERIES_MPS2
```

## arch/arm/soc/arm/mps2/Kconfig.series
```kconfig
#
# Copyright (c) 2017 Linaro Limited
#
# SPDX-License-Identifier: Apache-2.0
#

config SOC_SERIES_MPS2
	bool "ARM MPS2 MCU Series"
	depends on ARM
	select SOC_FAMILY_ARM
	select CPU_HAS_SYSTICK
	select GPIO_MMIO32 if GPIO
	help
	  Enable support for ARM MPS2 MCU Series
```

## arch/arm/soc/atmel_sam/Kconfig
```kconfig
# Kconfig - Atmel SAM MCU family configuration options
#
# Copyright (c) 2016 Piotr Mienkowski
# SPDX-License-Identifier: Apache-2.0

config SOC_FAMILY_SAM
	bool
	# omit prompt to signify a "hidden" option
	default n

if SOC_FAMILY_SAM

config SOC_FAMILY
	string
	default atmel_sam

endif #SOC_FAMILY_SAM

# Select SoC Part No. and configuration options
source "arch/arm/soc/atmel_sam/*/Kconfig.soc"
```

## arch/arm/soc/atmel_sam/Kconfig.defconfig
```kconfig
# Kconfig - Atmel SAM MCU family default configuration options
#
# Copyright (c) 2016 Piotr Mienkowski
# SPDX-License-Identifier: Apache-2.0
#

source "arch/arm/soc/atmel_sam/*/Kconfig.defconfig.series"

if SOC_FAMILY_SAM

config WATCHDOG
	def_bool y

endif
```

## arch/arm/soc/atmel_sam/Kconfig.soc
```kconfig
# Kconfig - Atmel SAM MCU series selection
#
# Copyright (c) 2016 Piotr Mienkowski
# SPDX-License-Identifier: Apache-2.0
#

source "arch/arm/soc/atmel_sam/*/Kconfig.series"
```

## arch/arm/soc/atmel_sam/sam3x/Kconfig.defconfig.series
```kconfig
# Kconfig - Atmel SAM3X MCU series configuration options
#
# Copyright (c) 2017 Justin Watson
# Copyright (c) 2016 Intel Corporation.
# Copyright (c) 2014-2015 Wind River Systems, Inc.
# SPDX-License-Identifier: Apache-2.0
#

if SOC_SERIES_SAM3X

config SOC_SERIES
	string
	default "sam3x"

config SOC_PART_NUMBER
	string
	default "sam3x8e" if SOC_PART_NUMBER_SAM3X8E

#
# SAM3 family has total 45 peripherals capable of
# generating interrupts.
#
config NUM_IRQS
	int
	default 45

config SYS_CLOCK_HW_CYCLES_PER_SEC
	int
	default 84000000

endif # SOC_SERIES_SAM3X
```

## arch/arm/soc/atmel_sam/sam4s/Kconfig.defconfig.series
```kconfig
# Kconfig - Atmel SAM4S MCU series configuration options
#
# Copyright (c) 2017 Justin Watson
#
# SPDX-License-Identifier: Apache-2.0
#

if SOC_SERIES_SAM4S

config SOC_SERIES
	string
	default sam4s

config SOC_PART_NUMBER
	string
	default sam4s16c if SOC_PART_NUMBER_SAM4S16C

#
# SAM4S family has total 35 peripherals capable of
# generating interrupts.
#
config NUM_IRQS
	int
	default 35

config SYS_CLOCK_HW_CYCLES_PER_SEC
	int
	default 120000000

endif # SOC_SERIES_SAM4S
```

## arch/arm/soc/atmel_sam/same70/Kconfig.defconfig.series
```kconfig
# Kconfig - Atmel SAM E70 MCU series configuration options
#
# Copyright (c) 2016 Piotr Mienkowski
# SPDX-License-Identifier: Apache-2.0
#

if SOC_SERIES_SAME70

config SOC_SERIES
	string
	default same70

config SOC_PART_NUMBER
	string
	default same70q21 if SOC_PART_NUMBER_SAME70Q21
	default same70q20 if SOC_PART_NUMBER_SAME70Q20
	default same70q19 if SOC_PART_NUMBER_SAME70Q19
	default same70n21 if SOC_PART_NUMBER_SAME70N21
	default same70n20 if SOC_PART_NUMBER_SAME70N20
	default same70n19 if SOC_PART_NUMBER_SAME70N19
	default same70j21 if SOC_PART_NUMBER_SAME70J21
	default same70j20 if SOC_PART_NUMBER_SAME70J20
	default same70j19 if SOC_PART_NUMBER_SAME70J19

config NUM_IRQ_PRIO_BITS
	int
	default 3

#
# SAM E70 family has in total 71 peripherals capable of generating interrupts
# (not all Peripheral Identifiers are used).
#
config NUM_IRQS
	int
	default 71

config SYS_CLOCK_HW_CYCLES_PER_SEC
	int
	default 300000000

#
# SRAM size and base address
#
config SRAM_BASE_ADDRESS
	hex
	default 0x20400000

config SRAM_SIZE
	int
	default 256 if SOC_PART_NUMBER_SAME70Q19 || SOC_PART_NUMBER_SAME70N19 || SOC_PART_NUMBER_SAME70J19
	default 384 if SOC_PART_NUMBER_SAME70Q20 || SOC_PART_NUMBER_SAME70N20 || SOC_PART_NUMBER_SAME70J20
	default 384 if SOC_PART_NUMBER_SAME70Q21 || SOC_PART_NUMBER_SAME70N21 || SOC_PART_NUMBER_SAME70J21

#
# Flash size and base address
#
config FLASH_BASE_ADDRESS
	hex
	default 0x00400000

config FLASH_SIZE
	int
	default  512 if SOC_PART_NUMBER_SAME70Q19 || SOC_PART_NUMBER_SAME70N19 || SOC_PART_NUMBER_SAME70J19
	default 1024 if SOC_PART_NUMBER_SAME70Q20 || SOC_PART_NUMBER_SAME70N20 || SOC_PART_NUMBER_SAME70J20
	default 2048 if SOC_PART_NUMBER_SAME70Q21 || SOC_PART_NUMBER_SAME70N21 || SOC_PART_NUMBER_SAME70J21

endif # SOC_SERIES_SAME70
```

## arch/arm/soc/atmel_sam0/Kconfig
```kconfig
# Kconfig - Atmel SAM0 MCU family configuration options
#
# Copyright (c) 2017 Google LLC.
# SPDX-License-Identifier: Apache-2.0

config SOC_FAMILY_SAM0
	bool
	default n

if SOC_FAMILY_SAM0

config SOC_FAMILY
	string
	default "atmel_sam0"


gsource "arch/arm/soc/atmel_sam0/*/Kconfig.soc"
endif # SOC_FAMILY_SAM0
```

## arch/arm/soc/atmel_sam0/Kconfig.defconfig
```kconfig
# Kconfig - Atmel SAM0 MCU family default configuration options
#
# Copyright (c) 2017 Google LLC.
# SPDX-License-Identifier: Apache-2.0

source "arch/arm/soc/atmel_sam0/*/Kconfig.defconfig.series"
```
