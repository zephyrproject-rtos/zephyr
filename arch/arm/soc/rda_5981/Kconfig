## arch/arm/soc/rda_5981/Kconfig
```kconfig
#
# Copyright (c) 2017 RDA
#
# SPDX-License-Identifier: Apache-2.0
#

config SOC_FAMILY_RDA5981
	bool
	# omit prompt to signify a "hidden" option
	default n

if SOC_FAMILY_RDA5981
config SOC_FAMILY
	string
	default rda_5981

config SOC_RDA_DEBUG
	bool
	prompt "Use for RDA SOC DBG"
	default n
	help
	say y if you want to print the verbose debugging messages.
endif

source "arch/arm/soc/rda_5981/*/Kconfig.soc"
```

## arch/arm/soc/rda_5981/Kconfig.defconfig
```kconfig
#
# Copyright (c) 2017 RDA
#
# SPDX-License-Identifier: Apache-2.0
#

source "arch/arm/soc/rda_5981/*/Kconfig.defconfig.series"

if SOC_FAMILY_RDA5981

config SRAM_BASE_ADDRESS
	default 0x100080

config FLASH_BASE_ADDRESS
	default 0x018001000

endif # SOC_FAMILY_RDA5981
```

## arch/arm/soc/rda_5981/Kconfig.soc
```kconfig
#
# Copyright (c) 2017 RDA
#
# SPDX-License-Identifier: Apache-2.0
#

source "arch/arm/soc/rda_5981/*/Kconfig.series"
```

## arch/arm/soc/silabs_exx32/Kconfig
```kconfig
#
# Copyright (c) 2017 Christian Taedcke
#
# SPDX-License-Identifier: Apache-2.0
#

config SOC_FAMILY_EXX32
	bool
	# omit prompt to signify a "hidden" option
	default n

if SOC_FAMILY_EXX32
config SOC_FAMILY
	string
	default "silabs_exx32"
endif

source "arch/arm/soc/silabs_exx32/*/Kconfig.soc"

config SOC_PART_NUMBER
	string
	default SOC_PART_NUMBER_EXX32_EFM32WG if SOC_SERIES_EFM32WG
	help
	  This string holds the full part number of the SoC. It is a hidden option
	  that you should not set directly. The part number selection choice defines
	  the default value for this string.

config HAS_CMU
	bool
	default n
	help
	  Set if the clock management unit (CMU) is present in the SoC.

if HAS_CMU

choice
	prompt "High Frequency Clock Selection"
	default CMU_HFCLK_HFXO

config CMU_HFCLK_HFXO
	bool "External high frequency crystal oscillator"
	help
	  Set this option to use the external high frequency crystal oscillator
	  as high frequency clock.

config CMU_HFCLK_LFXO
	bool "External low frequency crystal oscillator"
	help
	  Set this option to use the external low frequency crystal oscillator
	  as high frequency clock.

config CMU_HFCLK_HFRCO
	bool "Internal high frequency RC oscillator"
	help
	  Set this option to use the internal high frequency RC oscillator as high frequency clock.

endchoice

config CMU_HFXO_FREQ
	int "External high frequency oscillator frequency"
	help
	  Set the external high frequency oscillator frequency in Hz. This should be set by the
	  board's defconfig.

config CMU_LFXO_FREQ
	int "External low frequency oscillator frequency"
	help
	  Set the external low frequency oscillator frequency in Hz. This should be set by the
	  board's defconfig.

endif # HAS_CMU
```

## arch/arm/soc/silabs_exx32/Kconfig.soc
```kconfig
#
# Copyright (c) 2017 Christian Taedcke
#
# SPDX-License-Identifier: Apache-2.0
#

source "arch/arm/soc/silabs_exx32/*/Kconfig.series"
```

## arch/arm/soc/silabs_exx32/efm32pg12b/Kconfig.defconfig.efm32pg12b
```kconfig
# Kconfig - Silicon Labs EFM32PG-STK3402A platform configuration options

#
# Copyright (c) 2017 Christian Taedcke
#
# SPDX-License-Identifier: Apache-2.0
#

if SOC_EFM32PG12B

config SOC
	string
	default efm32pg12b

config GPIO
	def_bool y

if GPIO

config GPIO_GECKO
	def_bool y

endif # GPIO

if SERIAL

config USART_GECKO
	def_bool y

endif # SERIAL

endif # SOC_EFM32
```

## arch/arm/soc/silabs_exx32/efm32wg/Kconfig.defconfig.efm32wg
```kconfig
# Kconfig - Silicon Labs EFM32WG-STK3800 platform configuration options

#
# Copyright (c) 2017 Christian Taedcke
#
# SPDX-License-Identifier: Apache-2.0
#

if SOC_EFM32WG

config SOC
	string
	default "efm32wg"

config GPIO
	def_bool y

if GPIO

config GPIO_GECKO
	def_bool y

endif # GPIO

if SERIAL

config UART_GECKO
	def_bool y

endif # SERIAL

endif # SOC_EFM32
```

## arch/arm/soc/silabs_exx32/efm32wg/Kconfig.soc
```kconfig
# Kconfig - EFM32WG MCU line
#
# Copyright (c) 2017 Christian Taedcke
#
# SPDX-License-Identifier: Apache-2.0
#

choice
prompt "EFM32 Wonder Gecko MCU Selection"
depends on SOC_SERIES_EFM32WG

config SOC_EFM32WG
	bool "SOC_EFM32WG"
	select HAS_SILABS_GECKO
	select HAS_CMU
	select CPU_HAS_FPU

endchoice

if SOC_SERIES_EFM32WG

config SOC_PART_NUMBER_EFM32WG990F256
	bool

config SOC_PART_NUMBER_EXX32_EFM32WG
	string
	default "EFM32WG990F256" if SOC_PART_NUMBER_EFM32WG990F256
	help
	  This string holds the full part number of the SoC. It is a hidden option
	  that you should not set directly. The part number selection choice defines
	  the default value for this string.

endif # SOC_SERIES_EFM32WG
```

## arch/arm/soc/silabs_exx32/efr32fg1p/Kconfig.series
```kconfig
# Kconfig - EFR32FG1P MCU line
#
# Copyright (c) 2018 Christian Taedcke
#
# SPDX-License-Identifier: Apache-2.0
#

config SOC_SERIES_EFR32FG1P
	bool "EFR32FG1P Series MCU"
	select HAS_SILABS_GECKO
	select CPU_CORTEX_M4
	select CPU_HAS_FPU
	select SOC_FAMILY_EXX32
	select SYS_POWER_LOW_POWER_STATE_SUPPORTED
	select CPU_HAS_SYSTICK
	help
	  Enable support for EFR32 FlexGecko MCU series
```

## arch/arm/soc/silabs_exx32/efr32fg1p/Kconfig.soc
```kconfig
# Kconfig - EFR32FG1P MCU line
#
# Copyright (c) 2018 Christian Taedcke
#
# SPDX-License-Identifier: Apache-2.0
#

choice
prompt "EFR32FG1P Flex Gecko MCU Selection"
depends on SOC_SERIES_EFR32FG1P

config SOC_EFR32FG1P
	bool "SOC_EFR32FG1P"
	select HAS_CMU

endchoice

if SOC_SERIES_EFR32FG1P

config SOC_PART_NUMBER_EFR32FG1P133F256GM48
	bool

config SOC_PART_NUMBER_EXX32_EFR32FG1P
	string
	default "EFR32FG1P133F256GM48" if SOC_PART_NUMBER_EFR32FG1P133F256GM48
	help
	  This string holds the full part number of the SoC. It is a hidden option
	  that you should not set directly. The part number selection choice defines
	  the default value for this string.

endif # SOC_SERIES_EFR32FG1P
```

## arch/arm/soc/st_stm32/Kconfig
```kconfig
# Kconfig - ST Microelectronics STM32 MCU line
#
# Copyright (c) 2016 Open-RnD Sp. z o.o.
#
# SPDX-License-Identifier: Apache-2.0
#

config SOC_FAMILY_STM32
	bool
	# omit prompt to signify a "hidden" option
	default n

if SOC_FAMILY_STM32

config BUILD_OUTPUT_HEX
        default y

config SOC_FAMILY
	string
	default st_stm32
endif

config STM32_ARM_MPU_ENABLE
	bool "Enable MPU"
	depends on CPU_HAS_MPU
	select ARM_MPU
	default n
	help
	  Enable MPU

source "arch/arm/soc/st_stm32/*/Kconfig.soc"
```

## arch/arm/soc/st_stm32/Kconfig.defconfig
```kconfig
source "arch/arm/soc/st_stm32/*/Kconfig.defconfig.series"

if SOC_FAMILY_STM32

if !HAS_DTS
config SRAM_BASE_ADDRESS
	default 0x20000000

config FLASH_BASE_ADDRESS
	default 0x08000000
endif # !HAS_DTS

endif # SOC_FAMILY_STM32
```

## arch/arm/soc/st_stm32/stm32f0/Kconfig.defconfig.series
```kconfig
# Kconfig - ST Microelectronics STM32F0 MCU line
#
# Copyright (c) 2017 RnDity Sp. z o.o.
#
# SPDX-License-Identifier: Apache-2.0
#

if SOC_SERIES_STM32F0X

source "arch/arm/soc/st_stm32/stm32f0/Kconfig.defconfig.stm32f0*"

config SOC_SERIES
	default stm32f0

if WATCHDOG

config IWDG_STM32
	def_bool y

endif # WATCHDOG

endif # SOC_SERIES_STM32F0X
```

## arch/arm/soc/st_stm32/stm32f0/Kconfig.defconfig.stm32f030x8
```kconfig
# Kconfig - ST Microelectronics STM32F030X8 MCU
#
# Copyright (c) 2017 RnDity Sp. z o.o.
#
# SPDX-License-Identifier: Apache-2.0
#

if SOC_STM32F030X8

config SOC
	string
	default stm32f030x8

config FLASH_PAGE_SIZE
	hex
	default 0x400

config NUM_IRQS
	int
	default 29

endif # SOC_STM32F030X8
```

## arch/arm/soc/st_stm32/stm32f0/Kconfig.defconfig.stm32f070xb
```kconfig
# Kconfig - ST Microelectronics STM32F070XB MCU
#
# Copyright (c) 2018 qianfan Zhao
#
# SPDX-License-Identifier: Apache-2.0
#

if SOC_STM32F070XB

config SOC
	string
	default "stm32f070xb"

config NUM_IRQS
	int
	default 32

endif # SOC_STM32F070XB
```

## arch/arm/soc/st_stm32/stm32f0/Kconfig.defconfig.stm32f091xc
```kconfig
# Kconfig - ST Microelectronics STM32F091XC MCU
#
# Copyright (c) 2017 b0661n0e17e@gmail.com
#
# SPDX-License-Identifier: Apache-2.0
#

if SOC_STM32F091XC

config SOC
	string
	default stm32f091xc

config FLASH_PAGE_SIZE
	hex
	default 0x800

config NUM_IRQS
	int
	default 32

endif # SOC_STM32F091XC
```

## arch/arm/soc/st_stm32/stm32f0/Kconfig.series
```kconfig
# Kconfig - ST Microelectronics STM32F0 MCU series
#
# Copyright (c) 2017 RnDity Sp. z o.o.
#
# SPDX-License-Identifier: Apache-2.0
#

config SOC_SERIES_STM32F0X
	bool "STM32F0x Series MCU"
	select CPU_CORTEX_M0
	select CPU_CORTEX_M0_HAS_VECTOR_TABLE_REMAP
	select SOC_FAMILY_STM32
	select SYS_POWER_LOW_POWER_STATE_SUPPORTED
	select CPU_HAS_SYSTICK
	select HAS_STM32CUBE
	select CLOCK_CONTROL_STM32_CUBE if CLOCK_CONTROL
	help
	 Enable support for STM32F0 MCU series
```

## arch/arm/soc/st_stm32/stm32f0/Kconfig.soc
```kconfig
# Kconfig - ST Microelectronics STM32F0 MCU line
#
# Copyright (c) 2017 RnDity Sp. z o.o.
#
# SPDX-License-Identifier: Apache-2.0
#

choice
prompt "STM32F0x MCU Selection"
depends on SOC_SERIES_STM32F0X

config SOC_STM32F030X8
	bool "STM32F030X8"

config SOC_STM32F091XC
	bool "STM32F091XC"

endchoice
```

## arch/arm/soc/st_stm32/stm32f1/Kconfig.defconfig.family
```kconfig
# Kconfig - ST Microelectronics STM32F1 MCU line
#
# Copyright (c) 2016 Open-RnD Sp. z o.o.
#
# Licensed under the Apache License, Version 2.0 (the "License");
# you may not use this file except in compliance with the License.
# You may obtain a copy of the License at
#
#     http://www.apache.org/licenses/LICENSE-2.0
#
# Unless required by applicable law or agreed to in writing, software
# distributed under the License is distributed on an "AS IS" BASIS,
# WITHOUT WARRANTIES OR CONDITIONS OF ANY KIND, either express or implied.
# See the License for the specific language governing permissions and
# limitations under the License.
#

if SOC_SERIES_STM32F1X

source "arch/arm/soc/st_stm32/stm32f1/Kconfig.defconfig.stm32f1*"

config SOC
       default st_stm32/stm32f1

config SRAM_BASE_ADDRESS
        default 0x20000000

config FLASH_BASE_ADDRESS
        default 0x08000000

config NUM_IRQ_PRIO_BITS
        int
        default 4

endif # SOC_SERIES_STM32F1X
```

## arch/arm/soc/st_stm32/stm32f1/Kconfig.defconfig.series
```kconfig
# Kconfig - ST Microelectronics STM32F1 MCU line
#
# Copyright (c) 2016 Open-RnD Sp. z o.o.
#
# SPDX-License-Identifier: Apache-2.0
#

if SOC_SERIES_STM32F1X

source "arch/arm/soc/st_stm32/stm32f1/Kconfig.defconfig.stm32f1*"

config SOC_SERIES
	default stm32f1

config NUM_IRQ_PRIO_BITS
	int
	default 4

if WATCHDOG

config IWDG_STM32
	def_bool y

endif

endif # SOC_SERIES_STM32F1X
```

## arch/arm/soc/st_stm32/stm32f1/Kconfig.defconfig.stm32f103xb
```kconfig
# Kconfig - ST Microelectronics STM32F103RB MCU
#
# Copyright (c) 2016 Open-RnD Sp. z o.o.
#
# SPDX-License-Identifier: Apache-2.0
#

if SOC_STM32F103XB

config SOC
	string
	default stm32f103xb

config NUM_IRQS
	int
	default 59

endif # SOC_STM32F103XB
```

## arch/arm/soc/st_stm32/stm32f1/Kconfig.defconfig.stm32f103xe
```kconfig
# Kconfig - ST Microelectronics STM32F103VE MCU
#
# Copyright (c) 2016 Open-RnD Sp. z o.o.
#
# SPDX-License-Identifier: Apache-2.0
#

if SOC_STM32F103XE

config SOC
	string
	default stm32f103xe

config SRAM_SIZE
	default 64

config FLASH_SIZE
	default 512

config NUM_IRQS
	int
	default 68

endif # SOC_STM32F103XE
```

## arch/arm/soc/st_stm32/stm32f1/Kconfig.defconfig.stm32f103xx
```kconfig
# Kconfig - ST Microelectronics STM32F103XX MCU
#
# Copyright (c) 2017, embedjournal.com
#
# SPDX-License-Identifier: Apache-2.0
#

if SOC_STM32F103XB || SOC_STM32F103X8

config SOC
	string
	default stm32f103xb

config NUM_IRQS
	int
	default 59

endif # SOC_STM32F103XB || SOC_STM32F103X8

if SOC_STM32F103XE

config SOC
	string
	default stm32f103xe

config NUM_IRQS
	int
	default 68

endif # SOC_STM32F103XE
```

## arch/arm/soc/st_stm32/stm32f1/Kconfig.defconfig.stm32f107xc
```kconfig
# Kconfig - ST Microelectronics STM32F107XC MCU
#
# Copyright (c) 2016 RnDity Sp. z o.o.
#
# SPDX-License-Identifier: Apache-2.0
#

if SOC_STM32F107XC

config SOC
	string
	default stm32f107xc

config SRAM_SIZE
	default 64

config FLASH_SIZE
	default 256

config NUM_IRQS
	int
	default 68

endif # SOC_STM32F107XC
```
