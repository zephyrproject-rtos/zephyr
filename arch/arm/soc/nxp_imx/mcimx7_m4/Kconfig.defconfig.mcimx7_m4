## arch/arm/soc/nxp_imx/mcimx7_m4/Kconfig.defconfig.mcimx7_m4
```kconfig
# Kconfig - iMX7 M4 core series
#
# Copyright (c) 2017, NXP
#
# SPDX-License-Identifier: Apache-2.0
#

if SOC_MCIMX7_M4

config SOC
	string
	default "mcimx7d"

config SYS_CLOCK_TICKS_PER_SEC
	int
	default 1000

config SYS_CLOCK_HW_CYCLES_PER_SEC
	int
	default 200000000

if CLOCK_CONTROL

config CLOCK_CONTROL_IMX_CCM
	def_bool y

endif # CLOCK_CONTROL

config GPIO
	def_bool y

if GPIO

config GPIO_IMX
	def_bool y

endif # GPIO

if SERIAL

config UART_IMX
	def_bool y

endif # SERIAL

config DOMAIN_ID
	int
	default 1

endif # SOC_MCIMX7_M4
```

## arch/arm/soc/nxp_imx/mcimx7_m4/Kconfig.series
```kconfig
# Kconfig - iMX7 M4 core series
#
# Copyright (c) 2017, NXP
#
# SPDX-License-Identifier: Apache-2.0
#

config SOC_SERIES_IMX7_M4
	bool "i.MX7 M4 Core Series"
	select CPU_CORTEX_M
	select CPU_CORTEX_M4
	select SOC_FAMILY_IMX
	select SYS_POWER_LOW_POWER_STATE_SUPPORTED
	select CPU_HAS_SYSTICK
	select CLOCK_CONTROL
	help
	  Enable support for i.MX7 M4 MCU series
```

## arch/arm/soc/nxp_imx/rt/Kconfig.series
```kconfig
# Kconfig - iMX RT series
#
# Copyright (c) 2017, NXP
#
# SPDX-License-Identifier: Apache-2.0
#

config SOC_SERIES_IMX_RT
	bool "i.MX RT Series"
	select CPU_CORTEX_M
	select CPU_CORTEX_M7
	select SOC_FAMILY_IMX
	select SYS_POWER_LOW_POWER_STATE_SUPPORTED
	select CPU_HAS_SYSTICK
	select CLOCK_CONTROL
	help
	  Enable support for i.MX RT MCU series
```

## arch/arm/soc/nxp_kinetis/Kconfig
```kconfig
#
# Copyright (c) 2016 Intel Corporation
# Copyright (c) 2016, Freescale Semiconductor, Inc.
#
# SPDX-License-Identifier: Apache-2.0
#

config SOC_FAMILY_KINETIS
	bool
	# omit prompt to signify a "hidden" option
	default n

if SOC_FAMILY_KINETIS
config SOC_FAMILY
	string
	default "nxp_kinetis"
endif

source "arch/arm/soc/nxp_kinetis/*/Kconfig.soc"

config SOC_PART_NUMBER
	string
	default SOC_PART_NUMBER_KINETIS_K6X if SOC_SERIES_KINETIS_K6X
	help
	This string holds the full part number of the SoC. It is a hidden option
	that you should not set directly. The part number selection choice defines
	the default value for this string.

config HAS_OSC
	bool
	default n
	help
	Set if the oscillator (OSC) module is present in the SoC.

config HAS_MCG
	bool
	default n
	help
	Set if the multipurpose clock generator (MCG) module is present in the SoC.

config HAS_RNGA
	bool
	default n
	help
	Set if the random number generator accelerator (RNGA) module is present in the SoC.

config HAS_LPUART
	bool
	default n
	help
	Set if the low power uart (LPUART) module is present in the SoC.

if HAS_OSC

choice
	prompt "Oscillator Mode Selection"
	default OSC_EXTERNAL

config OSC_EXTERNAL
	bool "External reference clock"
	help
	Set this option to use the oscillator in external reference clock mode.

config OSC_LOW_POWER
	bool "Low power oscillator"
	help
	Set this option to use the oscillator in low-power mode.

config OSC_HIGH_GAIN
	bool "High gain oscillator"
	help
	Set this option to use the oscillator in high-gain mode.

endchoice

config OSC_XTAL0_FREQ
	int "External oscillator frequency"
	help
	Set the external oscillator frequency in Hz. This should be set by the
	board's defconfig.

endif # HAS_OSC

if HAS_MCG

config MCG_PRDIV0
	hex "PLL external reference divider"
	range 0 0x18
	default 0
	help
	Selects the amount to divide down the external reference clock for the PLL.
	The resulting frequency must be in the range of 2 MHz to 4 MHz.

config MCG_VDIV0
	hex "VCO 0 divider"
	range 0 0x1F
	default 0
	help
	Selects the amount to divide the VCO output of the PLL. The VDIV 0 bits
	establish the multiplication factor (M) applied to the reference clock
	frequency.

config MCG_FCRDIV
	int "Fast internal reference clock divider"
	range 0 7
	default 1
	help
	Selects the amount to divide down the fast internal reference clock. The
	resulting frequency must be in the range 31.25 kHz to 4 MHz.

endif # HAS_MCG
```

## arch/arm/soc/nxp_kinetis/Kconfig.soc
```kconfig
#
# Copyright (c) 2016 Intel Corporation
#
# SPDX-License-Identifier: Apache-2.0
#

source "arch/arm/soc/nxp_kinetis/*/Kconfig.series"
```

## arch/arm/soc/nxp_kinetis/k6x/Kconfig.defconfig.mk64f12
```kconfig
# Kconfig - FSL FRDM K64F platform configuration options

#
# Copyright (c) 2014-2016 Wind River Systems, Inc.
#
# SPDX-License-Identifier: Apache-2.0
#

if SOC_MK64F12

config SOC
	string
	default mk64f12

if ADC

config ADC_MCUX_ADC16
	def_bool y

endif # ADC

if CLOCK_CONTROL

config CLOCK_CONTROL_MCUX_SIM
	def_bool y

endif # CLOCK_CONTROL

if PINMUX

config PINMUX_MCUX
	def_bool y

endif # PINMUX

config GPIO
	def_bool y

if GPIO

config GPIO_MCUX
	def_bool y

endif # GPIO

if I2C

config I2C_MCUX
	def_bool y

endif # I2C

if PWM

config PWM_MCUX_FTM
	def_bool y

endif # PWM

config SPI
	def_bool n

if SPI

config SPI_MCUX_DSPI
	def_bool y

endif # SPI

if NET_L2_ETHERNET

config ETH_MCUX
	def_bool y

endif # NET_L2_ETHERNET

if ENTROPY_GENERATOR

config ENTROPY_MCUX_RNGA
	def_bool y

endif # ENTROPY_GENERATOR

if FLASH

config SOC_FLASH_MCUX
	def_bool y

endif # FLASH

if SERIAL

config UART_MCUX
	def_bool y

endif # SERIAL

endif # SOC_MK64F12
```

## arch/arm/soc/nxp_kinetis/k6x/Kconfig.defconfig.series
```kconfig
# Kconfig - Kinetis K6x series configuration options

#
# Copyright (c) 2014-2016 Wind River Systems, Inc.
#
# SPDX-License-Identifier: Apache-2.0
#

if SOC_SERIES_KINETIS_K6X

config SOC_SERIES
	default k6x

if !HAS_DTS

config SRAM_BASE_ADDRESS
	default 0x20000000

config FLASH_BASE_ADDRESS
	default 0x00000000

config NUM_IRQ_PRIO_BITS
	int
	default 4

config NUM_IRQS
	int
	# must be >= the highest interrupt number used
	default 86

endif # !HAS_DTS

source "arch/arm/soc/nxp_kinetis/k6x/Kconfig.defconfig.mk*"

endif # SOC_SERIES_KINETIS_K6X
```

## arch/arm/soc/nxp_kinetis/k6x/Kconfig.series
```kconfig
# Kconfig - Kinetis K6X MCU line
#
# Copyright (c) 2016 Open-RnD Sp. z o.o.
#
# SPDX-License-Identifier: Apache-2.0
#

config SOC_SERIES_KINETIS_K6X
	bool "Kinetis K6x Series MCU"
	select CPU_CORTEX_M4
	select SOC_FAMILY_KINETIS
	select SYS_POWER_LOW_POWER_STATE_SUPPORTED
	select CPU_HAS_SYSTICK
	select CPU_HAS_MPU
	select CLOCK_CONTROL
	help
	  Enable support for Kinetis K6x MCU series
```

## arch/arm/soc/nxp_kinetis/k6x/Kconfig.soc
```kconfig
# Kconfig - Kinetis K6X MCU line
#
# Copyright (c) 2016 Open-RnD Sp. z o.o.
#
# SPDX-License-Identifier: Apache-2.0
#

choice
prompt "Kinetis K6x MCU Selection"
depends on SOC_SERIES_KINETIS_K6X

config SOC_MK64F12
	bool "SOC_MK64F12"
	select HAS_MCUX
	select HAS_MCUX_ADC16
	select HAS_MCUX_FTM
	select HAS_MCUX_RNGA
	select HAS_MCUX_SIM
	select HAS_OSC
	select HAS_MCG
	select CPU_HAS_FPU

endchoice

if SOC_SERIES_KINETIS_K6X

config SOC_PART_NUMBER_MK64FN1M0CAJ12
	bool

config SOC_PART_NUMBER_MK64FN1M0VDC12
	bool

config SOC_PART_NUMBER_MK64FN1M0VLL12
	bool

config SOC_PART_NUMBER_MK64FN1M0VLQ12
	bool

config SOC_PART_NUMBER_MK64FN1M0VMD12
	bool

config SOC_PART_NUMBER_MK64FX512VDC12
	bool

config SOC_PART_NUMBER_MK64FX512VLL12
	bool

config SOC_PART_NUMBER_MK64FX512VLQ12
	bool

config SOC_PART_NUMBER_MK64FX512VMD12
	bool

config SOC_PART_NUMBER_KINETIS_K6X
	string
	default "MK64FN1M0CAJ12" if SOC_PART_NUMBER_MK64FN1M0CAJ12
	default "MK64FN1M0VDC12" if SOC_PART_NUMBER_MK64FN1M0VDC12
	default "MK64FN1M0VLL12" if SOC_PART_NUMBER_MK64FN1M0VLL12
	default "MK64FN1M0VLQ12" if SOC_PART_NUMBER_MK64FN1M0VLQ12
	default "MK64FN1M0VMD12" if SOC_PART_NUMBER_MK64FN1M0VMD12
	default "MK64FX512VDC12" if SOC_PART_NUMBER_MK64FX512VDC12
	default "MK64FX512VLL12" if SOC_PART_NUMBER_MK64FX512VLL12
	default "MK64FX512VLQ12" if SOC_PART_NUMBER_MK64FX512VLQ12
	default "MK64FX512VMD12" if SOC_PART_NUMBER_MK64FX512VMD12
	help
	  This string holds the full part number of the SoC. It is a hidden option
	  that you should not set directly. The part number selection choice defines
	  the default value for this string.

config K64_CORE_CLOCK_DIVIDER
	int
	prompt "Freescale K64 core clock divider"
	default 1
	help
	  This option specifies the divide value for the K64 processor core clock
	  from the system clock.

config K64_BUS_CLOCK_DIVIDER
	int
	prompt "Freescale K64 bus clock divider"
	default 2
	help
	  This option specifies the divide value for the K64 bus clock from the
	  system clock.

config K64_FLEXBUS_CLOCK_DIVIDER
	int
	prompt "Freescale K64 FlexBus clock divider"
	default 3
	help
	  This option specifies the divide value for the K64 FlexBus clock from the
	  system clock.

config K64_FLASH_CLOCK_DIVIDER
	int
	prompt "Freescale K64 flash clock divider"
	default 5
	help
	  This option specifies the divide value for the K64 flash clock from the
	  system clock.

config WDOG_INIT
	def_bool y
	# omit prompt to signify a "hidden" option
	help
	  This processor enables the watchdog timer with a short timeout
	  upon reset. Therefore, this requires that the watchdog be configured
	  during reset handling.

config PRESERVE_JTAG_IO_PINS
	bool "Kinetis K6x JTAG pin usage"
	depends on PINMUX
	default y
	help
	  The FRDM-K64F board routes the PTA0/1/2 pins as JTAG/SWD signals that
	  are used for the OpenSDAv2 debug interface.  These pins are also routed to
	  the Arduino header as D8, D3 and D5, respectively.
	  Enable this option to preserve these pins for the debug interface.

endif # SOC_SERIES_KINETIS_K6X
```

## arch/arm/soc/nxp_kinetis/kl2x/Kconfig.defconfig.series
```kconfig
# Kconfig - Kinetis KL2x series configuration options
#
# Copyright (c) 2017, NXP
#
# SPDX-License-Identifier: Apache-2.0
#

if SOC_SERIES_KINETIS_KL2X

config SOC_SERIES
	default kl2x

if !HAS_DTS

config SRAM_BASE_ADDRESS
	default 0x1FFFF000

config FLASH_BASE_ADDRESS
	default 0x00000000

endif # !HAS_DTS

source "arch/arm/soc/nxp_kinetis/kl2x/Kconfig.defconfig.mk*"

endif # SOC_SERIES_KINETIS_KL2X
```

## arch/arm/soc/nxp_kinetis/kwx/Kconfig.defconfig.mkw2xd512
```kconfig
# Kconfig - Kinetis KW2xD SoC configuration options
#
# Copyright (c) 2017, Phytec Messtechnik GmbH
#
# SPDX-License-Identifier: Apache-2.0
#

if SOC_MKW22D5 || SOC_MKW24D5

if SOC_MKW22D5

config SOC
	string
	default mkw22d5

endif # SOC_MKW22D5

if SOC_MKW24D5

config SOC
	string
	default mkw24d5

endif # SOC_MKW24D5

config NUM_IRQS
	int
	default 65

if ADC

config ADC_MCUX_ADC16
	def_bool y

endif # ADC

if CLOCK_CONTROL

config CLOCK_CONTROL_MCUX_SIM
	def_bool y

endif # CLOCK_CONTROL

if PINMUX

config PINMUX_MCUX
	def_bool y

endif # PINMUX

if GPIO

config GPIO_MCUX
	def_bool y

endif # GPIO

if I2C

config I2C_MCUX
	def_bool y

endif # I2C

config SPI
	def_bool y

if PWM

config PWM_MCUX_FTM
	def_bool y

endif # PWM

if SPI

config SPI_MCUX_DSPI
	def_bool y

endif # SPI

if ENTROPY_GENERATOR

config ENTROPY_MCUX_RNGA
	def_bool y

endif # ENTROPY_GENERATOR

if FLASH

config SOC_FLASH_MCUX
	def_bool y

endif # FLASH

if SERIAL

config UART_MCUX
	def_bool y

endif # SERIAL

endif # SOC_MKW2xD512
```

## arch/arm/soc/nxp_kinetis/kwx/Kconfig.defconfig.mkw40z4
```kconfig
# Kconfig - Kinetis KWx SoC configuration options
#
# Copyright (c) 2017, NXP
#
# SPDX-License-Identifier: Apache-2.0
#

if SOC_MKW40Z4

config SOC
	string
	default mkw40z4

config NUM_IRQS
	int
	default 32

if ADC

config ADC_MCUX_ADC16
	def_bool y

endif # ADC

if CLOCK_CONTROL

config CLOCK_CONTROL_MCUX_SIM
	def_bool y

endif # CLOCK_CONTROL

if PINMUX

config PINMUX_MCUX
	def_bool y

endif # PINMUX

if GPIO

config GPIO_MCUX
	def_bool y

endif # GPIO

if SERIAL

config UART_MCUX_LPUART
	def_bool y

endif # SERIAL

if I2C

config I2C_MCUX
	def_bool y

endif # I2C

if ENTROPY_GENERATOR

config ENTROPY_MCUX_TRNG
	def_bool y

endif # ENTROPY_GENERATOR

if FLASH

config SOC_FLASH_MCUX
	def_bool y

endif # FLASH

endif # SOC_MKW40Z4
```

## arch/arm/soc/nxp_kinetis/kwx/Kconfig.defconfig.mkw41z4
```kconfig
# Kconfig - Kinetis KWx SoC configuration options
#
# Copyright (c) 2017, NXP
#
# SPDX-License-Identifier: Apache-2.0
#

if SOC_MKW41Z4

config SOC
	string
	default mkw41z4

config NUM_IRQ_PRIO_BITS
	int
	default 2

config NUM_IRQS
	int
	default 32

if PINMUX

config PINMUX_MCUX
	def_bool y

endif # PINMUX

if GPIO

config GPIO_MCUX
	def_bool y

endif # GPIO

if SERIAL

config UART_MCUX_LPUART
	def_bool y

endif # SERIAL

if I2C

config I2C_MCUX
	def_bool y

endif # I2C

if FLASH

config SOC_FLASH_MCUX
	def_bool y

endif # FLASH

endif # SOC_MKW41Z4
```

## arch/arm/soc/nxp_kinetis/kwx/Kconfig.defconfig.series
```kconfig
# Kconfig - Kinetis KWx series configuration options
#
# Copyright (c) 2017, NXP
#
# SPDX-License-Identifier: Apache-2.0
#

if SOC_SERIES_KINETIS_KWX

config SOC_SERIES
	default kwx

if !HAS_DTS

config SRAM_BASE_ADDRESS
	default 0x20000000

config FLASH_BASE_ADDRESS
	default 0x00000000

endif # !HAS_DTS

source "arch/arm/soc/nxp_kinetis/kwx/Kconfig.defconfig.mk*"

endif # SOC_SERIES_KINETIS_KWX
```

## arch/arm/soc/nxp_kinetis/kwx/Kconfig.series
```kconfig
# Kconfig - Kinetis KWx MCU series
#
# Copyright (c) 2017, NXP
#
# SPDX-License-Identifier: Apache-2.0
#

config SOC_SERIES_KINETIS_KWX
	bool "Kinetis KWx Series MCU"
	select CPU_CORTEX_M
	select SOC_FAMILY_KINETIS
	select SYS_POWER_LOW_POWER_STATE_SUPPORTED
	select CPU_HAS_SYSTICK
	help
	 Enable support for Kinetis KWx MCU series
```

## arch/arm/soc/nxp_kinetis/kwx/Kconfig.soc
```kconfig
# Kconfig - Kinetis KWx MCU series
#
# Copyright (c) 2017, NXP
#
# SPDX-License-Identifier: Apache-2.0
#

choice
prompt "Kinetis KWx MCU Selection"
depends on SOC_SERIES_KINETIS_KWX

config SOC_MKW41Z4
	bool "SOC_MKW41Z4"
	select CPU_CORTEX_M0PLUS
	select HAS_MCUX
	select HAS_OSC
	select HAS_MCG
	select HAS_LPUART

endchoice

if SOC_SERIES_KINETIS_KWX

config SOC_PART_NUMBER_MKW41Z256VHT4
	bool

config SOC_PART_NUMBER_MKW41Z512VHT4
	bool

config SOC_PART_NUMBER_KINETIS_KWX
	string
	default "MKW41Z256VHT4" if SOC_PART_NUMBER_MKW41Z256VHT4
	default "MKW41Z512VHT4" if SOC_PART_NUMBER_MKW41Z512VHT4
	help
	This string holds the full part number of the SoC. It is a hidden option
	that you should not set directly. The part number selection choice defines
	the default value for this string.

endif # SOC_SERIES_KINETIS_KWX
```

## arch/arm/soc/nxp_lpc/lpc54xxx/Kconfig.defconfig.lpc54114
```kconfig
# Kconfig - NXP LPC54114 platform configuration options
#
# Copyright (c) 2017, NXP
#
# SPDX-License-Identifier: Apache-2.0
#

if SOC_LPC54114

config SOC
	string
	default lpc54114

if PINMUX

config PINMUX_MCUX_LPC
	def_bool y

endif # PINMUX

if GPIO

config GPIO_MCUX_LPC
	def_bool y

endif # GPIO

if SERIAL

config USART_MCUX_LPC
	def_bool y

endif # SERIAL

config SLAVE_CORE_MCUX
	bool "Enable LPC54114 Cortex-M0 slave core"
	default n
	depends on HAS_MCUX
	help
	Driver for slave core startup


endif # SOC_LPC54114
```

## arch/arm/soc/nxp_lpc/lpc54xxx/Kconfig.defconfig.lpc54114_m0
```kconfig
# Kconfig - NXP LPC54114 M0 platform configuration options

#
# Copyright (c) 2017, NXP
#
# SPDX-License-Identifier: Apache-2.0
#

if SOC_LPC54114_M0

config SOC
	string
	default "lpc54114_m0"

if PINMUX

config PINMUX_MCUX_LPC
	def_bool n

endif # PINMUX

config GPIO
	def_bool n

if GPIO

config GPIO_MCUX_LPC
	def_bool n

endif # GPIO

if SERIAL

config USART_MCUX_LPC
	def_bool n

endif # SERIAL

endif # SOC_LPC54114_M0
```
