## arch/arm/soc/nxp_lpc/lpc54xxx/Kconfig.soc
```kconfig
# Kconfig - LPC LPC54XXX MCU line
#
# Copyright (c) 2017, NXP
#
# SPDX-License-Identifier: Apache-2.0
#

choice
prompt "LPC LPC54XXX MCU Selection"
depends on SOC_SERIES_LPC54XXX

config SOC_LPC54114_M4
	bool "SOC_LPC54114_M4"
	select CPU_CORTEX_M4
	select PLATFORM_SPECIFIC_INIT

config SOC_LPC54114_M0
	bool "SOC_LPC54114_M0"
	select CPU_CORTEX_M0PLUS
	select CPU_CORTEX_M_HAS_VTOR

endchoice

if SOC_SERIES_LPC54XXX

config SOC_PART_NUMBER_LPC54114J256BD64
	bool

config SOC_PART_NUMBER_LPC54XXX
	string
	default "LPC54114J256BD64" if SOC_PART_NUMBER_LPC54114J256BD64

	help
	  This string holds the full part number of the SoC. It is a hidden
	  option that you should not set directly. The part number selection
	  choice defines the default value for this string.

config SLAVE_CORE_MCUX
	bool "Enable LPC54114 Cortex-M0 slave core"
	depends on HAS_MCUX
	help
	  Driver for slave core startup

config SLAVE_IMAGE_MCUX
	depends on SLAVE_CORE_MCUX
	string "Binary image of slave core's code"
	help
	  This points to the image file for the the binary code that will be
	  used by the slave core.

config SLAVE_BOOT_ADDRESS_MCUX
	depends on SLAVE_CORE_MCUX
	hex "Address the slave core will boot at"
	default 0x20010000
	help
	  This is the address the slave core will boot from.  Additionally this
	  address is where we will copy the SLAVE_IMAGE to.  We default this to
	  the base of SRAM1

endif # SOC_SERIES_LPC54XXX
```

## arch/arm/soc/rda_5981/5981a/Kconfig.defconfig.5981a
```kconfig
#
# Copyright (c) 2017 RDA
# Copyright (c) 2016-2017 Linaro Limited
#
# SPDX-License-Identifier: Apache-2.0
#

if SOC_5981A

config SOC
	string
	default rda5981A

config SYS_CLOCK_HW_CYCLES_PER_SEC
	int
	default 160000000

if !HAS_DTS
config SRAM_SIZE
	default 120

config FLASH_SIZE
	default 500

config NUM_IRQS
	int
	default 16
endif

endif # SOC_5981A
```

## arch/arm/soc/rda_5981/5981a/Kconfig.defconfig.series
```kconfig
#
# Copyright (c) 2017 RDA
# Copyright (c) 2016-2017 Linaro Limited
#
# SPDX-License-Identifier: Apache-2.0
#

if SOC_SERIES_RDA5981

source "arch/arm/soc/rda_5981/5981a/Kconfig.defconfig.5981a"

config SOC_SERIES
	default 5981a

config NUM_IRQ_PRIO_BITS
	int
	default 4

config SERIAL
	def_bool y

if SERIAL

config CONSOLE
	def_bool y

config UART_CONSOLE
	def_bool y

config UART_RDA5981A
	def_bool y

config UART_RDA5981A_PORT_0
	def_bool y

config UART_RDA5981A_PORT_0_NAME
	default UART_0

endif #SERIAL


endif # SOC_SERIES_RDA5981
```

## arch/arm/soc/rda_5981/5981a/Kconfig.series
```kconfig
#
# Copyright (c) 2017 RDA
# Copyright (c) 2016-2017 Linaro Limited
#
# SPDX-License-Identifier: Apache-2.0
#

config SOC_SERIES_RDA5981
	bool "RDA5981 Series MCU"
	select CPU_CORTEX_M
	select CPU_CORTEX_M4
	select SOC_FAMILY_RDA5981
	select SYS_POWER_LOW_POWER_STATE_SUPPORTED
	select CPU_HAS_SYSTICK
	help
	 Enable support for RDA5981 MCU series
```

## arch/arm/soc/rda_5981/5981a/Kconfig.soc
```kconfig
#
# Copyright (c) 2017 RDA
# Copyright (c) 2016-2017 Linaro Limited
#
# SPDX-License-Identifier: Apache-2.0
#

choice
prompt "RDA5981 MCU Selection"
depends on SOC_SERIES_RDA5981

config SOC_5981A
	bool "5981a"

endchoice
```
