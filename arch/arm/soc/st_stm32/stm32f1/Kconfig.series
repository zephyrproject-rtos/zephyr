## arch/arm/soc/st_stm32/stm32f1/Kconfig.series
```kconfig
# Kconfig - ST Microelectronics STM32F1 MCU series
#
# Copyright (c) 2016 Open-RnD Sp. z o.o.
#
# SPDX-License-Identifier: Apache-2.0
#

config SOC_SERIES_STM32F1X
	bool "STM32F1x Series MCU"
	select CPU_CORTEX_M3
	select SOC_FAMILY_STM32
	select SYS_POWER_LOW_POWER_STATE_SUPPORTED
	select HAS_STM32CUBE
	select CPU_HAS_SYSTICK
	select CLOCK_CONTROL_STM32_CUBE if CLOCK_CONTROL
	help
	 Enable support for STM32F1 MCU series
```

## arch/arm/soc/st_stm32/stm32f1/Kconfig.soc
```kconfig
# Kconfig - ST Microelectronics STM32F1 MCU line
#
# Copyright (c) 2016 Open-RnD Sp. z o.o.
# Copyright (c) RnDity Sp. z o.o.
#
# Licensed under the Apache License, Version 2.0 (the "License");
# you may not use this file except in compliance with the License.
# You may obtain a copy of the License at
#
#     http://www.apache.org/licenses/LICENSE-2.0
#
# Unless required by applicable law or agreed to in writing, software
# distributed under the License is distributed on an "AS IS" BASIS,
# WITHOUT WARRANTIES OR CONDITIONS OF ANY KIND, either express or implied.
# See the License for the specific language governing permissions and
# limitations under the License.
#

choice
prompt "STM32F1x MCU Selection"
depends on SOC_SERIES_STM32F1X

config SOC_STM32F103XE
	bool "STM32F103XE"
	select SOC_STM32F10X_DENSITY_DEVICE

config SOC_STM32F103XB
	bool "STM32F103XB"
	select SOC_STM32F10X_DENSITY_DEVICE

config SOC_STM32F107XC
	bool "STM32F107XC"
	select SOC_STM32F10X_CONNECTIVITY_LINE_DEVICE

endchoice

config SOC_STM32F10X_DENSITY_DEVICE
	bool
	help
	 * Low density Value line devices
	 * Medium density Value line devices
	 * High density Value line devices
	 * XL-density devices Value line devices

config SOC_STM32F10X_CONNECTIVITY_LINE_DEVICE
	bool
	help
	 Connectivity line devices are STM32F105xx and STM32F107xx
	 microcontrollers.  They are intended for applications where
	 connectivity and real-time performances are required such as
	 industrial control, control panels for security applications, UPS or
	 home audio.  For STM32F107xx also the Ethernet MAC is available.
```

## arch/arm/soc/st_stm32/stm32f2/Kconfig.defconfig.series
```kconfig
# Kconfig - ST Microelectronics STM32F2 MCU line
#
# Copyright (c) 2018 qianfan Zhao <qianfanguijin@163.com>
#
# SPDX-License-Identifier: Apache-2.0
#

if SOC_SERIES_STM32F2X

gsource "arch/arm/soc/st_stm32/stm32f2/Kconfig.defconfig.stm32f2*"

config SOC_SERIES
	default "stm32f2"

endif # SOC_SERIES_STM32F2X
```

## arch/arm/soc/st_stm32/stm32f2/Kconfig.defconfig.stm32f215xx
```kconfig
# Kconfig - ST Microelectronics stm32f215xx MCU
#
# Copyright (c) 2018 Istvan Bisz <istvan.bisz@t-online.hu>
#
# SPDX-License-Identifier: Apache-2.0
#

if SOC_STM32F215XG

config SOC
	string
	default "STM32F215xx"

config NUM_IRQS
	int
	default 81

endif
```

## arch/arm/soc/st_stm32/stm32f2/Kconfig.series
```kconfig
# Kconfig - ST Microelectronics STM32F2X MCU series
#
# Copyright (c) 2018 qianfan Zhao <qianfanguijin@163.com>
#
# SPDX-License-Identifier: Apache-2.0
#

config SOC_SERIES_STM32F2X
	bool "stm32f2x Series MCU"
	select CPU_CORTEX_M
	select CPU_CORTEX_M3
	select SOC_FAMILY_STM32
	select SYS_POWER_LOW_POWER_STATE_SUPPORTED
	select HAS_STM32CUBE
	select CPU_HAS_SYSTICK
	select CLOCK_CONTROL_STM32_CUBE if CLOCK_CONTROL
	help
	  Enable support for stm32f2 MCU series
```

## arch/arm/soc/st_stm32/stm32f3/Kconfig.defconfig.series
```kconfig
# Kconfig - ST Microelectronics STM32F3 MCU line
#
# Copyright (c) 2016 RnDity Sp. z o.o.
#
# SPDX-License-Identifier: Apache-2.0
#

if SOC_SERIES_STM32F3X

source "arch/arm/soc/st_stm32/stm32f3/Kconfig.defconfig.stm32f3*"

config SOC_SERIES
	default stm32f3

if WATCHDOG

config IWDG_STM32
	def_bool y

endif # WATCHDOG

if USB

config USB_DC_STM32
	def_bool y

endif # USB

endif # SOC_SERIES_STM32F3X
```

## arch/arm/soc/st_stm32/stm32f3/Kconfig.defconfig.stm32f302x8
```kconfig
# Kconfig - ST Microelectronics STM32F302X8 MCU
#
# Copyright (c) 2018 Diego Asanza
#
# SPDX-License-Identifier: Apache-2.0
#

if SOC_STM32F302X8

config SOC
	string
	default "stm32f302x8"

config FLASH_PAGE_SIZE
	hex
	default 0x800

config NUM_IRQS
	int
	default 82

endif # SOC_STM32F302X8
```

## arch/arm/soc/st_stm32/stm32f3/Kconfig.defconfig.stm32f303xc
```kconfig
# Kconfig - ST Microelectronics STM32F303XC MCU
#
# Copyright (c) 2016 RnDity Sp. z o.o.
#
# SPDX-License-Identifier: Apache-2.0
#

if SOC_STM32F303XC

config SOC
	string
	default stm32f303xc

config SRAM_SIZE
	default 40

config FLASH_SIZE
	default 256

config FLASH_PAGE_SIZE
	hex
	default 0x800

config NUM_IRQS
	int
	default 82

endif # SOC_STM32F303XC
```

## arch/arm/soc/st_stm32/stm32f3/Kconfig.defconfig.stm32f334x8
```kconfig
# Kconfig - ST Microelectronics STM32F334X8 MCU
#
# Copyright (c) 2016 RnDity Sp. z o.o.
#
# SPDX-License-Identifier: Apache-2.0
#

if SOC_STM32F334X8

config SOC
	string
	default stm32f334x8

config SRAM_SIZE
	default 12

config FLASH_SIZE
	default 64

config FLASH_PAGE_SIZE
	hex
	default 0x800

config NUM_IRQS
	int
	default 82

endif # SOC_STM32F334X8
```

## arch/arm/soc/st_stm32/stm32f3/Kconfig.defconfig.stm32f373xc
```kconfig
# Kconfig - ST Microelectronics STM32F373XC MCU
#
# Copyright (c) 2016 RnDity Sp. z o.o.
#
# SPDX-License-Identifier: Apache-2.0
#

if SOC_STM32F373XC

config SOC
	string
	default "stm32f373xc"

config FLASH_PAGE_SIZE
	hex
	default 0x800

config NUM_IRQS
	int
	default 82

if GPIO_STM32

config GPIO_STM32_PORTE
	default y

config GPIO_STM32_PORTF
	default y

endif # GPIO_STM32

endif # SOC_STM32F373XC
```

## arch/arm/soc/st_stm32/stm32f3/Kconfig.series
```kconfig
# Kconfig - ST Microelectronics STM32F3 MCU series
#
# Copyright (c) 2016 RnDity Sp. z o.o.
#
# SPDX-License-Identifier: Apache-2.0
#

config SOC_SERIES_STM32F3X
	bool "STM32F3x Series MCU"
	select CPU_CORTEX_M
	select CPU_CORTEX_M4
	select SOC_FAMILY_STM32
	select SYS_POWER_LOW_POWER_STATE_SUPPORTED
	select CPU_HAS_FPU
	select CPU_HAS_SYSTICK
	select HAS_STM32CUBE
	select CLOCK_CONTROL_STM32_CUBE if CLOCK_CONTROL
	help
	 Enable support for STM32F3 MCU series
```

## arch/arm/soc/st_stm32/stm32f4/Kconfig.defconfig.series
```kconfig
# Kconfig.defconfig.series - ST Microelectronics STM32F4 MCU line
#
# Copyright (c) 2016 Linaro Limited
#
# SPDX-License-Identifier: Apache-2.0
#

if SOC_SERIES_STM32F4X

source "arch/arm/soc/st_stm32/stm32f4/Kconfig.defconfig.stm32f4*"

config SOC_SERIES
	default stm32f4

config SERIAL
	def_bool y

if SERIAL

config CONSOLE
	def_bool y

config UART_CONSOLE
	def_bool y

config UART_STM32
	def_bool y

endif #SERIAL

if GPIO

config GPIO_STM32
	def_bool y

config GPIO_STM32_PORTA
	def_bool y

config GPIO_STM32_PORTB
	def_bool y

config GPIO_STM32_PORTC
	def_bool y

config GPIO_STM32_PORTD
       def_bool y

endif #GPIO

if PINMUX

config PINMUX_STM32
	def_bool y

endif #PINMUX

if USB

config USB_DC_STM32
	def_bool y

# USB OTG FS has four endpoints including ep0
config USB_DC_STM32_EP_NUM
        int
        default 4

# 320 4-Byte words FIFO for USB OTG FS controller
config USB_DC_STM32_RAM_SIZE
        int
        default 1280

if USB_CDC_ACM

config CDC_ACM_INT_EP_ADDR
       default 0x81

config CDC_ACM_IN_EP_ADDR
       default 0x82

config CDC_ACM_OUT_EP_ADDR
       default 0x03

endif # USB_CDC_ACM

endif #USB

if WATCHDOG

config IWDG_STM32
	def_bool y

endif # WATCHDOG

endif # SOC_SERIES_STM32F4X
```

## arch/arm/soc/st_stm32/stm32f4/Kconfig.defconfig.stm32f401xe
```kconfig
# Kconfig - ST STM32F401RE MCU configuration options
#
# Copyright (c) 2016 Linaro Limited.
#
# SPDX-License-Identifier: Apache-2.0
#

if SOC_STM32F401XE

config SOC
	string
	default "stm32f401xe"

config NUM_IRQS
	int
	default 85

endif # SOC_STM32F401XE
```

## arch/arm/soc/st_stm32/stm32f4/Kconfig.defconfig.stm32f405xx
```kconfig
# Kconfig - ST STM32F405XX MCU configuration options
#
# Copyright (c) 2016 Linaro Limited.
#
# SPDX-License-Identifier: Apache-2.0
#

if SOC_STM32F405XG

config SOC
	string
	default stm32f405xx

config NUM_IRQS
	int
	default 82

endif # SOC_STM32F405XG
```

## arch/arm/soc/st_stm32/stm32f4/Kconfig.defconfig.stm32f407xx
```kconfig
# Kconfig - ST STM32F407XX MCU configuration options
#
# Copyright (c) 2016 Linaro Limited.
#
# SPDX-License-Identifier: Apache-2.0
#

if SOC_STM32F407XG

config SOC
	string
	default stm32f407xx

config NUM_IRQS
	int
	default 82

if ENTROPY_GENERATOR

config ENTROPY_STM32_RNG
	def_bool y

endif # ENTROPY_GENERATOR

endif # SOC_STM32F407XG
```

## arch/arm/soc/st_stm32/stm32f4/Kconfig.defconfig.stm32f411xe
```kconfig
# Kconfig - ST STM32F411CE MCU configuration options
#
# Copyright (c) 2016 Linaro Limited.
#
# SPDX-License-Identifier: Apache-2.0
#

if SOC_STM32F411XE

config SOC
	string
	default stm32f411xe

config NUM_IRQS
	int
	default 85

if ENTROPY_GENERATOR

config ENTROPY_STM32_RNG
	def_bool y

endif # ENTROPY_GENERATOR

endif # SOC_STM32F411XE
```

## arch/arm/soc/st_stm32/stm32f4/Kconfig.defconfig.stm32f412zg
```kconfig
# Kconfig - ST STM32F412ZG MCU configuration options
#
# Copyright (c) 2017 Florian Vaussard, HEIG-VD
#
# SPDX-License-Identifier: Apache-2.0
#

if SOC_STM32F412ZG

config SOC
	string
	default stm32f412zx

config NUM_IRQS
	int
	default 97

if ENTROPY_GENERATOR

config ENTROPY_STM32_RNG
	def_bool y

endif # ENTROPY_GENERATOR

endif # SOC_STM32F412ZG
```

## arch/arm/soc/st_stm32/stm32f4/Kconfig.defconfig.stm32f413xx
```kconfig
# Kconfig - ST STM32F413XH MCU configuration options
#
# Copyright (c) 2017 Florian Vaussard, HEIG-VD
#
# SPDX-License-Identifier: Apache-2.0
#

if SOC_STM32F413XH

config SOC
	string
	default "stm32f413xx"

config NUM_IRQS
	int
	default 102

if GPIO_STM32

config GPIO_STM32_PORTF
	default y

config GPIO_STM32_PORTG
	default y

endif # GPIO_STM32

if ENTROPY_GENERATOR

config ENTROPY_STM32_RNG
	def_bool y

endif # ENTROPY_GENERATOR

endif # SOC_STM32F413XH
```

## arch/arm/soc/st_stm32/stm32f4/Kconfig.defconfig.stm32f417xx
```kconfig
# Kconfig - ST STM32F417XX MCU configuration options
#
# Copyright (c) 2016 Linaro Limited.
#
# SPDX-License-Identifier: Apache-2.0
#

if SOC_STM32F417XE || SOC_STM32F417XG

config SOC
	string
	default "stm32f417xx"

config NUM_IRQS
	int
	default 82

if GPIO_STM32

config GPIO_STM32_PORTF
	default y

config GPIO_STM32_PORTG
	default y

config GPIO_STM32_PORTI
	default y

endif # GPIO_STM32

if ENTROPY_GENERATOR

config ENTROPY_STM32_RNG
	def_bool y

endif # ENTROPY_GENERATOR

endif # SOC_STM32F417XE || SOC_STM32F417XG
```

## arch/arm/soc/st_stm32/stm32f4/Kconfig.defconfig.stm32f429xx
```kconfig
# Kconfig - ST STM32F429XX MCU configuration options
#
# Copyright (c) 2016 Linaro Limited.
#
# SPDX-License-Identifier: Apache-2.0
#

if SOC_STM32F429XX

config SOC
	string
	default stm32f429xx

config SRAM_SIZE
	default 256

config FLASH_SIZE
	default 2048

config NUM_IRQS
	int
	default 91

endif # SOC_STM32F429XX
```

## arch/arm/soc/st_stm32/stm32f4/Kconfig.defconfig.stm32f446xx
```kconfig
# Kconfig - ST STM32F446XX MCU configuration options
#
# Copyright (c) 2017 Pushpal Sidhu
#
# SPDX-License-Identifier: Apache-2.0
#

if SOC_STM32F446XE || SOC_STM32F446XC

config SOC
	string
	default stm32f446xx

config NUM_IRQS
	int
	default 97

endif # SOC_STM32F446XE || SOC_STM32F446XC
```

## arch/arm/soc/st_stm32/stm32f4/Kconfig.defconfig.stm32f469xi
```kconfig
# Kconfig - ST STM32F469XI MCU configuration options
#
# Copyright (c) 2016 Linaro Limited.
#
# SPDX-License-Identifier: Apache-2.0
#

if SOC_STM32F469XI

config SOC
	string
	default stm32f469xx

config NUM_IRQS
	int
	default 93

if GPIO_STM32

config GPIO_STM32_PORTF
	default y

config GPIO_STM32_PORTG
	default y

config GPIO_STM32_PORTI
	default y

config GPIO_STM32_PORTJ
	default y

config GPIO_STM32_PORTK
	default y

endif # GPIO_STM32

endif # SOC_STM32F469XI
```

## arch/arm/soc/st_stm32/stm32f4/Kconfig.series
```kconfig
# Kconfig - ST Microelectronics STM32F1 MCU series
#
# Copyright (c) 2016 Linaro Limited
#
# Licensed under the Apache License, Version 2.0 (the "License");
# you may not use this file except in compliance with the License.
# You may obtain a copy of the License at
#
#     http://www.apache.org/licenses/LICENSE-2.0
#
# Unless required by applicable law or agreed to in writing, software
# distributed under the License is distributed on an "AS IS" BASIS,
# WITHOUT WARRANTIES OR CONDITIONS OF ANY KIND, either express or implied.
# See the License for the specific language governing permissions and
# limitations under the License.
#

config SOC_SERIES_STM32F4X
	bool "STM32F4x Series MCU"
	select CPU_CORTEX_M
	select CPU_CORTEX_M4
	select SOC_FAMILY_STM32
	select SYS_POWER_LOW_POWER_STATE_SUPPORTED
	help
	 Enable support for STM32F4 MCU series
```

## arch/arm/soc/st_stm32/stm32f4/Kconfig.soc
```kconfig
# Kconfig.soc - ST Microelectronics STM32F4 MCU line
#
# Copyright (c) 2016 Linaro Limited.
#
# SPDX-License-Identifier: Apache-2.0
#

choice
prompt "STM32F4x MCU Selection"
depends on SOC_SERIES_STM32F4X

config SOC_STM32F401XE
	bool "STM32F401XE"

config SOC_STM32F407XG
	bool "STM32F407XG"

config SOC_STM32F411XE
	bool "STM32F411XE"

config SOC_STM32F412ZG
	bool "STM32F412ZG"

config SOC_STM32F413XH
	bool "STM32F413XH"

config SOC_STM32F429XI
	bool "STM32F429XI"

config SOC_STM32F469XI
	bool "STM32F469XI"

endchoice

config STM32_ARM_MPU_ENABLE
	bool "Enable MPU"
	depends on CPU_HAS_MPU
	select ARM_MPU
	default n
	help
	  Enable MPU

choice
prompt "Configure Bootloader Options"
depends on MPU_ENABLE

config BL_BOOTLOADER
	bool "Build the Bootloader"

config BL_APPLICATION
	bool "Build an Application"

endchoice
```

## arch/arm/soc/st_stm32/stm32f7/Kconfig.defconfig.series
```kconfig
# Kconfig.defconfig.series - ST Microelectronics STM32F7 MCU line
#
# Copyright (c) 2018 Yurii Hamann
#
# SPDX-License-Identifier: Apache-2.0
#

if SOC_SERIES_STM32F7X

gsource "arch/arm/soc/st_stm32/stm32f7/Kconfig.defconfig.stm32f7*"

config SOC_SERIES
	default "stm32f7"

endif # SOC_SERIES_STM32F7X
```
