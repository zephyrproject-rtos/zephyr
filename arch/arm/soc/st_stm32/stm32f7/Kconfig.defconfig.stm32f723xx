## arch/arm/soc/st_stm32/stm32f7/Kconfig.defconfig.stm32f723xx
```kconfig
# Kconfig - ST STM32F429XX MCU configuration options
#
# Copyright (c) 2016 Linaro Limited.
# Copyright (c) 2017 BayLibre, SAS
#
# SPDX-License-Identifier: Apache-2.0
#

if SOC_STM32F723XE

config SOC
	string
	default stm32f723xx

config NUM_IRQS
	int
	default 98

endif # SOC_STM32F723XE
```

## arch/arm/soc/st_stm32/stm32f7/Kconfig.defconfig.stm32f746xg
```kconfig
# Kconfig - ST STM32F746XG MCU configuration options
#
# Copyright (c) 2018 Yurii Hamann
#
# SPDX-License-Identifier: Apache-2.0
#

if SOC_STM32F746XG

config SOC
	string
	default "stm32f746xx"

config NUM_IRQS
	int
	default 98

endif # SOC_STM32F746XG
```

## arch/arm/soc/st_stm32/stm32f7/Kconfig.soc
```kconfig
# Kconfig.soc - ST Microelectronics STM32F7 MCU line
#
# Copyright (c) 2016 Linaro Limited.
#
# SPDX-License-Identifier: Apache-2.0
#

choice
prompt "STM32F7x MCU Selection"
depends on SOC_SERIES_STM32F7X

config SOC_STM32F769XI
	bool "STM32F769XI"

endchoice


choice
prompt "Configure Bootloader Options"
depends on MPU_ENABLE

config BL_BOOTLOADER
	bool "Build the Bootloader"

config BL_APPLICATION
	bool "Build an Application"

endchoice
```

## arch/arm/soc/st_stm32/stm32l0/Kconfig.defconfig.stm32l053x8
```kconfig
# Kconfig - ST Microelectronics STM32L053X8 MCU
#
# Copyright (c) 2018 Anthony Kreft <anthony.kreft@gmail.com>
#
# SPDX-License-Identifier: Apache-2.0
#

if SOC_STM32L053X8

config SOC
	string
	default "stm32l053xx"

config NUM_IRQS
	int
	default 32

if GPIO_STM32

config GPIO_STM32_PORTD
	default y

config GPIO_STM32_PORTH
	default y

endif # GPIO_STM32

endif # SOC_STM32L053X8
```

## arch/arm/soc/st_stm32/stm32l0/Kconfig.defconfig.stm32l073xz
```kconfig
# Kconfig - ST Microelectronics STM32L073XZ MCU
#
# Copyright (c) 2018 Ilya Tagunov <tagunil@gmail.com>
#
# SPDX-License-Identifier: Apache-2.0
#

if SOC_STM32L073XZ

config SOC
	string
	default "stm32l073xx"

config NUM_IRQS
	int
	default 32

if GPIO_STM32

config GPIO_STM32_PORTD
	default y

config GPIO_STM32_PORTE
	default y

config GPIO_STM32_PORTH
	default y

endif # GPIO_STM32

endif # SOC_STM32L073XZ
```

## arch/arm/soc/st_stm32/stm32l4/Kconfig.defconfig.series
```kconfig
# Kconfig - ST Microelectronics STM32L4 MCU line
#
# Copyright (c) 2016 Open-RnD Sp. z o.o.
# Copyright (c) 2016 BayLibre, SAS
#
# SPDX-License-Identifier: Apache-2.0
#

if SOC_SERIES_STM32L4X

source "arch/arm/soc/st_stm32/stm32l4/Kconfig.defconfig.stm32l4*"

config SOC_SERIES
	default stm32l4

if WATCHDOG

config IWDG_STM32
	def_bool y

endif # WATCHDOG

endif # SOC_SERIES_STM32L4X
```

## arch/arm/soc/st_stm32/stm32l4/Kconfig.defconfig.stm32l475xg
```kconfig
# Kconfig - ST Microelectronics STM32L475xG MCU
#
# Copyright (c) 2017 Linaro Limited
#
# SPDX-License-Identifier: Apache-2.0
#

if SOC_STM32L475XG

config SOC
	string
	default stm32l475xx

config NUM_IRQS
	int
	default 82

endif # SOC_STM32L475XG
```

## arch/arm/soc/st_stm32/stm32l4/Kconfig.defconfig.stm32l476xx
```kconfig
# Kconfig - ST Microelectronics STM32L476RG MCU
#
# Copyright (c) 2016 Open-RnD Sp. z o.o.
# Copyright (c) 2016 BayLibre, SAS
#
# SPDX-License-Identifier: Apache-2.0
#

if SOC_STM32L476XG

config SOC
	string
	default "stm32l476xx"

config NUM_IRQS
	int
	default 82

if GPIO_STM32

config GPIO_STM32_PORTD
	def_bool y

config GPIO_STM32_PORTE
	default y

config GPIO_STM32_PORTF
	default y

config GPIO_STM32_PORTG
	default y

config GPIO_STM32_PORTH
	default y

endif # GPIO_STM32

endif # SOC_STM32L476XG
```

## arch/arm/soc/st_stm32/stm32l4/Kconfig.defconfig.stm32l496xx
```kconfig
# Kconfig - ST Microelectronics STM32L496xx MCU
#
# Copyright (c) 2016 Open-RnD Sp. z o.o.
# Copyright (c) 2016 BayLibre, SAS
#
# SPDX-License-Identifier: Apache-2.0
#

if SOC_STM32L496XG

config SOC
	string
	default "stm32l496xx"

config NUM_IRQS
	int
	default 91

if GPIO_STM32

config GPIO_STM32_PORTD
	def_bool y

config GPIO_STM32_PORTE
	default y

config GPIO_STM32_PORTF
	default y

config GPIO_STM32_PORTG
	default y

config GPIO_STM32_PORTH
	default y

config GPIO_STM32_PORTI
	default y

endif # GPIO_STM32

endif # SOC_STM32L496XG
```

## arch/arm/soc/st_stm32/stm32l4/Kconfig.series
```kconfig
# Kconfig - ST Microelectronics STM32L4 MCU series
#
# Copyright (c) 2016 Open-RnD Sp. z o.o.
# Copyright (c) 2016 BayLibre, SAS
#
# SPDX-License-Identifier: Apache-2.0
#

config SOC_SERIES_STM32L4X
	bool "STM32L4x Series MCU"
	select CPU_CORTEX_M
	select CPU_CORTEX_M4
	select SOC_FAMILY_STM32
	select SYS_POWER_LOW_POWER_STATE_SUPPORTED
	select HAS_STM32CUBE
	select CPU_HAS_MPU
	select CPU_HAS_SYSTICK
	select CLOCK_CONTROL_STM32_CUBE if CLOCK_CONTROL
	help
		Enable support for STM32L4 MCU series
```

## arch/arm/soc/st_stm32/stm32l4/Kconfig.soc
```kconfig
# Kconfig - ST Microelectronics STM32L4 MCU line
#
# Copyright (c) 2016 Open-RnD Sp. z o.o.
# Copyright (c) 2016 BayLibre, SAS
#
# SPDX-License-Identifier: Apache-2.0
#

choice
prompt "STM32L4x MCU Selection"
depends on SOC_SERIES_STM32L4X

config SOC_STM32L476XG
	bool "STM32L476XG"

config SOC_STM32L496XG
	bool "STM32L496XG"

config SOC_STM32L432XC
	bool "STM32L432XC"

config SOC_STM32L475XG
	bool "STM32L475XG"

endchoice
```

## arch/arm/soc/ti_lm3s6965/Kconfig
```kconfig
# Kconfig - TI LM3S6965 platform configuration options

#
# Copyright (c) 2014-2015 Wind River Systems, Inc.
#
# Licensed under the Apache License, Version 2.0 (the "License");
# you may not use this file except in compliance with the License.
# You may obtain a copy of the License at
#
#     http://www.apache.org/licenses/LICENSE-2.0
#
# Unless required by applicable law or agreed to in writing, software
# distributed under the License is distributed on an "AS IS" BASIS,
# WITHOUT WARRANTIES OR CONDITIONS OF ANY KIND, either express or implied.
# See the License for the specific language governing permissions and
# limitations under the License.
#

if SOC_TI_LM3S6965

config SOC_TI_LM3S6965_QEMU
	def_bool y
	# Platform has only been tested on QEMU, not on real hardware, so always
	# assume it is used for a QEMU target.

endif # SOC_TI_LM3S6965
```

## arch/arm/soc/ti_lm3s6965/Kconfig.defconfig
```kconfig
# Kconfig - TI LM3S6965 platform configuration options

#
# Copyright (c) 2014-2015 Wind River Systems, Inc.
#
# SPDX-License-Identifier: Apache-2.0
#

if SOC_TI_LM3S6965

config SOC
	default "ti_lm3s6965"

config NUM_IRQS
	int
	# must be >= the highest interrupt number used
	# - include the UART interrupts
	default 34

config SYS_CLOCK_HW_CYCLES_PER_SEC
	int
	default 12000000

if UART_STELLARIS

config UART_STELLARIS_PORT_0
	def_bool y

config UART_STELLARIS_PORT_1
	def_bool y

config UART_STELLARIS_PORT_2
	def_bool y

endif # UART_STELLARIS

endif
```

## arch/arm/soc/ti_lm3s6965/Kconfig.soc
```kconfig
config SOC_TI_LM3S6965
	bool "TI LM3S6965"
	select CPU_CORTEX_M3
	select CPU_HAS_SYSTICK
```

## arch/arm/soc/ti_simplelink/Kconfig
```kconfig
# Kconfig - Texas Instruments SimpleLink Family
#

config SOC_FAMILY_TISIMPLELINK
	bool
	# omit prompt to signify a "hidden" option
	default n

if SOC_FAMILY_TISIMPLELINK
config SOC_FAMILY
	string
	default ti_simplelink
endif

source "arch/arm/soc/ti_simplelink/*/Kconfig.soc"
```

## arch/arm/soc/ti_simplelink/Kconfig.soc
```kconfig
# Kconfig - Texas Instruments SimpleLink Family
#

source "arch/arm/soc/ti_simplelink/*/Kconfig.series"
```

## arch/arm/soc/ti_simplelink/cc2650/Kconfig.defconfig.series
```kconfig
# SPDX-License-Identifier: Apache-2.0
#
# Kconfig.defconfig.series - TI SimpleLink CC2650
#

if SOC_SERIES_CC2650

config SOC_SERIES
	default cc2650

config SYS_CLOCK_HW_CYCLES_PER_SEC
	default 48000000

config NUM_IRQS
	default 34

endif # SOC_SERIES_CC2650
```

## arch/arm/soc/ti_simplelink/cc2650/Kconfig.series
```kconfig
# SPDX-License-Identifier: Apache-2.0
#
# Kconfig.series - TI SimpleLink CC2650
#

config  SOC_SERIES_CC2650
	bool "TI SimpleLink Family CC2650"
	select CPU_CORTEX_M3
	select SOC_FAMILY_TISIMPLELINK
	select CPU_HAS_SYSTICK
	help
	  Enable support for TI SimpleLink CC2650.
```

## arch/arm/soc/ti_simplelink/cc2650/Kconfig.soc
```kconfig
# SPDX-License-Identifier: Apache-2.0
#
# Kconfig.soc - Texas Instruments CC2650
#

choice
prompt "TI SimpleLink MCU Selection"
depends on SOC_SERIES_CC2650

config SOC_CC2650
	bool "CC2650"

endchoice

if SOC_SERIES_CC2650

config TI_CCFG_PRESENT
	bool
	default y

endif # SOC_SERIES_CC2650
```

## arch/arm/soc/ti_simplelink/cc32xx/Kconfig.defconfig.cc3200
```kconfig
# Kconfig.defconfig.cc3200- TI SimpleLink CC3200 SoC
#

if SOC_CC3200

config SOC
	string
	default cc3200

config SYS_CLOCK_HW_CYCLES_PER_SEC
	int
	default 80000000

if !HAS_DTS
config SRAM_SIZE
	default 240

config FLASH_SIZE
	default 0

config NUM_IRQS
	int
	# must be >= the highest interrupt number used
	# This includes the NWP interrupt
	default 179

endif # !HAS_DTS

config CC3200SDK_LIBRARY
	def_bool n

if !HAS_DTS
if UART_CC32XX
config UART_CC32XX_IRQ_PRI
	default 3
endif # UART_CC32XX
endif # !HAS_DTS

if GPIO

config GPIO_CC32XX
	def_bool y

config GPIO_CC32XX_A0
	default n

config GPIO_CC32XX_A1
	default y

config GPIO_CC32XX_A2
	default y

config GPIO_CC32XX_A3
	default n

endif # GPIO

endif # SOC_CC3200
```

## arch/arm/soc/ti_simplelink/cc32xx/Kconfig.defconfig.cc3220sf
```kconfig
# Kconfig.defconfig.cc3220sf - TI SimpleLink CC3220SF SoC
#

if SOC_CC3220SF

config SOC
	string
	default "cc3220sf"

config NUM_IRQS
	int
	# must be >= the highest interrupt number used
	# This includes the NWP interrupt
	default 179

config SYS_CLOCK_HW_CYCLES_PER_SEC
	int
	default 80000000

config TEXT_SECTION_OFFSET
	default 0x800 if XIP
	default 0x0   if !XIP

# Override the setting in misc/Kconfig to allow full use of SRAM:
config BOOTLOADER_SRAM_SIZE
	default 0 if !XIP

if GPIO

config GPIO_CC32XX
	def_bool y

config GPIO_CC32XX_A0
	default n

config GPIO_CC32XX_A1
	default y

config GPIO_CC32XX_A2
	default y

config GPIO_CC32XX_A3
	default n

endif # GPIO

endif # SOC_CC3220SF
```

## arch/arm/soc/ti_simplelink/cc32xx/Kconfig.defconfig.series
```kconfig
# Kconfig.defconfig.series - TI SimpleLink Family
#

if SOC_SERIES_CC32XX

source "arch/arm/soc/ti_simplelink/cc32xx/Kconfig.defconfig.cc32*"

config SOC_SERIES
	default "cc32xx"

endif # SOC_SERIES_CC32XX
```

## arch/arm/soc/ti_simplelink/cc32xx/Kconfig.soc
```kconfig
# Kconfig.soc - Texas Instruments CC32XX
#

choice
prompt "TI SimpleLink MCU Selection"
depends on SOC_SERIES_CC32XX

config SOC_CC3220SF
	bool "CC3220SF"
	select HAS_CC3220SDK

endchoice


if SOC_CC3220SF

config CC3220SF_DEBUG
	bool "Prepend debug header, disabling flash verification" if XIP
	default XIP

endif # SOC_CC3220SF
```

## arch/arm/soc/ti_simplelink/msp432p4xx/Kconfig.defconfig.msp432p401r
```kconfig
# SPDX-License-Identifier: Apache-2.0
#
# Copyright (c) 2017, Linaro Ltd
#
# Kconfig.defconfig.msp432p401r- TI SimpleLink MSP432P401R SoC
#

if SOC_MSP432P401R

config SOC
	string
	default "msp432p401r"

config SYS_CLOCK_HW_CYCLES_PER_SEC
	int
	default 48000000

config SYS_CLOCK_TICKS_PER_SEC
	int
	default 1000

config NUM_IRQS
	int
	default 64

endif # SOC_MSP432P401R
```
