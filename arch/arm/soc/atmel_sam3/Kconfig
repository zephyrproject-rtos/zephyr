## arch/arm/soc/atmel_sam3/Kconfig
```kconfig
# Kconfig - Atmel SAM3 family processor configuration options

#
# Copyright (c) 2016 Intel Corporation.
# Copyright (c) 2014-2015 Wind River Systems, Inc.
#
# Licensed under the Apache License, Version 2.0 (the "License");
# you may not use this file except in compliance with the License.
# You may obtain a copy of the License at
#
#     http://www.apache.org/licenses/LICENSE-2.0
#
# Unless required by applicable law or agreed to in writing, software
# distributed under the License is distributed on an "AS IS" BASIS,
# WITHOUT WARRANTIES OR CONDITIONS OF ANY KIND, either express or implied.
# See the License for the specific language governing permissions and
# limitations under the License.
#

config SOC_ATMEL_SAM3
	bool
	default n

if SOC_ATMEL_SAM3

config SOC
	default atmel_sam3

config NUM_IRQ_PRIO_BITS
	int
	default 3

#
# SAM3X8E has total 45 peripherals capable of
# generating interrupts.
#
config NUM_IRQS
	int
	default 45

config SYS_CLOCK_HW_CYCLES_PER_SEC
	int
	default 84000000

#
# SRAM address depends on the processor.
#
# SAM3X8E has two SRAM banks:
#   64K @ 0x20000000
#   32K @ 0x20080000
# The first 64K is mirrored at 0x20070000
# to provide one continuous 96K block.
#
config SRAM_SIZE
	default 96 if SOC_ATMEL_SAM3X8E

config SRAM_BASE_ADDRESS
	default 0x20000000
	default 0x20070000 if SOC_ATMEL_SAM3X8E

#
# Atmel SAM3 family has flash starting @ 0x00080000.
#
# SAM3X8E has 512K of flash.
#
config FLASH_SIZE
	default 512 if SOC_ATMEL_SAM3X8E

config FLASH_BASE_ADDRESS
	default 0x00080000

config SOC_ATMEL_SAM3_EXT_SLCK
	bool "Atmel SAM3 to use external crystal oscillator for slow clock"
	default n
	help
	Says y if you want to use external 32 kHz crystal
	oscillator to drive the slow clock. Note that this
	adds a few seconds to boot time, as the crystal
	needs to stabilize after power-up.

	Says n if you do not need accraute and precise timers.
	The slow clock will be driven by the internal fast
	RC oscillator running at 32 kHz.

config SOC_ATMEL_SAM3_EXT_MAINCK
	bool "Atmel SAM3 to use external crystal oscillator for main clock"
	default n
	help
	The main clock is being used to drive the PLL, and
	thus driving the processor clock.

	Says y if you want to use external crystal oscillator
	to drive the main clock. Note that this adds about
	a second to boot time, as the crystal needs to
	stabilize after power-up.

	The crystal used here can be from 3 to 20 MHz.

	Says n here will use the internal fast RC oscillator
	running at 12 MHz.

config SOC_ATMEL_SAM3_PLLA_MULA
	hex
	default 0x06
	help
	This is the multiplier (MULA) used by the PLL.
	The processor clock is (MAINCK * (MULA + 1) / DIVA).

	Board config file can override this settings
	for a particular board.

	With default of MULA == 6, and DIVA == 1,
	PLL is running at 7 times of main clock.

config SOC_ATMEL_SAM3_PLLA_DIVA
	hex
	default 0x01
	help
	This is the divider (DIVA) used by the PLL.
	The processor clock is (MAINCK * (MULA + 1) / DIVA).

	Board config file can override this settings
	for a particular board.

	With default of MULA == 6, and DIVA == 1,
	PLL is running at 7 times of main clock.

config KERNEL_INIT_PRIORITY_DEFAULT
	default 40

config KERNEL_INIT_PRIORITY_DEVICE
	default 50

config UART_CONSOLE_PRIORITY
	default 60

if UART_ATMEL_SAM3

config UART_ATMEL_SAM3_BAUD_RATE
	default 115200

config UART_ATMEL_SAM3_CLK_FREQ
	default 84000000

endif # UART_ATMEL_SAM3

if UART_CONSOLE

config UART_CONSOLE_ON_DEV_NAME
	default "UART_0"
config UART_CONSOLE_IRQ
	default 8
config UART_CONSOLE_IRQ_PRI
	default 3

endif # UART_CONSOLE

endif # SOC_ATMEL_SAM3
```

## arch/arm/soc/atmel_sam3/Kconfig.defconfig
```kconfig
# Kconfig - Atmel SAM3 family processor configuration options

#
# Copyright (c) 2016 Intel Corporation.
# Copyright (c) 2014-2015 Wind River Systems, Inc.
#
# SPDX-License-Identifier: Apache-2.0
#

if SOC_ATMEL_SAM3

config SOC
	default atmel_sam3

config NUM_IRQ_PRIO_BITS
	int
	default 3

#
# SAM3X8E has total 45 peripherals capable of
# generating interrupts.
#
config NUM_IRQS
	int
	default 45

config SYS_CLOCK_HW_CYCLES_PER_SEC
	int
	default 84000000

#
# SRAM address depends on the processor.
#
# SAM3X8E has two SRAM banks:
#   64K @ 0x20000000
#   32K @ 0x20080000
# The first 64K is mirrored at 0x20070000
# to provide one continuous 96K block.
#
config SRAM_SIZE
	default 96 if SOC_ATMEL_SAM3X8E

config SRAM_BASE_ADDRESS
	default 0x20000000 if !SOC_ATMEL_SAM3X8E
	default 0x20070000 if SOC_ATMEL_SAM3X8E

#
# Atmel SAM3 family has flash starting @ 0x00080000.
#
# SAM3X8E has 512K of flash.
#
config FLASH_SIZE
	default 512 if SOC_ATMEL_SAM3X8E

config FLASH_BASE_ADDRESS
	default 0x00080000

if UART_ATMEL_SAM3

config UART_ATMEL_SAM3_BAUD_RATE
	default 115200

config UART_ATMEL_SAM3_CLK_FREQ
	default 84000000

endif # UART_ATMEL_SAM3

if GPIO

config GPIO_ATMEL_SAM3
	def_bool y

config GPIO_ATMEL_SAM3_PORTA
	default y

config GPIO_ATMEL_SAM3_PORTB
	default y

config GPIO_ATMEL_SAM3_PORTC
	default y

config GPIO_ATMEL_SAM3_PORTD
	default y

endif # GPIO

if I2C

config I2C_ATMEL_SAM3
	def_bool y

config I2C_0
	default y
config I2C_0_IRQ_PRI
	default 0

config I2C_1
	default y

config I2C_1_IRQ_PRI
	default 0

endif # I2C

endif # SOC_ATMEL_SAM3
```

## arch/arm/soc/atmel_sam3/Kconfig.soc
```kconfig
config SOC_ATMEL_SAM3X8E
	bool "Atmel SAM3X8E Processor"
	select CPU_CORTEX_M
	select CPU_CORTEX_M3
	select SOC_ATMEL_SAM3
	select SYS_POWER_LOW_POWER_STATE_SUPPORTED
```

## arch/arm/soc/fsl_frdm_k64f/Kconfig
```kconfig
# Kconfig - FSL FRDM K64F platform configuration options

#
# Copyright (c) 2014-2016 Wind River Systems, Inc.
#
# Licensed under the Apache License, Version 2.0 (the "License");
# you may not use this file except in compliance with the License.
# You may obtain a copy of the License at
#
#     http://www.apache.org/licenses/LICENSE-2.0
#
# Unless required by applicable law or agreed to in writing, software
# distributed under the License is distributed on an "AS IS" BASIS,
# WITHOUT WARRANTIES OR CONDITIONS OF ANY KIND, either express or implied.
# See the License for the specific language governing permissions and
# limitations under the License.
#

if SOC_FSL_FRDM_K64F

config K64_CORE_CLOCK_DIVIDER
	int
	prompt "Freescale K64 core clock divider"
	default 1
	help
	This option specifies the divide value for the K64 processor core clock
	from the system clock.

config K64_BUS_CLOCK_DIVIDER
	int
	prompt "Freescale K64 bus clock divider"
	default 2
	help
	This option specifies the divide value for the K64 bus clock from the
	system clock.

config K64_FLEXBUS_CLOCK_DIVIDER
	int
	prompt "Freescale K64 FlexBus clock divider"
	default 3
	help
	This option specifies the divide value for the K64 FlexBus clock from the
	system clock.

config K64_FLASH_CLOCK_DIVIDER
	int
	prompt "Freescale K64 flash clock divider"
	default 5
	help
	This option specifies the divide value for the K64 flash clock from the
	system clock.

config WDOG_INIT
	def_bool y
	# omit prompt to signify a "hidden" option
	help
	This processor enables the watchdog timer with a short timeout
	upon reset. Therefore, this requires that the watchdog be configured
	during reset handling.

config PRESERVE_JTAG_IO_PINS
	bool "Freescale FRDM-K64F JTAG pin usage"
	depends on PINMUX
	default y
	help
	The FRDM-K64F board routes the PTA0/1/2 pins as JTAG/SWD signals that
	are used for the OpenSDAv2 debug interface.  These pins are also routed to
	the Arduino header as D8, D3 and D5, respectively.
	Enable this option to preserve these pins for the debug interface.

endif # SOC_FSL_FRDM_K64F
```

## arch/arm/soc/fsl_frdm_k64f/Kconfig.soc
```kconfig
config  SOC_FSL_FRDM_K64F
	bool "Freescale FRDM-K64F"
	select CPU_CORTEX_M
	select CPU_CORTEX_M4
	select SYS_POWER_LOW_POWER_STATE_SUPPORTED
```

## arch/arm/soc/nordic_nrf/Kconfig.soc
```kconfig
# Kconfig.soc - Nordic Semiconductor nRFx MCU line
#
# Copyright (c) 2016-2018 Nordic Semiconductor ASA
#
# SPDX-License-Identifier: Apache-2.0
#

source "arch/arm/soc/nordic_nrf/*/Kconfig.series"
```

## arch/arm/soc/nordic_nrf/nrf51/Kconfig.defconfig.nrf51822_QFAA
```kconfig
# Kconfig.defconfig.nrf51822_QFAA - Nordic Semiconductor nRF51822 MCU
#
# Copyright (c) 2016 Linaro Limited
# Copyright (c) 2016 Nordic Semiconductor ASA
#
# SPDX-License-Identifier: Apache-2.0
#

if SOC_NRF51822_QFAA

config SOC
	string
	default "nRF51822_QFAA"

config ISR_STACK_SIZE
	default 640

endif # SOC_NRF51822_QFAA
```

## arch/arm/soc/nordic_nrf/nrf51/Kconfig.defconfig.nrf51822_QFAC
```kconfig
# Kconfig.defconfig.nrf51822_QFAC - Nordic Semiconductor nRF51822 MCU
#
# Copyright (c) 2016 Linaro Limited
# Copyright (c) 2016 Nordic Semiconductor ASA
#
# SPDX-License-Identifier: Apache-2.0
#

if SOC_NRF51822_QFAC

config SOC
	string
	default "nRF51822_QFAC"

endif # SOC_NRF51822_QFAC
```

## arch/arm/soc/nordic_nrf/nrf52/Kconfig.soc
```kconfig
# Kconfig.soc - Nordic Semiconductor nRF52 MCU line
#
# Copyright (c) 2016 Nordic Semiconductor ASA
#
# SPDX-License-Identifier: Apache-2.0
#

config SOC_NRF52810
	depends on SOC_SERIES_NRF52X
	bool
	select HAS_HW_NRF_CCM
	select HAS_HW_NRF_CLOCK
	select HAS_HW_NRF_COMP
	select HAS_HW_NRF_ECB
	select HAS_HW_NRF_EGU0
	select HAS_HW_NRF_EGU1
	select HAS_HW_NRF_GPIO0
	select HAS_HW_NRF_GPIOTE
	select HAS_HW_NRF_PDM
	select HAS_HW_NRF_POWER
	select HAS_HW_NRF_PPI
	select HAS_HW_NRF_PWM0
	select HAS_HW_NRF_QDEC
	select HAS_HW_NRF_RNG
	select HAS_HW_NRF_RTC0
	select HAS_HW_NRF_RTC1
	select HAS_HW_NRF_SAADC
	select HAS_HW_NRF_SPIM0
	select HAS_HW_NRF_SPIS0
	select HAS_HW_NRF_SWI0
	select HAS_HW_NRF_SWI1
	select HAS_HW_NRF_SWI2
	select HAS_HW_NRF_SWI3
	select HAS_HW_NRF_SWI4
	select HAS_HW_NRF_SWI5
	select HAS_HW_NRF_TEMP
	select HAS_HW_NRF_TIMER0
	select HAS_HW_NRF_TIMER1
	select HAS_HW_NRF_TIMER2
	select HAS_HW_NRF_TWIM0
	select HAS_HW_NRF_TWIS0
	select HAS_HW_NRF_UARTE0
	select HAS_HW_NRF_WDT

config SOC_NRF52832
	depends on SOC_SERIES_NRF52X
	bool
	select CPU_HAS_FPU
	select HAS_HW_NRF_CCM
	select HAS_HW_NRF_CLOCK
	select HAS_HW_NRF_COMP
	select HAS_HW_NRF_ECB
	select HAS_HW_NRF_EGU0
	select HAS_HW_NRF_EGU1
	select HAS_HW_NRF_EGU2
	select HAS_HW_NRF_EGU3
	select HAS_HW_NRF_EGU4
	select HAS_HW_NRF_EGU5
	select HAS_HW_NRF_GPIO0
	select HAS_HW_NRF_GPIOTE
	select HAS_HW_NRF_I2S
	select HAS_HW_NRF_LPCOMP
	select HAS_HW_NRF_MWU
	select HAS_HW_NRF_NFCT
	select HAS_HW_NRF_PDM
	select HAS_HW_NRF_POWER
	select HAS_HW_NRF_PPI
	select HAS_HW_NRF_PWM0
	select HAS_HW_NRF_PWM1
	select HAS_HW_NRF_PWM2
	select HAS_HW_NRF_QDEC
	select HAS_HW_NRF_RNG
	select HAS_HW_NRF_RTC0
	select HAS_HW_NRF_RTC1
	select HAS_HW_NRF_RTC2
	select HAS_HW_NRF_SAADC
	select HAS_HW_NRF_SPI0
	select HAS_HW_NRF_SPI1
	select HAS_HW_NRF_SPI2
	select HAS_HW_NRF_SPIM0
	select HAS_HW_NRF_SPIM1
	select HAS_HW_NRF_SPIM2
	select HAS_HW_NRF_SPIS0
	select HAS_HW_NRF_SPIS1
	select HAS_HW_NRF_SPIS2
	select HAS_HW_NRF_SWI0
	select HAS_HW_NRF_SWI1
	select HAS_HW_NRF_SWI2
	select HAS_HW_NRF_SWI3
	select HAS_HW_NRF_SWI4
	select HAS_HW_NRF_SWI5
	select HAS_HW_NRF_TEMP
	select HAS_HW_NRF_TIMER0
	select HAS_HW_NRF_TIMER1
	select HAS_HW_NRF_TIMER2
	select HAS_HW_NRF_TIMER3
	select HAS_HW_NRF_TIMER4
	select HAS_HW_NRF_TWI0
	select HAS_HW_NRF_TWI1
	select HAS_HW_NRF_TWIM0
	select HAS_HW_NRF_TWIM1
	select HAS_HW_NRF_TWIS0
	select HAS_HW_NRF_TWIS1
	select HAS_HW_NRF_UART0
	select HAS_HW_NRF_UARTE0
	select HAS_HW_NRF_WDT

config SOC_NRF52840
	depends on SOC_SERIES_NRF52X
	bool
	select CPU_HAS_FPU
	select HAS_HW_NRF_ACL
	select HAS_HW_NRF_CC310
	select HAS_HW_NRF_CCM
	select HAS_HW_NRF_CLOCK
	select HAS_HW_NRF_COMP
	select HAS_HW_NRF_ECB
	select HAS_HW_NRF_EGU0
	select HAS_HW_NRF_EGU1
	select HAS_HW_NRF_EGU2
	select HAS_HW_NRF_EGU3
	select HAS_HW_NRF_EGU4
	select HAS_HW_NRF_EGU5
	select HAS_HW_NRF_GPIO0
	select HAS_HW_NRF_GPIO1
	select HAS_HW_NRF_GPIOTE
	select HAS_HW_NRF_I2S
	select HAS_HW_NRF_LPCOMP
	select HAS_HW_NRF_MWU
	select HAS_HW_NRF_NFCT
	select HAS_HW_NRF_PDM
	select HAS_HW_NRF_POWER
	select HAS_HW_NRF_PPI
	select HAS_HW_NRF_PWM0
	select HAS_HW_NRF_PWM1
	select HAS_HW_NRF_PWM2
	select HAS_HW_NRF_PWM3
	select HAS_HW_NRF_QDEC
	select HAS_HW_NRF_QSPI
	select HAS_HW_NRF_RNG
	select HAS_HW_NRF_RTC0
	select HAS_HW_NRF_RTC1
	select HAS_HW_NRF_RTC2
	select HAS_HW_NRF_SAADC
	select HAS_HW_NRF_SPI0
	select HAS_HW_NRF_SPI1
	select HAS_HW_NRF_SPI2
	select HAS_HW_NRF_SPIM0
	select HAS_HW_NRF_SPIM1
	select HAS_HW_NRF_SPIM2
	select HAS_HW_NRF_SPIM3
	select HAS_HW_NRF_SPIS0
	select HAS_HW_NRF_SPIS1
	select HAS_HW_NRF_SPIS2
	select HAS_HW_NRF_SWI0
	select HAS_HW_NRF_SWI1
	select HAS_HW_NRF_SWI2
	select HAS_HW_NRF_SWI3
	select HAS_HW_NRF_SWI4
	select HAS_HW_NRF_SWI5
	select HAS_HW_NRF_TEMP
	select HAS_HW_NRF_TIMER0
	select HAS_HW_NRF_TIMER1
	select HAS_HW_NRF_TIMER2
	select HAS_HW_NRF_TIMER3
	select HAS_HW_NRF_TIMER4
	select HAS_HW_NRF_TWI0
	select HAS_HW_NRF_TWI1
	select HAS_HW_NRF_TWIM0
	select HAS_HW_NRF_TWIM1
	select HAS_HW_NRF_TWIS0
	select HAS_HW_NRF_TWIS1
	select HAS_HW_NRF_UART0
	select HAS_HW_NRF_UARTE0
	select HAS_HW_NRF_UARTE1
	select HAS_HW_NRF_USBD
	select HAS_HW_NRF_WDT

choice
prompt "nRF52x MCU Selection"
depends on SOC_SERIES_NRF52X

config SOC_NRF52810_QFAA
	bool "NRF52810_QFAA"
	select SOC_NRF52810

config SOC_NRF52832_QFAA
	bool "NRF52832_QFAA"
	select SOC_NRF52832

config SOC_NRF52840_QIAA
	bool "NRF52840_QIAA"
	select SOC_NRF52840

endchoice

config SOC_DCDC_NRF52X
	bool
	help
	  Enable nRF52 series System on Chip DC/DC converter.

config ARM_MPU_NRF52X
	bool "Enable MPU on nRF52"
	depends on CPU_HAS_MPU
	select ARM_MPU
	help
	  Enable MPU support on Nordic Semiconductor nRF52x series ICs.

config NFCT_PINS_AS_GPIOS
	bool "NFCT pins as GPIOs"
	depends on SOC_NRF52832 || SOC_NRF52840
	help
	  P0.9 and P0.10 are usually reserved for NFC. This option switch
	  them to normal GPIO mode. HW enabling happens once in the device
	  lifetime, during the first system startup. Disabling this option will
	  not switch back these pins to NFCT mode. Doing this requires UICR
	  erase prior to flashing device using the image which has
	  this option disabled.

config GPIO_AS_PINRESET
	bool "GPIO as pin reset (reset button)"
	depends on SOC_SERIES_NRF52X
	default y

config NRF_ENABLE_ICACHE
	bool "Enable the instruction cache (I-Cache)"
	depends on SOC_NRF52832 || SOC_NRF52840
	default y
```

## arch/arm/soc/nordic_nrf5/Kconfig
```kconfig
# Kconfig - Nordic Semiconductor nRF5 MCU line
#
# Copyright (c) 2016 Nordic Semiconductor ASA
#
# SPDX-License-Identifier: Apache-2.0
#

config SOC_FAMILY_NRF5
	bool
	# omit prompt to signify a "hidden" option
	default n

if SOC_FAMILY_NRF5
config SOC_FAMILY
	string
	default nordic_nrf5
endif

source "arch/arm/soc/nordic_nrf5/*/Kconfig.soc"
```

## arch/arm/soc/nordic_nrf5/Kconfig.defconfig
```kconfig
# Kconfig.defconfig - Nordic Semiconductor nRF5 MCU line
#
# Copyright (c) 2016 Nordic Semiconductor ASA
#
# SPDX-License-Identifier: Apache-2.0
#

if SOC_FAMILY_NRF5

config BUILD_OUTPUT_HEX
	default y

if SERIAL

config GPIO
	default y

endif # SERIAL

if GPIO

config GPIO_NRF5
	default y

endif # GPIO

if FLASH

config SOC_FLASH_NRF5
	def_bool y

endif # FLASH

source "arch/arm/soc/nordic_nrf5/*/Kconfig.defconfig.series"

endif # SOC_FAMILY_NRF5
```

## arch/arm/soc/nordic_nrf5/Kconfig.soc
```kconfig
# Kconfig.soc - Nordic Semiconductor nRF5 MCU line
#
# Copyright (c) 2016 Nordic Semiconductor ASA
#
# SPDX-License-Identifier: Apache-2.0
#

source "arch/arm/soc/nordic_nrf5/*/Kconfig.series"
```

## arch/arm/soc/nordic_nrf5/nrf51/Kconfig.defconfig.nrf51822_QFAB
```kconfig
# Kconfig.defconfig.nrf51822_QFAB - Nordic Semiconductor nRF51822 MCU
#
# Copyright (c) 2016 Linaro Limited
# Copyright (c) 2016 Nordic Semiconductor ASA
#
# SPDX-License-Identifier: Apache-2.0
#

if SOC_NRF51822_QFAB

config SOC
	string
	default nRF51822_QFAB

config SRAM_SIZE
	default 16

config FLASH_SIZE
	default 128

config ISR_STACK_SIZE
	default 640

endif # SOC_NRF51822_QFAB
```
