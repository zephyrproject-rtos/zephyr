## arch/arm/soc/nordic_nrf5/nrf51/Kconfig.defconfig.nrf51822_QFAC
```kconfig
# Kconfig.defconfig.nrf51822_QFAC - Nordic Semiconductor nRF51822 MCU
#
# Copyright (c) 2016 Linaro Limited
# Copyright (c) 2016 Nordic Semiconductor ASA
#
# Licensed under the Apache License, Version 2.0 (the "License");
# you may not use this file except in compliance with the License.
# You may obtain a copy of the License at
#
#     http://www.apache.org/licenses/LICENSE-2.0
#
# Unless required by applicable law or agreed to in writing, software
# distributed under the License is distributed on an "AS IS" BASIS,
# WITHOUT WARRANTIES OR CONDITIONS OF ANY KIND, either express or implied.
# See the License for the specific language governing permissions and
# limitations under the License.
#

if SOC_NRF51822_QFAC

config SOC
	string
	default nRF51822_QFAC

config SRAM_SIZE
	default 32

config FLASH_SIZE
	default 256

endif # SOC_NRF51822_QFAC
```

## arch/arm/soc/nordic_nrf5/nrf51/Kconfig.defconfig.series
```kconfig
# Kconfig.defconfig.series - Nordic Semiconductor nRF5 MCU line
#
# Copyright (c) 2016 Linaro Limited
#
# SPDX-License-Identifier: Apache-2.0
#

if SOC_SERIES_NRF51X

source "arch/arm/soc/nordic_nrf5/nrf51/Kconfig.defconfig.nrf51*"

config SOC_SERIES
	default nrf51

config SYS_CLOCK_HW_CYCLES_PER_SEC
	int
	default 32768

config SYS_POWER_MANAGEMENT
	default y

config SRAM_BASE_ADDRESS
	default 0x20000000

config FLASH_BASE_ADDRESS
	default 0x00000000

config NUM_IRQS
	int
	default 26

config NUM_IRQ_PRIO_BITS
	int
	default 2

if SENSOR

config TEMP_NRF5
	def_bool y

endif # SENSOR

endif # SOC_SERIES_NRF51X
```

## arch/arm/soc/nordic_nrf5/nrf51/Kconfig.series
```kconfig
# Kconfig.series - Nordic Semiconductor nRF5 MCU line
#
# Copyright (c) 2016 Linaro Limited
#
# SPDX-License-Identifier: Apache-2.0
#

config  SOC_SERIES_NRF51X
	bool "Nordic Semiconductor nRF51 series MCU"
	select CPU_CORTEX_M
	select CPU_CORTEX_M0
	select SOC_FAMILY_NRF5
	select NRF_RTC_TIMER
	select CLOCK_CONTROL
	select CLOCK_CONTROL_NRF5
	select SYS_POWER_LOW_POWER_STATE_SUPPORTED
	select XIP
	select HAS_CMSIS
	select HAS_NORDIC_MDK
	select HAS_NORDIC_HAL
	help
	  Enable support for NRF51 MCU series
```

## arch/arm/soc/nordic_nrf5/nrf52/Kconfig.defconfig.nrf52832
```kconfig
# Kconfig.defconfig.nrf52832 - Nordic Semiconductor nRF52832 MCU
#
# Copyright (c) 2016 Nordic Semiconductor ASA
#
# SPDX-License-Identifier: Apache-2.0
#


if SOC_NRF52832

config SOC
	string
	default nRF52832

config SRAM_SIZE
	default 64

config FLASH_SIZE
	default 512

config NUM_IRQS
	int
	default 39

endif # SOC_NRF52832
```

## arch/arm/soc/nordic_nrf5/nrf52/Kconfig.defconfig.nrf52832_QFAA
```kconfig
# Kconfig.defconfig.nrf52832 - Nordic Semiconductor nRF52832 MCU
#
# Copyright (c) 2016 Nordic Semiconductor ASA
#
# SPDX-License-Identifier: Apache-2.0
#


if SOC_NRF52832_QFAA

config SOC
	string
	default nRF52832_QFAA

if !HAS_DTS
config SRAM_SIZE
	default 64

config FLASH_SIZE
	default 512
endif

config NUM_IRQS
	int
	default 39

endif # SOC_NRF52832_QFAA
```

## arch/arm/soc/nordic_nrf5/nrf52/Kconfig.defconfig.nrf52840
```kconfig
# Kconfig.defconfig.nrf52840 - Nordic Semiconductor nRF52840 MCU
#
# Copyright (c) 2016 Nordic Semiconductor ASA
#
# SPDX-License-Identifier: Apache-2.0
#


if SOC_NRF52840

config SOC
	string
	default nRF52840

config SRAM_SIZE
	default 256

config FLASH_SIZE
	default 1024

config NUM_IRQS
	int
	default 46

endif # SOC_NRF52840
```

## arch/arm/soc/nordic_nrf5/nrf52/Kconfig.defconfig.nrf52840_QIAA
```kconfig
# Kconfig.defconfig.nrf52840 - Nordic Semiconductor nRF52840 MCU
#
# Copyright (c) 2016 Nordic Semiconductor ASA
#
# SPDX-License-Identifier: Apache-2.0
#


if SOC_NRF52840_QIAA

config SOC
	string
	default nRF52840_QIAA

config NUM_IRQS
	int
	default 48

endif # SOC_NRF52840_QIAA
```

## arch/arm/soc/nordic_nrf5/nrf52/Kconfig.defconfig.series
```kconfig
# Kconfig.defconfig.series - Nordic Semiconductor nRF5 MCU line
#
# Copyright (c) 2016 Nordic Semiconductor ASA
#
# SPDX-License-Identifier: Apache-2.0
#

if SOC_SERIES_NRF52X

source "arch/arm/soc/nordic_nrf5/nrf52/Kconfig.defconfig.nrf52*"

config SOC_SERIES
	default nrf52

config SYS_CLOCK_HW_CYCLES_PER_SEC
	int
	default 32768

config SYS_POWER_MANAGEMENT
	default y

config SRAM_BASE_ADDRESS
	default 0x20000000

config FLASH_BASE_ADDRESS
	default 0x00000000

config NUM_IRQ_PRIO_BITS
	int
	default 3

endif # SOC_SERIES_NRF52X
```

## arch/arm/soc/nordic_nrf5/nrf52/Kconfig.series
```kconfig
# Kconfig.series - Nordic Semiconductor nRF5 MCU line
#
# Copyright (c) 2016 Nordic Semiconductor ASA
#
# SPDX-License-Identifier: Apache-2.0
#

config  SOC_SERIES_NRF52X
	bool "Nordic Semiconductor nRF52 series MCU"
	select CPU_CORTEX_M
	select CPU_CORTEX_M4
	select CPU_HAS_FPU
	select SOC_FAMILY_NRF5
	select NRF_RTC_TIMER
	select CLOCK_CONTROL
	select CLOCK_CONTROL_NRF5
	select SYS_POWER_LOW_POWER_STATE_SUPPORTED
	select XIP
	select HAS_CMSIS
	select HAS_NORDIC_MDK
	select HAS_NORDIC_HAL
	help
	 Enable support for NRF52 MCU series
```

## arch/arm/soc/nordic_nrf5/nrf52/Kconfig.soc
```kconfig
# Kconfig.soc - Nordic Semiconductor nRF52 MCU line
#
# Copyright (c) 2016 Nordic Semiconductor ASA
#
# SPDX-License-Identifier: Apache-2.0
#

config SOC_NRF52832
	depends on SOC_SERIES_NRF52X
	bool

config SOC_NRF52840
	depends on SOC_SERIES_NRF52X
	bool

choice
prompt "nRF52x MCU Selection"
depends on SOC_SERIES_NRF52X

config SOC_NRF52832_QFAA
	bool "NRF52832_QFAA"
	select SOC_NRF52832

config SOC_NRF52840_QIAA
	bool "NRF52840_QIAA"
	select SOC_NRF52840

endchoice

config ARM_MPU_NRF52X
	bool "Enable MPU on nRF52"
	depends on CPU_HAS_MPU
	select ARM_MPU
	default n
	help
	  Enable MPU support on Nordic Semiconductor nRF52x series ICs.
```

## arch/arm/soc/nxp_imx/Kconfig
```kconfig
#
# Copyright (c) 2017, NXP
#
# SPDX-License-Identifier: Apache-2.0
#

config SOC_FAMILY_IMX
	bool
	# omit prompt to signify a "hidden" option
	default n

if SOC_FAMILY_IMX
config SOC_FAMILY
	string
	default "nxp_imx"
endif

source "arch/arm/soc/nxp_imx/*/Kconfig.soc"

config SOC_PART_NUMBER
	string
	default SOC_PART_NUMBER_IMX_RT if SOC_SERIES_IMX_RT
	help
	  This string holds the full part number of the SoC. It is a hidden option
	  that you should not set directly. The part number selection choice defines
	  the default value for this string.
```

## arch/arm/soc/nxp_imx/Kconfig.soc
```kconfig
#
# Copyright (c) 2017, NXP
#
# SPDX-License-Identifier: Apache-2.0
#

source "arch/arm/soc/nxp_imx/*/Kconfig.series"
```
