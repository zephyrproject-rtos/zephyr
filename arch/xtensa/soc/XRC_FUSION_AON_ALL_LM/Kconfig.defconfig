## arch/xtensa/soc/XRC_FUSION_AON_ALL_LM/Kconfig.defconfig
```kconfig
# Kconfig - XTENSA board configuration
#
# Copyright (c) 2016 Open-RnD Sp. z o.o.
# Copyright (c) 2016 Cadence Design Systems, Inc.
# SPDX-License-Identifier: Apache-2.0

if SOC_XRC_FUSION_AON_ALL_LM

config SOC
	string
	default "XRC_FUSION_AON_ALL_LM"

config IRQ_OFFLOAD_INTNUM
	default 13

endif
```

## arch/xtensa/soc/hifi2_std/Kconfig.soc
```kconfig
# Copyright (c) 2017 Intel Corporation
# SPDX-License-Identifier: Apache-2.0

config SOC_HIFI2_STD
	bool "hifi2_std core"
```

## arch/xtensa/soc/hifi4_bd7/Kconfig
```kconfig
# Kconfig - XTENSA board configuration
#
# Copyright (c) 2016 Open-RnD Sp. z o.o.
# Copyright (c) 2016 Cadence Design Systems, Inc.
# SPDX-License-Identifier: Apache-2.0

if hifi4_bd7

config IRQ_OFFLOAD_INTNUM
	default 4

endif
```

## arch/xtensa/soc/hifi4_bd7/Kconfig.defconfig
```kconfig
# Kconfig - XTENSA board configuration
#
# Copyright (c) 2016 Open-RnD Sp. z o.o.
# Copyright (c) 2016 Cadence Design Systems, Inc.
# SPDX-License-Identifier: Apache-2.0

if SOC_HIFI4_BD7

config SOC
	string
	default "hifi4_bd7"

config IRQ_OFFLOAD_INTNUM
	default 4

endif
```

## arch/xtensa/soc/hifi_mini/Kconfig.soc
```kconfig
# Copyright (c) 2017 Intel Corporation
# SPDX-License-Identifier: Apache-2.0

config SOC_HIFI_MINI
	bool "hifi_mini core"
```

## arch/xtensa/soc/hifi_mini_4swIrq/Kconfig.defconfig
```kconfig
# Kconfig - XTENSA board configuration
#
# Copyright (c) 2016 Open-RnD Sp. z o.o.
# Copyright (c) 2016 Cadence Design Systems, Inc.
# SPDX-License-Identifier: Apache-2.0

if SOC_HIFI_MINI_4SWIRQ

config SOC
	string
	default "hifi_mini_4swIrq"

config IRQ_OFFLOAD_INTNUM
	default 1

endif
```

## arch/xtensa/soc/hifi_mini_4swIrq/Kconfig.soc
```kconfig
# Copyright (c) 2017 Intel Corporation
# SPDX-License-Identifier: Apache-2.0

config SOC_HIFI_MINI_4SWIRQ
	bool "hifi_mini_4swIrq (hifi_mini core with 4 additional SW IRQs)"
```

## arch/xtensa/soc/intel_s1000/Kconfig.defconfig
```kconfig
# Kconfig - XTENSA board configuration
#
# Copyright (c) 2017 Intel Corporation
# SPDX-License-Identifier: Apache-2.0

if SOC_INTEL_S1000

config SOC
	string
	default intel_s1000

config IRQ_OFFLOAD_INTNUM
	default 0

config TOOLCHAIN_VARIANT
	string
	default RF-2015.3-linux

endif
```

## arch/xtensa/soc/intel_s1000/Kconfig.soc
```kconfig
# Copyright (c) 2017 Intel Corporation
# SPDX-License-Identifier: Apache-2.0

config SOC_INTEL_S1000
	bool "intel_s1000"
```

## arch/xtensa/soc/sample_controller/Kconfig.soc
```kconfig
# Copyright (c) 2017 Intel Corporation
# SPDX-License-Identifier: Apache-2.0

config SOC_XTENSA_SAMPLE_CONTROLLER
	bool "Xtensa sample_controller core"
```

## boards/01space/esp32c3_042_oled/Kconfig.esp32c3_042_oled
```kconfig
# Copyright 2024 Nordic Semiconductor ASA
# SPDX-License-Identifier: Apache-2.0

config BOARD_ESP32C3_042_OLED
	select SOC_ESP32C3_FX4
```

## boards/01space/esp32c3_042_oled/board.yml
```yaml
board:
  name: esp32c3_042_oled
  full_name: ESP32C3 0.42 OLED
  vendor: 01space
  socs:
  - name: esp32c3
```

## boards/96b_nitrogen/Kconfig.defconfig
```kconfig
# Kconfig - 96Boards NITROGEN board configuration
#
# Copyright (c) 2016 Nordic Semiconductor ASA
#
# Licensed under the Apache License, Version 2.0 (the "License");
# you may not use this file except in compliance with the License.
# You may obtain a copy of the License at
#
#     http://www.apache.org/licenses/LICENSE-2.0
#
# Unless required by applicable law or agreed to in writing, software
# distributed under the License is distributed on an "AS IS" BASIS,
# WITHOUT WARRANTIES OR CONDITIONS OF ANY KIND, either express or implied.
# See the License for the specific language governing permissions and
# limitations under the License.

if BOARD_96B_NITROGEN

config BOARD
	default 96b_nitrogen

if UART_NRF5

config GPIO
	default y

config GPIO_NRF5
	default y

config GPIO_NRF5_P0
	default y

config UART_NRF5_GPIO_TX_PIN
	default 13

config UART_NRF5_GPIO_RX_PIN
	default 15

config UART_NRF5_GPIO_RTS_PIN
	default 12

config UART_NRF5_GPIO_CTS_PIN
	default 14

endif # UART_NRF5

endif # BOARD_96B_NITROGEN
```

## boards/96boards/96b_carbon/96b_carbon_nrf51822_defconfig
```kconfig
# SPDX-License-Identifier: Apache-2.0

# Enable GPIO
CONFIG_GPIO=y

# Enable UART driver
CONFIG_SERIAL=y

# Enable console
CONFIG_CONSOLE=y
CONFIG_UART_CONSOLE=y
```

## boards/96boards/96b_carbon/Kconfig.96b_carbon
```kconfig
# Copyright (c) 2016 Linaro Limited.
# SPDX-License-Identifier: Apache-2.0

config BOARD_96B_CARBON_STM32F401XE
	bool
	select SOC_STM32F401XE

config BOARD_96B_CARBON_NRF51822
	bool
	select SOC_NRF51822_QFAC
```

## boards/96boards/96b_stm32_sensor_mez/Kconfig.defconfig
```kconfig
# 96Boards STM32 Sensor Mezzanine board configuration

# Copyright (c) 2018 Linaro Limited.
# SPDX-License-Identifier: Apache-2.0

if BOARD_96B_STM32_SENSOR_MEZ

config SPI_STM32_INTERRUPT
	default y
	depends on SPI

endif # BOARD_96B_STM32_SENSOR_MEZ
```

## boards/96boards/96b_stm32_sensor_mez/board.yml
```yaml
board:
  name: 96b_stm32_sensor_mez
  vendor: st
  socs:
    - name: stm32f446xx
```

## boards/96boards/aerocore2/Kconfig.96b_aerocore2
```kconfig
#  Copyright (c) 2020 Linaro Limited
# SPDX-License-Identifier: Apache-2.0

config BOARD_96B_AEROCORE2
	select SOC_STM32F427XX
```

## boards/96boards/aerocore2/board.yml
```yaml
board:
  name: 96b_aerocore2
  full_name: Aerocore2
  vendor: 96boards
  socs:
    - name: stm32f427xx
```

## boards/96boards/argonkey/Kconfig.96b_argonkey
```kconfig
# Copyright (c) 2018 STMicroelectronics
# SPDX-License-Identifier: Apache-2.0

config BOARD_96B_ARGONKEY
	select SOC_STM32F412CX
```

## boards/96boards/argonkey/board.yml
```yaml
board:
  name: 96b_argonkey
  full_name: Argonkey
  vendor: 96boards
  socs:
    - name: stm32f412cx
```
