## arch/arm64/Kconfig
```kconfig
# ARM64 architecture configuration options

# Copyright (c) 2014-2015 Wind River Systems, Inc.
# SPDX-License-Identifier: Apache-2.0

menu "ARM64 Options"
	depends on ARM64

config ARCH
	default "arm64"

config CPU_CORTEX
	bool
	help
	  This option signifies the use of a CPU of the Cortex family.

config ARM_CUSTOM_INTERRUPT_CONTROLLER
	bool
	help
	  This option indicates that the ARM CPU is connected to a custom (i.e.
	  non-GIC) interrupt controller.

	  A number of Cortex-A and Cortex-R cores (Cortex-A5, Cortex-R4/5, ...)
	  allow interfacing to a custom external interrupt controller and this
	  option must be selected when such cores are connected to an interrupt
	  controller that is not the ARM Generic Interrupt Controller (GIC).

	  When this option is selected, the architecture interrupt control
	  functions are mapped to the SoC interrupt control interface, which is
	  implemented at the SoC level.

config ARM64_GIC_SOC_IRQ_HOOKS
	bool
	depends on !ARM_CUSTOM_INTERRUPT_CONTROLLER
	help
	  This option allows an SoC using the ARM Generic Interrupt Controller
	  (GIC) as its primary controller to wrap irq_enable, irq_disable,
	  irq_is_enabled, priority_set, and EOI via z_soc_irq_* hooks without
	  replacing GIC initialization or SMP IPI handling.

rsource "core/Kconfig"

endmenu
```

## boards/01studio/canmv_k230/Kconfig.canmv_k230_01studio
```kconfig
# Copyright (c) 2026 Process Mission
# SPDX-License-Identifier: Apache-2.0

config BOARD_CANMV_K230_01STUDIO
	select SOC_K230_C908 if BOARD_CANMV_K230_01STUDIO_K230_C908
```

## boards/01studio/canmv_k230/Kconfig.defconfig
```kconfig
# Copyright (c) 2026 Process Mission
# SPDX-License-Identifier: Apache-2.0

configdefault SYS_CLOCK_TICKS_PER_SEC
	default 1000
```

## boards/01studio/canmv_k230/board.yml
```yaml
board:
  name: canmv_k230_01studio
  full_name: 01Studio CanMV-K230
  vendor: 01studio
  socs:
    - name: k230
```

## boards/100ask/dshanpi_2a_plus/Kconfig.dshanpi_2a_plus
```kconfig
# Copyright (c) 2026 Jiaming Zhao
# SPDX-License-Identifier: Apache-2.0

config BOARD_DSHANPI_2A_PLUS
	select SOC_RK3506_A7
```

## boards/100ask/dshanpi_2a_plus/board.yml
```yaml
board:
  name: dshanpi_2a_plus
  full_name: DShanPi 2A+
  vendor: 100ask
  socs:
    - name: rk3506
      variants:
        - name: smp
          cpucluster: a7
```

## boards/100ask/dshanpi_2a_plus/dshanpi_2a_plus_rk3506_a7_smp_defconfig
```kconfig
# Copyright (c) 2026 Jiaming Zhao
# SPDX-License-Identifier: Apache-2.0

CONFIG_XIP=n
CONFIG_USE_SWITCH=y

CONFIG_SERIAL=y
CONFIG_CONSOLE=y
CONFIG_UART_CONSOLE=y

CONFIG_SMP=y
CONFIG_MP_MAX_NUM_CPUS=3
CONFIG_PM_CPU_OPS=y
CONFIG_PM_CPU_OPS_PSCI=y
```

## boards/amd/mbv32/Kconfig.defconfig
```kconfig
#
# Copyright (c) 2026 Advanced Micro Devices, Inc.
#
# SPDX-License-Identifier: Apache-2.0
#

configdefault 2ND_LVL_INTR_00_OFFSET
	default 11

configdefault 2ND_LVL_ISR_TBL_OFFSET
	default 12

configdefault MAX_IRQ_PER_AGGREGATOR
	default 32
```

## boards/antmicro/stm32h7_renode_reference_platform/Kconfig.defconfig
```kconfig
# Copyright (c) 2026 Antmicro <www.antmicro.com>
# SPDX-License-Identifier: Apache-2.0

if BOARD_STM32H7_RENODE_REFERENCE_PLATFORM

configdefault ETH_DRIVER
	default y

configdefault FLASH_MSPI_NOR_LAYOUT_PAGE_SIZE
	default 4096

endif # BOARD_STM32H7_RENODE_REFERENCE_PLATFORM
```

## boards/arduino/opta/Kconfig
```kconfig
# Copyright The Zephyr Project Contributors
# SPDX-License-Identifier: Apache-2.0

config BOARD_ARDUINO_OPTA
	select BOARD_EARLY_INIT_HOOK

config HEAP_MEM_POOL_ADD_SIZE_BOARD
	int
	default 20480 if WIFI_AIROC

config BOARD_ARDUINO_OPTA_FACTORY_MAC
	bool "Configure the eth device to use mac address from factory configuration"
	imply FLASH_STM32_QSPI_GENERIC_READ
	imply FLASH_EX_OP_ENABLED
	select BOARD_LATE_INIT_HOOK if FLASH_EX_OP_ENABLED && FLASH_STM32_QSPI_GENERIC_READ
	default y if NET_L2_ETHERNET
	help
	  Arduino opta boards have configurations written in qspi flash secure registers,
	  in particular the ethernet mac arduino provides is written there.
	  With this option enabled we set that value for ethernet interface
```

## boards/arm/fvp_corstone1000/Kconfig.fvp_corstone1000
```kconfig
# Copyright (c) 2026 BayLibre SAS
# Copyright 2026 Arm Limited and/or its affiliates <open-source-office@arm.com>
# SPDX-License-Identifier: Apache-2.0

config BOARD_FVP_CORSTONE1000
	select SOC_A320 if BOARD_FVP_CORSTONE1000_A320
	select SOC_A320 if BOARD_FVP_CORSTONE1000_A320_SMP
	select SOC_CORSTONE1000_EXTSYS if BOARD_FVP_CORSTONE1000_CORSTONE1000_EXTSYS
```

## boards/espressif/esp_sensairshuttle/Kconfig.defconfig
```kconfig
# Copyright (c) 2026 Espressif Systems (Shanghai) Co., Ltd.
# SPDX-License-Identifier: Apache-2.0

if BOARD_ESP_SENSAIRSHUTTLE_ESP32C5_HPCORE

configdefault REGULATOR
	default y if DISPLAY || ADC

endif # BOARD_ESP_SENSAIRSHUTTLE_ESP32C5_HPCORE
```

## boards/flipper/flipper_zero/Kconfig.defconfig
```kconfig
# SPDX-FileCopyrightText: Copyright The Zephyr Project Contributors
# SPDX-License-Identifier: Apache-2.0

if BOARD_FLIPPER_ZERO

source "boards/common/usb/Kconfig.cdc_acm_serial.defconfig"

endif # BOARD_FLIPPER_ZERO
```

## boards/flipper/flipper_zero/Kconfig.flipper_zero
```kconfig
# SPDX-FileCopyrightText: Copyright The Zephyr Project Contributors
# SPDX-License-Identifier: Apache-2.0

config BOARD_FLIPPER_ZERO
	select SOC_STM32WB55XX
```

## boards/flipper/flipper_zero/board.yml
```yaml
board:
  name: flipper_zero
  full_name: Flipper Zero
  vendor: flipper
  socs:
    - name: stm32wb55xx
```

## boards/flipper/flipper_zero/flipper_zero_defconfig
```kconfig
# SPDX-FileCopyrightText: Copyright The Zephyr Project Contributors
# SPDX-License-Identifier: Apache-2.0

# Console on the USB CDC ACM UART
CONFIG_SERIAL=y
CONFIG_CONSOLE=y
CONFIG_UART_CONSOLE=y

# Enable MPU
CONFIG_ARM_MPU=y

# Enable HW stack protection
CONFIG_HW_STACK_PROTECTION=y
```

## boards/infineon/kit_psoc_hvpa_spm1_lite/Kconfig.kit_psoc_hvpa_spm1_lite
```kconfig
# SPDX-FileCopyrightText: Copyright (c) 2026 Infineon Technologies AG,
# SPDX-FileCopyrightText: or an affiliate of Infineon Technologies AG. All rights reserved.
#
# SPDX-License-Identifier: Apache-2.0

config BOARD_KIT_PSOC_HVPA_SPM1_LITE
	select SOC_CY8C4147LDE_HV734
```

## boards/infineon/kit_psoc_hvpa_spm1_lite/board.yml
```yaml
# SPDX-FileCopyrightText: Copyright (c) 2026 Infineon Technologies AG,
# SPDX-FileCopyrightText: or an affiliate of Infineon Technologies AG. All rights reserved.
#
# SPDX-License-Identifier: Apache-2.0

board:
  name: kit_psoc_hvpa_spm1_lite
  full_name: PSOC™ 4 HVPA-SPM 1.0 Lite Kit
  vendor: infineon
  socs:
  - name: cy8c4147lde_hv734
```

## boards/intel/socfpga/agilex5_socdk/Kconfig.defconfig
```kconfig
# Copyright (c) 2022-2024 Intel Corporation
# SPDX-License-Identifier: Apache-2.0

config HAS_COVERAGE_SUPPORT
	default y

config MAX_THREAD_BYTES
	default 5

config NOCACHE_MEMORY
	default y

configdefault ETH_DRIVER
	default y

configdefault MDIO_INIT_PRIORITY
	default 50
```

## boards/lilygo/t_a7670x/Kconfig
```kconfig
# Copyright (c) 2026 Pedro Ramos
# SPDX-License-Identifier: Apache-2.0

config HEAP_MEM_POOL_ADD_SIZE_BOARD
	int
	default 4096 if BOARD_T_A7670X_ESP32_PROCPU
	default 256 if BOARD_T_A7670X_ESP32_APPCPU
```

## boards/lilygo/t_a7670x/Kconfig.t_a7670x
```kconfig
# Copyright (c) 2026 Pedro Ramos
# SPDX-License-Identifier: Apache-2.0

config BOARD_T_A7670X
	select SOC_ESP32
	select SOC_ESP32_PROCPU if BOARD_T_A7670X_ESP32_PROCPU
	select SOC_ESP32_APPCPU if BOARD_T_A7670X_ESP32_APPCPU
```

## boards/lilygo/t_a7670x/board.yml
```yaml
board:
  name: t_a7670x
  full_name: T-A7670X
  vendor: lilygo
  socs:
  - name: esp32
```
