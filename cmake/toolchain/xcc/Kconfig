## cmake/toolchain/xcc/Kconfig
```kconfig
# SPDX-FileCopyrightText: Copyright The Zephyr Project Contributors
# SPDX-License-Identifier: Apache-2.0

config TOOLCHAIN_SUPPORTS_ISR_TABLES_LOCAL_DECLARATION
	default y if XTENSA && "$(ZEPHYR_XCC_HAS_BUILTIN_COUNTER)" = "y"
```

## cmake/toolchain/xcc/Kconfig.defconfig
```kconfig
# SPDX-FileCopyrightText: Copyright The Zephyr Project Contributors
# SPDX-License-Identifier: Apache-2.0

config TOOLCHAIN_HAS_CRT_CTOR_MARKERS
	default y
```

## cmake/toolchain/xt-clang/Kconfig
```kconfig
# Copyright (c) 2026 Intel Corporation
# SPDX-License-Identifier: Apache-2.0

config TOOLCHAIN_SUPPORTS_ISR_TABLES_LOCAL_DECLARATION
	default y if XTENSA

if DT_HAS_CDNS_TENSILICA_XTENSA_LX7_ENABLED

choice COMPILER_CODEGEN_VLIW
	default COMPILER_CODEGEN_VLIW_DISABLED if USERSPACE

endchoice

endif # DT_HAS_CDNS_TENSILICA_XTENSA_LX7_ENABLED
```

## cmake/toolchain/xt-clang/Kconfig.defconfig
```kconfig
# Copyright (c) 2026 Antmicro <www.antmicro.com>
#
# SPDX-License-Identifier: Apache-2.0

config XTENSA_LIBC_SUPPORTED
	default y
```

## drivers/adc/Kconfig.ad463x
```kconfig
# Copyright (c) 2026 Analog Devices, Inc.
# SPDX-License-Identifier: Apache-2.0

config ADC_AD463X
	bool "Analog Devices AD463x precision SAR ADC"
	default y
	depends on DT_HAS_ADI_AD463X_ENABLED
	depends on SPI_ADI_AXI_SPI_ENGINE
	depends on DMA_ADI_AXI_DMAC
	depends on CLOCK_CONTROL_ADI_AXI_CLKGEN
	depends on PWM_ADI_AXI_PWMGEN
	help
	  Driver for the Analog Devices AD463x family precision SAR ADCs
	  (AD4630-x / AD4631-x / AD4632-x). Operates in offload mode using
	  the AXI SPI Engine, AXI DMAC, AXI CLKGEN, and AXI PWMGEN cores.

if ADC_AD463X

module = ADC_AD463X
module-str = adc_ad463x
source "subsys/logging/Kconfig.template.log_config"

endif
```

## drivers/adc/Kconfig.ad7794
```kconfig
# Copyright (c) 2026 Testo SE & Co. KGaA
# SPDX-License-Identifier: Apache-2.0

config ADC_AD7794
	bool "Analog Devices AD7794 ADC driver"
	default y
	depends on DT_HAS_ADI_AD7794_ENABLED
	select SPI
	select ADC_CONFIGURABLE_INPUTS
	select ADC_CONFIGURABLE_EXCITATION_CURRENT_SOURCE_PIN
	select ADC_CONFIGURABLE_VBIAS_PIN
	help
	  Enable the driver for the Analog Devices AD7794 24-bit
	  sigma-delta ADC.
```

## drivers/adc/Kconfig.ade7913
```kconfig
# SPDX-FileCopyrightText: Copyright The Zephyr Project Contributors
# SPDX-License-Identifier: Apache-2.0

config ADC_ADE7913
	bool "Analog Devices ADE7913 SPI ADC"
	select SPI
	default y
	depends on DT_HAS_ADI_ADE7913_ENABLED
	depends on MULTITHREADING
	help
	  Outputs raw signed 24-bit Values. Calibration and Conversion is left to user.

if ADC_ADE7913

config ADC_ADE7913_INIT_PRIORITY
	int "ADE7913 init priority"
	default SPI_INIT_PRIORITY
	help
	  ADE7913 device initialization.

config ADC_ADE7913_ACQUISITION_THREAD_STACK_SIZE
	int "Stack size for the ADC data acquisition thread"
	default 512
	help
	  Size of the stack used for the internal data acquisition
	  thread.

config ADC_ADE7913_ACQUISITION_THREAD_PRIORITY
	int "Priority for the ADC data acquisition thread"
	default 0
	help
	  Priority level for the internal ADC data acquisition thread.

endif # ADC_ADE7913
```

## drivers/adc/Kconfig.ads126x
```kconfig
# Copyright 2026 Sacra Systems Private Limited
#
# SPDX-License-Identifier: Apache-2.0

config ADC_ADS126X
	bool "Texas Instruments ADS126x ADC"
	default y
	select ADC_CONFIGURABLE_INPUTS
	depends on DT_HAS_TI_ADS1262_ENABLED || \
	DT_HAS_TI_ADS1263_ENABLED
	depends on SPI

	help
	  Enable support for the Texas Instruments ADS126x SPI ADC.

	  Supported devices include:
	  - ADS1262
	  - ADS1263
```

## drivers/adc/Kconfig.ads1x2s14
```kconfig
# Copyright (c) 2026 Testo SE & Co. KGaA
# SPDX-License-Identifier: Apache-2.0

config ADC_ADS1X2S14
	bool "Texas Instruments ADS112S14/ADS122S14 ADC driver"
	default y
	depends on DT_HAS_TI_ADS112S14_ENABLED || DT_HAS_TI_ADS122S14_ENABLED
	select SPI
	select ADC_CONFIGURABLE_INPUTS
	select ADC_CONFIGURABLE_EXCITATION_CURRENT_SOURCE_PIN
	help
	  Enable the driver for the Texas Instruments ADS112S14 (16-bit) and
	  ADS122S14 (24-bit) delta-sigma ADCs with eight multiplexed analog
	  inputs, PGA, internal voltage reference and two excitation current
	  sources, connected via SPI.
```

## drivers/adc/Kconfig.ads868x
```kconfig
# Copyright (c) 2026 Ryomei Osaki
# SPDX-License-Identifier: Apache-2.0

config ADC_ADS868X
	bool "TI ADS8684/ADS8688 SPI ADC driver"
	default y
	depends on DT_HAS_TI_ADS8684_ENABLED || DT_HAS_TI_ADS8688_ENABLED
	select SPI
	help
	  Enable the driver for the TI ADS8684 (4-channel) and ADS8688
	  (8-channel) 16-bit SAR ADCs with per-channel input ranges.

if ADC_ADS868X

config ADC_ADS868X_INIT_PRIORITY
	int "Init priority"
	default 80
	help
	  Device driver initialization priority. Must be higher than the
	  priority of the SPI bus driver.

config ADC_ADS868X_ACQUISITION_THREAD_STACK_SIZE
	int "Stack size for the ADC data acquisition thread"
	default 512
	help
	  Size of the stack used for the internal data acquisition thread.

config ADC_ADS868X_ACQUISITION_THREAD_PRIO
	int "Priority for the ADC data acquisition thread"
	default 0
	help
	  Priority level for the internal ADC data acquisition thread.

endif # ADC_ADS868X
```

## drivers/adc/Kconfig.bflb
```kconfig
# Copyright (c) 2024-2025 MASSDRIVER EI
# SPDX-License-Identifier: Apache-2.0

config ADC_BFLB
	bool "Bouffalolab ADC driver"
	default y
	depends on DT_HAS_BFLB_ADC_ENABLED
	select ADC_CONFIGURABLE_INPUTS
	help
	  Enables the Bouffalolab ADC driver.

if ADC_BFLB

config ADC_BFLB_FORCE_DYNAMIC_CALIBRATION
	bool "Use dynamic calibration instead of efuse calibration values"
	default y if SOC_SERIES_BL60X
	help
	  Use differential measurement of VBAT/2 to calibrated the ADC. This depends heavily on
	  the precision of the chip's power supply.

endif
```

## drivers/adc/Kconfig.cc35xx
```kconfig
# SPDX-License-Identifier: Apache-2.0

config ADC_CC35XX
	bool "CC35XX ADC driver"
	default y
	depends on DT_HAS_TI_CC35XX_ADC_ENABLED
	help
	  This option enables the CC35XX ADC driver.

config ADC_CC35XX_DMA_DRIVEN
	bool "DMA support for TI CC35XX ADC devices"
	depends on ADC_CC35XX
	select DMA
	help
	  DMA driven mode offloads data transfer tasks from the CPU
	  and requires fewer interrupts to handle the ADC sequence mode.
	  When DMA mode is used, the ADC internal gain is not compensated
	  for measurement adjustment.
```

## drivers/adc/Kconfig.esp32
```kconfig
# Copyright (c) 2022 Wolter HV <wolterhv@gmx.de>
#
# SPDX-License-Identifier: Apache-2.0

config ADC_ESP32
	bool "ESP32 ADC driver"
	default y
	depends on DT_HAS_ESPRESSIF_ESP32_ADC_ENABLED
	help
	  Enable the driver implementation for the ESP32 ADC

if ADC_ESP32

config ADC_ESP32_DMA
	bool "ESP32 ADC DMA Support"
	depends on $(dt_compat_any_has_prop,$(DT_COMPAT_ESPRESSIF_ESP32_ADC),dmas) || \
		SOC_SERIES_ESP32 || SOC_SERIES_ESP32S2
	select DMA if DT_HAS_ESPRESSIF_ESP32_GDMA_ENABLED
	help
	  Enable the ADC DMA mode. The ESP32 and ESP32-S2 ADCs have a DMA of
	  their own; the others take the GDMA channel the devicetree wires to
	  the controller.

config ADC_ESP32_CONVERSION_TIMEOUT_US
	int "Oneshot conversion completion timeout in microseconds"
	default 2000
	range 100 1000000
	help
	  Maximum time to wait for a oneshot conversion to complete
	  before adc_read returns -ETIMEDOUT. A conversion cannot
	  complete while a shared analog block is temporarily powered
	  down, for example during a Wi-Fi modem sleep window; callers
	  are expected to retry such reads.

endif
```

## drivers/adc/Kconfig.lpf3
```kconfig
# Copyright (c) 2025 Texas Instruments Incorporated
# Copyright (c) 2024 BayLibre, SAS
# SPDX-License-Identifier: Apache-2.0

config ADC_LPF3
	bool "LPF3 ADC driver"
	default y
	depends on DT_HAS_TI_LPF3_ADC_ENABLED
	select PINCTRL
	help
	  Enable ADC driver for Texas Instruments LPF3 MCUs (CC23x0 and CC27xx).

config ADC_LPF3_DMA_DRIVEN
	bool "DMA support for ADC operation in Texas Instruments LPF3 MCUs (CC23x0 and CC27xx)"
	depends on ADC_LPF3
	select DMA
	help
	  DMA driven mode offloads data transfer tasks from the CPU
	  and requires fewer interrupts to handle the ADC sequence mode.
	  When DMA mode is used, the ADC internal gain is not compensated
	  for measurement adjustment.
```

## drivers/adc/Kconfig.mchp
```kconfig
# Copyright (c) 2025 Microchip Technology Inc.
# SPDX-License-Identifier: Apache-2.0

config ADC_MCHP_G1
	bool "Microchip ADC support for G1 peripherals"
	depends on DT_HAS_MICROCHIP_ADC_G1_ENABLED
	default y
	select PINCTRL
	select ADC_CONFIGURABLE_INPUTS
	help
	  Enable support for the Microchip ADC driver on G1 ADC peripherals.

config ADC_MCHP_G3
	bool "Microchip ADC support for G3 peripherals"
	depends on DT_HAS_MICROCHIP_ADC_G3_ENABLED
	default y
	select PINCTRL
	select ADC_CONFIGURABLE_INPUTS
	help
	  Enable support for the Microchip ADC driver on G3 ADC peripherals.

config ADC_MCHP_G3_DMA_DRIVEN
	bool "Microchip ADC G3 DMA support"
	default y
	depends on ADC_MCHP_G3
	depends on $(dt_compat_all_has_prop,$(DT_COMPAT_MICROCHIP_ADC_G3),dmas)
	select DMA
	help
	  This enables DMA driven transfers for the ADC peripheral.
	  Requires DMA controller and dmas property in device tree.

config ADC_MCHP_G3_DMA_BUFFER_SIZE
	int "Microchip ADC G3 DMA buffer size"
	default 512
	range 512 4096
	depends on ADC_MCHP_G3_DMA_DRIVEN
	help
	  This driver use a scratch buffer to handle unaligned accesses.
	  Specify the DMA buffer size here.
```

## drivers/adc/Kconfig.mcp355x
```kconfig
# SPDX-FileCopyrightText: Copyright The Zephyr Project Contributors
# SPDX-License-Identifier: Apache-2.0

config ADC_MCP355X
	bool "Microchip MCP3550/1/3 ADC driver"
	default y
	depends on DT_HAS_MICROCHIP_MCP3550_50_ENABLED || DT_HAS_MICROCHIP_MCP3550_60_ENABLED || \
		DT_HAS_MICROCHIP_MCP3551_ENABLED || DT_HAS_MICROCHIP_MCP3553_ENABLED
	select SPI
	help
	  Enable the driver for the Microchip MCP3550/1/3 single-channel 22-bit
	  delta-sigma ADCs with SPI interface.

if ADC_MCP355X

config ADC_MCP355X_ACQUISITION_THREAD_STACK_SIZE
	int "Stack size for the ADC data acquisition thread"
	default 512
	help
	  Size of the stack used for the internal data acquisition thread.

config ADC_MCP355X_ACQUISITION_THREAD_PRIO
	int "Priority for the ADC data acquisition thread"
	default 0
	help
	  Priority level for the internal data acquisition thread.

endif # ADC_MCP355X
```

## drivers/adc/Kconfig.msp432p4xx
```kconfig
# Copyright (c) 2026 Gail Rojas <gailroco@gmail.com>
# SPDX-License-Identifier: Apache-2.0

config ADC_MSP432P4XX
	bool "MSP432P4xx ADC14 driver"
	default y
	depends on DT_HAS_TI_MSP432P4XX_ADC_ENABLED
	help
	  ADC14 driver for the TI MSP432P4xx. Supports 14-bit single-ended
	  conversions on channels A0-A(MAX), the internal temperature sensor
	  via TCMAP on A(MAX-1), and the AVCC/2 supply monitor via BATMAP on
	  A(MAX). MAX is package-dependent (23 on the 24-channel VQFN-80).
```

## drivers/adc/Kconfig.mspm0
```kconfig
# SPDX-License-Identifier: Apache-2.0
# Copyright (c) 2026 Texas Instruments
# Copyright (c) 2026 Linumiz

config ADC_MSPM0_ADC12
	bool "TI ADC MSPM0 driver"
	default y
	depends on DT_HAS_TI_MSPM0_ADC12_ENABLED
	select PINCTRL
	help
	  Enable support for ADC12 on the TI MSPM0 series.

if ADC_MSPM0_ADC12

config ADC_MSPM0_ADC12_DMA
	bool "TI MSPM0 ADC12 DMA support"
	depends on $(dt_compat_any_has_prop,$(DT_COMPAT_TI_MSPM0_ADC12),dmas)
	select DMA
	help
	  Offload ADC12 result transfers to DMA instead of CPU interrupt handler.
	  This is only used to guard the DMA code, actual DMA depends on whether the instance has
	  the dmas property in their devicetree node or not.

endif # ADC_MSPM0_ADC12
```

## drivers/adc/Kconfig.nxp_aon_lpadc
```kconfig
# SPDX-FileCopyrightText: Copyright 2026 NXP
# SPDX-License-Identifier: Apache-2.0

config ADC_NXP_AON_LPADC
	bool "NXP AON_LPADC driver"
	default y
	depends on DT_HAS_NXP_AON_LPADC_ENABLED
	select ADC_CONFIGURABLE_INPUTS
	select PINCTRL
	help
	  Enable the NXP always-on LPADC (AON_LPADC) driver.
```

## drivers/adc/Kconfig.py32
```kconfig
# SPDX-FileCopyrightText: Copyright The Zephyr Project Contributors
# SPDX-License-Identifier: Apache-2.0

config ADC_PY32
	bool "Puya PY32 ADC driver"
	default y
	depends on DT_HAS_PUYA_PY32_ADC_ENABLED
	select PINCTRL
	select RESET
	help
	  Enable the Puya PY32 ADC with single-ended inputs, 6/8/10/12-bit
	  conversions and synchronous or asynchronous sampling. Channels 0-9
	  are external inputs, 11 is the temperature sensor and 12 is VREFINT.
```

## drivers/adc/Kconfig.stm32
```kconfig
# ADC configuration options

# Copyright (c) 2019 Intel Corporation
# Copyright (c) 2019 Endre Karlson
# Copyright (c) 2019 Song Qiang <songqiang1304521@gmail.com>
# Copyright (c) 2021 Marius Scholtz, RIC Electronics
# Copyright (c) 2022 Hein Wessels, Nobleo Technology
# Copyright (c) 2024 STMicroelectronics
# SPDX-License-Identifier: Apache-2.0

ADC_STM32_INJECTED_SUPPORT := st,adc-has-injected-support

config ADC_STM32
	bool "STM32 ADC driver"
	default y
	depends on DT_HAS_ST_STM32_ADC_ENABLED
	select PINCTRL
	select ADC_ASYNC if ADC_STREAM
	select ADC_HAS_SEQUENCE_PRIORITY if \
		$(dt_compat_any_has_prop,$(DT_COMPAT_ST_STM32_ADC),$(ADC_STM32_INJECTED_SUPPORT))
	help
	  Enable the driver implementation for the stm32xx ADC

if ADC_STM32

config ADC_STM32_VREFINT_CALIBRATE
	bool "Measure VREF+ from VREFINT at init/calibrate"
	depends on DT_HAS_ST_STM32_VREF_ENABLED
	default y
	help
	  Measure the ADC reference rail (VREF+/VDDA) using the VREFINT
	  channel and factory calibration described by the st,stm32-vref
	  node. The value is cached SoC-wide and returned by
	  adc_ref_internal() / adc_ref_get() for ADC_REF_INTERNAL on all
	  STM32 ADC instances. Re-measure when sequence.calibrate is set
	  on the VREFINT-owning ADC.

config ADC_STM32_VREFINT_CALIB_VIA_NVMEM
	bool
	default y
	depends on ADC_STM32_VREFINT_CALIBRATE && OTP && NVMEM
	help
	  Read VREFINT_CAL via the NVMEM API instead of a raw OTP pointer.
	  Independent of CONFIG_STM32_VREF (the sensor).

endif # ADC_STM32

config ADC_STM32WB0
	bool "STM32WB0 ADC driver"
	default y
	depends on DT_HAS_ST_STM32WB0_ADC_ENABLED
	select PINCTRL
	help
	  Enable the driver implementation for the STM32WB0 series ADC

if ADC_STM32 || ADC_STM32WB0

config ADC_STM32_DMA
	bool "STM32 MCU ADC DMA Support"
	select DMA
	help
	  Enable the ADC DMA mode for ADC instances
	  that enable dma channels in their device tree node.

config ADC_STM32_INJECTED_CHANNELS
	def_bool y
	depends on ADC_SEQUENCE_PRIORITY
	help
	  Enable the support for injected channels.
	  To define a sequence as injected, set the `priority` field of the
	  `struct adc_sequence` to 1. A regular sequence should have a value
	  of 0. Any other values will return an error.
	  When using injected channels, it is recommended to setup all channels
	  that will be used (both regular and injected) before any measurement
	  is started, because it is not possible to setup a new channel while
	  conversions are running (typically, one can't configure an injected
	  channel if a regular conversion is on-going).

endif
```

## drivers/adc/Kconfig.waveshare_ch32v003
```kconfig
# Copyright (c) 2026 Kim Bøndergaard
# SPDX-License-Identifier: Apache-2.0

menuconfig ADC_WAVESHARE_CH32V003
	bool "Waveshare CH32V003 ADC input"
	default y
	depends on DT_HAS_WAVESHARE_CH32V003_ADC_ENABLED
	depends on ADC
	select MFD
	select MFD_WAVESHARE_CH32V003
	help
	  Enable ADC input support for the Waveshare CH32V003.

if ADC_WAVESHARE_CH32V003

config ADC_WAVESHARE_CH32V003_INIT_PRIORITY
	int "ADC init priority"
	default 71
	help
	  Device driver initialization priority for CH32V003 ADC.

endif # ADC_WAVESHARE_CH32V003
```
