## drivers/adc/Kconfig.waveshare_ch32vc003
```kconfig
# Copyright (c) 2026 Kim Bøndergaard
# SPDX-License-Identifier: Apache-2.0

if GPIO_CH32V003

config ADC_WAVESHARE_CH32V003
	bool "Waveshare CH32V003 ADC input"
	default y
	depends on ADC
	help
	  Enable ADC input support for the Waveshare CH32V003.

config ADC_WAVESHARE_CH32V003_INIT_PRIORITY
	int "ADC init priority"
	default 71
	depends on ADC_WAVESHARE_CH32V003
	help
	  Device driver initialization priority for CH32V003 ADC.

endif # GPIO_CH32V003
```
