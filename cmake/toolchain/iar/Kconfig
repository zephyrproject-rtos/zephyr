## cmake/toolchain/iar/Kconfig
```kconfig
# Copyright (c) 2025 IAR Systems AB
#
# SPDX-License-Identifier: Apache-2.0

config LD_LINKER_SCRIPT_SUPPORTED
	default n

choice LINKER_SCRIPT
	default CMAKE_LINKER_GENERATOR
endchoice

menu "IAR options"

choice IAR_INIT
	bool "Static initialization method"
	depends on XIP
	default IAR_ZEPHYR_INIT

config IAR_DATA_INIT
	bool "IAR"
	select SKIP_BSS_CLEAR # IAR handles zeroing.
	help
	  IAR handles initialization of static variables.
	  Instead of `z_prep_c` calling Zephyrs `arch_data_copy`
	  we call IARs own proprietary initialization method
	  which can save time and space.

config IAR_ZEPHYR_INIT
	bool "Zephyr"
	help
	  Zephyr handles initialization of static variables.
	  This is the regular `arch_data_copy`.

endchoice


config IAR_SEMIHOSTING
	bool "Use the IAR semihosting implementation."
	depends on IAR_LIBC
	help
	  Use the semihosting implementation in the IAR library
	  instead of the Zephyr implementation.

config IAR_BUFFERED_WRITE
	bool "Use buffered write"
	depends on IAR_SEMIHOSTING
	help
	  Instead of printing one character at a time
	  this option uses a buffer to print a line
	  at a time instead, increasing speed of printout.

endmenu

config TOOLCHAIN_IAR_SUPPORTS_THREAD_LOCAL_STORAGE
	def_bool y
	select TOOLCHAIN_SUPPORTS_THREAD_LOCAL_STORAGE

# Should we set this? It doesn't seem to be used
# We support most but don't set __GNUC__
#
config TOOLCHAIN_IAR_SUPPORTS_GNU_EXTENSIONS
	def_bool y
	select TOOLCHAIN_SUPPORTS_GNU_EXTENSIONS
```

## cmake/toolchain/llvm/Kconfig
```kconfig
# Copyright (c) 2023 Intel Corporation
# SPDX-License-Identifier: Apache-2.0

choice LLVM_LINKER
	prompt "LLVM Linker"
	depends on "${ZEPHYR_TOOLCHAIN_VARIANT}" = "llvm"
	default LLVM_USE_LD

config LLVM_USE_LD
	bool "GNU ld"
	help
	  Use binutils ld linker with llvm/clang.

config LLVM_USE_LLD
	bool "LLVM lld"
	help
	  Use LLVM built-in lld linker with llvm/clang.

endchoice

config TOOLCHAIN_LLVM_SUPPORTS_THREAD_LOCAL_STORAGE
	depends on RISCV
	def_bool y
	select TOOLCHAIN_SUPPORTS_THREAD_LOCAL_STORAGE

config TOOLCHAIN_LLVM_SUPPORTS_GNU_EXTENSIONS
	def_bool y
	select TOOLCHAIN_SUPPORTS_GNU_EXTENSIONS
```

## cmake/toolchain/oneApi/Kconfig
```kconfig
# oneAPI Toolchain

# Copyright (c) 2023 Intel Corporation
# SPDX-License-Identifier: Apache-2.0

config TOOLCHAIN_ONEAPI
	def_bool y
```

## cmake/toolchain/rxgcc/Kconfig.defconfig
```kconfig
# Copyright (c) 2024 Renesas Electronics Corporation
# SPDX-License-Identifier: Apache-2.0

config PICOLIBC_SUPPORTED
	default n
```

## cmake/toolchain/xc32/Kconfig
```kconfig
# Copyright (c) 2026 Microchip Technology Inc.
# SPDX-License-Identifier: Apache-2.0

config TOOLCHAIN_XC
	def_bool y
	select HAS_COVERAGE_SUPPORT
	help
	  Microchip MPLAB XC32 compiler toolchain. XC32 is a GCC-based
	  toolchain targeting PIC32 (MIPS-core), PIC32C/PIC32CX (ARM
	  Cortex-M), and PIC32AK/dsPIC33A device families.

config TOOLCHAIN_XC_SUPPORTS_GNU_EXTENSIONS
	def_bool y
	select TOOLCHAIN_SUPPORTS_GNU_EXTENSIONS

config TOOLCHAIN_XC_SUPPORTS_THREAD_LOCAL_STORAGE
	def_bool y
	depends on ARM
	select TOOLCHAIN_SUPPORTS_THREAD_LOCAL_STORAGE
```

## cmake/toolchain/xc32/Kconfig.defconfig
```kconfig
# Copyright (c) 2026 Microchip Technology Inc.
# SPDX-License-Identifier: Apache-2.0

# XC32 sets TOOLCHAIN_HAS_PICOLIBC because the toolchain bundles picolibc
# (libstdc++ relies on it), but that copy uses a 32-bit time_t. Force the
# module build so Zephyr still gets the 64-bit time_t variant.
choice PICOLIBC_SOURCE
	default PICOLIBC_USE_MODULE
endchoice

choice LIBCPP_IMPLEMENTATION
	default EXTERNAL_LIBCPP
endchoice

choice LINKER_ORPHAN_CONFIGURATION
	default LINKER_ORPHAN_SECTION_PLACE
endchoice
```

## cmake/toolchain/xcdsc/Kconfig
```kconfig
# Copyright (c) 2025, Microchip Technology Inc.
# SPDX-License-Identifier: Apache-2.0

config TOOLCHAIN_XCDSC
	bool "MPLAB XC-DSC toolchain"
	select HAVE_CUSTOM_LINKER_SCRIPT
	help
	  Enable support for compiling with MPLAB XC-DSC toolchain for dsPIC.
config PICOLIBC_SUPPORTED
	def_bool y
	help
	  XC-DSC toolchain supports picolib for C development.
config LIBC_ERRNO
	default y
config TOOLCHAIN_XCDSC_SUPPORTS_THREAD_LOCAL_STORAGE
	bool "XC-DSC toolchain supports TLS"
	def_bool y
	select TOOLCHAIN_SUPPORTS_THREAD_LOCAL_STORAGE
	help
	  Set this if the XC-DSC toolchain being used for the build supports
	  thread local storage.
choice LIBC_IMPLEMENTATION
	prompt "C Library Implementation"
	default EXTERNAL_LIBC
endchoice
```

## cmake/toolchain/xcdsc/Kconfig.defconfig
```kconfig
# Copyright (c) 2025, Microchip Technology Inc.
# SPDX-License-Identifier: Apache-2.0

config MINIMAL_LIBC_SUPPORTED
	default n

config NEWLIB_LIBC_SUPPORTED
	default n

config PICOLIBC_SUPPORTED
	default n
```

## cmake/toolchain/xtools/Kconfig
```kconfig
# Copyright © 2022 Keith Packard
# SPDX-License-Identifier: Apache-2.0

config TOOLCHAIN_XTOOLS_SUPPORTS_THREAD_LOCAL_STORAGE
	def_bool y
	select TOOLCHAIN_SUPPORTS_THREAD_LOCAL_STORAGE

config NEWLIB_LIBC_SUPPORTED
	def_bool y
	help
	  Crosstools is assumed to support newlib for C and C++ development.
```

## cmake/toolchain/zephyr-tools/Kconfig
```kconfig
# Copyright (c) 2020 Stephanos Ioannidis <root@stephanos.io>
# SPDX-License-Identifier: Apache-2.0

config TOOLCHAIN_ZEPHYR_TOOLS
	def_bool y
	select HAS_NEWLIB_LIBC_NANO if (ARC || (ARM && !ARM64) || RISCV)
```

## cmake/toolchain/zephyr/0.11/Kconfig
```kconfig
# Zephyr 0.11 SDK Toolchain

# Copyright (c) 2020 Linaro Limited.
# SPDX-License-Identifier: Apache-2.0

config TOOLCHAIN_ZEPHYR_0_11
	def_bool y
	select HAS_NEWLIB_LIBC_NANO if (ARC || (ARM && !ARM64) || RISCV)
```

## cmake/toolchain/zephyr/Kconfig
```kconfig
# Zephyr Toolchain

# Copyright (c) 2023 Intel Corporation
# SPDX-License-Identifier: Apache-2.0

osource "$(ZEPHYR_TOOLCHAIN_KCONFIG_DIR)/Kconfig"

config TOOLCHAIN_ZEPHYR
	def_bool y
```

## configs/arduino_101_defconfig
```kconfig
CONFIG_X86=y
CONFIG_PLATFORM_QUARK_SE=y
CONFIG_CPU_MINUTEIA=y
CONFIG_CONSOLE=y
CONFIG_UART_CONSOLE=y
CONFIG_SERIAL=y
CONFIG_SERIAL_INTERRUPT_LEVEL=n
CONFIG_SERIAL_INTERRUPT_LOW=n
CONFIG_UART_NS16550=y
CONFIG_PRINTK=y
CONFIG_IPI=y
CONFIG_IPI_QUARK_SE=y
CONFIG_IPI_QUARK_SE_MASTER=y
CONFIG_IPI_CONSOLE_RECEIVER=y
CONFIG_ARC_INIT=y
CONFIG_PINMUX=y
CONFIG_PINMUX_NUM_PINS=58
```

## configs/basic_cortex_m3_defconfig
```kconfig
CONFIG_ARM=y
CONFIG_SYS_CLOCK_HW_CYCLES_PER_SEC=12000000
CONFIG_PLATFORM_TI_LM3S6965=y
CONFIG_CONSOLE=y
CONFIG_UART_CONSOLE=y
CONFIG_UART_CONSOLE_INDEX=0
CONFIG_UART_CONSOLE_BAUDRATE=115200
CONFIG_SERIAL=y
CONFIG_CORTEX_M_SYSTICK=y
CONFIG_FLASH_SIZE=256
CONFIG_SRAM_SIZE=64
CONFIG_STELLARIS_UART=y
```

## configs/fsl_frdm_k64f_defconfig
```kconfig
CONFIG_ARM=y
CONFIG_SYS_CLOCK_HW_CYCLES_PER_SEC=120000000
CONFIG_PLATFORM_FSL_FRDM_K64F=y
CONFIG_CONSOLE=y
CONFIG_UART_CONSOLE=y
CONFIG_UART_CONSOLE_INDEX=0
CONFIG_UART_CONSOLE_BAUDRATE=115200
CONFIG_SERIAL=y
CONFIG_CORTEX_M_SYSTICK=y
CONFIG_FLASH_SIZE=1024
CONFIG_SRAM_SIZE=192
CONFIG_UART_K20=y
```

## configs/quark_d2000_ref_board_defconfig
```kconfig
CONFIG_X86=y
CONFIG_PLATFORM_QUARK_D2000=y
CONFIG_BOARD_QUARK_D2000_REFERENCE=y
CONFIG_CPU_MINUTEIA=y
CONFIG_IDT_NUM_VECTORS=64
CONFIG_LOAPIC_TIMER_DIVIDER_UNSUPPORTED=y
CONFIG_UART_NS16550=y
CONFIG_UART_CONSOLE=y
CONFIG_CONSOLE=y
CONFIG_SERIAL=y
CONFIG_SERIAL_HAS_DRIVER=y
CONFIG_PRINTK=y
CONFIG_ISR_STACK_SIZE=256
CONFIG_MAIN_STACK_SIZE=512
CONFIG_PINMUX=y
```

## configs/quark_se_defconfig
```kconfig
CONFIG_X86=y
CONFIG_PLATFORM_QUARK_SE=y
CONFIG_CPU_MINUTEIA=y
CONFIG_CONSOLE=y
CONFIG_UART_CONSOLE=y
CONFIG_SERIAL=y
CONFIG_SERIAL_INTERRUPT_LEVEL=n
CONFIG_SERIAL_INTERRUPT_LOW=n
CONFIG_UART_NS16550=y
CONFIG_PRINTK=y
CONFIG_IPM=y
CONFIG_IPM_QUARK_SE=y
CONFIG_IPM_QUARK_SE_MASTER=y
CONFIG_IPM_CONSOLE_RECEIVER=y
CONFIG_ARC_INIT=y
```

## configs/quark_se_ss_defconfig
```kconfig
CONFIG_ARC=y
CONFIG_SYS_CLOCK_TICKS_PER_SEC=100
CONFIG_SYS_CLOCK_HW_CYCLES_PER_SEC=32000000
CONFIG_XIP=y
CONFIG_NANO_TIMERS=y
CONFIG_PRINTK=y
CONFIG_PLATFORM_QUARK_SE_SS=y
CONFIG_CPU_ARCEM4=y
CONFIG_CPU_ARCV2=y
CONFIG_ARCV2_INTERRUPT_UNIT=y
CONFIG_ARCV2_TIMER=y
CONFIG_IPI=y
CONFIG_IPI_QUARK_SE=y
CONFIG_IPI_CONSOLE_SENDER=y
CONFIG_CONSOLE=y
```

## drivers/802.15.4/Kconfig
```kconfig
# Kconfig - IEEE 802.15.4 driver configuration options

#
# Copyright (c) 2015 Intel Corporation
#
# Redistribution and use in source and binary forms, with or without
# modification, are permitted provided that the following conditions are met:
#
# 1) Redistributions of source code must retain the above copyright notice,
# this list of conditions and the following disclaimer.
#
# 2) Redistributions in binary form must reproduce the above copyright notice,
# this list of conditions and the following disclaimer in the documentation
# and/or other materials provided with the distribution.
#
# 3) Neither the name of Intel Corporation nor the names of its contributors
# may be used to endorse or promote products derived from this software without
# specific prior written permission.
#
# THIS SOFTWARE IS PROVIDED BY THE COPYRIGHT HOLDERS AND CONTRIBUTORS "AS IS"
# AND ANY EXPRESS OR IMPLIED WARRANTIES, INCLUDING, BUT NOT LIMITED TO, THE
# IMPLIED WARRANTIES OF MERCHANTABILITY AND FITNESS FOR A PARTICULAR PURPOSE
# ARE DISCLAIMED. IN NO EVENT SHALL THE COPYRIGHT HOLDER OR CONTRIBUTORS BE
# LIABLE FOR ANY DIRECT, INDIRECT, INCIDENTAL, SPECIAL, EXEMPLARY, OR
# CONSEQUENTIAL DAMAGES (INCLUDING, BUT NOT LIMITED TO, PROCUREMENT OF
# SUBSTITUTE GOODS OR SERVICES; LOSS OF USE, DATA, OR PROFITS; OR BUSINESS
# INTERRUPTION) HOWEVER CAUSED AND ON ANY THEORY OF LIABILITY, WHETHER IN
# CONTRACT, STRICT LIABILITY, OR TORT (INCLUDING NEGLIGENCE OR OTHERWISE)
# ARISING IN ANY WAY OUT OF THE USE OF THIS SOFTWARE, EVEN IF ADVISED OF THE
# POSSIBILITY OF SUCH DAMAGE.
#

#
# IEEE 802.15.4 options
#
menu "IEEE 802.15.4 Options"
depends on NETWORKING_WITH_15_4

if NETWORKING_WITH_15_4_TI_CC2520

config	TI_CC2520_DEBUG
	bool
	prompt "CC2520 driver debug"
	default n
	help
	  This option enables debug support for 802.15.4 CC2520
	  driver

config  TI_CC2520_SPI_DRV_NAME
	string "SPI driver's name to use to access CC2520"
	default ""
	help
	  This option is mandatory to set which SPI controller to use in order
	  to actually control the CC2520 chip.

config  TI_CC2520_SPI_FREQ
	int "SPI system frequency"
	default 0
	help
	  This option sets the SPI controller's frequency. Beware this value
	  depends on the SPI controller being used and also on the system
	  clock.

config	TI_CC2520_SPI_SLAVE
	int "SPI slave linked to CC2520"
	default 0
	help
	  This option sets the SPI slave number SPI controller has to switch
	  to when dealing with CC2520 chip.

endif

endmenu
```

## drivers/Kconfig
```kconfig
# drivers configuration options

# Copyright (c) 2015 Intel Corporation
# SPDX-License-Identifier: Apache-2.0

menu "Device Drivers"

# zephyr-keep-sorted-start
source "drivers/adc/Kconfig"
source "drivers/audio/Kconfig"
source "drivers/auxdisplay/Kconfig"
source "drivers/bbram/Kconfig"
source "drivers/bluetooth/Kconfig"
source "drivers/cache/Kconfig"
source "drivers/can/Kconfig"
source "drivers/charger/Kconfig"
source "drivers/clock_control/Kconfig"
source "drivers/console/Kconfig"
source "drivers/coredump/Kconfig"
source "drivers/counter/Kconfig"
source "drivers/crypto/Kconfig"
source "drivers/dac/Kconfig"
source "drivers/dai/Kconfig"
source "drivers/disk/Kconfig"
source "drivers/display/Kconfig"
source "drivers/dma/Kconfig"
source "drivers/dp/Kconfig"
source "drivers/edac/Kconfig"
source "drivers/eeprom/Kconfig"
source "drivers/entropy/Kconfig"
source "drivers/espi/Kconfig"
source "drivers/ethernet/Kconfig"
source "drivers/firmware/Kconfig"
source "drivers/flash/Kconfig"
source "drivers/fpga/Kconfig"
source "drivers/fuel_gauge/Kconfig"
source "drivers/gnss/Kconfig"
source "drivers/gpio/Kconfig"
source "drivers/haptics/Kconfig"
source "drivers/hwinfo/Kconfig"
source "drivers/hwspinlock/Kconfig"
source "drivers/i2c/Kconfig"
source "drivers/i2s/Kconfig"
source "drivers/i3c/Kconfig"
source "drivers/ieee802154/Kconfig"
source "drivers/input/Kconfig"
source "drivers/intc/Kconfig"
source "drivers/interrupt_controller/Kconfig"
source "drivers/interrupt_controller/Kconfig.shared_irq"
source "drivers/ipm/Kconfig"
source "drivers/kscan/Kconfig"
source "drivers/led/Kconfig"
source "drivers/led_strip/Kconfig"
source "drivers/lora/Kconfig"
source "drivers/mbox/Kconfig"
source "drivers/mdio/Kconfig"
source "drivers/memc/Kconfig"
source "drivers/mfd/Kconfig"
source "drivers/mipi_dbi/Kconfig"
source "drivers/mipi_dsi/Kconfig"
source "drivers/misc/Kconfig"
source "drivers/mm/Kconfig"
source "drivers/modem/Kconfig"
source "drivers/mspi/Kconfig"
source "drivers/net/Kconfig"
source "drivers/pcie/Kconfig"
source "drivers/peci/Kconfig"
source "drivers/pinctrl/Kconfig"
source "drivers/pm_cpu_ops/Kconfig"
source "drivers/power_domain/Kconfig"
source "drivers/ps2/Kconfig"
source "drivers/ptp_clock/Kconfig"
source "drivers/pwm/Kconfig"
source "drivers/regulator/Kconfig"
source "drivers/reset/Kconfig"
source "drivers/retained_mem/Kconfig"
source "drivers/rtc/Kconfig"
source "drivers/sdhc/Kconfig"
source "drivers/sensor/Kconfig"
source "drivers/serial/Kconfig"
source "drivers/sip_svc/Kconfig"
source "drivers/smbus/Kconfig"
source "drivers/spi/Kconfig"
source "drivers/stepper/Kconfig"
source "drivers/syscon/Kconfig"
source "drivers/timer/Kconfig"
source "drivers/usb/Kconfig"
source "drivers/usb_c/Kconfig"
source "drivers/video/Kconfig"
source "drivers/virtualization/Kconfig"
source "drivers/w1/Kconfig"
source "drivers/watchdog/Kconfig"
source "drivers/wifi/Kconfig"
source "drivers/xen/Kconfig"
# zephyr-keep-sorted-stop

source "drivers/tee/Kconfig"

endmenu
```

## drivers/actuator/Kconfig
```kconfig
# Copyright (c) 2025 Nordic Semiconductor ASA
# SPDX-License-Identifier: Apache-2.0

config ACTUATOR
	bool "Actuator device driver support"
	select EXPERIMENTAL

if ACTUATOR

module = ACTUATOR
module-str = actuator
source "subsys/logging/Kconfig.template.log_config"

config ACTUATOR_INIT_PRIORITY
	int "Actuator init priority"
	default KERNEL_INIT_PRIORITY_DEVICE
	help
	  Actuator device driver initialization priority.

# zephyr-keep-sorted-start
rsource "Kconfig.fake"
rsource "Kconfig.shell"
# zephyr-keep-sorted-stop

endif # ACTUATOR
```

## drivers/actuator/Kconfig.fake
```kconfig
# Copyright (c) 2025 Nordic Semiconductor ASA
# SPDX-License-Identifier: Apache-2.0

config ACTUATOR_FAKE
	bool "Fake actuator device driver"
	default y
	depends on DT_HAS_ZEPHYR_ACTUATOR_FAKE_ENABLED
	depends on ZTEST
```
