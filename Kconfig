## arch/arc/platforms/generic_arc/Kconfig
```kconfig
#
# Copyright (c) 2015 Intel Corporation
#
# Licensed under the Apache License, Version 2.0 (the "License");
# you may not use this file except in compliance with the License.
# You may obtain a copy of the License at
#
#     http://www.apache.org/licenses/LICENSE-2.0
#
# Unless required by applicable law or agreed to in writing, software
# distributed under the License is distributed on an "AS IS" BASIS,
# WITHOUT WARRANTIES OR CONDITIONS OF ANY KIND, either express or implied.
# See the License for the specific language governing permissions and
# limitations under the License.
#

if PLATFORM_GENERIC_ARC
config PLATFORM
	string
	default generic_arc
	help
	 This option holds the directory name used by the build system
	 to locate the correct linker file.

config NUM_IRQ_PRIO_LEVELS
	# This processor supports only 2 priority levels:
	# 0 for Fast Interrupts (FIRQs) and 1 for Regular Interrupts (IRQs).
	default 2

config NUM_REGULAR_IRQ_PRIO_LEVELS
	# This processor supports only 1 Regular Interrupt priority level (1).
	default 1

config  NUM_IRQS
	# must be >= the highest interrupt number used
	default 17


menu "Generic BSP Options"


config	SYS_CLOCK_HW_CYCLES_PER_SEC
	default 32000000

config RAM_START
	default 0x4000 if NSIM
	default 0xa8000000

config RAM_SIZE
	default 16 if NSIM
	default 80

endmenu

config KERNEL_INIT_PRIORITY_DEFAULT
	default 40

config KERNEL_INIT_PRIORITY_DEVICE
	default 50

config UART_CONSOLE_PRIORITY
	default 60

config UART_NSIM_PORT_0_BASE_ADDR
	default 0x4242
	depends on NSIM

endif
```

## arch/arc/platforms/generic_arc/Kconfig.platform
```kconfig
config PLATFORM_GENERIC_ARC
        bool "Minimum configuration for generic arc"
```

## arch/arc/platforms/quark_se_ss/Kconfig
```kconfig
#
# Copyright (c) 2014 Wind River Systems, Inc.
#
# Licensed under the Apache License, Version 2.0 (the "License");
# you may not use this file except in compliance with the License.
# You may obtain a copy of the License at
#
#     http://www.apache.org/licenses/LICENSE-2.0
#
# Unless required by applicable law or agreed to in writing, software
# distributed under the License is distributed on an "AS IS" BASIS,
# WITHOUT WARRANTIES OR CONDITIONS OF ANY KIND, either express or implied.
# See the License for the specific language governing permissions and
# limitations under the License.
#

if PLATFORM_QUARK_SE_SS

config PLATFORM
	default quark_se_ss

config NUM_IRQ_PRIO_LEVELS
	# This processor supports only 2 priority levels:
	# 0 for Fast Interrupts (FIRQs) and 1 for Regular Interrupts (IRQs).
	default 2

config NUM_REGULAR_IRQ_PRIO_LEVELS
	# This processor supports only 1 Regular Interrupt priority level (1).
	default 1

config  NUM_IRQS
	# must be >= the highest interrupt number used
	default 68


config SYS_CLOCK_HW_CYCLES_PER_SEC
	default 32000000

config RAM_START
	default 0x4000 if NSIM
	default 0xa8000400

config RAM_SIZE
	default 16 if NSIM
	default 24

if GPIO_DW

config GPIO_DW_BOTHEDGES_SUPPORT
	default n

config GPIO_DW_0_BASE_ADDR
	default 0x80017800
config GPIO_DW_0_IRQ
	default 8

config GPIO_DW_1_BASE_ADDR
	default 0x80017900
config GPIO_DW_1_IRQ
	default 8

endif


if I2C_QUARK_SE_SS_0

config I2C_QUARK_SE_SS_0_BASE
	default 0x80012000

config I2C_QUARK_SE_SS_0_NAME
	default "SS_I2C0"

config I2C_QUARK_SE_SS_0_DEFAULT_CFG
	default 0x12

endif

if I2C_QUARK_SE_SS_1

config I2C_QUARK_SE_SS_1_BASE
	default 0x80012100

config I2C_QUARK_SE_SS_1_NAME
	default "SS_I2C1"

config I2C_QUARK_SE_SS_1_DEFAULT_CFG
	default 0x12


endif

config KERNEL_INIT_PRIORITY_DEFAULT
	default 40

config KERNEL_INIT_PRIORITY_DEVICE
	default 50

config IPI_CONSOLE_PRIORITY
	default 60

config UART_CONSOLE_PRIORITY
	default 60

config GPIO_DW_INIT_PRIORITY
	default 60

config I2C_INIT_PRIORITY
	default 60

endif #PLATFORM_QUARK_SE_ARC
```

## arch/arc/platforms/quark_se_ss/Kconfig.platform
```kconfig
config PLATFORM_QUARK_SE_SS
        bool "Minimum configuration for Quark SE Sensor Subsystem"
```

## arch/arc/soc/em7d/Kconfig.defconfig
```kconfig
#
# Copyright (c) 2014 Wind River Systems, Inc.
# Copyright (c) 2016 Synopsys, Inc. All rights reserved.
#
# SPDX-License-Identifier: Apache-2.0
#

if SOC_EM7D

config SOC
	default em7d

config NUM_IRQ_PRIO_LEVELS
	# This processor supports 4 priority levels:
	# 0 for Fast Interrupts (FIRQs) and 1-3 for Regular Interrupts (IRQs).
	default 4

config NUM_IRQS
	# must be > the highest interrupt number used
	default 38 if BOARD_EM_STARTERKIT_R23
	default 36 if BOARD_EM_STARTERKIT_R22

config ARC_MPU_VER
	default 3 if BOARD_EM_STARTERKIT_R23
	default 2 if BOARD_EM_STARTERKIT_R22

config RGF_NUM_BANKS
	default 1

config SYS_CLOCK_HW_CYCLES_PER_SEC
	default 25000000 if BOARD_EM_STARTERKIT_R23
	default 30000000 if BOARD_EM_STARTERKIT_R22

config HARVARD
	def_bool y

config ARC_FIRQ
	def_bool n if BOARD_EM_STARTERKIT_R23
	def_bool y if BOARD_EM_STARTERKIT_R22

config FLASH_BASE_ADDRESS
	default 0x00000000

config FLASH_SIZE
	default 0
	# em7d has no FLASH so size is 0.

config SRAM_BASE_ADDRESS
	default 0x10000000

config SRAM_SIZE
	default 131072

config ICCM_BASE_ADDRESS
	default 0x00000000

config ICCM_SIZE
	default 256

config DCCM_BASE_ADDRESS
	default 0x80000000

config DCCM_SIZE
	default 128

config CACHE_FLUSHING
	def_bool y

endif #SOC_EM7D
```

## arch/arc/soc/em7d/Kconfig.soc
```kconfig
config SOC_EM7D
	bool "Synopsys ARC EM7D"
	select CPU_HAS_MPU
	select ARC_HAS_SECURE if BOARD_EM_STARTERKIT_R23
```

## arch/arc/soc/em9d/Kconfig.defconfig
```kconfig
#
# Copyright (c) 2014 Wind River Systems, Inc.
# Copyright (c) 2016 Synopsys, Inc. All rights reserved.
#
# SPDX-License-Identifier: Apache-2.0
#

if SOC_EM9D

config SOC
	default em9d

config NUM_IRQ_PRIO_LEVELS
	# This processor supports 4 priority levels:
	# 0 for Fast Interrupts (FIRQs) and 1-3 for Regular Interrupts (IRQs).
	default 4

config NUM_IRQS
	# must be > the highest interrupt number used
	default 38 if BOARD_EM_STARTERKIT_R23
	default 36 if BOARD_EM_STARTERKIT_R22

config RGF_NUM_BANKS
	default 2

config SYS_CLOCK_HW_CYCLES_PER_SEC
	default 20000000

config HARVARD
	def_bool y

config FLASH_BASE_ADDRESS
	default 0x00000000

config FLASH_SIZE
	default 0
	# em9d has no FLASH so size is 0.

config SRAM_BASE_ADDRESS
	default 0x00000000

config SRAM_SIZE
	default 0
	# em9d has no SRAM so size is 0.

config ICCM_BASE_ADDRESS
	default 0x00000000

config ICCM_SIZE
	default 256

config DCCM_BASE_ADDRESS
	default 0x80000000

config DCCM_SIZE
	default 128

endif #SOC_EM9D
```
