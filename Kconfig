## Kconfig
```kconfig
# Kconfig - general configuration options

#
# Copyright (c) 2014-2015 Wind River Systems, Inc.
#
# SPDX-License-Identifier: Apache-2.0
#
mainmenu "Zephyr Kernel Configuration"

source "Kconfig.zephyr"
```

## Kconfig.defconfig
```kconfig
if COMPILE_TEST

config UART_CONSOLE_ON_DEV_NAME
	default ""

config BLUETOOTH_UART_ON_DEV_NAME
	default ""

config UART_PIPE_ON_DEV_NAME
	default ""

config FXOS8700_I2C_NAME
	default ""

config MAX30101_I2C_NAME
	default ""

config FXAS21002_I2C_NAME
	default ""

endif
```

## Kconfig.headers
```kconfig
# Configurations for headers
# This file can't be added like other Kconfig files since putting it under include/ will make
# it visibile to IDEs when writing 'include' statements.

# Copyright (c) 2022 Google Inc
# SPDX-License-Identifier: Apache-2.0

config MATH_UTIL_FLOAT
	bool "Enable the math utility library to use floating point values"
	depends on FPU
	help
	  When enabled, 'fp_t' type will be mapped to 'float'. Otherwise, it will use int32_t and
	  represent fixed point math.

config MATH_UTIL_FP_BITS
	int "The number of bits that will be used for the floating component of fp_t"
	range 0 31
	default 16
	depends on !MATH_UTIL_FLOAT
	help
	  Determines what portion of the int32_t will be used for the floating component of the
	  fixed point number. The valid range is 0-31 where 31 means that fp_t can represent values
	  with a resolution of 1/INT32_MAX (bounds are roughly -0.99.. to 0.99..). And 0 meaning
	  fp_t is just an int32_t with no decimal representation. Default is 16 having an int range
	  of INT16_MIN to INT16_MAX and decimal resolution of 1/INT16_MAX.

config MATH_UTIL_PRIf_PRECISION
	int "The number of decimal points to print when using PRIf and PRIf_ARG()"
	range 0 10
	default 6 if MATH_UTIL_FLOAT
	default 10 if MATH_UTIL_FP_BITS >= 30
	default 9 if MATH_UTIL_FP_BITS >= 28
	default 8 if MATH_UTIL_FP_BITS >= 24
	default 7 if MATH_UTIL_FP_BITS >= 20
	default MATH_UTIL_FP_BITS if MATH_UTIL_FP_BITS < 6
	default 6
```

## Kconfig.mcuboot
```kconfig
# General configuration options

# Copyright (c) 2014-2015 Wind River Systems, Inc.
# Copyright (c) 2016 Intel Corporation
# Copyright (c) 2023 Nordic Semiconductor ASA
# SPDX-License-Identifier: Apache-2.0

config MCUBOOT
	bool
	help
	  Hidden option used to indicate that the current image is MCUBoot

config BOOTLOADER_MCUBOOT
	bool "MCUboot bootloader support"
	select USE_DT_CODE_PARTITION
	imply INIT_ARCH_HW_AT_BOOT if ARCH_SUPPORTS_ARCH_HW_INIT
	depends on !MCUBOOT
	help
	  This option signifies that the target uses MCUboot as a bootloader,
	  or in other words that the image is to be chain-loaded by MCUboot.
	  This sets several required build system and Device Tree options in
	  order for the image generated to be bootable using the MCUboot open
	  source bootloader. Currently this includes:

	    * Setting ROM_START_OFFSET to a default value that allows space
	      for the MCUboot image header
	    * Activating SW_VECTOR_RELAY_CLIENT on Cortex-M0
	      (or Armv8-M baseline) targets with no built-in vector relocation
	      mechanisms

	  By default, this option instructs Zephyr to initialize the core
	  architecture HW registers during boot, when this is supported by
	  the application. This removes the need by MCUboot to reset
	  the core registers' state itself.

if BOOTLOADER_MCUBOOT

config MCUBOOT_CMAKE_WEST_SIGN_PARAMS
	string "Extra parameters to west sign"
	default "--quiet"
	help
	  Parameters that are passed by cmake to west sign, just after
	  the command, before all other parameters needed for image
	  signing.
	  By default this is set to "--quiet" to prevent extra, non-error,
	  diagnostic messages from west sign. This does not affect signing
	  tool for which extra parameters are passed with
	  MCUBOOT_EXTRA_IMGTOOL_ARGS.

config MCUBOOT_SIGNATURE_KEY_FILE
	string "Path to the mcuboot signing key file"
	default ""
	depends on !MCUBOOT_GENERATE_UNSIGNED_IMAGE
	help
	  The file contains a key pair whose public half is verified
	  by your target's MCUboot image. The file is in PEM format.

	  If set to a non-empty value, the build system tries to
	  sign the final binaries using a 'west sign -t imgtool' command.
	  The signed binaries are placed in the build directory
	  at zephyr/zephyr.signed.bin and zephyr/zephyr.signed.hex.

	  The file names can be customized with CONFIG_KERNEL_BIN_NAME.
	  The existence of bin and hex files depends on CONFIG_BUILD_OUTPUT_BIN
	  and CONFIG_BUILD_OUTPUT_HEX.

	  This option should contain a path to the same file as the
	  BOOT_SIGNATURE_KEY_FILE option in your MCUboot .config. The path
	  may be absolute or relative to the west workspace topdir. (The MCUboot
	  config option is used for the MCUboot bootloader image; this option is
	  for your application which is to be loaded by MCUboot. The MCUboot
	  config option can be a relative path from the MCUboot repository
	  root.)

	  If left empty, you must sign the Zephyr binaries manually.

config MCUBOOT_ENCRYPTION_KEY_FILE
	string "Path to the mcuboot encryption key file"
	default ""
	depends on MCUBOOT_SIGNATURE_KEY_FILE != ""
	help
	  The file contains the public key that is used to encrypt the
	  ephemeral key that encrypts the image. The corresponding
	  private key is hard coded in the MCUboot source code and is
	  used to decrypt the ephemeral key that is embedded in the
	  image. The file is in PEM format.

	  If set to a non-empty value, the build system tries to
	  sign and encrypt the final binaries using a 'west sign -t imgtool'
	  command. The binaries are placed in the build directory at
	  zephyr/zephyr.signed.encrypted.bin and
	  zephyr/zephyr.signed.encrypted.hex.

	  The file names can be customized with CONFIG_KERNEL_BIN_NAME.
	  The existence of bin and hex files depends on CONFIG_BUILD_OUTPUT_BIN
	  and CONFIG_BUILD_OUTPUT_HEX.

	  This option should either be an absolute path or a path relative to
	  the west workspace topdir.
	  Example: './bootloader/mcuboot/enc-rsa2048-pub.pem'

	  If left empty, you must encrypt the Zephyr binaries manually.

config MCUBOOT_EXTRA_IMGTOOL_ARGS
	string "Extra arguments to pass to imgtool when signing"
	default ""
	help
	  When signing (CONFIG_MCUBOOT_SIGNATURE_KEY_FILE is a non-empty
	  string) you can use this option to pass extra options to
	  imgtool.  For example, you could set this to "--version 1.2".

config MCUBOOT_GENERATE_UNSIGNED_IMAGE
	bool "Generate unsigned binary image bootable with MCUboot"
	help
	  Enabling this configuration allows automatic unsigned binary image
	  generation when MCUboot signing key is not provided,
	  i.e., MCUBOOT_SIGNATURE_KEY_FILE is left empty.

config MCUBOOT_GENERATE_CONFIRMED_IMAGE
	bool "Also generate a padded, confirmed image"
	help
	  The signed, padded, and confirmed binaries are placed in the build
	  directory at zephyr/zephyr.signed.confirmed.bin and
	  zephyr/zephyr.signed.confirmed.hex.

	  The file names can be customized with CONFIG_KERNEL_BIN_NAME.
	  The existence of bin and hex files depends on CONFIG_BUILD_OUTPUT_BIN
	  and CONFIG_BUILD_OUTPUT_HEX.

endif # BOOTLOADER_MCUBOOT
```
