## dts/bindings/pwm/ti,mspm0-timer-pwm.yaml
```yaml
# Copyright 2025 Linumiz GmbH
# SPDX-License-Identifier: Apache-2.0

description: |
  TI MSPM0 PWM node for MSPM0 SoCs. Each channel in MSPM0 can be configured
  to use for PWM operation. There are three PWM modes supported by hardware.

  timer0: timer {
    pwm0: pwm {
      compatible = "ti,mspm0-timer-pwm";
      #pwm-cells = <3>;

      ti,cc-index = <0>;
      ti,pwm-mode = "PULSE_WIDTH";
      ti,period = <1000>;
    };
  };

compatible: "ti,mspm0-timer-pwm"

include: [pwm-controller.yaml, base.yaml, pinctrl-device.yaml]

properties:
  pinctrl-0:
    required: true

  pinctrl-names:
    required: true

  ti,cc-index:
    type: array
    required: true
    description: |
      Capture input/Compare output index, should match with the pin function.

  ti,pwm-mode:
    type: string
    description: |
      Select PWM OUT mode:
      - EDGE_ALIGN: generate pulses with edge aligned down counting mode.

      - EDGE_ALIGN_UP: generate pulses with edge aligned up counting mode.

      - CENTER_ALIGN: generates pulses center aligned up and down counting mode.

    enum:
      - "EDGE_ALIGN"
      - "EDGE_ALIGN_UP"
      - "CENTER_ALIGN"

  ti,cc-mode:
    type: string
    description: |
      Select input capture mode:
      - EDGE_TIME: capture edge time mode.

      - PULSE_WIDTH: capture pulse width and/or period mode.

    enum:
      - "EDGE_TIME"
      - "PULSE_WIDTH"

  ti,period:
    type: int
    required: true
    description: |
      Time period in TIMCLK cycle for Capture mode or PWM output.

pwm-cells:
  - channel
  - period
  - flags
```

## dts/bindings/pwm/wch,adtm-pwm.yaml
```yaml
# SPDX-FileCopyrightText: Copyright Michael Hope <michaelh@juju.nz>
# SPDX-License-Identifier: Apache-2.0

description: WCH Advanced-control Timer (ADTM) for PWM

compatible: "wch,adtm-pwm"

include: [base.yaml, pwm-controller.yaml, pinctrl-device.yaml]

properties:
  "#pwm-cells":
    const: 3

pwm-cells:
  - channel
  - period
  - flags
```

## dts/bindings/pwm/wch,gptm-pwm.yaml
```yaml
# Copyright (c) 2025 Michael Hope <michaelh@juju.nz>
# SPDX-License-Identifier: Apache-2.0

description: WCH General-purpose Timer (GPTM) for PWM

compatible: "wch,gptm-pwm"

include: [base.yaml, pwm-controller.yaml, pinctrl-device.yaml]

properties:
  "#pwm-cells":
    const: 3

pwm-cells:
  - channel
  - period
  - flags
```

## dts/bindings/pwm/wch,gptm.yaml
```yaml
# Copyright (c) 2025 Michael Hope <michaelh@juju.nz>
# SPDX-License-Identifier: Apache-2.0

description: WCH General-purpose Timer (GPTM)

compatible: "wch,gptm"

include: [base.yaml, pwm-controller.yaml, pinctrl-device.yaml]

properties:
  prescaler:
    type: int
    default: 0
    description: |
      Counter prescaler from 0 to 65535. The clock frequency to the counter
      is the input frequency divided by (prescaler + 1). For example, if the
      input clock is 48 MHz and the desired counter clock is 1 MHz, set this
      property to 47.

  "#pwm-cells":
    const: 3

pwm-cells:
  - channel
  - period
  - flags
```

## dts/bindings/pwm/wisblock-pwm.yaml
```yaml
# Copyright (c) 2026 RAKwireless Technology Limited
# SPDX-License-Identifier: Apache-2.0

description: |
  PWM channels exposed on the WisBlock IO connector.

  WisBlock Core modules can expose PWM-capable lines through the WisBlock
  IO connector. This binding provides a nexus mapping where parent pin
  indices correspond to the WISBLOCK_PWM_* constants defined in
  <zephyr/dt-bindings/pwm/wisblock-pwm.h>:

    0   IO1   PWM channel routed to IO1
    1   IO2   PWM channel routed to IO2
    2   IO3   PWM channel routed to IO3
    3   IO4   PWM channel routed to IO4
    4   IO5   PWM channel routed to IO5
    5   IO6   PWM channel routed to IO6
    6   IO7   PWM channel routed to IO7

  Example usage in a WisBlock Core board file:

    wisblock_pwm: wisblock-pwm {
      compatible = "wisblock-pwm";
      pwm-map = <WISBLOCK_PWM_IO1 0 0 &pwm0 0 0 0>,
                <WISBLOCK_PWM_IO2 0 0 &pwm0 1 0 0>;
      #pwm-cells = <3>;
    };

compatible: "wisblock-pwm"

include: [base.yaml, pwm-nexus.yaml]
```

## dts/bindings/pwm/xlnx,xps-timer-1.00.a-pwm.yaml
```yaml
description: Xilinx AXI Timer IP node (PWM controller)

compatible: "xlnx,xps-timer-1.00.a-pwm"

include: ["xlnx,xps-timer-1.00.a.yaml", pwm-controller.yaml]

properties:
  xlnx,gen0-assert:
    required: true

  xlnx,gen1-assert:
    required: true

  xlnx,trig0-assert:
    required: true

  xlnx,trig1-assert:
    required: true

pwm-cells:
  - channel
  # period in terms of nanoseconds
  - period
  - flags
```

## dts/bindings/pwm/zephyr,fake-pwm.yaml
```yaml
# Copyright (c) 2024 Kickmaker
# SPDX-License-Identifier: Apache-2.0

description: |
    This binding provides a fake PWM for use as either a stub or a mock in Zephyr
    testing.

compatible: "zephyr,fake-pwm"

include: [pwm-controller.yaml, base.yaml, pinctrl-device.yaml]

properties:
  "#pwm-cells":
    const: 2
    description: |
      Number of items to expect in a PWM
      - channel of the timer used for PWM
      - period to set in ns
  frequency:
    type: int
    description: |
      Frequency for the underlying timer (in Hz)

pwm-cells:
  - channel
  - period
```

## dts/bindings/pwm/zephyr,pwm-bitbang.yaml
```yaml
# Copyright (c) 2026 Siemens
# SPDX-License-Identifier: Apache-2.0

description: |
  Bitbang PWM controller.

  Generates PWM signals on arbitrary GPIO pins using a hardware timer
  as the time base. Each channel maps to one GPIO pin.
  The period is the same for all PWM channels.

examples:
  - |
     bitbang_pwm: bitbang-pwm {
         compatible = "zephyr,pwm-bitbang";
         status = "okay";
         #pwm-cells = <3>;
         timer = <&timer2>;
         pwm-gpios = <&gpioa 5 GPIO_ACTIVE_HIGH>,
                     <&gpiob 3 GPIO_ACTIVE_HIGH>;
     };

compatible: "zephyr,pwm-bitbang"

include: [pwm-controller.yaml, base.yaml]

properties:
  timer:
    type: phandle
    required: true
    description: |
      Reference to the hardware timer peripheral used as a time base
      for generating the timer interrupts (e.g., &timer2).

  pwm-gpios:
    type: phandle-array
    required: true
    description: |
      List of GPIO pins that serve as PWM output channels. Each entry
      corresponds to one PWM channel.

  "#pwm-cells":
    const: 3

pwm-cells:
  - channel
  - period
  - flags
```

## dts/bindings/pxp/nxp,imx-pxp.yaml
```yaml
#
# Copyright (c) 2019, Linaro Limited
#
# SPDX-License-Identifier: Apache-2.0
#

description: NXP MCUX PXP module

compatible: "nxp,imx-pxp"

include: base.yaml

properties:
    interrupts:
      required: true

    label:
      required: true
```

## dts/bindings/qspi/adi,max32-spixf.yaml
```yaml
# Copyright (c) 2025 Analog Devices, Inc
# SPDX-License-Identifier: Apache-2.0

description: |
    MAX32 SPIXF device representation. A node would typically looks to this:

        &spixf {
            pinctrl-0 = <&spixf_sdio0_p0_1 &spixf_sdio2_p0_2 &spixf_sck_p0_3
                         &spixf_sdio3_p0_4 &spixf_sdio1_p0_5 &spixf_ss0_p0_6>;
            pinctrl-names = "default";

            status = "okay";
        };

compatible: "adi,max32-spixf"

include: [base.yaml, pinctrl-device.yaml]

bus: qspi

properties:
  reg:
    required: true

  interrupts:
    required: true

  pinctrl-0:
    required: true

  pinctrl-names:
    required: true
```
