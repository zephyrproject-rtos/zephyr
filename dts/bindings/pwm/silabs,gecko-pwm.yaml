## dts/bindings/pwm/silabs,gecko-pwm.yaml
```yaml
description: Silabs Gecko PWM port

compatible: "silabs,gecko-pwm"

include: [pwm-controller.yaml, pinctrl-device.yaml, base.yaml]

properties:
  pin-location:
    type: array
    description: pwm pin configuration defined as <location port pin>

  prescaler:
    type: int
    default: 1
    description: prescaling factor from the HFPERCLK clock
    enum:
      - 1
      - 2
      - 4
      - 8
      - 16
      - 32
      - 64
      - 128
      - 256
      - 512
      - 1024

  "#pwm-cells":
    const: 3

pwm-cells:
  - channel
  - period
  - flags
```

## dts/bindings/pwm/silabs,letimer-pwm.yaml
```yaml
title: Silicon Labs LETIMER (Low Energy Timer) PWM (Pulse Width Modulation)

description: |
  PWM controller using the LETIMER peripheral on Silicon Labs Series 2 SoCs.

  The LETIMER can output PWM signals up to 16 kHz. It does not support input capture.

compatible: "silabs,letimer-pwm"

include: [pwm-controller.yaml, pinctrl-device.yaml, base.yaml]

properties:
  pinctrl-0:
    required: true

  "#pwm-cells":
    const: 3

pwm-cells:
  - channel
  - period
  - flags
```

## dts/bindings/pwm/silabs,siwx91x-pwm.yaml
```yaml
description: |
  Silabs siwx91x PWM Controller

  The siwx91x PWM controller is designed to generate PWM signals. The mapping
  between PWM channels and GPIO pins is configured through pinctrl settings.

compatible: "silabs,siwx91x-pwm"

include: [base.yaml, pinctrl-device.yaml, pwm-controller.yaml]

properties:
  "#pwm-cells":
    const: 2

  silabs,ch_prescaler:
    type: array
    required: true
    description: |
      Contains the prescaler values for all the 4 channels
    enum:
      - 1
      - 2
      - 4
      - 8
      - 16
      - 32
      - 64

  silabs,pwm_polarity:
    type: int
    required: true
    description: |
        Common PWM polarity for all the channels
        0 - Normal polarity
        1 - Inverted polarity

pwm-cells:
  - channel
  - period
```

## dts/bindings/pwm/silabs,timer-pwm.yaml
```yaml
title: Silicon Labs TIMER PWM (Pulse Width Modulation)

description: |
  PWM controller using the TIMER peripheral on Silicon Labs Series 2 SoCs.

compatible: "silabs,timer-pwm"

include: [pwm-controller.yaml, pinctrl-device.yaml, base.yaml]

properties:
  pinctrl-0:
    required: true

  "#pwm-cells":
    const: 3

pwm-cells:
  - channel
  - period
  - flags
```

## dts/bindings/pwm/snps,designware-pwm.yaml
```yaml
# Copyright (c) 2020 Intel Corporation
# SPDX-License-Identifier: Apache-2.0

description: Synopsys DesignWare PWM node

compatible: "snps,designware-pwm"

include: base.yaml

properties:
    reg:
      required: true

    channels:
      type: int
      required: true
      description: Number of PWM channels
```

## dts/bindings/pwm/sophgo,cvi-pwm.yaml
```yaml
# Copyright (c) 2023-2024 Chen Xingyu <hi@xingrz.me>
# SPDX-License-Identifier: Apache-2.0

description: SOPHGO CVI series PWM

compatible: "sophgo,cvi-pwm"

include: [pwm-controller.yaml, pinctrl-device.yaml, base.yaml]

properties:
  clock-frequency:
    type: int
    required: true

  pinctrl-0:
    required: true

  pinctrl-names:
    required: true

  "#pwm-cells":
    const: 3

pwm-cells:
- channel
- period
- flags
```

## dts/bindings/pwm/st,stm32-lptim-pwm.yaml
```yaml
description: STM32 LPTIM PWM

compatible: "st,stm32-lptim-pwm"

include:
  - name: pwm-controller.yaml
  - name: base.yaml
  - name: pinctrl-device.yaml
  - name: st,stm32-lptim.yaml
    property-blocklist:
      - st,timeout

properties:
  pinctrl-0:
    required: true

  pinctrl-names:
    required: true

  "#pwm-cells":
    const: 3
    description: |
      Number of items to expect in a PWM
      - channel of the timer used for PWM
      - period to set in ns
      - flags : combination of standard flags like PWM_POLARITY_NORMAL

pwm-cells:
  - channel
  - period
  - flags
```

## dts/bindings/pwm/st,stm32-pwm.yaml
```yaml
description: STM32 PWM

compatible: "st,stm32-pwm"

include: [pwm-controller.yaml, base.yaml, pinctrl-device.yaml]

properties:
  pinctrl-0:
    required: true

  pinctrl-names:
    required: true

  four-channel-capture-support:
    type: boolean
    description: |
      Add support to capture on four channels. This is less accurate than
      the default 2 channel support because the counter is reset by
      interrupt instead of slave-mode controller. This option can also
      be used as alternative for timers that does not support slave mode.

  dmas:
    description: |
      Optional DMA specifiers used by the DMA-based batch capture backend
      (CONFIG_PWM_CAPTURE_WITH_DMA). One specifier per timer capture/compare
      channel that participates in capture, streaming the CCRx register into a
      RAM ring buffer. For period/pulse capture on channel N, provide both the
      direct channel (CCRn) and its complementary channel used for the pulse.
      Each specifier follows the SoC DMA binding.

  dma-names:
    description: |
      Names matching the "dmas" specifiers. Use "cc1".."cc4" to associate each
      DMA specifier with the corresponding timer capture/compare channel.

  "#pwm-cells":
    const: 3
    description: |
      Number of items to expect in a PWM
      - channel of the timer used for PWM
      - period to set in ns
      - flags : combination of standard flags like PWM_POLARITY_NORMAL
        or specific flags like STM32_PWM_COMPLEMENTARY.
        The input capture prescaler for period capture can be enabled using
        STM32_PWM_CAPTURE_PSC_x (x = 2, 4, 8). The measured period is
        compensated at driver level.
        As an example, the following complementary PWMs(CH2&CH2N) are shown
        below.
          <&pwm1 2 100 (PWM_POLARITY_NORMAL)>;
          <&pwm1 2 100 (PWM_POLARITY_NORMAL | STM32_PWM_COMPLEMENTARY)>;

pwm-cells:
  - channel
  - period
  - flags

examples: |
    &pwm1 {
      status = "okay";
      pinctrl-0 = <&pwm1_ch1_pa8>, <&pwm1_ch2_pa9>;
      pinctrl-names = "default";
      dmas = <&gpdma1 0 SLOT_TIMx_CH1 0>,
             <&gpdma1 1 SLOT_TIMx_CH2 0>;
      dma-names = "cc1", "cc2";
    };
```

## dts/bindings/pwm/telink,b91-pwm.yaml
```yaml
# Copyright (c) 2021, Telink Semiconductor
# SPDX-License-Identifier: Apache-2.0


description: Telink B91 PWM

include: [pwm-controller.yaml, base.yaml]

compatible: "telink,b91-pwm"

properties:

    pinctrl-0:
      type: phandles
      required: true

    clock-frequency:
      type: int
      required: true
      description: Default PWM Peripheral Clock frequency in Hz (is used if 32K Clock is disabled)

    clk32k-ch0-enable:
      type: boolean
      required: false
      description: Enable 32K Source Clock for PWM Channel 0

    clk32k-ch1-enable:
      type: boolean
      required: false
      description: Enable 32K Source Clock for PWM Channel 1

    clk32k-ch2-enable:
      type: boolean
      required: false
      description: Enable 32K Source Clock for PWM Channel 2

    clk32k-ch3-enable:
      type: boolean
      required: false
      description: Enable 32K Source Clock for PWM Channel 3

    clk32k-ch4-enable:
      type: boolean
      required: false
      description: Enable 32K Source Clock for PWM Channel 4

    clk32k-ch5-enable:
      type: boolean
      required: false
      description: Enable 32K Source Clock for PWM Channel 5

    channels:
      type: int
      const: 6
      required: true
      description: Number of channels this PWM has

    reg:
      required: true

    "#pwm-cells":
      const: 2

pwm-cells:
  - channel
  - flags
```

## dts/bindings/pwm/telink,b9x-pwm.yaml
```yaml
# Copyright (c) 2021-2023, Telink Semiconductor
# SPDX-License-Identifier: Apache-2.0


description: Telink B9x PWM

include: [pwm-controller.yaml, base.yaml]

compatible: "telink,b9x-pwm"

properties:

  pinctrl-ch0:
    type: phandles
    description: PWM cahnnel 0 pincontrol

  pinctrl-ch1:
    type: phandles
    description: PWM cahnnel 1 pincontrol

  pinctrl-ch2:
    type: phandles
    description: PWM cahnnel 2 pincontrol

  pinctrl-ch3:
    type: phandles
    description: PWM cahnnel 3 pincontrol

  pinctrl-ch4:
    type: phandles
    description: PWM cahnnel 4 pincontrol

  pinctrl-ch5:
    type: phandles
    description: PWM cahnnel 5 pincontrol

  clk32k-ch0-enable:
    type: boolean
    description: Enable 32K Source Clock for PWM Channel 0

  clk32k-ch1-enable:
    type: boolean
    description: Enable 32K Source Clock for PWM Channel 1

  clk32k-ch2-enable:
    type: boolean
    description: Enable 32K Source Clock for PWM Channel 2

  clk32k-ch3-enable:
    type: boolean
    description: Enable 32K Source Clock for PWM Channel 3

  clk32k-ch4-enable:
    type: boolean
    description: Enable 32K Source Clock for PWM Channel 4

  clk32k-ch5-enable:
    type: boolean
    description: Enable 32K Source Clock for PWM Channel 5

  clock-frequency:
    type: int
    required: true
    description: Default PWM Peripheral Clock frequency in Hz (is used if 32K Clock is disabled)

  channels:
    type: int
    const: 6
    required: true
    description: Number of channels this PWM has

  reg:
    required: true

  "#pwm-cells":
    const: 3

pwm-cells:
  - channel
  - period
  - flags
```

## dts/bindings/pwm/telink,w91-pwm.yaml
```yaml
# Copyright (c) 2024, Telink Semiconductor
# SPDX-License-Identifier: Apache-2.0


description: Telink W91 PWM

include: [pwm-controller.yaml, base.yaml]

compatible: "telink,w91-pwm"

properties:

  pinctrl-ch0:
    type: phandles
    description: PWM cahnnel 0 pincontrol

  pinctrl-ch1:
    type: phandles
    description: PWM cahnnel 1 pincontrol

  pinctrl-ch2:
    type: phandles
    description: PWM cahnnel 2 pincontrol

  pinctrl-ch3:
    type: phandles
    description: PWM cahnnel 3 pincontrol

  pinctrl-ch4:
    type: phandles
    description: PWM cahnnel 4 pincontrol

  channels:
    type: int
    const: 5
    required: true
    description: Number of channels this PWM has

  "#pwm-cells":
    const: 3

pwm-cells:
  - channel
  - period
  - flags
```

## dts/bindings/pwm/ti,am3352-ehrpwm.yaml
```yaml
# SPDX-FileCopyrightText: Copyright (c) 2026 Texas Instruments
# SPDX-License-Identifier: Apache-2.0

description: TI SOC EHRPWM based PWM controller

include: [pwm-controller.yaml, base.yaml, pinctrl-device.yaml]

compatible: "ti,am3352-ehrpwm"

properties:
  reg:
    required: true

  clocks:
    required: true

  symmetric:
    type: boolean
    description: Generate a symmetric PWM by using up-down count mode

  tbclk:
    type: phandle-array
    specifier-space: epwm-tbclk
    description: |
      Offset and bit configuration for selecting the time-base clock
      Format: <&syscon_phandle offset bit>
      - syscon_phandle: reference to syscon device
      - offset: register offset within syscon for clock selection
      - value: bit within the register that controls the timebase clock

  "#pwm-cells":
    const: 3

pwm-cells:
  - channel
  - period
  - flags
```

## dts/bindings/pwm/ti,cc13xx-cc26xx-timer-pwm.yaml
```yaml
# Copyright (c) 2023, Zephyr Project
# SPDX-License-Identifier: Apache-2.0

description: |
  TI SimpleLink CC13xx/CC26xx GPT timer PWM Controller Node

  To configure a PWM node, you first need to define a board overlay with a
  pinctrl configuration for the pin on which the PWM signal should be present:

    &pinctrl {
      gpt0_pwm: gpt0_pwm {
        pinmux = <25 IOC_PORT_MCU_PORT_EVENT1>;
        bias-disable;
        drive-strength = <8>; /* in mA, can be 2, 4 or 8 */
      };
    };

  Please be aware that the port event depends on the GPT instance chosen. The
  following port events must be used for PWM:
    - GPT0: IOC_PORT_MCU_PORT_EVENT1
    - GPT1: IOC_PORT_MCU_PORT_EVENT3
    - GPT2: IOC_PORT_MCU_PORT_EVENT5
    - GPT3: IOC_PORT_MCU_PORT_EVENT7

  Be careful not to choose a pin that is already in use on your board, this
  might irreversible damage to your board as the given pin will be configured as
  output and actively driven by the PWM driver.

  Then enable the corresponding timer and PWM nodes and add a reference to the
  pinctrl entry:

    &gpt0 {
      status = "okay";
    };

    &pwm0 {
      status = "okay";
      pinctrl-0 = <&gpt0_pwm>;
      pinctrl-names = "default";
    };

  Now you can programmatically enable the PWM signal in your code:

    static const struct device *pwm = DEVICE_DT_GET(DT_NODELABEL(pwm0));

    int init_pwm(void)
    {
      uint32_t pwm_period_ns, pwm_pulse_ns;
      uint32_t pwm_duty_percent = 50U;
      uint32_t pwm_frequency = 1000U; /* 1kHz */

      if (!device_is_ready(pwm)) {
        LOG_ERR("Error: PWM device %s is not ready\n", pwm->name);
        return -ENODEV;
      }

      pwm_period_ns = NSEC_PER_SEC / pwm_frequency;
      pwm_pulse_ns = (pwm_duty_percent * pwm_period_ns) / 100;

      return pwm_set(pwm, 0, pwm_period_ns, pwm_pulse_ns, 0);
    }

compatible: "ti,cc13xx-cc26xx-timer-pwm"

include: [base.yaml, pwm-controller.yaml, pinctrl-device.yaml]

properties:
  pinctrl-0:
    required: true

pwm-cells:
- period
```

## dts/bindings/pwm/ti,cc23x0-lgpt-pwm.yaml
```yaml
# Copyright (c) 2024 BayLibre, SAS
# SPDX-License-Identifier: Apache-2.0

description: |
  TI CC23x0 LGPT PWM Controller Node

    &lgpt0 {
      status = "okay";
    };

    &pwm0 {
      status = "okay";
      pinctrl-0 = <&pwm0_default>;
      pinctrl-names = "default";
    };

  Note: PWM0-PWM8 are 16bit without prescale, max timeout is 1365100 ns
        PWM9-PWM11 are 24bit without prescale, max timeout is 349519750 ns

compatible: "ti,cc23x0-lgpt-pwm"

include: [base.yaml, pwm-controller.yaml, pinctrl-device.yaml]

properties:
  pinctrl-0:
    required: true

  pinctrl-names:
    required: true

pwm-cells:
  - channel
  - period
  - flags
```

## dts/bindings/pwm/ti,mspm0-pwm.yaml
```yaml
# Copyright 2024 Linumiz
# SPDX-License-Identifier: Apache-2.0

description: |
  TI MSPM0 PWM node for MSPM0 SoCs. Each channel in MSPM0 can be configured
  to use for PWM operation. There are three PWM modes supported by this module.

  mspm0pwm: pwm {
    pwm_0 {
      ti,cc-index = <0>;
      ti,clk-prescaler = <255>;
      ti,clk-div = <1>;

      ti,cc-mode = "PULSE_WIDTH";
      ti,period = <62499>;

    };

    pwm_1 {
      ti,cc-index = <0>;
      ti,clk-prescaler = <255>;
      ti,clk-div = <1>;

      ti,pwm-mode = "EDGE_ALIGN";
      ti,pulse-cycle = <249>;
      ti,period = <1000>;
    };
  };

compatible: "ti,mspm0g1x0x_g3x0x-timer-pwm"

include: [pwm-controller.yaml, base.yaml, pinctrl-device.yaml]

properties:
  pinctrl-0:
    required: true

  pinctrl-names:
    required: true

  ti,advanced:
    type: boolean
    description: |
      Indicate as General Purpose Timer Advance (TIMA).

  ti,cc-index:
    type: int
    required: true
    description: |
      Capture input/Compare output index, should match with the pin function.

  ti,pwm-mode:
    type: string
    description: |
      Select PWM OUT mode:
      - EDGE_ALIGN: generate pulses with edge aligned down counting mode.

      - EDGE_ALIGN_UP:  generate pulses with edge aligned up counting mode.

      - CENTER_ALIGN: generates pulses center aligned up and down counting mode.

    enum:
      - "EDGE_ALIGN"
      - "EDGE_ALIGN_UP"
      - "CENTER_ALIGN"

  ti,cc-mode:
    type: string
    description: |
      Select input capture mode:
      - EDGE_TIME: capture edge time mode.

      - PULSE_WIDTH: capture pulse width and/or period mode.

    enum:
      - "EDGE_TIME"
      - "PULSE_WIDTH"

  ti,pulse-cycle:
    type: int
    description: |
      Duty-cycle in TIMCLK cycle for PWM out at boot time.

  ti,period:
    type: int
    required: true
    description: |
      Time period in TIMCLK cycle for Capture mode or PWM output.

  ti,clk-prescaler:
    type: int
    required: true
    description: |
      TIMCLK clock source prescaler value.
      Valid range [0 ... 255].

  ti,clk-div:
    type: int
    required: true
    description: |
      TIMCLK clock source divider.
```
