## dts/bindings/pwm/fsl,imx7d-pwm.yaml
```yaml
# Copyright (c) 2018, Diego Sueiro <diego.sueiro@gmail.com>
# SPDX-License-Identifier: Apache-2.0

title: i.MX7D PWM

description: |
    This binding gives a base representation of the i.MX7D PWM

compatible: "fsl,imx7d-pwm"

include: [pwm-controller.yaml, base.yaml]

properties:
    reg:
      required: true

    interrupts:
      required: true

    prescaler:
     type: int
     required: true
     description: Set the PWM prescale between 0 and 4096

    rdc:
     type: int
     required: true
     description: Set the RDC permission for this peripheral

    "#pwm-cells":
     const: 2

pwm-cells:
  - channel
# period in terms of nanoseconds
  - period
```

## dts/bindings/pwm/gd,gd32-pwm.yaml
```yaml
# Copyright (c) 2021 Teslabs Engineering S.L.
# SPDX-License-Identifier: Apache-2.0

description: GigaDevice GD32 PWM

compatible: "gd,gd32-pwm"

include: [base.yaml, pwm-controller.yaml, pinctrl-device.yaml]

properties:
  pinctrl-0:
    required: true

  pinctrl-names:
    required: true

  "#pwm-cells":
    const: 3

pwm-cells:
  - channel
  - period
  - flags
```

## dts/bindings/pwm/infineon,cat1-pwm.yaml
```yaml
include: [pwm-controller.yaml, pinctrl-device.yaml, "infineon,system-interrupts.yaml"]


properties:
  reg:
    type: array
    required: true
    description: Register base address and size information


  pinctrl-0:
    description: |
      PORT pin configuration for the PWM signal.
      We expect that the phandles will reference pinctrl nodes. These
      nodes will have a nodelabel that matches the Infineon SoC Pinctrl
      defines and have following
      format: p<port>_<pin>_<peripheral inst>_<signal>.


      Examples:
        pinctrl-0 = <&p1_1_pwm0_0>;
    required: true


  pinctrl-names:
    required: true


  resolution:
    type: int
    required: true
    description: Counter/timer resolution (16 or 32 bits)
    enum:
      - 16
      - 32


  "#pwm-cells":
    const: 3
    description: |
      Number of items to expect in a PWM
      - channel of the timer used for PWM (not used)
      - period to set in ns
      - flags: standard flags like PWM_POLARITY_NORMAL


pwm-cells:
  - channel
  - period
  - flags
```

## dts/bindings/pwm/infineon,tcpwm-pwm.yaml
```yaml
# Copyright (c) 2025 Infineon Technologies AG,
# or an affiliate of Infineon Technologies AG.
#
# SPDX-License-Identifier: Apache-2.0

description: Infineon TCPWM PWM

compatible: "infineon,tcpwm-pwm"

include: [pwm-controller.yaml, pinctrl-device.yaml, "infineon,system-interrupts.yaml"]

properties:
  "#pwm-cells":
    const: 3
    description: |
      Number of items to expect in a PWM
      - channel of the timer used for PWM (not used)
      - period to set in ns
      - flags: standard flags like PWM_POLARITY_NORMAL

  pinctrl-0:
    description: |
      PORT pin configuration for the PWM signal.
      We expect that the phandles will reference pinctrl nodes. These
      nodes will have a nodelabel that matches the Infineon SoC Pinctrl
      defines and have following
      format: p<port>_<pin>_<peripheral inst>_<signal>.

      Examples:
        pinctrl-0 = <&p1_1_pwm0_0>;
    required: true

  pinctrl-names:
    required: true

pwm-cells:
  - channel
  - period
  - flags
```

## dts/bindings/pwm/infineon,xmc4xxx-ccu4-pwm.yaml
```yaml
# Copyright (c) 2023 SLB
# SPDX-License-Identifier: Apache-2.0

description: |
  Infineon XMC4XXX PWM Capture Compare Unit 4 (CCU4) module

  The are four CCU4 modules with dts node labels:
  pwm_ccu40, pwm_ccu41, pwm_ccu42, pwm_ccu43.
  Each module has four slices and each slice has one channel.
  A channel is connected to a particular gpio pin, which are defined
  using pinctrl in:
  dts/arm/infineon/xmc4xxx_xxx-pinctrl.dtsi

  The CCU4 modules uses the CCU clock source. Each slice applies a separate
  prescalar which divides the clock.

  Device tree example:
  A node can define a 'pwm' field, usually referenced in a 'pwms'
  property, where the entries include the PWM module phandle,
  channel number, pulse period (in nanoseconds or set using
  PWM_XX() macros), and a channela
  flag (PWM_POLARITY_NORMAL/PWM_POLARITY_INVERTED).

  The pwm ccu4 node must define the slice-prescaler values and the pinctrl nodes:
  &pwm_ccu40 {
      slice-prescaler = <15 15 15 15>;
      pinctrl-0 = <&pwm_out_p1_1_ccu40_ch2>;
      pinctrl-names = "default";
  };

  Another node can reference the PWM as follows:
  &test_node {
     ...
     pwms = <&pwm_ccu40 0 PWM_SEC(1) PWM_POLARITY_NORMAL>;
     ...
  };

  The user must also explicitly set pinctrl properties.
  The pin should be configured with drive-push-pull bool option and hwctrl should be set
  to disabled. The drive-strength field can be set to any of the supported values:
  &pwm_out_p1_1_ccu40_ch2 {
      drive-strength = "strong-medium-edge";
      drive-push-pull;
      hwctrl = "disabled";
  };

  The CCU4 pinctrl nodes have a node labels in the format
  pwm_out_p{PORT}_{PIN}_ccu4{MODULE_IDX}_ch{CHANNEL_IDX}, where MODULE_IDX and
  CHANNEL_IDX refers to specific pwm_ccu4x module and channel, respectively.
  PORT/PIN pair defines what gpio the channel connects to.

compatible: "infineon,xmc4xxx-ccu4-pwm"

include:
  - name: base.yaml
  - name: pwm-controller.yaml
  - name: pinctrl-device.yaml

properties:
  reg:
    required: true

  pinctrl-0:
    required: true

  pinctrl-names:
    required: true

  slice-prescaler:
    type: array
    required: true
    description: |
      Defines the clock divider for each channel.
      The entry in the array will divide CCU clock by (2 << value).
      The range for the prescaler values is [0, 15].
      Reducing prescaler value will improve resolution but decrease the maximum period.

  "#pwm-cells":
    const: 3

pwm-cells:
  - channel
  - period
  - flags
```

## dts/bindings/pwm/infineon,xmc4xxx-ccu8-pwm.yaml
```yaml
# Copyright (c) 2023 SLB
# SPDX-License-Identifier: Apache-2.0

description: |
  Infineon XMC4XXX PWM Capture Compare Unit 8 (CCU8) module

  The PWM CCU8 module can automatically generate a high-side
  and a low-side PWM signal, where the two signals are complementary
  to each other.

  The module supports adding a dead time between the high-side and
  low-side PWM signals.

  The dead time ensures that there is a delay before the PWM state
  transitions from 0 to 1, preventing the high-side and low-side
  switches from being on simultaneously.

  There are two CCU8 modules with DTS node labels: pwm_ccu80 and
  pwm_ccu81. Each module has four slices, and each slice has
  two channels. A channel consists of a corresponding high-side
  and low-side PWM signal.

  The CCU8 modules use the CCU clock source. Each slice applies
  a separate prescaler to divide the clock. The clock divider is
  defined by the 'slice-prescaler' property. Additionally, each
  slice has a dead time prescaler, which divides the slice clock
  for the dead time counter.

  Device tree example:
  A node can define a 'pwm' field, usually referenced in a 'pwms'
  property, where the entries include the PWM module phandle,
  channel number, pulse period (in nanoseconds or set using
  PWM_XX() macros), and a channel
  flag (PWM_POLARITY_NORMAL/PWM_POLARITY_INVERTED).

  The 'pwm_ccu8' node must define the following fields:
  &pwm_ccu80 {
          slice-prescaler = <15 15 15 15>;
          slice-deadtime-prescaler = <3 3 3 3>;
          channel-deadtime-high = <0 0 0 0 PWM_MSEC(100) 0 0 0>;
          channel-deadtime-low = <0 0 0 0 PWM_MSEC(100) 0 0 0>;
          pinctrl-0 = <&pwm_out_p5_9_ccu80_ch4_high &pwm_out_p0_0_ccu80_ch4_low>;
          pinctrl-names = "default";
  };

  This will configure channel 4 with a 100msec deadtime on the high
  and low side PWM signals.

  Another node can reference the PWM as follows:
  &test_node {
     ...
     pwms = <&pwm_ccu80 0 PWM_SEC(1) PWM_POLARITY_NORMAL>;
     ...
  };

  The 'pwm_out_p{PORT}_{PIN}_ccu8{MODULE_IDX}_ch{CHANNEL_IDX}_{HIGH_LOW}'
  format is used for CCU8 pinctrl nodes. 'MODULE_IDX' and 'CHANNEL_IDX'
  refer to a specific 'pwm_ccu8x' module and channel, respectively.
  'PORT/PIN' defines the GPIO that the channel connects to.
  'HIGH_LOW' indicates whether the pin is for the high or low-side signal.

  It's not necessary to specify both the high and low pinctrls. Only the low-side
  signal can, for example, be used as PWM, but note that the duty cycle of the
  low signal will be (1 - duty) as set via the API.

  Note that a slice has two channels. Channels 0/1 are in slice 0,
  channels 2/3 are in slice 1, and so on. Each channel can have its own
  duty cycle and high/low dead times. But the pulse duration applies to
  both channels. Thus, when using the PWM control api to modify the pulse width
  on a channel 0, it will also be updated for channel 1 since they are
  in the same slice.

compatible: "infineon,xmc4xxx-ccu8-pwm"

include:
  - name: base.yaml
  - name: pwm-controller.yaml
  - name: pinctrl-device.yaml

properties:
  reg:
    required: true

  pinctrl-0:
    required: true

  pinctrl-names:
    required: true

  slice-prescaler:
    type: array
    required: true
    description: |
      Defines the clock divider for each slice.
      The entry in the array will divide CCU clock by (2 << value).
      The range for the prescaler values is [0, 15].
      Reducing prescaler value will improve resolution but decrease the maximum period.

  slice-deadtime-prescaler:
    type: array
    required: true
    description: |
      Defines the clock divider for dead time counter for each slice.
      The range for the values is [0, 3].
      Reducing prescaler value will improve dead time resolution but decrease the
      maximum dead time.

  channel-deadtime-high:
    type: array
    required: true
    description: |
      Defines the dead time in nanoseconds for the high-side PWM signal for each channel.

  channel-deadtime-low:
    type: array
    required: true
    description: |
      Defines the dead time in nanoseconds for the low-side PWM signal for each channel.

  "#pwm-cells":
    const: 3

pwm-cells:
  - channel
  - period
  - flags
```

## dts/bindings/pwm/intel,blinky-pwm.yaml
```yaml
# Copyright (c) 2023 Intel Corporation
#
# SPDX-License-Identifier: Apache-2.0

description: Intel blinky PWM

compatible: "intel,blinky-pwm"

include: [pwm-controller.yaml, base.yaml]

properties:
  reg:
    required: true

  reg-offset:
    type: int
    required: true
    description: PWM control register offset from base

  clock-frequency:
    type: int
    required: true
    description: PWM Peripheral Clock frequency in Hz

  max-pins:
    type: int
    required: true
    description: Maximum number of pins supported by platform

  reg-upper32:
    type: int
    default: 0
    description: |
      Few platforms have 64 bit PWM register address,
      this property will be used to share the higher
      32 bits(63-32).

  "#pwm-cells":
    const: 2

pwm-cells:
  - channel
  - period
```

## dts/bindings/pwm/ite,it51xxx-pwmprs.yaml
```yaml
# Copyright (c) 2025 ITE Corporation. All Rights Reserved.
# SPDX-License-Identifier: Apache-2.0

description: ITE, it51xxx PWM prescaler node

compatible: "ite,it51xxx-pwmprs"

include: base.yaml

properties:
  reg:
    required: true
```

## dts/bindings/pwm/ite,it8801-pwm.yaml
```yaml
# Copyright (c) 2024 ITE Corporation. All Rights Reserved.
# SPDX-License-Identifier: Apache-2.0

description: ITE IT8801 I2C-based PWM device driver

compatible: "ite,it8801-pwm"

include: [base.yaml, pinctrl-device.yaml, pwm-controller.yaml]

properties:
  reg:
    required: true

  mfdctrl:
    type: phandle
    required: true
    description: |
      Switching the pin to PWM alternate function.

  channel:
    type: int
    required: true
    enum:
      - 1
      - 2
      - 3
      - 4
      - 7
      - 8
      - 9
    description: |
      1 = PWM_CHANNEL_1, 2 = PWM_CHANNEL_2, 3 = PWM_CHANNEL_3,
      4 = PWM_CHANNEL_4, 7 = PWM_CHANNEL_7, 8 = PWM_CHANNEL_8,
      9 = PWM_CHANNEL_9

pwm-cells:
  - channel
  - period
  - flags
```

## dts/bindings/pwm/ite,it8xxx2-pwm.yaml
```yaml
# Copyright (c) 2021 ITE Corporation. All Rights Reserved.
# SPDX-License-Identifier: Apache-2.0

description: ITE, it8xxx2 Pulse Width Modulator (PWM) node

compatible: "ite,it8xxx2-pwm"

include: [pwm-controller.yaml, base.yaml, pinctrl-device.yaml]

properties:
    reg:
      required: true

    label:
      required: true

    interrupts:
      required: false

    channel:
      type: int
      required: true
      enum:
            - 0
            - 1
            - 2
            - 3
            - 4
            - 5
            - 6
            - 7
      description: |
        0 = PWM_CHANNEL_0, 1 = PWM_CHANNEL_1, 2 = PWM_CHANNEL_2,
        3 = PWM_CHANNEL_3, 4 = PWM_CHANNEL_4, 5 = PWM_CHANNEL_5,
        6 = PWM_CHANNEL_6, 7 = PWM_CHANNEL_7

    pwmctrl:
        type: phandle
        required: true
        description: PWM prescaler controller

    prescaler-cx:
      type: int
      required: true
      enum:
            - 1
            - 2
            - 3
      description: 1 = PWM_PRESCALER_C4, 2 = PWM_PRESCALER_C6, 3 = PWM_PRESCALER_C7

    pwm-output-frequency:
      type: int
      required: false
      description: PWM output frequency for operation

    pinctrl-0:
      required: true

    pinctrl-names:
      required: true

pwm-cells:
  - channel
  - period
  - flags
```

## dts/bindings/pwm/ite,it8xxx2-pwmprs.yaml
```yaml
# Copyright (c) 2021 ITE Corporation. All Rights Reserved.
# SPDX-License-Identifier: Apache-2.0

description: ITE, it8xxx2 PWM prescaler node

compatible: "ite,it8xxx2-pwmprs"

include: base.yaml

properties:
    reg:
      required: true

    label:
      required: true

    interrupts:
      required: false
```

## dts/bindings/pwm/litex,pwm.yaml
```yaml
#
# Copyright (c) 2019 Antmicro <www.antmicro.com>
#
# SPDX-License-Identifier: Apache-2.0
#

description: LiteX PWM controller

include: [pwm-controller.yaml, base.yaml]

compatible: "litex,pwm"

properties:
  reg:
    required: true

  "#pwm-cells":
    const: 2

pwm-cells:
  - channel
  - period
```

## dts/bindings/pwm/maxim,max31790-pwm.yaml
```yaml
# Copyright (c) 2023 SILA Embedded Solutions GmbH
# SPDX-License-Identifier: Apache-2.0

description: Maxim MAX31790 6-channel I2C-bus PWM controller

compatible: "maxim,max31790-pwm"

include: [pwm-controller.yaml, base.yaml]

on-bus: max31790

properties:
  "#pwm-cells":
    const: 2

pwm-cells:
  - channel
  - period
```
