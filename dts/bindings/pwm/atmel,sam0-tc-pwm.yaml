## dts/bindings/pwm/atmel,sam0-tc-pwm.yaml
```yaml
# Copyright (c) 2020 Google LLC.
# SPDX-License-Identifier: Apache-2.0

description: Atmel SAM0 TC in PWM mode

compatible: "atmel,sam0-tc-pwm"

include:
  - name: base.yaml
  - name: pwm-controller.yaml
  - name: pinctrl-device.yaml

properties:
  reg:
    required: true

  interrupts:
    required: true

  clocks:
    required: true

  clock-names:
    required: true

  channels:
    type: int
    required: true
    description: Number of channels this TC has
    enum:
      - 2

  counter-size:
    type: int
    required: true
    description: Width of the TC counter in bits
    enum:
      - 8
      - 16

  prescaler:
    type: int
    required: true
    description: PWM prescaler
    enum:
      - 1
      - 2
      - 4
      - 8
      - 16
      - 64
      - 256
      - 1024

  "#pwm-cells":
    const: 2

pwm-cells:
  - channel
  - period
```

## dts/bindings/pwm/atmel,sam0-tcc-pwm.yaml
```yaml
# Copyright (c) 2020 Google LLC.
# SPDX-License-Identifier: Apache-2.0

description: Atmel SAM0 TCC in PWM mode

compatible: "atmel,sam0-tcc-pwm"

include:
    - name: base.yaml
    - name: pwm-controller.yaml
    - name: pinctrl-device.yaml

properties:
  reg:
    required: true

  interrupts:
    required: true

  clocks:
    required: true

  clock-names:
    required: true

  label:
    required: true

  channels:
    type: int
    required: true
    description: Number of channels this TCC has
    enum:
      - 2
      - 3
      - 4
      - 6

  counter-size:
    type: int
    required: true
    description: Width of the TCC counter in bits
    enum:
      - 16
      - 24

  prescaler:
    type: int
    required: true
    description: PWM prescaler
    enum:
      - 1
      - 2
      - 4
      - 8
      - 16
      - 64
      - 256
      - 1024

  "#pwm-cells":
    const: 2

pwm-cells:
  - channel
  - period
```

## dts/bindings/pwm/atmosic,atm-pwm.yaml
```yaml
# Copyright (c) 2021-2024, Atmosic
# SPDX-License-Identifier: Apache-2.0

description: Shared Atmosic PWM

compatible: "atmosic,atm3x-pwm"

include: [pwm-controller.yaml, base.yaml]

properties:
    reg:
      required: true

    pin:
      type: int
      required: false
      description: PWM pin to use

    channel:
      type: int
      required: true
      description: PWM channel

    "#pwm-cells":
      const: 3

    max-frequency:
      type: int
      required: true
      description: Max PWM frequency

    min-frequency:
      type: int
      required: true
      description: Min PWM frequency

pwm-cells:
  - channel
  - period
  - flags
```

## dts/bindings/pwm/atmosic,atmx2-pwm.yaml
```yaml
# Copyright (c) 2024, Atmosic
# SPDX-License-Identifier: Apache-2.0

description: ATMx2 PWM

compatible: "atmosic,atmx2-pwm"

include: ["atmosic,atm-pwm.yaml"]

properties:

    max-duty-cycle:
      type: int
      required: true
      description: Max Duty Cycle

    min-duty-cycle:
      type: int
      required: true
      description: Min Duty Cycle
```

## dts/bindings/pwm/bflb,pwm-1.yaml
```yaml
# Copyright (c) 2025 MASSDRIVER EI (massdriver.space)
# SPDX-License-Identifier: Apache-2.0

description: |
  Bouffalolab PWM 1

compatible: "bflb,pwm-1"

include: [pwm-controller.yaml, pinctrl-device.yaml, base.yaml]

properties:
  reg:
    required: true

  "#pwm-cells":
    const: 3

pwm-cells:
  - channel
  - period
  - flags
```

## dts/bindings/pwm/bflb,pwm-2.yaml
```yaml
# Copyright (c) 2025 MASSDRIVER EI (massdriver.space)
# SPDX-License-Identifier: Apache-2.0

description: |
  Bouffalolab PWM 2.
  The period is common to all channels on this PWM!

compatible: "bflb,pwm-2"

include: [pwm-controller.yaml, pinctrl-device.yaml, base.yaml]

properties:
  reg:
    required: true

  "#pwm-cells":
    const: 3

pwm-cells:
  - channel
  - period
  - flags
```

## dts/bindings/pwm/elan,em32-pwm.yaml
```yaml
# Copyright (c) 2024 ELAN Microelectronics Corp.
# SPDX-License-Identifier: Apache-2.0

description: |
  ELAN EM32F967 PWM Controller

  The EM32F967 features a dedicated 6-channel PWM controller with:
  - 6 independent PWM channels (PWMA through PWMF)
  - Complementary outputs (P and N) for each channel
  - Programmable dead-time insertion with 4-level prescaler
  - Flexible pin multiplexing (PA0-5 or PB10-15)

  Pin Assignments:
  - Port A (use-port-a = true, PWM_S=0):
    PA0: PWMA_P, PA1: PWMA_N
    PA2: PWMB_P, PA3: PWMB_N
    PA4: PWMC_P, PA5: PWMC_N

  - Port B (use-port-a = false, PWM_S=1):
    PB10: PWMA_P, PB11: PWMA_N
    PB12: PWMB_P, PB13: PWMB_N
    PB14: PWMC_P, PB15: PWMC_N

  Output Type:
  - 0 (PWM_EM32_OUTPUT_P): P output only
  - 1 (PWM_EM32_OUTPUT_N): N output only
  - 2 (PWM_EM32_OUTPUT_BOTH): Both P and N outputs

  Example usage for PWMB_N on PA3:

    &pwm0 {
        status = "okay";
        use-port-a;
        output-type = <1>;  /* N output only */
        pinctrl-0 = <&pwmb_pa3_n>;
        pinctrl-names = "default";
    };

compatible: "elan,em32-pwm"

include:
  - name: base.yaml
  - name: pinctrl-device.yaml

properties:
  reg:
    type: array
    required: true

  clocks:
    type: phandle-array
    required: true

  interrupts:
    type: array
    description: |
      Interrupt lines for each PWM channel.
      Order: PWMA, PWMB, PWMC, PWMD, PWME, PWMF

  interrupt-names:
    type: string-array
    description: |
      Names for the interrupt lines.
      Should be: "pwma", "pwmb", "pwmc", "pwmd", "pwme", "pwmf"

  "#pwm-cells":
    type: int
    const: 3
    description: |
      Number of cells in a PWM specifier:
      - channel: PWM channel number (0-5 for PWMA-PWMF)
      - period: PWM period in nanoseconds
      - flags: PWM flags (e.g., PWM_POLARITY_INVERTED)

  use-port-a:
    type: boolean
    description: |
      Use Port A pins (PA0-PA5) for PWM output instead of Port B (PB10-PB15).
      When true, sets IP_Share[18] (PWM_S) = 0 for PA pins.
      When false or not specified, sets PWM_S = 1 for PB pins.

  output-type:
    type: int
    default: 0
    description: |
      PWM output type selection:
      0 = P output only (default)
      1 = N output only (complementary output, e.g., for PA3 PWMB_N)
      2 = Both P and N outputs (complementary pair with dead-time)

pwm-cells:
  - channel
  - period
  - flags
```

## dts/bindings/pwm/ene,kb106x-pwm.yaml
```yaml
# Copyright (c) 2025 ENE Technology Inc.
# SPDX-License-Identifier: Apache-2.0

description: ENE, Pulse Width Modulator (PWM) node

compatible: "ene,kb106x-pwm"

include: [pwm-controller.yaml, base.yaml, pinctrl-device.yaml]

properties:
  reg:
    required: true
  pwm-channel:
    type: int
    description: |
        A index to indicate PWM module that generates a single PWM signal.
        Please don't overwrite it in the board-level DT driver.
  pinctrl-0:
    required: true

  pinctrl-names:
    required: true

pwm-cells:
  - channel
  - period
  - flags
```

## dts/bindings/pwm/ene,kb1200-pwm.yaml
```yaml
# Copyright (c) 2024 ENE Technology Inc.
# SPDX-License-Identifier: Apache-2.0

description: ENE, Pulse Width Modulator (PWM) node

compatible: "ene,kb1200-pwm"

include: [pwm-controller.yaml, base.yaml, pinctrl-device.yaml]

properties:
  reg:
    required: true

  pinctrl-0:
    required: true

  pinctrl-names:
    required: true

pwm-cells:
  - channel
  - period
  - flags
```

## dts/bindings/pwm/espressif,esp32-ledc.yaml
```yaml
# Copyright (c) 2025 Espressif Systems (Shanghai) Co., Ltd.
# SPDX-License-Identifier: Apache-2.0

description: |

  Espressif's LEDC controller Node

  The LEDC controller is primarily designed to control the intensity of LEDs, although it can be
  used to generate PWM signals for other purposes as well.

  The mapping between the channel and GPIO is done through pinctrl

    &ledc0 {
      pinctrl-0 = <&ledc0_default>;
      pinctrl-names = "default";
    }

  The 'ledc0_default' node state is defined in <board>-pinctrl.dtsi.

    ledc0_default: ledc0_default {
            group1 {
                    pinmux = <LEDC_CH0_GPIO0>,
                             <LEDC_CH1_GPIO2>,
                             <LEDC_CH2_GPIO4>;
                    output-enable;
            };
    };

  If another GPIO mapping is desired, check if <board>-pinctrl.dtsi already have it defined,
  otherwise, define the required mapping at your own application folder into a custom
  <board>.overlay file.
  The 'pinmux' property uses a macro defined in
  https://github.com/zephyrproject-rtos/hal_espressif/tree/zephyr/include/dt-bindings/pinctrl
  Before including a new node, check if the desired mapping is available according to the SoC.

  As an example, the 'ledc0_custom' state below illustrates an alternate mapping using another set
  of channels and pins in a custom overlay file.

    &pinctrl {

            ledc0_custom:  ledc0_custom {
                    group1 {
                            pinmux = <LEDC_CH0_GPIO0>,
                                     <LEDC_CH9_GPIO2>,
                                     <LEDC_CH10_GPIO4>;
                            output-enable;
                    };
             };

    };

  Use the child bindings to configure the desired channel:

    &ledc0 {
      pinctrl-0 = <&ledc0_custom>;
      pinctrl-names = "default";
      status = "okay";
      #address-cells = <1>;
      #size-cells = <0>;
      channel0@0 {
        reg = <0x0>;
        timer = <0>;
      };
      channel9@9 {
        reg = <0x9>;
        timer = <0>;
        inverted;
      };
      channel10@a {
        reg = <0xa>;
        timer = <1>;
      };
    };

    For the channel to be initially inverted after the driver's init, the flag 'inverted' can
    be declared, as shown above for channel 9.

    Note: The channel's 'reg' property defines the ID of the channel. It must match the channel used
      in the 'pinmux'.


compatible: "espressif,esp32-ledc"

include: [pwm-controller.yaml, pinctrl-device.yaml, base.yaml]

properties:
  "#pwm-cells":
    const: 3

child-binding:
  description: Channel configuration.

  properties:
    reg:
      type: int
      required: true
      enum:
      - 0
      - 1
      - 2
      - 3
      - 4
      - 5
      - 6
      - 7
      - 8
      - 9
      - 10
      - 11
      - 12
      - 13
      - 14
      - 15

      description: |
        The ESP32 has 8 low speed channel and 8 high speed channels.
        The low speed channel are mapped from channel 0 to 7, and the high speed are mapped from
        channel 8 to 15.

        High speed channels are only available in the ESP32 SoC. ESP32S2 and ESP32S3 have 8
        available channels, and ESP32C3 has 6. In these SoCs there is no differentiation between
        low or high speed.

    timer:
      type: int
      required: true
      enum:
      - 0
      - 1
      - 2
      - 3
      description: |
        Timer selection.
        For maximum flexibility, the high-speed as well as the low-speed channels can be driven from
        one of four high-speed/low-speed timers.

    inverted:
      type: boolean
      description: |
        Initial channel output level.
        This flag defines if the channel will remain initially inverted after driver init,
        as any pwm_set() operation will re-evaluate if the output is inverted or not
        according to the flag passed as parameter.

pwm-cells:
- channel
- period
- flags
```

## dts/bindings/pwm/espressif,esp32-mcpwm.yaml
```yaml
# Copyright (c) 2022 Espressif Systems (Shanghai) Co., Ltd.
# SPDX-License-Identifier: Apache-2.0

description: |

  Espressif's Motor Control Pulse Width Modulator (MCPWM) controller Node

  The MCPWM peripheral is intended for motor and power control.
  It provides six PWM outputs that can be set up to operate in several topologies

  ESP32 contains two MCPWM peripherals: MCPWM0 and MCPWM1

  Each MCPWM peripheral has one clock divider (prescaler), three PWM timers, three PWM operators,
  and a capture module.

  Every PWM operator has two PWM outputs: PWMxA and PWMxB. They can work independently, in symmetric
  and asymmetric configuration. MCPWMxA and MCPWMxB will share the same timer, thus having the same
  operating frequency.

  The driver currently always use the timer x for operator x. Timer 0 will use operator 0 for
  PWM0A/B.
  Timer 1 will use operator 1 for PWM1A/B, and so on.

  Mapping channel ID:
  Channel 0 -> Timer 0, Operator 0, output PWM0A
  Channel 1 -> Timer 0, Operator 0, output PWM0B
  Channel 2 -> Timer 1, Operator 1, output PWM1A
  Channel 3 -> Timer 1, Operator 1, output PWM1B
  Channel 4 -> Timer 2, Operator 2, output PWM2A
  Channel 5 -> Timer 2, Operator 2, output PWM2B
  Channel 6 -> Capture 0
  Channel 7 -> Capture 1
  Channel 8 -> Capture 2

  Example: Use PWM0A output and capture 0:

  pwm_loopback_0 {
    compatible = "test-pwm-loopback";
    pwms = <&mcpwm0 0 0 PWM_POLARITY_NORMAL>, #Channel 0 -> Output PWM0A
           <&mcpwm0 6 0 PWM_POLARITY_NORMAL>; #Channel 6 -> Capture 0;
  };

  The mapping between the output PWMxA/B or CaptureX and GPIO is done through pinctrl:

    &mcpwm0 {
      pinctrl-0 = <&mcpwm0_default>;
      pinctrl-names = "default";
    }

  The 'mcpwm0_default' node is defined inside the pinctrl node.

    &pinctrl {
      mcpwm0_default: mcpwm0_default {
        group1 {
          pinmux = <MCPWM0_OUT0A_GPIO0>,
            <MCPWM0_OUT0B_GPIO2>,
            <MCPWM0_OUT1A_GPIO4>;
          output-enable;
        };
        group2 {
          pinmux = <MCPWM0_CAP0_GPIO5>;
        };
      };
    };

  Note: Check espressif,esp32-pinctrl.yaml for complete documentation regarding pinctrl.

  Use the prescale-timerX property to configure the timers:

    &mcpwm0 {
      pinctrl-0 = <&mcpwm0_default>;
      pinctrl-names = "default";
      prescale = <255>;
      prescale-timer0 = <103>;
      prescale-timer1 = <0>;
      prescale-timer2 = <255>;
      status = "okay";
    };

compatible: "espressif,esp32-mcpwm"

include: [pwm-controller.yaml, pinctrl-device.yaml, base.yaml]

properties:
  prescale:
    type: int
    required: true
    description: |
      8 bit timer prescale for the global clock.
      Period of PWM_clk = 6.25ns * (PWM_CLK_PRESCALE + 1).

  "#pwm-cells":
    const: 3

  prescale-timer0:
    type: int
    description: |
      8 bit timer prescale for timer 0.
      Period of PT0_clk = Period of PWM_clk * (PWM_TIMER0_PRESCALE + 1).

  prescale-timer1:
    type: int
    description: |
      8 bit timer prescale for timer 1.
      Period of PT1_clk = Period of PWM_clk * (PWM_TIMER1_PRESCALE + 1).

  prescale-timer2:
    type: int
    description: |
      8 bit timer prescale for timer 2.
      Period of PT2_clk = Period of PWM_clk * (PWM_TIMER2_PRESCALE + 1).

pwm-cells:
  - channel
  - period
  - flags
```

## dts/bindings/pwm/fsl,imx27-pwm.yaml
```yaml
# Copyright (c) 2018, Diego Sueiro <diego.sueiro@gmail.com>
# SPDX-License-Identifier: Apache-2.0

description: |
    This driver supports both i.MX6SX and i.MX7D PWM.
    The compatible string is named "imx27" because the hardware module is the
    same module present starting from imx27 CPUs and this driver can potentially
    support other CPUs with imx27 module. This is also the same string used
    in the Linux kernel.

compatible: "fsl,imx27-pwm"

include: [pwm-controller.yaml, pinctrl-device.yaml, base.yaml]

properties:
    reg:
      required: true

    interrupts:
      required: true

    prescaler:
     type: int
     required: true
     description: Set the PWM prescale between 0 and 4096

    rdc:
     type: int
     required: true
     description: Set the RDC permission for this peripheral

    "#pwm-cells":
     const: 2

pwm-cells:
  - channel
# period in terms of nanoseconds
  - period
```
