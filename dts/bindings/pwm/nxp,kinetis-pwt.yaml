## dts/bindings/pwm/nxp,kinetis-pwt.yaml
```yaml
# Copyright (c) 2021 Vestas Wind Systems A/S
# SPDX-License-Identifier: Apache-2.0

description: Kinetis PWT PWM Capture

compatible: "nxp,kinetis-pwt"

include: [pwm-controller.yaml, base.yaml, pinctrl-device.yaml]

properties:
    reg:
      required: true

    interrupts:
      required: true

    prescaler:
      type: int
      required: true
      enum:
        - 1
        - 2
        - 4
        - 8
        - 16
        - 32
        - 64
        - 128
      description: Input clock prescaler

    "#pwm-cells":
      const: 3

pwm-cells:
  - channel
# period in terms of nanoseconds
  - period
  - flags
```

## dts/bindings/pwm/nxp,kinetis-tpm.yaml
```yaml
# Copyright (c) 2019 Henrik Brix Andersen <henrik@brixandersen.dk>
# SPDX-License-Identifier: Apache-2.0

description: MCUX Timer/PWM Module (TPM)

compatible: "nxp,kinetis-tpm"

include: [pwm-controller.yaml, base.yaml, pinctrl-device.yaml]

properties:
  reg:
    required: true

  interrupts:
    required: true

  pinctrl-0:
    required: true

  prescaler:
    type: int
    required: true
    enum:
      - 1
      - 2
      - 4
      - 8
      - 16
      - 32
      - 64
      - 128
    description: Input clock prescaler

  pwm-mode:
    type: int
    enum:
      - 0
      - 1
    description: |
      TPM PWM operation mode
        0 - Edge aligned PWM (kTPM_EdgeAlignedPwm)
        1 - Center aligned PWM (kTPM_CenterAlignedPwm)
      Default is edge aligned PWM if not specified.

  "#pwm-cells":
    const: 3

pwm-cells:
  - channel
  # period in terms of nanoseconds
  - period
  - flags
```

## dts/bindings/pwm/nxp,pca9685.yaml
```yaml
# Copyright (c) 2022, Nick Ward <nix.ward@gmail.com>
# SPDX-License-Identifier: Apache-2.0

description: NXP PCA9685 16-channel, 12-bit PWM Fm+ I2C-bus LED controller

compatible: "nxp,pca9685-pwm"

include: [pwm-controller.yaml, i2c-device.yaml, base.yaml]

properties:
  reg:
    required: true

  open-drain:
    type: boolean
    description:
      The 16 LEDn outputs are configured with an open-drain structure.
      Otherwise they are configured with a totem pole structure.

  och-on-ack:
    type: boolean
    description:
      Outputs change on ACK.  Otherwise the outputs change on STOP
      command.

  invert:
    type: boolean
    description:
      Output logic state inverted. Value to use when no external driver
      used.

  "#pwm-cells":
    const: 2

pwm-cells:
  - channel
  - period
```

## dts/bindings/pwm/nxp,qtmr-pwm.yaml
```yaml
# Copyright (c) 2024, NXP
# SPDX-License-Identifier: Apache-2.0

description: NXP QTMR PWM

compatible: "nxp,qtmr-pwm"

include: [pwm-controller.yaml, pinctrl-device.yaml, base.yaml]

properties:
  prescaler:
    type: int
    required: true
    description: prescale factor from the qtmr clock.
    enum: [1, 2, 4, 8, 16, 32, 64, 128]

  "#pwm-cells":
    const: 3

pwm-cells:
  - channel
  - period
  - flags
```

## dts/bindings/pwm/nxp,s32-emios-pwm.yaml
```yaml
# Copyright 2023 NXP
# SPDX-License-Identifier: Apache-2.0

description: |
  NXP S32 eMIOS PWM node for S32 SoCs. Each channel in eMIOS can be configured
  to use for PWM operation. There are several PWM modes supported by this module,
  some modes only support on channels that have internal counter, some modes
  require to use a reference timebase from a master bus.

  For example to configuring eMIOS instance 0 with:
    - Channel 0 for mode OPWFMB
    - Channel 1 for mode OPWMB
    - Channel 2 for mode OPWMCB with deadtime inserted at leading edge
    - Channel 3 for mode SAIC, use internal timebase with input filter = 2 eMIOS clock

    emios0_pwm: pwm {
      pwm_0 {
        channel = <0>;
        pwm-mode = "OPWFMB";
        prescaler = <8>;
        period = <65534>;
        duty-cycle = <32768>;
        polarity = "ACTIVE_HIGH";
      };

      pwm_1 {
        channel = <1>;
        master-bus = <&emios1_bus_a>;
        pwm-mode = "OPWMB";
        duty-cycle = <32768>;
        phase-shift = <100>;
        polarity = "ACTIVE_LOW";
      };

      pwm_2 {
        channel = <2>;
        master-bus = <&emios1_bus_b>;
        pwm-mode = "OPWMCB_LEAD_EDGE";
        duty-cycle = <32768>;
        dead-time = <100>;
        polarity = "ACTIVE_LOW";
      };

      pwm_3 {
        channel = <3>;
        pwm-mode = "SAIC";
        prescaler = <8>;
        input-filter = <2>;
      };
    };

  OPWMB and OPWMCB modes use reference timebase, the master bus is chosen over
  phandle 'master-bus'. For OPWMB mode, PWM's period is master bus's period and
  is 2 * master bus's period - 2 for OPWMCB mode. Please notice that the devicetree
  node for master bus should be enabled and configured for using, please see
  'nxp,s32-emios' bindings.

compatible: "nxp,s32-emios-pwm"

include: [pwm-controller.yaml, base.yaml, pinctrl-device.yaml]

properties:
  pinctrl-0:
    required: true

  pinctrl-names:
    required: true

  "#pwm-cells":
    const: 3

pwm-cells:
  - channel
  # Period in terms of nanoseconds
  - period
  - flags

child-binding:
  description: |
    eMIOS PWM channel configuration.

  properties:
    channel:
      type: int
      required: true
      description: eMIOS PWM channel

    master-bus:
      type: phandle
      description: |
        A phandle to master-bus node that will be used as external timebase
        for current channel, this can be bypassed if internal counter is used
        for PWM operation. A master bus must be used exclusively, such as if
        is used as a timebase for a channel in SAIC mode, do not use that
        master bus as a timebase for generate PWM pulse.

    pwm-mode:
      type: string
      required: true
      description: |
        Select PWM mode:
        - OPWFMB: provides waveforms with variable duty cycle and frequency,
                  this mode uses internal counter.

        - OPWMB:  generate pulses with programmable leading and trailing
                  edge placement. The period is determined by period of
                  an external counter driven in MCB Up Mode. Changing PWM period
                  at runtime will impact to all channels share the same timebase.
                  The new period and cycle take effect in next period boundary.

        - OPWMCB: generates a center aligned PWM with dead time insertion to the
                  leading or trailing edge. The period is determined by period of
                  an external counter driven in MCB Up Down Mode. Changing PWM period
                  at runtime will impact to all channels share the same timebase,
                  The new period and cycle take effect in next period boundary.

        - SAIC: single action input capture mode, the eMIOS captures events as soon as
                they occur. The value of latest captured event is stored and can be read
                by software.
      enum:
        - "OPWFMB"
        - "OPWMB"
        - "OPWMCB_TRAIL_EDGE"
        - "OPWMCB_LEAD_EDGE"
        - "SAIC"

    polarity:
      type: string
      description: |
        Output polarity for PWM channel.
      enum:
        - "ACTIVE_LOW"
        - "ACTIVE_HIGH"

    duty-cycle:
      type: int
      description: |
        Duty-cycle (in ticks) for PWM channel at boot time.

    period:
      type: int
      description: |
        Period (in ticks) for OPWFMB at boot time. Period for the rest
        of PWM mode depends on period's master bus. Must be in range [2 ... 65535].

    freeze:
      type: boolean
      description: Freeze individual internal counter when the chip enters Debug mode.

    prescaler-src:
      type: string
      default: "PRESCALED_CLOCK"
      description: |
        Select clock source for internal counter prescaler.
      enum:
        - "PRESCALED_CLOCK" # Clock source = eMIOS clock / (global prescaler)
        - "MODULE_CLOCK"    # Clock source = eMIOS clock

    prescaler:
      type: int
      description: |
        The clock divider for internal counter prescaler.
      enum: [1, 2, 3, 4, 5, 6, 7, 8, 9, 10, 11, 12, 13, 14, 15, 16]

    dead-time:
      type: int
      default: 0
      description: |
        Dead time (in ticks) for PWM channel in OPWMCB mode.

    phase-shift:
      type: int
      default: 0
      description: |
        Phase Shift (in ticks) for PWM channel in OPWMB mode.

    input-filter:
      type: int
      default: 0
      enum: [0, 2, 4, 8, 16]
      description: |
        Select the minimum input pulse width, in filter clock cycles that can pass
        through the input filter. The filter latency - the difference in time between
        the input and the response is three clock edges. Default 0 means the filter
        is bypassed. The clock source for programmable input filter is eMIOS clock.
```

## dts/bindings/pwm/nxp,sctimer-pwm.yaml
```yaml
# Copyright (c) 2021, NXP
# SPDX-License-Identifier: Apache-2.0

description: NXP SCTimer PWM

compatible: "nxp,sctimer-pwm"

include: [pwm-controller.yaml, pinctrl-device.yaml, base.yaml, mux-consumer.yaml]

properties:
  prescaler:
    type: int
    default: 1
    description: prescaling factor from the SCT clock. Default to 1 which is the reset value
    enum:
      - 1
      - 2
      - 4
      - 8
      - 16
      - 32
      - 64
      - 128

  mux-states:
    type: phandle-array
    description: |
      INPUTMUX routing for the SCTimer capture inputs. Optional; only needed
      when PWM capture is used. Each entry is <&inputmuxN index connection>:
        - &inputmuxN is the INPUTMUX mux controller providing the route
        - index is the SCTimer input channel number (0-7 for most NXP SoCs)
        - connection is an inputmux_connection_t value from
          fsl_inputmux_connections.h. Take LPC55S36 as example:
          - 0: kINPUTMUX_SctGpioInAToSct0 (GPIO to SCT input A)
          - 1: kINPUTMUX_SctGpioInBToSct0 (GPIO to SCT input B)
      Example (route SCT input channel 1 via INPUTMUX0):
        mux-states = <&inputmux0 1 0>;

  out-init-state:
    type: int
    default: 0
    description: |
      Initial output state applied at init Bitmask, one bit per output.
      8-bit value. Maps to the MCUX SCTimer outInitState field.
      Default to 0 (all low)

  "#pwm-cells":
    const: 3

pwm-cells:
  - channel
  - period
  - flags
```

## dts/bindings/pwm/openisa,rv32m1-tpm.yaml
```yaml
# Copyright (c) 2019 Henrik Brix Andersen <henrik@brixandersen.dk>
# SPDX-License-Identifier: Apache-2.0

description: OpenISA Timer/PWM Module (TPM)

compatible: "openisa,rv32m1-tpm"

include: [pwm-controller.yaml, base.yaml, pinctrl-device.yaml]

properties:
    reg:
      required: true

    interrupts:
      required: true

    "#pwm-cells":
      const: 3

pwm-cells:
  - channel
# period in terms of nanoseconds
  - period
  - flags
```

## dts/bindings/pwm/pwm-controller.yaml
```yaml
# Copyright (c) 2017, NXP
# SPDX-License-Identifier: Apache-2.0

# Common fields for PWM controllers

properties:
  "#pwm-cells":
    type: int
    required: true
    description: Number of items to expect in a pwm specifier
```

## dts/bindings/pwm/pwm-nexus.yaml
```yaml
# Copyright (c) 2025 TOKITA Hiroshi
# SPDX-License-Identifier: Apache-2.0

# Common fields for PWM nexus nodes
#
# see 2.5 Nexus Nodes and Specifier Mapping
# https://devicetree-specification.readthedocs.io/en/latest/chapter2-devicetree-basics.html#nexus-nodes-and-specifier-mapping
# in the Devicetree Specification

properties:
  pwm-map:
    type: compound
    required: true

  pwm-map-mask:
    type: array

  pwm-map-pass-thru:
    type: array

  "#pwm-cells":
    type: int
    required: true
    description: Number of items to expect in a PWM specifier
```

## dts/bindings/pwm/pwm.yaml
```yaml
#
# Copyright (c) 2017, NXP
#
# SPDX-License-Identifier: Apache-2.0
#

# Common fields for PWM devices

properties:
    label:
      category: required

    "#pwm-cells":
      type: int
      category: required
      description: Number of items to expect in a pwm specifier
```

## dts/bindings/pwm/raspberrypi,pico-pwm.yaml
```yaml
# Copyright (c) 2022, Joep Buruma
# SPDX-License-Identifier: Apache-2.0

description: Raspberry Pi Pico PWM

compatible: "raspberrypi,pico-pwm"

include: [pwm-controller.yaml, pinctrl-device.yaml, reset-device.yaml, base.yaml]

properties:
  reg:
    required: true

  interrupts:
    required: true

  divider-int-0:
    type: int
    description: |
      The integral part of the divider for pwm slice 0.
      If a value between 1 and 255 is set, it will be set to the register
      as the integer part of the divider.
      If the value is set to 0 or this property is not defined when setting
      the number of cycles to PWM, a division ratio appropriate to that value is set.

  divider-frac-0:
    type: int
    description: |
      The fractional part of the divider for pwm slice 0.
      This number should be in the range 0 - 15.
      When the "divider-int-0" is set to 0 or is not defined, this property will be
      ignored.

  divider-int-1:
    type: int
    description: See divider-int-0 for help

  divider-frac-1:
    type: int
    description: See divider-frac-0 for help

  divider-int-2:
    type: int
    description: See divider-int-0 for help

  divider-frac-2:
    type: int
    description: See divider-frac-0 for help

  divider-int-3:
    type: int
    description: See divider-int-0 for help

  divider-frac-3:
    type: int
    description: See divider-frac-0 for help

  divider-int-4:
    type: int
    description: See divider-int-0 for help

  divider-frac-4:
    type: int
    description: See divider-frac-0 for help

  divider-int-5:
    type: int
    description: See divider-int-0 for help

  divider-frac-5:
    type: int
    description: See divider-frac-0 for help

  divider-int-6:
    type: int
    description: See divider-int-0 for help

  divider-frac-6:
    type: int
    description: See divider-frac-0 for help

  divider-int-7:
    type: int
    description: See divider-int-0 for help

  divider-frac-7:
    type: int
    description: See divider-frac-0 for help

  divider-int-8:
    type: int
    description: |
      See divider-int-0 for help, however this PWM slice is not available on
      RP2040.

  divider-frac-8:
    type: int
    description: |
      See divider-frac-0 for help, however this PWM slice is not available on
      RP2040.

  divider-int-9:
    type: int
    description: See divider-int-8 for help

  divider-frac-9:
    type: int
    description: See divider-frac-8 for help

  divider-int-10:
    type: int
    description: See divider-int-8 for help

  divider-frac-10:
    type: int
    description: See divider-frac-8 for help

  divider-int-11:
    type: int
    description: See divider-int-8 for help

  divider-frac-11:
    type: int
    description: See divider-frac-8 for help

  "#pwm-cells":
    const: 3

pwm-cells:
  # The rpi pico pwm peripheral is divided in 8 slices with an individual
  # clock setting and two output channels. The pwm channels are mapped the
  # following way PWM_CH0_A is addressed as <&pwm 0 PWM_FLAGS>, PWM_CH0B
  # is <&pwm 1 PMW_FLAGS>, PWM_CH1_A si <&pwm 2 PWM_FLAGS> and so on.
  - channel
  - period
  - flags
```
