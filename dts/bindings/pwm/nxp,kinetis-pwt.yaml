## dts/bindings/pwm/realtek,ameba-pwm.yaml
```yaml
# Copyright (c) 2026 Realtek Semiconductor Corp.
# SPDX-License-Identifier: Apache-2.0

description: AMEBA PWM

compatible: "realtek,ameba-pwm"

include: [pwm-controller.yaml, base.yaml, pinctrl-device.yaml]

properties:
  pinctrl-0:
    required: true

  pinctrl-names:
    required: true

  prescale:
    type: int
    required: true
    description: 16 bit timer prescale for the global clock.

  clock-frequency:
    type: int
    default: 40000000
    description: clock-frequency of PWM timer clk source

  index:
    type: int
    required: true
    description: pwm index

  channel-count:
    type: int
    required: true
    description: pwm channel count

  "#pwm-cells":
    const: 3
    description: |
      Number of items to expect in a PWM
      - channel of the timer used for PWM
      - period to set in ns
      - flags : combination of standard flags like PWM_POLARITY_NORMAL
        or specific flags like AMEBA_PWM_COMPLEMENTARY. As an example,
        the following complementary PWMs(CH2&CH2N) are shown below.
          <&pwm1 2 100 (PWM_POLARITY_NORMAL)>;
          <&pwm1 2 100 (PWM_POLARITY_NORMAL | AMEBA_PWM_COMPLEMENTARY)>;

pwm-cells:
  - channel
  - period
  - flags
```

## dts/bindings/pwm/realtek,bee-pwm.yaml
```yaml
# Copyright (c) 2026, Realtek Semiconductor Corporation
# SPDX-License-Identifier: Apache-2.0

description: Realtek Bee Timer implemented as PWM

compatible: "realtek,bee-pwm"

include: [base.yaml, pwm-controller.yaml, pinctrl-device.yaml]

properties:
  clocks:
    type: phandle-array

  pinctrl-0:
    required: true

  pinctrl-names:
    required: true

  "#pwm-cells":
    const: 3

pwm-cells:
  - channel
  - period
  - flags
```

## dts/bindings/pwm/realtek,rts5912-pwm.yaml
```yaml
# Copyright (c) 2025, Realtek, SIBG-SD7
# SPDX-License-Identifier: Apache-2.0

description: Realtek RTS5912 PWM

include: [pwm-controller.yaml, base.yaml, pinctrl-device.yaml]

compatible: "realtek,rts5912-pwm"

properties:
  reg:
    required: true

  "#pwm-cells":
    const: 3

pwm-cells:
  - channel
  - period
  - flags
```

## dts/bindings/pwm/renesas,pwm-rcar.yaml
```yaml
# Copyright (c) 2022, IoT.bzh
# SPDX-License-Identifier: Apache-2.0

description: Renesas R-Car PWM controller

compatible: "renesas,pwm-rcar"

include: [pwm-controller.yaml, pinctrl-device.yaml, base.yaml]

properties:
  "#pwm-cells":
    const: 3

pwm-cells:
  - channel
  # period in terms of nanoseconds
  - period
  - flags
```

## dts/bindings/pwm/renesas,ra-pwm.yaml
```yaml
# Copyright (c) 2024 Renesas Electronics Corporation
# SPDX-License-Identifier: Apache-2.0

description: Renesas RA Pulse Width Modulation

compatible: "renesas,ra-pwm"

include: [pwm-controller.yaml, base.yaml, pinctrl-device.yaml]

properties:
  divider:
    type: int
    required: true

  channel:
    type: int
    required: true

  clocks:
    required: true

  interrupts:
    required: true

  interrupt-names:
    required: true
    enum:
      - "gtioca"
      - "gtiocb"
      - "overflow"
    description: |
      A list of interrupt identifiers that correspond to the interrupt lines
      provided in the `interrupts` property. The names must be listed in the
      same order as their matching entries in `interrupts`.
      Common configurations based on the operating mode:
      - Input capture mode:"gtioca", "gtiocb", "overflow"
          "gtioca": Input capture A
          "gtiocb": Input capture B
          "overflow" : Overflow interrupt

  renesas-elcs:
    type: phandle-array
    description: |
      Phandle array pointing to the Renesas ELC node.
      The cell configuration must follow the Renesas
      ELC bindings "#renesas-elc-cells".

  renesas-elc-names:
    type: string-array
    description: |
      Optional names given to the Renesas ELC specifiers
      in the "renesas-elcs" property.

  start-source:
    type: string
    description: Signal source name for start
    enum:
      - "GPT_SOURCE_NONE"
      - "GPT_SOURCE_GPT_A"
      - "GPT_SOURCE_GPT_B"
      - "GPT_SOURCE_GPT_C"
      - "GPT_SOURCE_GPT_D"
      - "GPT_SOURCE_GPT_E"
      - "GPT_SOURCE_GPT_F"
      - "GPT_SOURCE_GPT_G"
      - "GPT_SOURCE_GPT_H"

  stop-source:
    type: string
    description: Signal source name for stop
    enum:
      - "GPT_SOURCE_NONE"
      - "GPT_SOURCE_GPT_A"
      - "GPT_SOURCE_GPT_B"
      - "GPT_SOURCE_GPT_C"
      - "GPT_SOURCE_GPT_D"
      - "GPT_SOURCE_GPT_E"
      - "GPT_SOURCE_GPT_F"
      - "GPT_SOURCE_GPT_G"
      - "GPT_SOURCE_GPT_H"

  "#pwm-cells":
    const: 3

pwm-cells:
  - channel
  - period
  - flags
```

## dts/bindings/pwm/renesas,rx-mtu-pwm.yaml
```yaml
# Copyright (c) 2025 Renesas Electronics Corporation
# SPDX-License-Identifier: Apache-2.0

description:
  Renesas PWM RX Controller. There are two PWM modes in RX, PWM mode 1 and PWM mode 2.
  In this version, we only support PWM mode 1.
  The PWM waveform is output from the MTIOCnA and MTIOCnC pins by coupling the TGRA
  register to the TGRB register and the TGRC register to the TGRD register.
  // +----------------+----------------+----------------+--------------------+
  // | Channel        | Register       | PWM Mode 1     | PWM Mode 2         |
  // +----------------+----------------+----------------+--------------------+
  // | MTU0           | MTU0.TGRA       | MTIOCOA        | MTIOCOA           |
  // |                | MTU0.TGRB       |                | MTIOCOB           |
  // |                | MTU0.TGRC       | MTIOCOC        | MTIOCOC           |
  // |                | MTU0.TGRD       |                | MTIOCOD           |
  // +----------------+----------------+----------------+--------------------+
  // | MTU1           | MTU1.TGRA       | MTIOC1A        | MTIOC1A           |
  // |                | MTU1.TGRB       |                | MTIOC1B           |
  // +----------------+----------------+----------------+--------------------+
  // | MTU2           | MTU2.TGRA       | MTIOC2A        | MTIOC2A           |
  // |                | MTU2.TGRB       |                | MTIOC2B           |
  // +----------------+----------------+----------------+--------------------+
  // | MTU3           | MTU3.TGRA       | MTIOC3A        | Setting prohibited|
  // |                | MTU3.TGRB       |                |                   |
  // |                | MTU3.TGRC       | MTIOC3C        |                   |
  // |                | MTU3.TGRD       |                |                   |
  // +----------------+----------------+----------------+                    +
  // | MTU4           | MTU4.TGRA       | MTIOC4A        |                   |
  // |                | MTU4.TGRB       |                |                   |
  // |                | MTU4.TGRC       | MTIOC4C        |                   |
  // |                | MTU4.TGRD       |                |                   |
  // +----------------+----------------+----------------+--------------------+

compatible: "renesas,rx-mtu-pwm"

include: [pwm-controller.yaml, pinctrl-device.yaml, base.yaml]

properties:
  prescaler:
    type: int
    default: 0
    description: Valid values are in the range 0-7 but
      specifically depend on the device (see RX user's manual). Common settings are 0-3 for
      dividers PCKL/1, PCLK/4, PCLK/16 and PCLK/64.

  "#pwm-cells":
    const: 3
    description: |
      Number of items to expect in a PWM
        - channel of the timer used for PWM
        - period to set in ns
        - flags : combination of standard flags like PWM_POLARITY_NORMAL

pwm-cells:
  - channel
  - period
  - flags
```

## dts/bindings/pwm/renesas,rz-gpt-pwm.yaml
```yaml
# Copyright (c) 2024 Renesas Electronics Corporation
# SPDX-License-Identifier: Apache-2.0

description: Renesas RZ GPT PWM

compatible: "renesas,rz-gpt-pwm"

include: [pwm-controller.yaml, base.yaml, pinctrl-device.yaml]

properties:
  "#pwm-cells":
    const: 3

pwm-cells:
  - channel
  - period
  - flags
```

## dts/bindings/pwm/renesas,rz-mtu-pwm.yaml
```yaml
# Copyright (c) 2025 Renesas Electronics Corporation
# SPDX-License-Identifier: Apache-2.0

description:
  Renesas RZ Multi-Function Timer Pulse Unit (MTU) PWM Controller.

  There are two PWM modes in RZ, PWM mode 1 and PWM mode 2. In this version, we only
  support PWM mode 1.
  The PWM waveform is output from the MTIOCnA and MTIOCnC pins by coupling the TGRA
  register to the TGRB register and the TGRC register to the TGRD register.

compatible: "renesas,rz-mtu-pwm"

include: [pwm-controller.yaml, pinctrl-device.yaml, base.yaml]

properties:
  "#pwm-cells":
    const: 3
    description: |
      Number of items to expect in a PWM
        - channel of the timer used for PWM
        - period to set in ns
        - flags : combination of standard flags like PWM_POLARITY_NORMAL

pwm-cells:
  - channel
  - period
  - flags
```

## dts/bindings/pwm/renesas,rza2m-gpt-pwm.yaml
```yaml
# Copyright (c) 2025 Renesas Electronics Corporation
# SPDX-License-Identifier: Apache-2.0

description: Renesas RZA2M GPT PWM

compatible: "renesas,rza2m-gpt-pwm"

include: [pwm-controller.yaml, base.yaml, pinctrl-device.yaml]

properties:
  "#pwm-cells":
    const: 3

pwm-cells:
  - channel
  - period
  - flags
```

## dts/bindings/pwm/shakti,pwm.yaml
```yaml
# Copyright (c) 2026 RISE Lab, IIT Madras
# SPDX-License-Identifier: Apache-2.0

description: Shakti PWM

compatible: "shakti,pwm"

include: [pwm-controller.yaml, base.yaml]

properties:
  reg:
    required: true

  clock-frequency:
    type: int
    required: true
    description: Clock frequency feeding the PWM block, in Hz.

pwm-cells:
  - channel
  - period
  - flags
```

## dts/bindings/pwm/sifive,pwm0.yaml
```yaml
# Copyright (c) 2018, SiFive Inc.
# SPDX-License-Identifier: Apache-2.0

description: SiFive PWM

compatible: "sifive,pwm0"

include: [pwm-controller.yaml, pinctrl-device.yaml, base.yaml]

properties:
    reg:
      required: true

    interrupts:
      required: true

    sifive,compare-width:
      type: int
      required: true
      description: Width of the PWM comparator in bits

    "#pwm-cells":
      const: 2

pwm-cells:
  - channel
# period in terms of nanoseconds
  - period
```

## dts/bindings/pwm/sifli,sf32lb-atim-pwm.yaml
```yaml
# Copyright (c) 2025, Qingsong Gou <gouqs@hotmail.com>
# SPDX-License-Identifier: Apache-2.0

description: SF32LB ATIM PWM controller

compatible: "sifli,sf32lb-atim-pwm"

include: [pwm-controller.yaml, pinctrl-device.yaml, base.yaml]

properties:
  pinctrl-0:
    required: true

  pinctrl-names:
    required: true

  "#pwm-cells":
    const: 3

pwm-cells:
  - channel
  - period
  - flags
```

## dts/bindings/pwm/sifli,sf32lb-gpt-pwm.yaml
```yaml
# Copyright (c) 2025, Qingsong Gou <gouqs@hotmail.com>
# SPDX-License-Identifier: Apache-2.0

description: Sifli PWM controller

compatible: "sifli,sf32lb-gpt-pwm"

include: [base.yaml, pwm-controller.yaml, pinctrl-device.yaml]

properties:
  pinctrl-0:
    required: true

  pinctrl-names:
    required: true

  "#pwm-cells":
    const: 3

pwm-cells:
  - channel
  - period
  - flags
```

## dts/bindings/pwm/sifli,sf32lb-lptim-pwm.yaml
```yaml
# Copyright (c) 2025, Qingsong Gou <gouqs@hotmail.com>
# SPDX-License-Identifier: Apache-2.0

description: SF32LB LPTIM PWM controller

compatible: "sifli,sf32lb-lptim-pwm"

include: [pwm-controller.yaml, pinctrl-device.yaml, base.yaml]

properties:
  pinctrl-0:
    required: true

  pinctrl-names:
    required: true

  "#pwm-cells":
    const: 3

pwm-cells:
  - channel
  - period
  - flags
```
