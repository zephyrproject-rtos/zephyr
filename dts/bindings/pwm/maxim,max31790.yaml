## dts/bindings/pwm/nxp,ctimer-pwm.yaml
```yaml
# (c) Meta Platforms, Inc. and affiliates.
# Copyright 2026 NXP
# SPDX-License-Identifier: Apache-2.0

description: NXP CTimer PWM

compatible: "nxp,ctimer-pwm"

include:
  - pwm-controller.yaml
  - pinctrl-device.yaml
  - base.yaml
  - "nxp,lpc-ctimer.yaml"
  - mux-consumer.yaml

properties:
  reg:
    required: true

  prescaler:
    type: int
    default: 1
    description: |
      Specifies the prescale value. Valid range: 0x0 - 0xFFFFFFFF.
      The clock is divided by (prescaler + 1).

  clk-source:
    type: int
    required: true
    description: clock to use

  mux-states:
    type: phandle-array
    description: |
      PWM capture input routing. Optional; only needed when PWM capture is
      used. Each entry is <&inputmuxN index connection>:
        - &inputmuxN is the INPUTMUX mux controller providing the route
        - index is the CAPTSEL destination index (0..3)
        - connection is an inputmux_connection_t value from
          fsl_inputmux_connections.h
      Example (route CT_INP15 to CTIMER2 CAPTSEL[0] via INPUTMUX0):
        mux-states = <&inputmux0 0 0x06000010>;

  "#pwm-cells":
    const: 3

pwm-cells:
  - channel
  - period
  - flags
```

## dts/bindings/pwm/nxp,emios-pwm.yaml
```yaml
# Copyright 2026 NXP
# SPDX-License-Identifier: Apache-2.0

description: |
  NXP eMIOS PWM node. Each channel (UC) in eMIOS can be configured to use for
  PWM and capture operation. There are several modes supported by this module,
  some modes only support on channels that have internal counter, some modes
  require to use a reference timebase from a counter bus.

  For example to configuring eMIOS instance 0 with:
    - Channel 16 for mode OPWFMB
    - Channel 9 for mode OPWMB
    - Channel 2 for mode OPWMCB with deadtime inserted at leading edge

    emios0_pwm: pwm {
      pwm_0 {
        channel = <16>;
        mode = "OPWFMB";
        counter-bus-type = "BUS_INTERNAL";
        prescaler = <8>;
      };

      pwm_1 {
        channel = <9>;
        mode = "OPWMB";
        counter-bus-type = "BUS_C";
        phase-shift = <100>;
      };

      pwm_2 {
        channel = <2>;
        mode = "OPWMCB_LEAD_EDGE";
        counter-bus-type = "BUS_B";
        dead-time = <100>;
      };
    };

  OPWMB and OPWMCB modes use reference timebase. Please notice that the devicetree
  node for counter bus should be enabled and configured for using, please see
  'nxp,emios' bindings.

compatible: "nxp,emios-pwm"

include: [pwm-controller.yaml, base.yaml, pinctrl-device.yaml]

properties:
  pinctrl-0:
    required: true

  pinctrl-names:
    required: true

  "#pwm-cells":
    const: 3

pwm-cells:
  - channel
  - period
  - flags

child-binding:
  description: |
    eMIOS PWM channel configuration.

  properties:
    channel:
      type: int
      required: true
      description: eMIOS PWM channel

    mode:
      type: string
      required: true
      description: |
        Select PWM mode:
        - OPWFMB: Provides waveforms with variable duty cycle and frequency.
                  This mode uses internal counter.

        - OPWMB:  Generate pulses with programmable leading and trailing
                  edge placement. The period is determined by period of
                  an external counter driven in MCB Up Mode. Changing PWM period
                  at runtime will impact to all channels share the same timebase.
                  The new period and cycle take effect in next period boundary.

        - OPWMCB: Generates a center aligned PWM with dead time insertion to the
                  leading or trailing edge. The period is determined by period of
                  an external counter driven in MCB Up Down Mode. Changing PWM period
                  at runtime will impact to all channels share the same timebase,
                  The new period and cycle take effect in next period boundary.

        - SAIC: Single action input capture mode, the eMIOS captures events as soon as
                they occur. The value of latest captured event is stored and can be read
                by software. This mode uses internal counter with range [0, 0xFFFF].
      enum:
        - "OPWFMB"
        - "OPWMB"
        - "OPWMCB_TRAIL_EDGE"
        - "OPWMCB_LEAD_EDGE"
        - "SAIC"

    counter-bus-type:
      type: string
      required: true
      description: |
        Counter bus provides the time base for each channel (UC).
        Global counter bus provides the time base for any other channels.
        Local counter bus provides the time base for specific channels.
        Channel drives counter bus only use the internal counter as its time base.
          - BUS_A: global bus, driven by channel 23, used by other all channels
          - BUS_B: local bus,  driven by channel 0,  used by channels 1-7
          - BUS_C: local bus,  driven by channel 8,  used by channels 9-15
          - BUS_D: local bus,  driven by channel 16, used by channels 17-23
          - BUS_F: global bus, driven by channel 22, used by other all channels
          - BUS_INTERNAL: the channel's own internal counter, OPWFMB and SAIC mode use this type
      enum:
        - "BUS_A"
        - "BUS_B"
        - "BUS_C"
        - "BUS_D"
        - "BUS_F"
        - "BUS_INTERNAL"

    prescaler:
      type: int
      min: 1
      max: 16
      default: 1
      description: |
        The clock divider for internal counter prescaler.

    dead-time:
      type: int
      default: 0
      description: |
        Dead time (in ticks) for PWM channel in OPWMCB mode.

    phase-shift:
      type: int
      default: 0
      description: |
        Phase Shift (in ticks) for PWM channel in OPWMB mode.

    input-filter:
      type: int
      default: 0
      enum: [0, 2, 4, 8, 16]
      description: |
        Select the minimum input pulse width, in filter clock cycles that can pass
        through the input filter. The filter latency - the difference in time between
        the input and the response is three clock edges. Default 0 means the filter
        is bypassed. The clock source for programmable input filter is eMIOS clock.
```

## dts/bindings/pwm/nxp,emios.yaml
```yaml
# Copyright 2026 NXP
# SPDX-License-Identifier: Apache-2.0

description: Enhanced Modular IO SubSystem (eMIOS).

compatible: "nxp,emios"

include: [base.yaml]

properties:
  reg:
    required: true

  interrupts:
    required: true

  interrupt-names:
    required: true

  clocks:
    required: true

  global-prescaler:
    type: int
    min: 1
    max: 256
    default: 1
    description: |
      Global clock prescaler value.

child-binding:
  child-binding:
    description: |
      Node for eMIOS counter bus. Each channel (UC) capable of becoming a counter bus
      has a node defined in the root devicetree but is disabled by default. To allow
      using the counter bus, the devicetree node should be enabled and dts properties
      should be configured as required by the application.

      For example, to enable bus A of eMIOS instance 0 that can be used as a timebase
      for channels from 0 to 22:
        counter_bus {
          emios0_bus_a: emios0_bus_a {
            channel = <23>;
            prescaler = <1>;
            mode = "MCB_UP_COUNTER";
            status = "okay";
          };
        };

    properties:
      channel:
        type: int
        required: true
        description: |
          Channel identifier for the counter bus.

      prescaler:
        type: int
        min: 1
        max: 16
        default: 1
        description: |
          Clock divider value for internal UC prescaler.
          Clock for internal counter = (eMIOS clock / global prescaler) / internal prescaler.

      mode:
        type: string
        required: true
        description: |
          Counter bus mode.
        enum:
          - "MCB_UP_COUNTER"
          - "MCB_UP_DOWN_COUNTER"
```

## dts/bindings/pwm/nxp,flexio-pwm.yaml
```yaml
# Copyright 2024 NXP
# SPDX-License-Identifier: Apache-2.0

description: NXP Flexio PWM controller.
  Each flexio timer can be used for generating one pwm pulse.
  The two PWM modes supported by flexio are chosen based on the selected polarity -
  Dual 8-bit counters PWM mode and Dual 8-bit counters PWM Low mode.

compatible: "nxp,flexio-pwm"

include: [pwm-controller.yaml, pinctrl-device.yaml, base.yaml]

properties:
  pinctrl-0:
    required: true

  pinctrl-names:
    required: true

  "#pwm-cells":
    const: 3

pwm-cells:
  - channel
  - period
  - flags

child-binding:
  description: |
    Flexio PWM channel configuration.

  properties:
    pin-id:
      type: int
      required: true
      description: |
        pin-id should be populated with number 'n' specified in the
        FXIO_D<n> data pin of your board's schematic.

    prescaler:
      type: int
      description: |
        The clock divider for internal counter prescaler.
        - 1: Divide by 1
        - 16: Divide by 16
        - 256: Divide by 256
      enum: [1, 16, 256]
```

## dts/bindings/pwm/nxp,flexpwm.yaml
```yaml
# Copyright (c) 2019, Linaro Limited
# SPDX-License-Identifier: Apache-2.0

description: NXP eFLEX PWM module with mcux-pwm submodules

compatible: "nxp,flexpwm"

include: base.yaml

properties:
    reg:
      required: true

    interrupts:
      required: true
```

## dts/bindings/pwm/nxp,ftm-pwm.yaml
```yaml
# Copyright 2017, 2024-2025 NXP
# SPDX-License-Identifier: Apache-2.0

description: NXP FlexTimer Module (FTM) PWM controller

compatible: "nxp,ftm-pwm"

include: [pwm-controller.yaml, "nxp,ftm.yaml", "pinctrl-device.yaml"]

properties:
  "#pwm-cells":
    const: 3

  pinctrl-0:
    required: true

pwm-cells:
  - channel
  # period in terms of nanoseconds
  - period
  - flags
```

## dts/bindings/pwm/nxp,imx-pwm.yaml
```yaml
# Copyright (c) 2019 Linaro Limited
# Copyright 2025 NXP
# SPDX-License-Identifier: Apache-2.0

description: NXP MCUX PWM

compatible: "nxp,imx-pwm"

include: [pwm-controller.yaml, pinctrl-device.yaml, base.yaml]

properties:
  index:
    type: int
    description: flexpwm submodule index
    required: true

  interrupts:
    required: true

  run-in-wait:
    type: boolean
    description: |
      Enable for PWM to keep running in WAIT mode.

  run-in-debug:
    type: boolean
    description: |
      Enable for PWM to keep running in debug mode.

  nxp,prescaler:
    type: int
    enum: [1, 2, 4, 8, 16, 32, 64, 128]
    required: true
    description: |
      Clock prescaler at the input of the PWM.

  nxp,reload:
    type: string
    enum:
      - "immediate"
      - "half-cycle"
      - "full-cycle"
      - "half-and-full-cycle"
    description: |
      Select how to load the buffered-registers with new values:
      "immediate" - buffered-registers get loaded with new values as soon as LDOK bit is set;
      "half-cycle" - registers loaded on a PWM half cycle;
      "full-cycle" - registers loaded on a PWM full cycle;
      "half-and-full-cycle" - registers loaded on a PWM half & full cycle.

  input-filter-count:
    type: int
    description: |
      Set the number of consecutive samples that must agree prior to
      the input filter accepting an input transition. The number of samples
      is the decimal value of this field plus three: the bit field value of 0-7
      represents 3-10 samples, respectively. The value affects the input latency.
      Valid range: 0 - 7

  input-filter-period:
    type: int
    description: |
      Set the sampling period (in IPBus clock cycles) of the input capture pin input filter.
      Each input is sampled multiple times at the rate specified by this field.
      If the value is 0x00 (default), then the input filter is bypassed. The value affects
      the input latency.
      Valid range: 0 - 255

  "#pwm-cells":
    const: 3

pwm-cells:
  - channel
  - period
  - flags
```

## dts/bindings/pwm/nxp,kinetis-ftm-pwm.yaml
```yaml
# Copyright 2017, 2024 NXP
# SPDX-License-Identifier: Apache-2.0

description: Kinetis FTM PWM

compatible: "nxp,kinetis-ftm-pwm"

include: [pwm-controller.yaml, "nxp,kinetis-ftm.yaml", "pinctrl-device.yaml"]

properties:
  "#pwm-cells":
    const: 3

  pinctrl-0:
    required: true

  clock-source:
    type: string
    required: true
    enum:
      - "system"
      - "fixed"
      - "external"
    description: |
      Select one of three possible clock sources for the FTM counter:
        * system: it's the bus interface clock driving the FTM module. Usually
          provides higher timer resolution than the other two clock sources.
        * fixed: it's a fixed clock defined by chip integration.
        * external: it's a clock that can be accessed externally to the chip and
          passes through a sychronizer clocked by the FTM bus interface clock.

      This clock source selection is independent of the bus interface clock
      driving the FTM module. Refer to the chip specific documentation for
      further information.

pwm-cells:
  - channel
  # period in terms of nanoseconds
  - period
  - flags
```

## dts/bindings/pwm/nxp,kinetis-ftm.yaml
```yaml
# Copyright (c) 2017, NXP
# SPDX-License-Identifier: Apache-2.0

description: Kinetis FTM

compatible: "nxp,kinetis-ftm"

include: [pwm-controller.yaml, base.yaml]

properties:
    reg:
      required: true

    interrupts:
      required: true

    "#pwm-cells":
      const: 3

pwm-cells:
  - channel
# period in terms of nanoseconds
  - period
  - flags
```
