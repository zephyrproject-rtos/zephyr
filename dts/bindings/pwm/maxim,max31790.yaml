## dts/bindings/pwm/maxim,max31790.yaml
```yaml
# Copyright (c) 2023 SILA Embedded Solutions GmbH
# SPDX-License-Identifier: Apache-2.0

description: Maxim MAX31790 6-channel I2C-bus PWM controller

compatible: "maxim,max31790"

include: [pwm-controller.yaml, i2c-device.yaml, base.yaml]

properties:
  reg:
    required: true

  "#pwm-cells":
    const: 2

pwm-cells:
  - channel
  - period
```

## dts/bindings/pwm/microchip,mec5-pwm.yaml
```yaml
# Copyright (c) 2024 Microchip Technology Inc. All Rights Reserved.
# SPDX-License-Identifier: Apache-2.0

description: Microchip MEC5 HAL based PWM driver

compatible: "microchip,mec5-pwm"

include: [pwm-controller.yaml, base.yaml, pinctrl-device.yaml]

properties:
  reg:
    required: true

  pinctrl-0:
    required: true

  pinctrl-names:
    required: true

pwm-cells:
  - channel
  - period
  - flags
```

## dts/bindings/pwm/microchip,pwm-g1.yaml
```yaml
# Copyright (c) 2026 Microchip Technology Inc.
# SPDX-License-Identifier: Apache-2.0
title: Microchip PWM g1 driver.

description: |
  Microchip Pulse Width Modulation Controller (PWM).

  Group g1 PWM driver supports following hardware peripherals:
    - module name="PWM" id="6343" version="802"

  This driver is responsible for configuring and managing the PWM peripheral in
  Microchip microprocessors.

examples:
  - |
    /* 'pwm_led0' is a node representing a device (e.g., an LED) controlled by PWM. */
    pwm_led0: pwm_led_0 {
      status = "okay";
      /*
       * The 'pwms' property uses the phandle to the PWM controller (here, 'pwm0'),
       * specifies channel 1, sets the PWM period to 20 milliseconds, and uses a
       * polarity of normal.
       *
       * The order of the 'pwms' arguments matches the 'pwm-cells' definition:
       * <&controller channel period polarity>
       */
      pwms = <&pwm0 1 PWM_MSEC(20) PWM_POLARITY_NORMAL>;
    };

compatible: "microchip,pwm-g1"

include:
  - name: base.yaml
  - pwm-controller.yaml
  - name: pinctrl-device.yaml

properties:
  reg:
    required: true

  interrupts:
    required: true

  clocks:
    required: true

  clka-prescaler:
    type: int
    default: 1
    enum: [1, 2, 4, 8, 16, 32, 64, 128, 256, 512, 1024]
    description: |
      CLKA Source Clock Selection.
      CLKA is derived by dividing the peripheral clock by this prescaler.

  clka-divide-factor:
    type: int
    default: 0
    description: |
      CLKA Divide Factor.
        0: CLKA clock is turned off
        1: CLKA clock is clock selected by PREA
        2 - 255: CLKA clock is clock selected by PREA divided by this factor
    min: 0
    max: 255

  clkb-prescaler:
    type: int
    default: 1
    enum: [1, 2, 4, 8, 16, 32, 64, 128, 256, 512, 1024]
    description: |
      CLKB Source Clock Selection.
      CLKB is derived by dividing the peripheral clock by this prescaler.

  clkb-divide-factor:
    type: int
    default: 0
    description: |
      CLKB Divide Factor.
        0: CLKB clock is turned off
        1: CLKB clock is clock selected by PREB
        2 - 255: CLKB clock is clock selected by PREB divided by this factor
    min: 0
    max: 255

  "#pwm-cells":
    const: 3

pwm-cells:
  - channel
  - period
  - polarity
```

## dts/bindings/pwm/microchip,tc-g1-pwm.yaml
```yaml
# Copyright (c) 2025 Microchip Technology Inc.
# SPDX-License-Identifier: Apache-2.0
title: Microchip PWM TC g1 driver.

description: |
  Microchip PWM TC g1 driver.

  This driver is responsible for configuring
  and managing the TC peripheral in Microchip microcontrollers for PWM configuration.
  The supported devices :
    - tc-u2249 (3.0.0)

  Example usage in a Device Tree Source (DTS) file:

     pwm_led0: pwm_led_0 {
         status = "okay";
         pwms = <&tc0 1 PWM_MSEC(20) 0>;
     };

  Explanation:
     - 'pwm_led0' is a node representing a device (e.g., an LED) controlled by PWM.
     - The 'pwms' property uses the phandle to the PWM controller (here, 'tc0'),
       specifies channel 2, sets the PWM period to 20 milliseconds,
       and uses a polarity of 0 (normal).
     - The order of the 'pwms' arguments matches the 'pwm-cells' definition:
         <&controller channel period polarity>
     - This allows the device to be driven with a specific PWM configuration using
       the Microchip PWM TC driver.

compatible: "microchip,tc-g1-pwm"

include:
  - pwm-controller.yaml
  - microchip,tc-g1.yaml

properties:
  "#pwm-cells":
    const: 3

pwm-cells:
  - channel
  - period
  - polarity
```

## dts/bindings/pwm/microchip,tcc-g1-pwm.yaml
```yaml
# Copyright (c) 2025 Microchip Technology Inc.
# SPDX-License-Identifier: Apache-2.0

title: Microchip G1 TCC pwm driver.

description: |
  Microchip TCC pwm driver.

  This driver is used for configuring
  and managing TCC (Timer/ Counter for Control Applications)
  peripheral in Microchip microcontrollers. This peripherals
  support creating PWM signals. The supported peripherals are
  as follows:
    - module name="TCC" id="U2213" version="3.1.0"

compatible: "microchip,tcc-g1-pwm"

include:
  - base.yaml
  - pwm-controller.yaml
  - microchip,tcc-g1.yaml
  - pinctrl-device.yaml

properties:
  "#pwm-cells":
    const: 3

pwm-cells:
  - channel
  - period
  - polarity
```

## dts/bindings/pwm/microchip,xec-pwm.yaml
```yaml
# Copyright (c) 2019, Intel Corporation
# SPDX-License-Identifier: Apache-2.0

description: Microchip XEC PWM

include: [pwm-controller.yaml, base.yaml, pinctrl-device.yaml]

compatible: "microchip,xec-pwm"

properties:
  reg:
    required: true

  pcr-scr:
    type: int
    required: true
    description: |
      PWM Power Clock Reset(PCR) peripheral index and bit position

  "#pwm-cells":
    const: 3

pwm-cells:
  - channel
  - period
  - flags
```

## dts/bindings/pwm/microchip,xec-pwmbbled.yaml
```yaml
# Copyright (c) 2019, Intel Corporation
# SPDX-License-Identifier: Apache-2.0

description: Microchip XEC PWM using BBLED hardware

include: [pwm-controller.yaml, base.yaml, pinctrl-device.yaml]

compatible: "microchip,xec-pwmbbled"

properties:
  reg:
    required: true

  interrupts:
    required: true

  girqs:
    type: array
    required: true
    description: Array of pairs of GIRQ number and bit position

  pcrs:
    type: array
    required: true
    description: BBLED PCR register index and bit position

  clock-select:
    type: string
    required: true
    description: |
      Clock source selection: 32 KHz is available in deep sleep.
      - PWM_BBLED_CLK_AHB: Clock source is the PLL based AHB clock
      - PWM_BBLED_CLK_SLOW: Clock source is the PLL based PCR slow clock
      - PWM_BBLED_CLK_32K: Clock source is the 32KHz domain
    enum:
      - "PWM_BBLED_CLK_32K"
      - "PWM_BBLED_CLK_SLOW"
      - "PWM_BBLED_CLK_48M"

  pinctrl-0:
    required: true

  pinctrl-names:
    required: true

  "#pwm-cells":
    const: 2

  enable-low-power-32k:
    type: boolean
    description: |
      BBLED has two clock inputs.
      - Main system clock (48MHz)
      - 32KHz Core clock (32.768KHz)
      When BBLED enter into Suspend state, 48MHz clock will be switched off by
      PCR(Power, Clock and Reset) block. But 32KHz Core clock will be available to BBLED.
      There may be a product requirement, either to blink (or) not blink LED in Suspend state.
      Flag "enable-low-power-32k" shall be used along with 32KHz clock to blink (or) not blink
      the LED in Suspend state.

pwm-cells:
  - channel
  - period
```

## dts/bindings/pwm/microchip,xec-rpm2pwm-tach.yaml
```yaml
# Copyright (c) 2023, Silicom Connectivity Solutions, Ltd.
# SPDX-License-Identifier: Apache-2.0

description: Microchip XEC RPM2PWM Tach

include: [base.yaml]

compatible: "microchip,xec-rpm2pwm-tach"
```

## dts/bindings/pwm/microchip,xec-rpm2pwm.yaml
```yaml
# Copyright (c) 2023, Silicom Connectivity Solutions, Ltd.
# SPDX-License-Identifier: Apache-2.0

description: |

  Microchip XEC RPM2PWM

  Microchip's MEC172x series of embedded controllers supports up to 2 closed loop fan controllers.
  The fan controllers use an input tachometer reading and a target RPM to control the PWM to the
  fans.  There are multiple fan type configurations to support fans with different numbers of poles
  in order to read the RPM correctly, as well as options to control the fan ramp up/down and
  startup spin control.

  This driver is an initial baseline requesting review and comment on the design and feature-set.

  Example DTS board configuration:

  &rpmfan0 {
          pinctrl-0 = <&gpwm0_gpio53 &gtach_gpio050>;
          pinctrl-names = "default";
          status = "okay";

          rpmfantach0: {
                  status = "okay";
          }

          fan {
                  fan0: fan {
                          pwms = <&rpmfan0 0 PWM_MSEC(30) 0>;
                          edges = <5>;
                  };
          };
  };

include: [pwm-controller.yaml, base.yaml, pinctrl-device.yaml]

compatible: "microchip,xec-rpm2pwm"

properties:
  reg:
    required: true

  pcrs:
    type: array
    required: true
    description: RPM2PWM PCR register index and bit position

  "#pwm-cells":
    const: 3

  girqs:
    type: array
    required: true
    description: |
      Array of encoded interrupt information

  pinctrl-0:
    required: true

  pinctrl-names:
    required: true

child-binding:
  child-binding:
    properties:
      pwms:
        required: true
        type: phandle-array
        description: |
          Reference to RPM2PWM instance.

          The period field is ignored, period is fixed in hardware.  Flags
          should be used to set the desired spin-up and update period etc.
          of the rpm2pwm fan controller.

      edges:
        required: true
        type: int
        description: |
          Number of edges on this fan that are needed to count a single
          revolution.

pwm-cells:
  - channel
  - period
  - flags
```

## dts/bindings/pwm/neorv32,pwm.yaml
```yaml
# Copyright (c) 2025 Henrik Brix Andersen <henrik@brixandersen.dk>
# SPDX-License-Identifier: Apache-2.0

description: NEORV32 PWM

compatible: "neorv32,pwm"

include: [pwm-controller.yaml, base.yaml]

properties:
  reg:
    required: true

  syscon:
    type: phandle
    required: true
    description: |
      phandle to syscon (NEORV32 SYSINFO) node.

  "#pwm-cells":
    const: 3

pwm-cells:
  - channel
  # period in terms of nanoseconds
  - period
  - flags
```

## dts/bindings/pwm/nordic,nrf-pwm.yaml
```yaml
description: nRF PWM

compatible: "nordic,nrf-pwm"

include: [pwm-controller.yaml, base.yaml, pinctrl-device.yaml, memory-region.yaml]

properties:
  reg:
    required: true

  pinctrl-0:
    required: true

  pinctrl-names:
    required: true

  center-aligned:
    type: boolean
    description: Set this to use center-aligned (up and down) counter mode.

  idleout-supported:
    type: boolean
    description: |
      Indicates if the PWM instance has the IDLEOUT register.

  "#pwm-cells":
    const: 3

pwm-cells:
  - channel
  - period
  - flags
```

## dts/bindings/pwm/nordic,nrf-sw-pwm.yaml
```yaml
description: nRFx S/W PWM

compatible: "nordic,nrf-sw-pwm"

include: [pwm-controller.yaml, base.yaml]

properties:
    generator:
      type: phandle
      required: true
      description: |
        Reference to TIMER or RTC instance for generating PWM output signals

    clock-prescaler:
      type: int
      required: true
      description: |
        Clock prescaler for RTC or TIMER used for generating PWM output signals.

        RTC: needs to be set to 0, which gives 32768 Hz base clock for PWM
        generation.

        TIMER: 16 MHz / 2^prescaler base clock is used for PWM generation.

    channel-gpios:
      type: phandle-array
      required: true
      description: |
        An array of GPIOs assigned as outputs for the PWM channels. The number
        of items in this array determines the number of channels that this PWM
        will provide. This value is limited by the number of compare registers
        in the used RTC/TIMER instance minus 1.

        Example:

          sw_pwm: sw-pwm {
            compatible = "nordic,nrf-sw-pwm";
            ...
            channel-gpios = <&gpio0 20 GPIO_ACTIVE_HIGH>,
                            <&gpio1 12 GPIO_ACTIVE_HIGH>;
            ...
          };

        The above will assign P0.20 as the output for channel 0 and P1.12 as
        the output for channel 1. Both outputs will be initially configured as
        active high.

        Please note that in the flags cell (the last component of each item
        of the array) only the GPIO flags that specify the active level are
        taken into account (any others are ignored), and they are used only
        when the initial (inactive) state of the outputs is set.
        After any PWM signal generation is requested for a given channel,
        the polarity of its output is determined by the flag specified
        in the request, i.e. PWM_POLARITY_INVERTED or PWM_POLARITY_NORMAL.

    "#pwm-cells":
      const: 3

pwm-cells:
  - channel
  - period
  - flags
```

## dts/bindings/pwm/nuvoton,nct-pwm.yaml
```yaml
# Copyright (c) 2025 Nuvoton Technology Corporation.
# SPDX-License-Identifier: Apache-2.0

description: Nuvoton, NCT Pulse Width Modulator (PWM) node

compatible: "nuvoton,nct-pwm"

include: [pwm-controller.yaml, base.yaml, pinctrl-device.yaml]

properties:
  reg:
    required: true
  clocks:
    required: true
  pinctrl-0:
    required: true
  pinctrl-names:
    required: true

pwm-cells:
  - channel
  - period
  - flags
```

## dts/bindings/pwm/nuvoton,npcm-pwm.yaml
```yaml
# Copyright (c) 2024 Nuvoton Technology Corporation.
# SPDX-License-Identifier: Apache-2.0

description: Nuvoton, NPCM Pulse Width Modulator (PWM) node

compatible: "nuvoton,npcm-pwm"

include: [pwm-controller.yaml, base.yaml, pinctrl-device.yaml]

properties:
  reg:
    required: true
  clocks:
    required: true
  pinctrl-0:
    required: true
  pinctrl-names:
    required: true

pwm-cells:
  - channel
  - period
  - flags
```

## dts/bindings/pwm/nuvoton,npcx-pwm.yaml
```yaml
# Copyright (c) 2020 Nuvoton Technology Corporation.
# SPDX-License-Identifier: Apache-2.0

description: Nuvoton, NPCX Pulse Width Modulator (PWM) node

compatible: "nuvoton,npcx-pwm"

include: [pwm-controller.yaml, base.yaml, pinctrl-device.yaml]

properties:
    reg:
        required: true
    clocks:
        required: true
    pinctrl-0:
        required: true
    pinctrl-names:
        required: true
    pwm-channel:
        type: int
        description: |
            A index to indicate PWM module that generates a single PWM signal.
            Please don't overwrite it in the board-level DT driver.
    clock-bus:
        required: false
        type: string
        description: |
            Select a specific input clock source for the PWM module. If this
            property doesn't exist, fallback to default value in clocks property.
        enum:
            - NPCX_CLOCK_BUS_APB2
            - NPCX_CLOCK_BUS_LFCLK

pwm-cells:
    - channel
    - period
    - flags
```

## dts/bindings/pwm/nuvoton,numaker-pwm.yaml
```yaml
# Copyright (c) 2023 Nuvoton Technology Corporation.
# SPDX-License-Identifier: Apache-2.0

description: Nuvoton, NuMaker PWM controller

compatible: "nuvoton,numaker-pwm"

include: [pwm-controller.yaml, base.yaml, reset-device.yaml, pinctrl-device.yaml]

properties:
  reg:
    required: true

  interrupts:
    required: true

  resets:
    required: true

  clocks:
    required: true

  prescaler:
    type: int
    required: true
    description: Set the PWM prescale 0 ~ 4095

  "#pwm-cells":
    const: 3

pwm-cells:
  - channel
  - period
  - flags
```
