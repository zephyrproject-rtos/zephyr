## dts/bindings/multi_heap_manager/shared-multi-heap.yaml
```yaml
description: Shared multi-heap memory pool manager

compatible: "shared-multi-heap"

include:
  - name: base.yaml
    property-allowlist: ['reg', 'label']

properties:
    # Keep this is sync with shared_multi_heap.h
    capability:
      type: string
      required: false
      description: memory region capability
      enum:
        - "cacheable"
        - "non-cacheable"

    label:
      required: true
```

## dts/bindings/mux/adi,adgm3121-gpio.yaml
```yaml
# SPDX-FileCopyrightText: 2026 NXP
# SPDX-FileCopyrightText: 2026 Analog Devices Inc.
# SPDX-License-Identifier: Apache-2.0

description: |
  Analog Devices ADGM3121 DPDT MEMS switch (DC-24GHz), parallel GPIO control
  mode, exposed as a MUX controller.

  Each of the four MEMS switches (SW1..SW4) is controlled by a dedicated GPIO
  pin (IN1..IN4). The four switches are modeled as a single control line whose
  state is a 4-bit switch bitmask: bit i selects SW(i+1), 1 = closed.
  mux_control_disconnect() opens all four switches (drives every line low).

  Example:

    adgm3121 {
        compatible = "adi,adgm3121-gpio";
        in1-gpios = <&gpio0 0 GPIO_ACTIVE_HIGH>;
        in2-gpios = <&gpio0 1 GPIO_ACTIVE_HIGH>;
        in3-gpios = <&gpio0 2 GPIO_ACTIVE_HIGH>;
        in4-gpios = <&gpio0 3 GPIO_ACTIVE_HIGH>;
        #mux-control-cells = <0>;
        #mux-state-cells = <1>;
    };

compatible: "adi,adgm3121-gpio"

include: [base.yaml, mux-controller.yaml]

properties:
  in1-gpios:
    type: phandle-array
    required: true
    description: GPIO controlling switch SW1 (RF1A-RFCA).

  in2-gpios:
    type: phandle-array
    required: true
    description: GPIO controlling switch SW2 (RF2A-RFCA).

  in3-gpios:
    type: phandle-array
    required: true
    description: GPIO controlling switch SW3 (RF2B-RFCB).

  in4-gpios:
    type: phandle-array
    required: true
    description: GPIO controlling switch SW4 (RF1B-RFCB).

  "#mux-control-cells":
    const: 0

  "#mux-state-cells":
    const: 1

mux-state-cells:
  - switches
```

## dts/bindings/mux/adi,adgm3121.yaml
```yaml
# SPDX-FileCopyrightText: 2026 NXP
# SPDX-FileCopyrightText: 2026 Analog Devices Inc.
# SPDX-License-Identifier: Apache-2.0

description: |
  Analog Devices ADGM3121 DPDT MEMS switch (DC-24GHz), SPI control mode,
  exposed as a MUX controller.

  The four MEMS switches (SW1..SW4) are modeled as a single control line
  whose state is a 4-bit switch bitmask: bit i selects SW(i+1), 1 = closed.
  mux_control_disconnect() opens all four switches (mask = 0).

  Example:

    &spi1 {
        adgm3121: adgm3121@0 {
            compatible = "adi,adgm3121";
            reg = <0>;
            spi-max-frequency = <10000000>;
            #mux-control-cells = <0>;
            #mux-state-cells = <1>;
        };
    };

    consumer {
        mux-controls = <&adgm3121>;        /* runtime switch mask */
        mux-states   = <&adgm3121 0x5>;    /* static: SW1 + SW3 closed */
    };

compatible: "adi,adgm3121"

include: [spi-device.yaml, mux-controller.yaml]

properties:
  "#mux-control-cells":
    const: 0

  "#mux-state-cells":
    const: 1

mux-state-cells:
  - switches
```

## dts/bindings/mux/gpio-mux.yaml
```yaml
# Copyright 2026 NXP
# SPDX-License-Identifier: Apache-2.0

description: |
  GPIO-based multiplexer.

  A set of GPIO lines drive a MUX select bus. The state value is encoded
  on the GPIOs as a binary pattern: bit N of state goes to mux-gpios[N].

  Single-channel by design: the controller has no addressing, so
  #mux-control-cells is 0 and #mux-state-cells is 1 (state value only).

  Example:

    mux0: mux-controller {
        compatible = "gpio-mux";
        #mux-control-cells = <0>;
        #mux-state-cells = <1>;
        mux-gpios = <&gpio0 5 GPIO_ACTIVE_HIGH>,
                    <&gpio0 6 GPIO_ACTIVE_HIGH>;
    };

    consumer {
        mux-controls = <&mux0>;          /* runtime state */
        mux-states   = <&mux0 2>;        /* static default state = 2 */
    };

compatible: "gpio-mux"

include: [base.yaml, mux-controller.yaml]

properties:
  mux-gpios:
    type: phandle-array
    required: true
    description: |
      GPIO lines driving the MUX select bus, in LSB-first order. Bit 0 of
      the state value is written to mux-gpios[0], bit 1 to mux-gpios[1],
      and so on.

  "#mux-control-cells":
    const: 0

  "#mux-state-cells":
    const: 1

mux-state-cells:
  - state
```

## dts/bindings/mux/mux-consumer.yaml
```yaml
# Copyright 2026 NXP
# SPDX-License-Identifier: Apache-2.0

# Properties to be included by devicetree nodes that consume one or more
# MUX controllers.

description: |
  Consumer-side properties for referencing MUX controllers.

  Use "mux-controls" when the consumer needs to drive the MUX state at
  runtime (state value is supplied by code).

  Use "mux-states" when the desired state is fixed in devicetree, and a
  single mux_state_apply() call is enough.

properties:
  mux-controls:
    type: phandle-array
    description: |
      List of MUX controller specifiers. Each entry is a phandle to a MUX
      controller followed by #mux-control-cells addressing cells.

  mux-control-names:
    type: string-array
    description: |
      Optional names for the entries in "mux-controls"

  mux-states:
    type: phandle-array
    description: |
      List of MUX state specifiers. Each entry is a phandle to a MUX
      controller followed by #mux-state-cells cells: the addressing cells
      followed by a trailing "state" cell carrying the default state value.

  mux-state-names:
    type: string-array
    description: |
      Optional names for the entries in "mux-states"
```

## dts/bindings/mux/mux-controller.yaml
```yaml
# Copyright 2026 NXP
# SPDX-License-Identifier: Apache-2.0

# Common fields for MUX (multiplexer) controllers.

properties:
  "#mux-control-cells":
    type: int
    required: true
    description: |
      Number of cells in a "mux-controls" specifier. These cells form the
      addressing portion only (which output line) and do NOT include the
      target state value. Drivers receive the addressing cells in
      mux_control::cells.

  "#mux-state-cells":
    type: int
    required: true
    description: |
      Number of cells in a "mux-states" specifier. Equals
      #mux-control-cells + 1: the trailing cell carries the default state
      value. Backends may name the trailing cell whatever best describes
      the hardware (e.g. "state" for a generic GPIO mux, "input" for an
      XBAR, "source" for a TRGMUX).
```

## dts/bindings/mux/nxp,inputmux.yaml
```yaml
# Copyright 2026 NXP
# SPDX-License-Identifier: Apache-2.0

description: |
  NXP INPUTMUX peripheral.

  The INPUTMUX is an on-chip signal router that connects internal
  trigger sources to peripheral capture/trigger inputs (e.g. CTIMER
  capture inputs, DMA triggers, PINT sources).

  Consumers reference an INPUTMUX via a phandle-array property and
  pass two specifier cells:
    - channel:    destination index inside the destination register
                  group (e.g. CAPTSEL0..3, PINTSEL0..7).
    - connection: 32-bit inputmux_connection_t value from the NXP HAL
                  header fsl_inputmux_connections.h. It encodes the
                  destination register-group offset in the upper bits
                  and the source/function id in the lower bits.

compatible: "nxp,inputmux"

include: base.yaml

properties:
  reg:
    required: true

  "#inputmux-cells":
    type: int
    const: 2

inputmux-cells:
  - channel
  - connection
```

## dts/bindings/mux/nxp,mcux-xbar.yaml
```yaml
# Copyright 2026 NXP
# SPDX-License-Identifier: Apache-2.0

description: |
  NXP MCUX XBAR (Crossbar Switch) peripheral binding.

  The XBAR peripheral routes signals between different on-chip peripherals,
  enabling flexible interconnection of timers, ADCs, DMA, and other peripherals.

  This driver uses the Zephyr MUX subsystem to provide devicetree-driven signal
  routing configuration.

  The XBAR uses a 2-cell format for mux-controls:
    - Cell 0: Input signal index (xbar_input_signal_t from MCUX HAL)
    - Cell 1: Output signal index (xbar_output_signal_t from MCUX HAL)

  The XBAR uses a 3-cell format for mux-states:
    - Cell 0: Input signal index
    - Cell 1: Output signal index
    - Cell 2: Enable (1 to configure XBAR output, 0 to skip configuration)

  Example usage:

    xbar0: xbar@40055000 {
        compatible = "nxp,mcux-xbar";
        reg = <0x40055000 0x1000>;
        clocks = <&syscon MCUX_XBAR_CLK>;
        #mux-control-cells = <2>;
        #mux-state-cells = <3>;
    };

    /* Configure XBAR at boot to route TMR0 output to ADC trigger (enable=1) */
    peripheral {
        mux-states = <&xbar0 XBAR_INPUT_TMR0_OUT XBAR_OUTPUT_ADC_TRIG 1>;
    };

    /* Runtime configuration using mux-controls */
    peripheral2 {
        mux-controls = <&xbar0 XBAR_INPUT_DMA_REQ XBAR_OUTPUT_GPIO>;
    };

compatible: "nxp,mcux-xbar"

include: [mux-controller.yaml, base.yaml]

properties:
  reg:
    required: true
    description: XBAR peripheral register base address and size

  clocks:
    required: true
    description: Clock configuration for XBAR peripheral

  '#mux-control-cells':
    const: 2
    description: |
      Number of cells in mux-controls property.
      Cell 0: Input signal index
      Cell 1: Output signal index

  '#mux-state-cells':
    const: 3
    description: |
      Number of cells in mux-states property.
      Cell 0: Input signal index
      Cell 1: Output signal index
      Cell 2: Enable (1 to configure XBAR output, 0 to skip configuration)

mux-control-cells:
  - input
  - output

mux-state-cells:
  - input
  - output
  - enable
```

## dts/bindings/mux/reg-mux.yaml
```yaml
# Copyright 2025 NXP
# SPDX-License-Identifier: Apache-2.0

description: |
  Generic register bitfield-based multiplexer controller.

  This binding describes a multiplexer whose channels are controlled by
  writing bitfield values into memory-mapped registers.  Each logical mux
  channel is described by an <offset, mask> pair inside the mux-reg-masks
  property, where:
    - offset  is the byte offset from the device base address to the
              control register
    - mask    is the bitmask that selects the relevant bitfield within
              that register

  Example:

    mux0: mux-controller@40010000 {
        compatible = "reg-mux";
        reg = <0x40010000 0x100>;
        #mux-control-cells = <1>;
        #mux-state-cells = <2>;

        /* Two channels: bit[1:0] and bit[3:2] of the same register */
        mux-reg-masks = <0x00 0x00000003>,  /* mux[0]: reg+0x00, bits[1:0] */
                        <0x00 0x0000000C>;  /* mux[1]: reg+0x00, bits[3:2] */
    };

  A consumer node references a channel with a mux-state specifier:

    some_node {
        /* Set mux channel 1 to state value 2 (writes 0b10 into bits[3:2]) */
        mux-states = <&mux0 1 2>;
    };

compatible: "reg-mux"

include: [base.yaml, mux-controller.yaml]

properties:
  mux-reg-masks:
    type: array
    description: |
      Flat array of <offset, mask> pairs, one pair per logical mux channel.

      offset - byte offset from the device base address to the target register.
      mask   - bitmask that identifies the bitfield controlling this channel.
               The state value written by the driver is shifted and masked
               into this field using FIELD_PREP(mask, state).

      The number of pairs determines the total number of available mux channels.
      Channel indices used in mux-control / mux-state specifiers map directly
      to the zero-based pair index in this array.

  '#mux-control-cells':
    const: 1
    description: |
      Number of cells in a mux-controls specifier for this controller.
      Always 1 for reg-mux; the single cell is the mux channel index.

  '#mux-state-cells':
    const: 2
    description: |
      Number of cells in a mux-states specifier for this controller.
      Always 2 for reg-mux:
        cell 0 (mux)   - index of the mux channel to configure
        cell 1 (state) - value to write into the channel's bitfield

mux-control-cells:
  - mux  # Zero-based index selecting one <offset, mask> pair from mux-reg-masks

mux-state-cells:
  - mux    # Zero-based index selecting one <offset, mask> pair from mux-reg-masks
  - state  # Value to be written into the selected bitfield via FIELD_PREP(mask, state)
```

## dts/bindings/net/microchip,lan78xx.yaml
```yaml
# SPDX-FileCopyrightText: Copyright (c) 2026 Narek Aydinyan
# SPDX-License-Identifier: Apache-2.0

description: Microchip LAN78xx USB-to-Ethernet adapter configuration

compatible: "microchip,lan78xx"

include:
  - name: ethernet-controller.yaml
  - name: base.yaml

properties:
  uhc:
    type: phandle
    required: true
    description: USB Host Controller device node (UHC) used to reach the adapter.

  vid:
    type: int
    default: 0x0424
    description: USB Vendor ID to match (default is Microchip 0x0424).

  pid:
    type: int
    default: 0x7800
    description: USB Product ID to match (default LAN78xx 0x7800).

  reset-gpios:
    type: phandle-array
    description: Optional reset GPIO controlling the LAN78xx or hub power/reset

  rx-buf-size:
    type: int
    default: 2048
    description: USB RX buffer size for bulk-IN transfers.

  rx-xfers:
    type: int
    default: 4
    description: Number of concurrent bulk-IN transfers kept queued.

  tx-inflight:
    type: int
    default: 4
    description: Number of concurrent bulk-OUT transfers kept queued.

  led-enable-mask:
    type: int
    default: 0
    description: |
      Bitmask of LAN78xx LED outputs to enable in HW_CFG.

      Bit 0 = LED0
      Bit 1 = LED1
      Bit 2 = LED2
      Bit 3 = LED3

      Examples:
        <0x1> enables LED0
        <0x2> enables LED1
        <0x4> enables LED2
        <0x8> enables LED3
        <0x3> enables LED0 and LED1
        <0xf> enables LED0..LED3
```

## dts/bindings/net/wireless/gpio-radio-coex.yaml
```yaml
# Copyright (c) 2022-2023 Dronetag s.r.o.
# SPDX-License-Identifier: Apache-2.0

description: |
    Generic representation of Coexistance pin interface for radios. This
    interface is usually available on Wifi/Bluetooth/LTE modules to
    interact with each other when sharing same antenna. This prevents
    any collisions between transmissions from different modules. The grant
    signal should signal that the external transceiver/module is not
    transmitting. Therefore you are free to perform any TX operations as
    required. When grant pin becomes inactive then you have time to
    finish all of the ongoing TX operations before the external
    transceiver begins their transmission. This is specified by the
    grant-delay-us property.

compatible: "gpio-radio-coex"

include: base.yaml

properties:
  grant-gpios:
    type: phandle-array
    required: true
    description: |
        GPIO input from the external transceiver

  grant-delay-us:
    type: int
    required: true
    description: |
        Delay after assertion for the external transceiver operation
```

## dts/bindings/net/wireless/gpio-rf-switch.yaml
```yaml
# Copyright (c) 2025 Mario Paja
# SPDX-License-Identifier: Apache-2.0

description: |
  Group of GPIO-controlled relays used to enable an RF switch and select the active antenna.

compatible: "gpio-rf-switch"

child-binding:
  description: GPIO rf switch child node
  properties:
    gpios:
      type: phandle-array
      required: true

    label:
      type: string
      description: Descriptive name of the switch
```
