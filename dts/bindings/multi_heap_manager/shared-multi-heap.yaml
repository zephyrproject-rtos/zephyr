## dts/bindings/net/wireless/nordic,nrf21540-fem.yaml
```yaml
# Copyright (c) 2020, 2021 Nordic Semiconductor ASA
# SPDX-License-Identifier: Apache-2.0


description: |
    nRF21540 Radio Front-End module.

    See the "nordic,nrf21540-fem-spi" binding to configure the SPI
    interface. The SPI interface should be configured as a child node
    of the SPI bus you have connected to the FEM. Then you "connect"
    the FEM and SPI configurations using the spi-if property.

    Here is an example nRF21540 configuration with a SPI interface
    selected, using the SPIM0 peripheral found on several nRF5 SoCs:

      &spi0 {
              compatible = "nordic,nrf-spim";
              status = "okay";
              cs-gpios = <&gpio1 3 GPIO_ACTIVE_LOW>;
              /* ... MISO/MOSI/SCK pin configuration goes here ... */

              my_spi_if: nrf21540-spi@0 {
                      compatible = "nordic,nrf21540-fem-spi";
                      reg = <0>;
                      spi-max-frequency = <8000000>;
              };
      };

      nrf_radio_fem: nrf21540 {
              compatible = "nordic,nrf21540-fem";
              tx-en-gpios = <&gpio0 2 GPIO_ACTIVE_HIGH>;
              rx-en-gpios = <&gpio0 5 GPIO_ACTIVE_HIGH>;
              spi-if = <&my_spi_if>;
              pdn-gpios = <...>;
              ant-sel-gpios = <...>;
              mode-gpios = <...>;
              /* ... other nRF21540 properties go here ... */
      };

      &radio {
              fem = <&nrf_radio_fem>;
      };

    In the above example, the nRF21540 is configured for use with:

      - TX_EN on P0.2 (from 'tx-en-gpios')
      - RX_EN on P0.5 (from 'rx-en-gpios')
      - SPI communication via SPIM0 (the bus, or parent node, of
        the 'my_spi_if' node
      - CSN on P1.3 (from index 0 in the bus node's 'cs-gpios' property)

    You must perform any additional required SPI pin configuration
    (nRF21540 MISO, MOSI, and SCK pins) within the SPI bus node
    ('spi0' in the above example). See your SPI node's binding for
    details on these pin mux properties. You can use any SPI node
    available in your SoC's devicetree.

    Configure any other nRF21540 pins as needed using 'pdn-gpios',
    'ant-sel-gpios', and 'mode-gpios' properties. If unsure about the
    format, use 'tx-en-gpios' as an example.

    Finally, the nRF5 SoC's radio peripheral is set up for use with
    the nRF21540 via the 'fem' property in the 'radio' node.

compatible: "nordic,nrf21540-fem"

include: base.yaml

properties:
  tx-en-gpios:
    type: phandle-array
    description: |
        GPIO of the SOC controlling TX_EN pin of the nRF21540
  rx-en-gpios:
    type: phandle-array
    description: |
        GPIO of the SOC controlling RX_EN pin of the nRF21540
  pdn-gpios:
    type: phandle-array
    description: |
        GPIO of the SOC controlling PDN pin of the nRF21540
  ant-sel-gpios:
    type: phandle-array
    description: |
        GPIO of the SOC controlling ANT-SEL pin of the nRF21540
  mode-gpios:
    type: phandle-array
    description: |
        GPIO of the SOC controlling MODE pin of the nRF21540
  spi-if:
    type: phandle
    description: |
        Reference to the nordic,nrf21540-fem-spi SPI bus interface.

        This must be present to support SPI control of the FEM.
  tx-en-settle-time-us:
    type: int
    default: 11
    description: |
        Settling time in microseconds from state PG to TX.

        Default value is based on Table 6 of the nRF21540 Product
        Specification (v1.0), and can be overridden for tuned
        configurations.
  rx-en-settle-time-us:
    type: int
    default: 11
    description: |
        Settling time in microseconds from state PG to RX.

        Default value is based on Table 6 of the nRF21540 Product
        Specification (v1.0), and can be overridden for tuned
        configurations.
  pdn-settle-time-us:
    type: int
    default: 18
    description: |
        Settling time in microseconds from state PD to PG.

        Default value is based on Table 6 of the nRF21540 Product
        Specification (v1.0), and can be overridden for tuned
        configurations.
  trx-hold-time-us:
    type: int
    default: 3
    description: |
        Power-off time in microseconds when changing from RX or TX to PG.

        Default value is based on Table 6 of the nRF21540 Product
        Specification (v1.0), and can be overridden for tuned
        configurations.
  supply-voltage-mv:
    type: int
    description: |
        nRF21540 supply voltage in mV.

        This is used if compensation for nRF21540 supply voltage is supported
        by software.
```

## dts/bindings/net/wireless/radio-fem-two-ctrl-pins.yaml
```yaml
# Copyright (c) 2020-2021 Nordic Semiconductor ASA
# SPDX-License-Identifier: Apache-2.0

description: |
    Generic radio Front-End Module (FEM) with a two-pin
    control interface (CTX, CRX).

    The CTX control pin is used to enable the Power Amplifier (PA) in
    the transmit path. This is therefore sometimes referred to as
    the "PA pin" in other contexts.

    The CRX control pin is used to enable the Low Noise Amplifier
    (LNA) in the receive path, and is sometimes referred to as
    the "LNA pin" in other contexts.

    Each of these pins is optional, and may be omitted if not present.
    (Though if you do specify a pin, you must also specify its
    corresponding settle-time-us property.)

compatible: "radio-fem-two-ctrl-pins"

include: base.yaml

properties:
  ctx-gpios:
    type: phandle-array
    description: |
        SoC GPIO connected to the CTX input pin on the FEM device.

  crx-gpios:
    type: phandle-array
    description: |
        SoC GPIO connected to the CRX input pin on the FEM device.

  ctx-settle-time-us:
    type: int
    description: |
        Desired minimum settling time, in microseconds, from
        assertion of the CTX pin to beginning of transmission.

  crx-settle-time-us:
    type: int
    description: |
        Desired minimum settling time, in microseconds, from
        assertion of the CRX pin to beginning of reception.

  tx-gain-db:
    type: int
    description: |
        TX gain of the PA of the FEM device, in dB.

  rx-gain-db:
    type: int
    description: |
        RX gain of the LNA of the FEM device, in dB.
```

## dts/bindings/net/wireless/radio.yaml
```yaml
# Copyright (c) 2025 Nordic Semiconductor ASA
# Copyright (c) 2025 Silicon Laboratories Inc.
# SPDX-License-Identifier: Apache-2.0

description: |
  Base binding for generic radio hardware capabilities that are not specific
  to any wireless protocol or vendor.

  These properties describe hardware-supported features that are common across
  different vendors but are not part of any specific wireless protocol
  specification. They are read-only and indicate what the hardware is capable
  of, not what features are currently enabled.

properties:
  radio-tx-high-power-supported:
    type: boolean
    description: |
      If set, indicates that the radio hardware supports high TX power settings.
      This capability enables transmission beyond standard power levels
      (typically >10 dBm).

      This property should be treated as read-only and should not be overridden;
      the correct value is provided for your target's SoC already.
```

## dts/bindings/net/wireless/silabs,series1-radio.yaml
```yaml
# Copyright (c) 2025 Silicon Laboratories Inc.
# SPDX-License-Identifier: Apache-2.0

title: Silicon Labs Series 1 Radio Interface

description: |
  Controls the radio transceiver on Silicon Labs Series 1 SoCs.

compatible: "silabs,series1-radio"

include: [base.yaml, ble-radio.yaml, radio.yaml]

properties:
  reg:
    required: true

  interrupts:
    required: true

  pa-initial-power-dbm:
    type: int
    required: true
    description: |
      Initial Power Amplifier power in dBm.

  pa-ramp-time-us:
    type: int
    required: true
    description: |
      Power Amplifier ramp time in microseconds.

  pa-voltage-mv:
    type: int
    required: true
    description: |
      Voltage on PAVDD supply pin in millivolts.

  pa-2p4ghz:
    type: string
    description: |
      Power Amplifier selection for 2.4 GHz.
      If this property is not set, no 2.4 GHz PA is enabled.
    enum:
      - hp
      - lp

  pa-subghz:
    type: string
    description: |
      Power Amplifier selection for sub-GHz.
      If this property is not set, no sub-GHz PA is enabled.
    enum:
      - hp
```

## dts/bindings/net/wireless/silabs,series2-radio.yaml
```yaml
# Copyright (c) 2025 Silicon Laboratories Inc.
# SPDX-License-Identifier: Apache-2.0

title: Silicon Labs Series 2 Radio Interface

description: |
  Controls the radio transceiver on Silicon Labs Series 2 SoCs.

compatible: "silabs,series2-radio"

include: [base.yaml, ble-radio.yaml]

properties:
  reg:
    required: true

  interrupts:
    required: true

  pa-initial-power-dbm:
    type: int
    required: true
    description: |
      Initial Power Amplifier power in dBm.

  pa-ramp-time-us:
    type: int
    required: true
    description: |
      Power Amplifier ramp time in microseconds.

  pa-voltage-mv:
    type: int
    required: true
    description: |
      Voltage on PAVDD supply pin in millivolts.

  pa-2p4ghz:
    type: string
    description: |
      Power Amplifier selection for 2.4 GHz. A value of 'highest' selects the highest
      available PA on the given device. Other values explicitly select a specific PA.
      Not all PAs are available on all devices, check device specific documentation.
      If this property is not set, no 2.4 GHz PA is enabled.
    enum:
      - highest
      - hp
      - mp
      - lp

  pa-subghz:
    type: string
    description: |
      Power Amplifier selection for sub-GHz. A value of 'highest' selects the highest
      available PA on the given device. This is the only available option. If this
      property is not set, no sub-GHz PA is enabled.
    enum:
      - highest

  ble-tx-high-power-supported:
    type: boolean
    description: |
      If set, indicates that the radio hardware supports high TX power settings.
      This is a vendor-specific capability that enables transmission beyond
      standard power levels (typically >10 dBm).
      This property should be treated as read-only and should not be overridden;
      the correct value is provided for your target's SoC already.
```

## dts/bindings/net/wireless/silabs,siwx91x-nwp.yaml
```yaml
# Copyright (c) 2025 Silicon Laboratories Inc.
# SPDX-License-Identifier: Apache-2.0

title: Silicon Labs SiWx91x NWP (Network Wireless Coprocessor)

description: |
  The Network Wireless Processor (NWP) manages Wi-Fi and Bluetooth connectivity on SiWx91x devices,
  offloading wireless networking tasks from the main processor and
  supporting configurable power and performance modes.

compatible: "silabs,siwx91x-nwp"

include: base.yaml

properties:
  interrupts:
    required: true

  stack-size:
    type: int
    description: Stack size for the NWP in bytes
    required: true

  power-profile:
    type: string
    description: Power/performance profile
    enum:
      - high-performance
      - associated-power-save
      - associated-power-save-low-latency
      - deep-sleep-without-ram-retention
      - deep-sleep-with-ram-retention
    required: true
```

## dts/bindings/net/wireless/ti,cc13xx-cc26xx-radio.yaml
```yaml
# Copyright (c) 2022 Nordic Semiconductor ASA
# SPDX-License-Identifier: Apache-2.0

description: TI SimpleLink CC13xx / CC26xx radio

compatible: "ti,cc13xx-cc26xx-radio"

include: base.yaml

properties:
  reg:
    required: true
```
