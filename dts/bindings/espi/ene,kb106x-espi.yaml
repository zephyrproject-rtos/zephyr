## dts/bindings/espi/microchip,mec5-espi.yaml
```yaml
# Copyright (c) 2024 Microchip Technology Inc.
# SPDX-License-Identifier: Apache-2.0

description: Microchip MEC5 eSPI target mode controller

compatible: "microchip,mec5-espi"

include: [espi-controller.yaml, pinctrl-device.yaml]

properties:
  reg:
    description: mmio register space
    required: true

  reg-names:
    required: true
    description: Name of each register space

  pinctrl-0:
    required: true

  pinctrl-names:
    required: true

  espi-alert-od-capable:
    type: boolean
    description: |
      Platform supports ESPI_ALERT# signal as opendrain in addition
      to push-pull. If this property is present it allows the Host
      eSPI Controller to select push-pull versus open-drain for
      this signal.

  espi-max-supp-freq-mhz:
    type: string
    default: "50"
    description: |
      Maximum supported frequency in MHz this eSPI target controller reports
      to the eSPI Host Controller.
    enum:
      - "20"
      - "25"
      - "33"
      - "50"
      - "66"

  espi-io-mode:
    type: string
    default: "IO124"
    description: |
      I/O mode(s) supported by this eSPI target controller exposed to
      the eSPI Host Controller via capability registers. The target may
      report single, single/dual, single/quad, or single/dual/quad.
    enum:
      - "IO1"
      - "IO12"
      - "IO14"
      - "IO124"

  vwires:
    type: phandle-array
    description: |
      Optional property to override hardware default configuration of MEC5
      Virtual Wire registers or configure unused VW registers. Each array
      entry is a phandle to a VW node from mchp-mec5-espi-vw-routing and an
      integer containing flags indicating the VW node properites for
      modification.

  vwire-names:
    type: string-array
    description: name of each virtual wire

  sirqs:
    type: array
    description: |
      Host Serial IRQ numbers assigned to this device. A value of 255
      disables SIRQ genaration.

  sirq-names:
    type: string-array
    description: |
      Names for the provided Serial IRQs. The number of names needs to match the
      number of sirqs.

  config-io-addr:
    type: int
    required: true
    description: |
      Host I/O base address for the eSPI legacy I/O configuration port.

  host-memmap-addr-high:
    type: int
    required: true
    description: |
      Contains bits [47:32] of the Host address range where all memory mapped
      host (logical) devices are mapped.

  sram-bar-addr-high:
    type: int
    required: true
    description: |
      Contains Host address bits [47:32] where both SRAM BAR's are mapped.

  "#vwire-cells":
    type: int
    const: 1

  "#ldn-cells":
    type: int
    const: 4

  "#sirq-cells":
    type: int
    const: 1

  "#sram-bar-cells":
    type: int
    const: 4

vwire-cells:
  - flags

ldn-cells:
  - ldn
  - hostaddr
  - haddrmsk
  - flags
```

## dts/bindings/espi/microchip,mec5-host-uart.yaml
```yaml
# Copyright (c) 2024 Microchip Technology Inc.
# SPDX-License-Identifier: Apache-2.0

description: Microchip MEC5 eSPI Mailbox host facing device

compatible: "microchip,mec5-host-uart"

include: [base.yaml, pinctrl-device.yaml]

# on-bus: espi

properties:
  pinctrl-0:
    required: true

  pinctrl-names:
    required: true

  hwdev:
    type: phandle
    required: true
    description: Handle to the UART hardware device node.

  host-infos:
    type: phandles
    description: |
      Handles to the device node containing properties:
      logical device number, host address, SIRQ, etc.
```

## dts/bindings/espi/microchip,mec5-kbc.yaml
```yaml
# Copyright (c) 2024 Microchip Technology Inc.
# SPDX-License-Identifier: Apache-2.0

description: Microchip MEC5 eSPI 8042 Keyboard Controller(KBC) host facing device

compatible: "microchip,mec5-kbc"

include: [base.yaml]

on-bus: espi

properties:
  reg:
    description: mmio register space
    required: true

  interrupts:
    required: true
    description: Interrupt number and priority for keyboard and mouse interrupts

  interrupt-names:
    required: true
    description: Names for Keyboard controller keyboard and mouse interrupts

  host-infos:
    type: phandles
    description: |
      Handles to the two logical device nodes containing host
      properties: logical device number, host address, etc.
```

## dts/bindings/espi/microchip,mec5-mailbox.yaml
```yaml
# Copyright (c) 2024 Microchip Technology Inc.
# SPDX-License-Identifier: Apache-2.0

description: Microchip MEC5 eSPI Mailbox host facing device

compatible: "microchip,mec5-mailbox"

include: [base.yaml]

on-bus: espi

properties:
  reg:
    description: mmio register space
    required: true

  interrupts:
    required: true
    description: Interrupt number and priority for Mailbox interrupt.

  host-infos:
    type: phandles
    description: |
      Handles to the two logical device nodes containing host
      properties: logical device number, host address, etc.
```

## dts/bindings/espi/microchip,mec5-shm-emi.yaml
```yaml
# Copyright (c) 2024 Microchip Technology Inc.
# SPDX-License-Identifier: Apache-2.0

description: |
  Microchip MEC5 eSPI EMI host facing device

compatible: "microchip,mec5-shm-emi"

include: [base.yaml]

on-bus: espi

properties:
  reg:
    description: mmio register space
    required: true

  interrupts:
    required: true
    description: Interrupt number and priority for EMI interrupt.

  host-infos:
    type: phandles
    description: |
      Handles to the two logical device nodes containing host
      properties: logical device number, host address, etc.
```

## dts/bindings/espi/microchip,xec-espi-host-dev.yaml
```yaml
# Copyright (c) 2021, Microchip Technology Inc.
# SPDX-License-Identifier: Apache-2.0

description: Microchip XEC eSPI Host devices

compatible: "microchip,xec-espi-host-dev"

include: [base.yaml]

on-bus: espi

properties:
    reg:
      required: true

    interrupts:
      required: false

    interrupt-names:
      required: false

    ldn:
      type: int
      required: true
      description: logical device number

    girqs:
      type: array
      required: false
      description: array of GIRQ and bit positions

    pcrs:
      type: array
      required: false
      description: PCR sleep register index and bit position

# optional properties application to different host facing devices
    host-io:
      type: int
      required: false
      description: |
        Logical device Host I/O (x86) base. Refer to SoC documentation for the
        number of I/O decoders implemented by a device (1 or 2) and the fixed
        I/O masks.

    host-io-addr-mask:
      type: int
      required: false
      description: |
        Host I/O address mask. This value is fixed for all HW and is only
        used by Port80 BIOS debug alias device to specify the byte lane the
        alias address is mapped to in the 80h to 83h I/O range.

    host-mem:
      type: int
      required: false
      description: |
        Logical device Host memory (x86) base address. Refer to SoC
        documentation for which logical devices implement a memory decoder
        and the fixed memory address masking.

    emi-mems:
      type: array
      required: false
      description: |
        Each EMI host device supports Host access to two SoC data memory
        regions. Each region requires three configuration parameters:
        Base address in the SoC data memory, read limit, and write limit.
        If bits[14:2] of the address written by the Host to the EC address
        register is less than the limit value the access is allowed. Bit[15]
        of the EC address selects which of the two memory regions is accessed.

    "emi-mem-cells":
      type: int
      const: 3

emi-mem-cells:
    - base
    - rdlimit
    - wrlimit
```

## dts/bindings/espi/microchip,xec-espi-saf-v2.yaml
```yaml
# Copyright (c) 2019 Intel Corporation
# Copyright (c) 2022 Microchip Technology Inc.
# SPDX-License-Identifier: Apache-2.0

description: Microchip ESPI SAF version 2 controller

compatible: "microchip,xec-espi-saf-v2"

include: espi-controller.yaml

properties:
  reg:
    description: mmio register space
    required: true

  girqs:
    type: array
    required: true
    description: Array of encoded interrupt information

  pcrs:
    type: array
    required: true
    description: Array of eSPI PCR register index and bit position

  poll-timeout:
    type: int
    description: poll flash busy timeout in 32KHz periods

  poll-interval:
    type: int
    description: interval between flash busy poll in 20 ns units

  consec-rd-timeout:
    type: int
    description: timeout after last read to resume supended operations in 20 ns units

  sus-chk-delay:
    type: int
    description: hold off poll after suspend in 20 ns units

  sus-rsm-interval:
    type: int
    description: force suspended erase or program to resume in 32KHz periods

  "#girq-cells":
    type: int
    const: 1

  "#pcr-cells":
    type: int
    const: 2

girq-cells:
  - girqinfo

pcr-cells:
  - regidx
  - bitpos
```

## dts/bindings/espi/microchip,xec-espi-saf.yaml
```yaml
# Copyright (c) 2019 Intel Corporation
# Copyright (c) 2020 Microchip Technology Inc.
# SPDX-License-Identifier: Apache-2.0

description: Microchip ESPI SAF controller

compatible: "microchip,xec-espi-saf"

include: espi-controller.yaml

properties:
  reg:
    description: mmio register space
    required: true

  io-girq:
    type: int
    description: soc group irq index for eSPI I/O

  poll-timeout:
    type: int
    description: poll flash busy timeout in 32KHz periods

  poll-interval:
    type: int
    description: interval between flash busy poll in 20 ns units

  consec-rd-timeout:
    type: int
    description: timeout after last read to resume supended operations in 20 ns units

  sus-chk-delay:
    type: int
    description: hold off poll after suspend in 20 ns units

  sus-rsm-interval:
    type: int
    description: force suspended erase or program to resume in 32KHz periods
```

## dts/bindings/espi/microchip,xec-espi-v2.yaml
```yaml
# Copyright (c) 2019 Intel Corporation
# Copyright (c) 2021 Microchip Technology Inc.
# SPDX-License-Identifier: Apache-2.0

description: Microchip ESPI V2 controller

compatible: "microchip,xec-espi-v2"

include: [espi-controller.yaml, pinctrl-device.yaml]

properties:
  reg:
    description: mmio register space
    required: true

  reg-names:
    required: true
    description: Name of each register space

  girqs:
    type: array
    required: true
    description: |
      Array of encoded interrupt information

  pcr-scr:
    type: int
    required: true
    description: |
      Encoded PCR sleep, clock required, reset register index and bit position.

  pinctrl-0:
    required: true

  pinctrl-names:
    required: true

  host-memmap-addr-high:
    type: int
    description: |
      Contains bits [47:32] of the Host address range where all memory mapped
      host (logical) devices are located in Host memory address space.

  sram-bar-addr-high:
    type: int
    description: |
      Contains Host address bits [47:32] where both SRAM BAR's are mapped
      to Host memory address space.
```

## dts/bindings/espi/microchip,xec-espi-vw-routing.yaml
```yaml
# Copyright (c) 2021 Microchip Technology Inc.
# SPDX-License-Identifier: Apache-2.0

description: Microchip XEC eSPI Virtual Wire routing

compatible: "microchip,xec-espi-vw-routing"

include: [base.yaml]

child-binding:
  description: |
    Child node containing the routing of an eSPI virtual wire to the SoC
    VW registers and ECIA GIRQ registers.
  properties:
    vw-reg:
      type: array
      required: true
      description: vw signal's register index and vw bitmask.

    vw-girq:
      type: array
      description: |
        Routing of MSVW source to aggregated GIRQs

        For example, OOB_RST_WARN is source 2 of MSVW01 routed
        to GIRQ24 b[5]. vw-girq = <24 5>;

    reset-state:
      type: string
      description: |
        Optional default virtual wire state on reset (0 or 1).
        If the property is not present hardware default is used.
      enum:
      - "HW_DFLT"
      - "0"
      - "1"

    reset-source:
      type: string
      description: |
        Optional reset source in addition to chip reset.
        0 is ESPI_RESET, 1 is RESET_SYS, 2 is RESET_SIO,
        and 3 is ESPI Platform Reset. If this property is not
        present the hardware default is used. Note: reset source
        affects all four virtual wires in the VW group.
      enum:
      - "HW_DFLT"
      - "ESPI_RESET"
      - "RESET_SYS"
      - "RESET_SIO"
      - "PLTRST"
```

## dts/bindings/espi/microchip,xec-espi.yaml
```yaml
# Copyright (c) 2019 Intel Corporation
# SPDX-License-Identifier: Apache-2.0

description: Microchip ESPI controller

compatible: "microchip,xec-espi"

include: [espi-controller.yaml, pinctrl-device.yaml]

properties:
  reg:
    description: mmio register space
    required: true

  io-girq:
    type: int
    description: soc group irq index for eSPI I/O
    required: true

  vw-girqs:
    type: array
    description: soc group irq indexes for eSPI virtual wires channel
    required: true

  pc-girq:
    type: int
    description: soc group irq index for eSPI peripheral channel
    required: true

  pinctrl-0:
    required: true

  pinctrl-names:
    required: true
```

## dts/bindings/espi/nuvoton,nct-espi-vw-conf.yaml
```yaml
# Copyright (c) 2025 Nuvoton Technology Corporation.
# SPDX-License-Identifier: Apache-2.0

description: Nuvoton NCT eSPI Virtual Wire (VW) mapping child node

compatible: "nuvoton,nct-espi-vw-conf"

child-binding:
    description: Child node to to present the mapping between VW signal, its core register and input source of MIWU
    properties:
       vw-reg:
          type: array
          required: true
          description: vw signal's register index and vw bitmask.

       vw-wui:
        type: phandle
        description: |
            Mapping table between Wake-Up Input (WUI) and vw input signal.

            For example the WUI mapping on NCT for VW_SLP5 would be
               vw-wui = <&wui_vw_slp_s5>;
```
