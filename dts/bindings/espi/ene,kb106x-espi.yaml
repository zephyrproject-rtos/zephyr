## dts/bindings/espi/ene,kb106x-espi.yaml
```yaml
# Copyright (c) 2026 ENE Technology Inc.
# SPDX-License-Identifier: Apache-2.0

description: ENE ESPI controller

compatible: "ene,kb106x-espi"

include: [espi-controller.yaml, pinctrl-device.yaml]

properties:
  reg:
    description: register space
    required: true

  espivw-reg:
    type: int
    description: espivw register space
    required: true

  espivw-tab:
    type: int
    description: espivw table space
    required: true

  espioob-reg:
    type: int
    description: espioob register space
    required: true

  espifa-reg:
    type: int
    description: espifa register space
    required: true

  hif-reg:
    type: int
    description: espi hif register space
    required: true

  kbc-reg:
    type: int
    description: espi kbc register space
    required: true

  eci-reg:
    type: int
    description: espi eci register space
    required: true

  dbi-reg:
    type: int
    description: espi debug io register space
    required: true

  legi-reg:
    type: int
    description: espi legacy io register space
    required: true

  mbx-reg:
    type: int
    description: espi mailbox io register space
    required: true

  uart-reg:
    type: int
    description: espi uart io register space
    required: true

  rst-gpios:
    type: phandle-array

  interrupts:
    required: true

  interrupt-names:
    required: true

  pinctrl-0:
    required: true

  pinctrl-names:
    required: true

  eci-port:
    type: int

  dbi0-port:
    type: int

  dbi1-port:
    type: int

  oob-max-timeout:
    type: int

  fa-max-timeout:
    type: int
```

## dts/bindings/espi/ene,kb1200-espi.yaml
```yaml
# Copyright (c) 2024 ENE Technology Inc.
# SPDX-License-Identifier: Apache-2.0

description: ENE ESPI controller

compatible: "ene,kb1200-espi"

include: [espi-controller.yaml, pinctrl-device.yaml]

properties:
  reg:
    description: register space
    required: true

  espivw-reg:
    type: int
    description: espivw register space
    required: true

  espivw-tab:
    type: int
    description: espivw table space
    required: true

  espioob-reg:
    type: int
    description: espioob register space
    required: true

  espifa-reg:
    type: int
    description: espifa register space
    required: true

  hif-reg:
    type: int
    description: esp hif register space
    required: true

  kbc-reg:
    type: int
    description: esp kbc table space
    required: true

  eci-reg:
    type: int
    description: esp eci register space
    required: true

  dbi-reg:
    type: int
    description: espi debug io register space
    required: true

  gpios:
    type: phandle-array

  interrupts:
    required: true

  interrupt-names:
    required: true

  pinctrl-0:
    required: true

  pinctrl-names:
    required: true
```

## dts/bindings/espi/espi-controller.yaml
```yaml
# Copyright (c) 2019 Intel Corporation
# SPDX-License-Identifier: Apache-2.0

# Common fields for ESPI devices

include: base.yaml

bus: espi
```

## dts/bindings/espi/espi.yaml
```yaml
# Copyright (c) 2019 Intel Corporation
#
# SPDX-License-Identifier: Apache-2.0

title: ESPI Base Structure

description: >
    This binding gives the base structures for all ESPI devices

inherits:
    !include base.yaml

child:
    bus: espi

properties:
    label:
      category: required
```

## dts/bindings/espi/gpio-espi.yaml
```yaml
# Copyright (c) 2018, Intel Corporation
# SPDX-License-Identifier: Apache-2.0

description: GPIO eSPI parent node

compatible: "gpio-espi"

description: GPIOs required for eSPI handshake
properties:
   pwrg-gpios:
      type: phandle-array
      required: true
      description: Board GPIO used to detect power rails are stable.
   rsm-gpios:
      type: phandle-array
      required: true
      description: Board GPIO used to notify eSPI master that handshake
         power has stabilized and bare minimum initialization in eSPI slave
         is complete so eSPI master can initiate eSPI handshake.
```

## dts/bindings/espi/intel,espi-peci.yaml
```yaml
# Copyright (c) 2026 Intel Corporation
# SPDX - License - Identifier : Apache - 2.0

description: PECI node associated to this eSPI bus.

compatible: "intel,espi-peci"

on-bus: espi

properties:
  peci-addr:
    type: int
    default: 0x7
    description: |
      I2C/PECI address of the PECI controller exposed over the eSPI bus.
      This address is used by the host to communicate with the PECI device.
```

## dts/bindings/espi/ite,it8xxx2-espi.yaml
```yaml
# Copyright (c) 2023 ITE Corporation. All Rights Reserved.
# SPDX-License-Identifier: Apache-2.0

description: ITE IT8XXX2 ESPI controller

compatible: "ite,it8xxx2-espi"

include: espi-controller.yaml

properties:
  wucctrl:
    type: phandles
    description: |
      eSPI node WUC interrupt.
```

## dts/bindings/espi/microchip,mec5-acpi-ec-hcmd.yaml
```yaml
# Copyright (c) 2024 Microchip Technology Inc.
# SPDX-License-Identifier: Apache-2.0

description: |
  Microchip MEC5 eSPI peripheral channel ACPI_EC for processing
  host specific commands.

compatible: "microchip,mec5-acpi-ec-hcmd"

include: [base.yaml]

on-bus: espi

properties:
  reg:
    description: mmio register space
    required: true

  interrupts:
    required: true
    description: Interrupt number and priority for ACPI_EC IBF and OBE interrupts.

  interrupt-names:
    required: true
    description: Names for ACPI_EC IBF and OBE interrupts.

  four-byte-data-mode:
    type: boolean
    description: |
      ACPI_EC data register size is defined as one byte. Add this boolean to
      configure the data register to be four bytes. When four byte mode is
      enabled the IBF bit is cleared by the host reading data byte 3. The
      Host memory or I/O address should be at least 4-byte aligned when this
      mode is enabled.

  host-infos:
    type: phandles
    description: |
      Handle to the logical device node containing host
      properties: logical device number, host address, etc.
```

## dts/bindings/espi/microchip,mec5-bdp.yaml
```yaml
# Copyright (c) 2024 Microchip Technology Inc.
# SPDX-License-Identifier: Apache-2.0

description: Microchip MEC5 eSPI BIOS I/O port capture device

compatible: "microchip,mec5-bdp"

include: [base.yaml]

on-bus: espi

properties:
  reg:
    description: mmio register space
    required: true

  interrupts:
    required: true
    description: Interrupt number and priority for BDP interrupt.

  fifo-threshold:
    type: string
    description: |
      BDP will generate an interrupt to the EC when the number of
      Host I/O writes to the capture range is equal to or greater
      than this value.
    enum:
      - "1"
      - "4"
      - "8"
      - "16"
      - "20"
      - "24"
      - "28"
      - "30"

  host-infos:
    type: phandles
    description: |
      Handles to the two logical device nodes containing host
      properties: logical device number, host address, etc.
```

## dts/bindings/espi/microchip,mec5-espi-host-dev.yaml
```yaml
# Copyright (c) 2024 Microchip Technology Inc.
# SPDX-License-Identifier: Apache-2.0

description: Microchip MEC5 eSPI Host Logical Devices

compatible: "microchip,mec5-espi-host-dev"

include: [espi-controller.yaml]

child-binding:
  description: |
    Child node containing eSPI Host device properties.
  properties:
    devhandle:
      type: phandle
      description: Handle to the Host devices hardware node

    ldn:
      type: int
      required: true
      description: Host device logical device number.

    host-address:
      type: int
      required: true
      description: |
        Host address the logical device appears at. On x86 systems this
        address may be I/O or memory space.

    host-mem-space:
      type: boolean
      description: |
        If present indicates host-address is in Host memory address space.

    bdp-host-alias-byte-lane:
      type: int
      description: |
        BDP peripheral has an 8-bit alias Host I/O address which
        can be mapped to a specific byte lane (0-3) of the primary
        I/O port.

    sirqs:
      type: array
      description: |
        Host Serial IRQ numbers assigned to this device. A value of 255
        disables SIRQ genaration.

        Example: Mailbox implements two Serial IRQ slots.
          sirqs = <13 14>;
        Example: UART implements one Serial IRQ slot.
          sirqs = <3>;

    sirq-names:
      type: string-array
      description: |
        Names for the provided Serial IRQs. The number of names needs to match the
        number of sirqs.

    "#sirq-cells":
      type: int
      const: 1
```

## dts/bindings/espi/microchip,mec5-espi-sram-bar.yaml
```yaml
# Copyright (c) 2024 Microchip Technology Inc.
# SPDX-License-Identifier: Apache-2.0

description: Microchip MEC5 eSPI SRAM BAR

compatible: "microchip,mec5-espi-sram-bar"

child-binding:
  description: |
    Child node containing eSPI SRAM BARs hardware. SRAM BAR allows
    mapping of a section of EC SRAM to the Host address space.
  properties:
    id:
      type: int
      required: true
      description: |
        Zero based SRAM BAR identification.

    host-address-lsw:
      type: int
      required: true
      description: |
        Low 32-bits of the Host address the EC SRAM can be accessed at.

    region-base:
      type: int
      required: true
      description: |
        Base address of the EC SRAM being mapped. Hardware requires the
        address to aligned with the SRAM region size.

    region-size:
      type: string
      required: true
      description: |
        Region size is powers of 2 from 0 to 15 creating regions from 1
        byte to 32KB. Note: hardware enforces region base address to
        be aligned on the size.
      enum:
        - "1B"
        - "2B"
        - "4B"
        - "8B"
        - "16B"
        - "32B"
        - "64B"
        - "128B"
        - "256B"
        - "512B"
        - "1KB"
        - "2KB"
        - "4KB"
        - "8KB"
        - "16KB"
        - "32KB"

    access:
      type: string
      required: true
      default: "DISABLED"
      description: |
        Host access mode: disabled, read-only, write-only, and read-write.
      enum:
        - "DISABLED"
        - "READ_ONLY"
        - "WRITE_ONLY"
        - "READ_WRITE"
```

## dts/bindings/espi/microchip,mec5-espi-vw-map.yaml
```yaml
# Copyright (c) 2024 Microchip Technology Inc.
# SPDX-License-Identifier: Apache-2.0

description: Microchip MEC5 map eSPI virtual wires to hardware

compatible: "microchip,mec5-espi-vw-map"

child-binding:
  description: |
    Child node containing the mapping of eSPI Virtual Wires to the
    Host and MEC5 hardware.
  properties:
    host-index:
      type: int
      required: true
      description: |
        Virtual wires are grouped by eSPI into sets of four identfied by a Host
        index and source position. This field specifies the Host index used for
        a group of vwires.

    vw-reg:
      type: int
      required: true
      description: |
        Zero based logical index into MEC5 eSPI Virtual Wire register banks.

    reset-source:
      type: string
      default: "reset_espi"
      description: |
        Specifies the reset signal causing the HW to load default values into
        all four VWires.  The reset value of each vwire is one of the properties
        of the vwire nodes whose handles are specified in the vwires property.
      enum:
        - "reset_espi"
        - "reset_sys"
        - "reset_sio"
        - "pltrst"

    direction:
      type: string
      required: true
      description: |
        Downstream is Controller(Host) to Target(EC) and upstream is Target(EC) to
        Controller(Host).
      enum:
        - "downstream"
        - "upstream"

    override-defaults:
      type: boolean
      description: |
        If present the driver will override default(POR) eSPI Host Index VWire
        register configuration.
```

## dts/bindings/espi/microchip,mec5-espi-vwires.yaml
```yaml
# Copyright (c) 2024 Microchip Technology Inc.
# SPDX-License-Identifier: Apache-2.0

description: Microchip MEC5 eSPI Virtual Wire routing

compatible: "microchip,mec5-espi-vwires"

child-binding:
  description: |
    Child node containing the routing of an eSPI virtual wire to the SoC
    VW registers and ECIA GIRQ registers.
  properties:
    source-bit:
      type: int
      required: true
      description: |
        Position in the virtual wire group of 4 signals. Allowd values are
        0 to 3. Default values are based upon eSPI version 1.5 specification.

    vw-group:
      type: phandle
      required: true
      description: |
        Phandle to the virtual wire group containing this signal.

        Example: eSPI SLP_S3 is source 0 in the group mapped to CTVW00 registers
          vw-group = <&ctvw00>;

    irq-sel:
      type: string
      default: "disabled"
      description: |
        Controller to Target virtual wires can generate an interrupt to EC.
        This field selects edge or level mode.
      enum:
        - "disabled"
        - "level low"
        - "level high"
        - "rising edge"
        - "falling edge"
        - "both edges"

    reset-state:
      type: int
      required: true
      description: |
        Value (0 or 1) loaded into the virtual wire by hardware when the
        group's configured reset event occurs.

    vw-name:
      type: string
      required: true
      description: |
        The last part of the virtual wire signal name from the zephyr
        espi driver header file. This property is appended with an
        underscore to ESPI_VWIRE_SIGNAL to create the enumerated type
        value name.
```
