## dts/bindings/ethernet/brcm,bcm2711-genet.yaml
```yaml
# Copyright (c) 2026 Khaled Abdalla <khaled.3bdulaziz@gmail.com>
# SPDX-License-Identifier: Apache-2.0

description: |
  Broadcom BCM2711 GENET v5 Gigabit Ethernet MAC controller.
  The GENET block includes an integrated UMAC (Unimac), Hardware Filter
  Block (HFB), TX/RX DMA rings, and an internal MDIO bus for PHY management.

compatible: "brcm,bcm2711-genet"

include: [ethernet-controller.yaml]

properties:
  reg:
    required: true
    description: MMIO base address and size of the GENET register block.

  interrupts:
    required: true
    description: |
      Two interrupt lines:
        [0] INTRL2_0 — RX DMA done, link events, MDIO done.
        [1] INTRL2_1 — TX DMA done.

  phy-addr:
    type: int
    required: true
    description: MDIO address of the PHY (0-31).

  rx-internal-delay-ps:
    type: int
    default: 0
    description: |
      Internal RX delay in picoseconds inserted by the MAC.
      Set to a non-zero value to enable RGMII-RXID mode (PHY provides
      TX delay; MAC provides RX delay). Typical value: 2000 (2 ns).

  local-mac-address:
    type: uint8-array
    description: |
      6-byte MAC address. If omitted the driver generates a random address
      from the Zephyr entropy source.
```

## dts/bindings/ethernet/brcm,genet.yaml
```yaml
# Copyright (c) 2026 Muhammad Waleed Badar
# SPDX-License-Identifier: Apache-2.0

description: Broadcom GENET (Gigabit Ethernet) Controller

compatible: "brcm,genet"

include: ethernet-controller.yaml

properties:
  reg:
    required: true

  phy-handle:
    required: true

  phy-connection-type:
    const: "rgmii"
```

## dts/bindings/ethernet/davicom,dm8806-phy.yaml
```yaml
# Copyright 2024 Robert Slawinski <robert.slawinski1@gmail.com>
# SPDX-License-Identifier: Apache-2.0

description: Davicom DM8806 Ethernet MAC and PHY with RMII interface

compatible: "davicom,dm8806-phy"

include: [ethernet-phy.yaml]

on-bus: mdio

properties:
  reg:
    required: true
    description: |
      5-bit PHY address for Internal PHY Registers group of Davicom DM8806 MAC
      PHY Ethernet Switch Controller, separate for each MAC PHY, build in DM8806
      and correlate with Ethenet port. DM8806 has five MAC PHY inside, but it is
      not mandatory to define all of them in device tree if there is no need to
      communicate with all of them. Each MAC PHY has its own PHY address, which
      together with Register address creates the absolute address of the
      concrete register in conrete MAC PHY acoring to Clause 22 MDIO
      communication standard. Below example shows how the PHY address and
      Register address are glued together in Internal PHY Registers group:

                        Internal PHY Registers
      Port0: (5-bit PHY Address) + (5-bit Register address) = Absolute address

      Absolute address is the address of the concrete register in MAC PHY0
      which is responsible for Ethernet Port0 in Davicom DM8806
  reg-switch:
    required: true
    description: |
      5-bit PHY address for Switch Per-Port Registers group of Davicom DM8806
      MAC PHY Ethernet Switch Controller, separate for each MAC PHY, build in
      DM8806 and correlate with Ethenet port. DM8806 has five MAC PHY inside,
      but it is not mandatory to define all of them in device tree if there is
      no need to communicate with all of them. Each MAC PHY has its own PHY
      address, which together with Register address creates the absolute address
      of the concrete register in conrete MAC PHY acoring to Clause 22 MDIO
      communication standard. Below example shows how the PHY address and
      Register address are glued together in Switch Per-Port Registers group:

                        Switch Per-Port Registers
      Port0: (5bit PHY Address) + (5bit Register address) = Absolute address

      Absolute address is the address of the concrete register in MAC PHY0
      which is responsible for Ethernet Port0 in Davicom DM8806
  reset-gpios:
    type: phandle-array
    description: GPIO connected to MAC PHY reset signal pin. Reset is active low.
  int-gpios:
    type: phandle-array
    description: GPIO for   upt signal indicating MAC PHY state change.
  davicom,interface-type:
    type: string
    required: true
    description: Which type of phy connection the mac phy is set up for
    enum:
      - "mii"
      - "rmii"
```

## dts/bindings/ethernet/davicom,dm9051.yaml
```yaml
# Copyright (c) 2026 Andrei-Edward Popa
# SPDX-License-Identifier: Apache-2.0

description: Davicom DM9051 10/100BASE-T Ethernet Controller with SPI interface

compatible: "davicom,dm9051"

include: [spi-device.yaml, ethernet-controller.yaml]

properties:
  int-gpios:
    type: phandle-array
    required: true
    description: |
      Interrupt pin of DM9051. The interrupt pin is active low.
```

## dts/bindings/ethernet/espressif,esp32-eth.yaml
```yaml
# Copyright (c) 2022 Grant Ramsay <grant.ramsay@hotmail.com>
# Copyright (c) 2026 Espressif Systems (Shanghai) Co., Ltd.
# SPDX-License-Identifier: Apache-2.0

description: ESP32 Ethernet

compatible: "espressif,esp32-eth"

include:
  - name: ethernet-controller.yaml
  - name: pinctrl-device.yaml

properties:
  phy-handle:
    required: true

  ref-clk-output-gpios:
    type: phandle-array
    description: |
      GPIO to output RMII Clock.

  pinctrl-0:
    description: |
      RMII pin configuration, using the RMII_* macros from the SoC
      pinctrl header to select the GPIO for each signal.
```

## dts/bindings/ethernet/ethernet,fixed-link.yaml
```yaml
# Copyright (c) 2020, DENX Software Engineering GmbH
#		      Lukasz Majewski <lukma@denx.de>
# SPDX-License-Identifier: Apache-2.0

child-binding:
    description: Fixed link ethernet node
    properties:
       speed:
          type: int
          required: true
          description: The speed of fixed link
          enum:
            - 100
            - 10
       full-duplex:
          type: boolean
          required: false
          description: The fixed link operates in full duplex mode
```

## dts/bindings/ethernet/ethernet-phy.yaml
```yaml
# Copyright (c) 2021 IP-Logix Inc.
# SPDX-License-Identifier: Apache-2.0

# Common fields for MIIPHY devices

description: Generic MII PHY

compatible: "ethernet-phy"

include: phy.yaml

properties:
    address:
      type: int
      required: true
      description: PHY address
    mdio:
      type: phandle
      required: true
      description: MDIO driver node
    no-reset:
      type: boolean
      required: false
      description: Do not reset the PHY during initialization
    late_mii_start:
      type: boolean
      description: Start MII communication when callback is registered (instead of init)
    fixed-link:
      type: string
      required: false
      description: This link is fixed and does not require PHY configuration
      enum:
        - "10BASE-T Half-Duplex"
        - "10BASE-T Full-Duplex"
        - "100BASE-T Half-Duplex"
        - "100BASE-T Full-Duplex"
```

## dts/bindings/ethernet/ethernet.yaml
```yaml
# Copyright (c) 2018, Linaro Limited
# SPDX-License-Identifier: Apache-2.0

# Common fields for Ethernet devices

include: base.yaml

properties:
    local-mac-address:
      type: uint8-array
      required: false
      description: Specifies the MAC address that was assigned to the network device
    label:
      required: true
```

## dts/bindings/ethernet/gd,gd32-ethernet.yaml
```yaml
# Copyright (c) 2022 Carbon Robotics
# SPDX-License-Identifier: Apache-2.0

description: GigaDevice GD32 Ethernet

compatible: "gd,gd32-ethernet"

include: ["ethernet.yaml", "ethernet,fixed-link.yaml", "pinctrl-device.yaml"]

properties:
    reg:
      required: true
    interrupts:
      required: true
    pinctrl-0:
      required: true
    pinctrl-names:
      required: true
```
