## dts/bindings/espi/nuvoton,nct-espi.yaml
```yaml
# Copyright (c) 2025 Nuvoton Technology Corporation.
# SPDX-License-Identifier: Apache-2.0

description: Nuvoton, NCT-eSPI node

compatible: "nuvoton,nct-espi"

include: [espi-controller.yaml, pinctrl-device.yaml]

properties:
    reg:
      description: mmio register space
      required: true

    clocks:
        required: true
        description: configurations of device source clock controller

    espi-rst-wui:
        type: phandle
        required: true
        description: |
            Mapping table between Wake-Up Input (WUI) and ESPI_RST signal.

            For example the WUI mapping on NCT would be
               espi-rst-wui = <&wui_espi_rst>;

    rx-plsize:
        type: int
        required: true
        description: The maximum receive channel payload size.

    tx-plsize:
        type: int
        required: true
        description: The maximum transmit channel payload size.
```

## dts/bindings/espi/nuvoton,npcm-espi-taf.yaml
```yaml
# Copyright (c) 2023 Nuvoton Technology Corporation.
# SPDX-License-Identifier: Apache-2.0

description: |
    The target flash devices accessed by Nuvoton eSPI TAF controller.

    Representation:

      espi_taf: espitaf@4000a000 {
        compatible = "nuvoton,npcm-espi-taf";
        reg = <0x4000a000 0x1000>;

        mapped-addr = <0x70000000>;
        max-read-sz = "NPCM_ESPI_TAF_MAX_READ_REQ_64B";
        erase-sz = "NPCM_ESPI_TAF_ERASE_BLOCK_SIZE_4KB";

        #address-cells = <1>;
        #size-cells = <1>;
        status = "okay";
      };

compatible: "nuvoton,npcm-espi-taf"

include: [espi-controller.yaml, pinctrl-device.yaml]

properties:
  mapped-addr:
    type: int
    description: |
      Mapped memory address of direct read access for flash.
    required: true

  erase-sz:
    type: string
    required: true
    description: |
      Erase block size of target flash. The default was 4KB Erase Block Size.
      All Intel platforms require support for at least 4 KB Erase Block Size.
    default: "NPCM_ESPI_TAF_ERASE_BLOCK_SIZE_4KB"
    enum:
      - "NPCM_ESPI_TAF_ERASE_BLOCK_SIZE_4KB"
      - "NPCM_ESPI_TAF_ERASE_BLOCK_SIZE_32KB"
      - "NPCM_ESPI_TAF_ERASE_BLOCK_SIZE_64KB"
      - "NPCM_ESPI_TAF_ERASE_BLOCK_SIZE_128KB"

  max-read-sz:
    type: string
    required: true
    description: |
      Maximum read request size of flash access channel. The default was 64 bytes.
      This value is recommended in datasheet.
    default: "NPCM_ESPI_TAF_MAX_READ_REQ_64B"
    enum:
      - "NPCM_ESPI_TAF_MAX_READ_REQ_64B"
      - "NPCM_ESPI_TAF_MAX_READ_REQ_128B"
      - "NPCM_ESPI_TAF_MAX_READ_REQ_256B"
      - "NPCM_ESPI_TAF_MAX_READ_REQ_512B"
      - "NPCM_ESPI_TAF_MAX_READ_REQ_1024B"
      - "NPCM_ESPI_TAF_MAX_READ_REQ_2048B"
      - "NPCM_ESPI_TAF_MAX_READ_REQ_4096B"
```

## dts/bindings/espi/nuvoton,npcm-espi.yaml
```yaml
# Copyright (c) 2020 Nuvoton Technology Corporation.
# SPDX-License-Identifier: Apache-2.0

description: Nuvoton, NPCM-eSPI node

compatible: "nuvoton,npcm-espi"

include: [espi-controller.yaml, pinctrl-device.yaml]

properties:
    reg:
      description: mmio register space
      required: true

    clocks:
        required: true
        description: configurations of device source clock controller

    espi-rst-wui:
        type: phandle
        required: true
        description: |
            Mapping table between Wake-Up Input (WUI) and ESPI_RST signal.

            For example the WUI mapping on NPCM would be
               espi-rst-wui = <&wui_espi_rst>;
```

## dts/bindings/espi/nuvoton,npcx-espi-taf.yaml
```yaml
# Copyright (c) 2023 Nuvoton Technology Corporation.
# SPDX-License-Identifier: Apache-2.0

description: |
    The target flash devices accessed by Nuvoton eSPI TAF controller.

    Representation:

      espi_taf: espitaf@4000a000 {
        compatible = "nuvoton,npcx-espi-taf";
        reg = <0x4000a000 0x2000>;

        mapped-addr = <0x68000000>;
        max-read-sz = "NPCX_ESPI_TAF_MAX_READ_REQ_64B";
        erase-sz = "NPCX_ESPI_TAF_ERASE_BLOCK_SIZE_4KB";

        #address-cells = <1>;
        #size-cells = <1>;
        status = "okay";
      };

compatible: "nuvoton,npcx-espi-taf"

include: [espi-controller.yaml, pinctrl-device.yaml]

properties:
  mapped-addr:
    type: int
    description: |
      Mapped memory address of direct read access for flash.
    required: true

  erase-sz:
    type: string
    required: true
    description: |
      Erase block size of target flash. The default was 4KB Erase Block Size.
      All Intel platforms require support for at least 4 KB Erase Block Size.
    default: "NPCX_ESPI_TAF_ERASE_BLOCK_SIZE_4KB"
    enum:
      - "NPCX_ESPI_TAF_ERASE_BLOCK_SIZE_4KB"
      - "NPCX_ESPI_TAF_ERASE_BLOCK_SIZE_32KB"
      - "NPCX_ESPI_TAF_ERASE_BLOCK_SIZE_64KB"
      - "NPCX_ESPI_TAF_ERASE_BLOCK_SIZE_128KB"

  max-read-sz:
    type: string
    required: true
    description: |
      Maximum read request size of flash access channel. The default was 64 bytes.
      This value is recommended in datasheet.
    default: "NPCX_ESPI_TAF_MAX_READ_REQ_64B"
    enum:
      - "NPCX_ESPI_TAF_MAX_READ_REQ_64B"
      - "NPCX_ESPI_TAF_MAX_READ_REQ_128B"
      - "NPCX_ESPI_TAF_MAX_READ_REQ_256B"
      - "NPCX_ESPI_TAF_MAX_READ_REQ_512B"
      - "NPCX_ESPI_TAF_MAX_READ_REQ_1024B"
      - "NPCX_ESPI_TAF_MAX_READ_REQ_2048B"
      - "NPCX_ESPI_TAF_MAX_READ_REQ_4096B"

  rpmc-cntr:
    type: int
    description: |
      RPMC counter on RPMC flash devices.
    default: 0

  rpmc-op1-code:
    type: int
    description: |
      RPMC OP1 opcode on RPMC flash devices.
    default: 0
```

## dts/bindings/espi/nuvoton,npcx-espi-vw-conf.yaml
```yaml
# Copyright (c) 2020 Nuvoton Technology Corporation.
# SPDX-License-Identifier: Apache-2.0

description: Nuvoton NPCX eSPI Virtual Wire (VW) mapping child node

compatible: "nuvoton,npcx-espi-vw-conf"

child-binding:
  description: |
    Child node to to present the mapping between VW signal, its core register and input source of
    MIWU

  properties:
    vw-reg:
      type: array
      required: true
      description: vw signal's register index and vw bitmask.

    vw-wui:
      type: phandle
      description: |
         Mapping table between Wake-Up Input (WUI) and vw input signal.

         For example the WUI mapping on NPCX7 for VW_SLP5 would be
            vw-wui = <&wui_vw_slp_s5>;
```

## dts/bindings/espi/nuvoton,npcx-espi.yaml
```yaml
# Copyright (c) 2020 Nuvoton Technology Corporation.
# SPDX-License-Identifier: Apache-2.0

description: Nuvoton, NPCX-eSPI node

compatible: "nuvoton,npcx-espi"

include: [espi-controller.yaml, pinctrl-device.yaml]

properties:
  reg:
    description: mmio register space
    required: true

  clocks:
    required: true
    description: configurations of device source clock controller

  pinctrl-0:
    required: true

  pinctrl-names:
    required: true

  espi-rst-wui:
    type: phandle
    required: true
    description: |
        Mapping table between Wake-Up Input (WUI) and ESPI_RST signal.

        For example the WUI mapping on NPCX7 would be
           espi-rst-wui = <&wui_cr_sin1>;

  rx-plsize:
    type: int
    required: true
    description: The maximum receive channel payload size.

  tx-plsize:
    type: int
    required: true
    description: The maximum transmit channel payload size.

  vw-index-extend-set:
    type: array
    description: |
      Array of encoded virtual wire information
      Update the vw index in group setting. Here is the format.
      < ESPI_NPCX_VW_EX_VAL(direction, group_number, index) >
      direction: 1 for ESPI_CONTROLLER_TO_TARGET and 0 for ESPI_TARGET_TO_CONTROLLER.
      group_number: The number of VWEVMS or VWEVSM.
      index: The index to be replaced.

      For example, update the index of VWEVMS6 into 0x4A and the index of VWEVSM8 into 0x53
        vw-index-extend-set = < ESPI_NPCX_VW_EX_VAL(1, 6, 0x4A)
                                ESPI_NPCX_VW_EX_VAL(0, 8, 0x53) >
```

## dts/bindings/espi/nuvoton,npcx-host-sub.yaml
```yaml
# Copyright (c) 2020 Nuvoton Technology Corporation.
# SPDX-License-Identifier: Apache-2.0

description: Nuvoton, NPCX-Host Sub-Modules node

compatible: "nuvoton,npcx-host-sub"

include: [base.yaml]

properties:
  reg:
    description: mmio register space
    required: true

  clocks:
    required: true
    description: configurations of device source clock controller

  host-acc-wui:
    type: phandle
    required: true
    description: |
        Mapping table between Wake-Up Input (WUI) and any legacy host
        access transactions.

        For example the WUI mapping on NPCX7 would be
           host-acc-wui = <&wui_host_acc>;
```

## dts/bindings/espi/nuvoton,npcx-host-uart.yaml
```yaml
# Copyright (c) 2020 Nuvoton Technology Corporation.
# SPDX-License-Identifier: Apache-2.0

description: Nuvoton, NPCX-Host UART IO node

compatible: "nuvoton,npcx-host-uart"

include: [base.yaml, pinctrl-device.yaml]

properties:
  pinctrl-0:
    required: true
  pinctrl-names:
    required: true
```

## dts/bindings/espi/realtek,rts5912-espi.yaml
```yaml
# Copyright (c) 2025, Realtek, SIBG-SD7
# SPDX-License-Identifier: Apache-2.0

description: Realtek RTS5912 eSPI controller

compatible: "realtek,rts5912-espi"

include: [espi-controller.yaml, pinctrl-device.yaml]

properties:
  reg:
    description: mmio register space
    required: true

  pinctrl-0:
    required: true

  pinctrl-names:
    required: true

  cs-gpios:
    description: |
      select the cs pin to support the espi wakeup
      and it is required when CONFIG_PM is enabled.
      please check include/zephyr/dt-bindings/gpio/realtek-gpio.h
      For example:
      cs-gpios = <RTS5912_GPIO004 0>;
    type: phandle-array
```

## dts/bindings/espi/zephyr,espi-emul-controller.yaml
```yaml
# Copyright 2020 Google LLC
# SPDX-License-Identifier: Apache-2.0

description: Zephyr eSPI Emulation controller

compatible: "zephyr,espi-emul-controller"

include: espi-controller.yaml

properties:
    reg:
      required: true
```

## dts/bindings/ethernet/adi,adin1110.yaml
```yaml
# Copyright (c) 2023 Analog Devices Inc.
# SPDX-License-Identifier: Apache-2.0

description: |
  ADIN1110 standalone 10BASE-T1L Ethernet controller with SPI interface.

  An example:

  adin1110: adin1110@0 {
          compatible = "adi,adin1110";
          reg = <0x0>;
          spi-max-frequency = <25000000>;
          int-gpios   = <&gpioe 12 (GPIO_ACTIVE_LOW | GPIO_PULL_UP)>;
          reset-gpios = <&gpioe 8 GPIO_ACTIVE_LOW>;
          port1 {
              local-mac-address = [ CA 2F B7 10 23 63 ];
          };
          mdio: mdio {
                  compatible = "adi,adin2111-mdio";
                  status = "okay";
                  #address-cells = <1>;
                  #size-cells = <0>;
                  ethernet-phy@1 {
                    reg = <0x1>;
                    compatible = "adi,adin2111-phy";
                    status = "okay";
                  };
          };
  };

compatible: "adi,adin1110"

include: adi,adin2111.yaml
```

## dts/bindings/ethernet/adi,adin1140.yaml
```yaml
# Copyright (c) 2024-2026 Analog Devices Inc.
# SPDX-License-Identifier: Apache-2.0

description: |
  ADIN1140 10BASE-T1S Ethernet MAC-PHY with SPI Interface

compatible: "adi,adin1140"

include: [spi-device.yaml, ethernet-controller.yaml]

properties:
  int-gpios:
    type: phandle-array
    required: true
    description: |
      The interrupt (IRQn) pin of ADIN1140 is active low.
      If connected directly the MCU pin should be configured
      as active low.
  wake-gpios:
    type: phandle-array
    required: true
    description: |
      WAKE pin of ADIN1140 is used to trigger a wake-up of the
      local PHY and to optionally send a WUP over the network.
      By default, it is active high.
  tx-cut-through-en:
    type: boolean
    description: Transmit Cut-Through Enable.
  rx-cut-through-en:
    type: boolean
    description: Receive Cut-Through Enable.

examples:
  - |
    adin1140: adin1140@0 {
            compatible = "adi,adin1140";
            reg = <0x0>;
            spi-max-frequency = <DT_FREQ_M(25)>;
            int-gpios = <&gpioc 1 (GPIO_ACTIVE_LOW | GPIO_PULL_UP)>;
            wake-gpios = <&gpioc 2 (GPIO_ACTIVE_HIGH | GPIO_PULL_DOWN)>;
            local-mac-address = [ 00 E0 22 FE DA D0 ];
            phy-handle = <&adin1140_phy>;
            status = "okay";

            mdio {
                    compatible = "adi,adin1140-mdio";
                    #address-cells = <1>;
                    #size-cells = <0>;

                    adin1140_phy: ethernet-phy@0 {
                            reg = <0x0>;
                            compatible = "adi,adin1140-phy";
                            plca-enable;
                            plca-node-id = <0>;
                            plca-node-count = <5>;
                            plca-burst-count = <0>;
                            plca-burst-timer = <0x60>;
                            plca-to-timer = <0x20>;
                    };
            };
    };
```

## dts/bindings/ethernet/adi,adin2111-phy.yaml
```yaml
# Copyright (c) 2023 PHOENIX CONTACT Electronics GmbH
# SPDX-License-Identifier: Apache-2.0

description: ADIN2111 PHY

compatible: "adi,adin2111-phy"

include: phy.yaml

on-bus: mdio

properties:
  reg:
    required: true
    description: 5-bit physical/port address (PRTAD).
  led0-en:
    type: boolean
    description: Enable LED 0.
  led1-en:
    type: boolean
    description: Enable LED 1.
  disable-tx-mode-24v:
    type: boolean
    description: |
      Disables requirement of 2.4V TX operating mode in the AN advertisement.
```

## dts/bindings/ethernet/atmel,gmac-common.yaml
```yaml
# Copyright (c) 2020 Stephanos Ioannidis <root@stephanos.io>
# Copyright (c) 2020-2021 Gerson Fernando Budke <nandojve@gmail.com>
# SPDX-License-Identifier: Apache-2.0

include:
  - name: ethernet-controller.yaml
  - name: pinctrl-device.yaml

properties:
  phy-handle:
    required: true

  num-queues:
    type: int
    required: true
    description: |
      Number of hardware TX and RX queues.

  max-speed:
    type: int
    default: 100
    description: |
      This specifies maximum speed in Mbit/s supported by the device.  The
      gmac driver supports 10Mbit/s and 100Mbit/s.  Using 100, as default
      value, enables driver to configure 10 and 100Mbit/s speeds.

  mac-eeprom:
    type: phandle
    description: phandle to I2C eeprom device node.

  phy-connection-type:
    default: "rmii"

  ref-clk-source:
    type: string
    default: "internal"
    description: |
      Specifies the source for the ethernet MAC reference clock.
    enum:
      - "internal"
      - "external"
```

## dts/bindings/ethernet/atmel,sam-gmac.yaml
```yaml
# Copyright (c) 2021-2023 Gerson Fernando Budke <nandojve@gmail.com>
# SPDX-License-Identifier: Apache-2.0

description: Atmel SAM-family GMAC Ethernet

compatible: "atmel,sam-gmac"

include: atmel,gmac-common.yaml

properties:
  clocks:
    required: true
```

## dts/bindings/ethernet/atmel,sam0-gmac.yaml
```yaml
# Copyright (c) 2021 Gerson Fernando Budke <nandojve@gmail.com>
# SPDX-License-Identifier: Apache-2.0

description: Atmel SAM0-family GMAC Ethernet

compatible: "atmel,sam0-gmac"

include: atmel,gmac-common.yaml
```
