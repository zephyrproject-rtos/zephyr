## dts/bindings/can/microchip,mpfs-can.yaml
```yaml
#
# Copyright (C) 2025 embedded brains GmbH & Co. KG
#
# SPDX-License-Identifier: Apache-2.0
#

description: Microchip MPFS CAN Controller

compatible: "microchip,mpfs-can"

include: [can-controller.yaml, reset-device.yaml]

properties:
  reg:
    type: array
    required: true

  interrupts:
    required: true

  clock-frequency:
    description: |
      The CAN module input clock is derived from the MSS PLL output.  The
      supported frequencies in MHz are 8, 16, 24, 32, 40, 48, 56, 64, 72, and
      80.
    type: int
    enum:
      - 8000000
      - 16000000
      - 24000000
      - 32000000
      - 40000000
      - 48000000
      - 56000000
      - 64000000
      - 72000000
      - 80000000
    required: true
```

## dts/bindings/can/microchip,pic32cxsg-can.yaml
```yaml
description: Specialization of Bosch m_can CAN FD controller for Microchip PIC32CXSG

compatible: "microchip,pic32cxsg-can"

include:
  - name: bosch,m_can-base.yaml
  - name: pinctrl-device.yaml

properties:
  reg:
    required: true

  interrupts:
    required: true

  interrupt-names:
    required: true

  clocks:
    required: true

  clock-names:
    required: true

  divider:
    type: int
    required: true
    description: Clock divider of GLCK7 used by CAN as clock source
```

## dts/bindings/can/nordic,nrf-can.yaml
```yaml
# Copyright (c) 2024 Nordic Semiconductor ASA
# SPDX-License-Identifier: Apache-2.0

description: Nordic CAN (Controller Area Network)

compatible: "nordic,nrf-can"

include:
  - base.yaml
  - pinctrl-device.yaml
  - bosch,m_can-base.yaml

properties:
  reg:
    required: true

  clocks:
    required: true

  pinctrl-0:
    required: true
```

## dts/bindings/can/nuvoton,numaker-canfd.yaml
```yaml
# Copyright (c) 2023 Nuvoton Technology Corporation
# SPDX-License-Identifier: Apache-2.0

description: Nuvoton NuMaker CAN FD controller, using Bosch M_CAN IP

compatible: "nuvoton,numaker-canfd"

include: ["bosch,m_can-base.yaml", reset-device.yaml, pinctrl-device.yaml]

properties:
  reg:
    required: true

  interrupts:
    required: true

  interrupt-names:
    required: true

  resets:
    required: true

  clocks:
    required: true
```

## dts/bindings/can/nuvoton,numaker.yaml
```yaml
# Copyright (c) 2022 Nuvoton Technology Corporation
# SPDX-License-Identifier: Apache-2.0

description: Nuvoton NuMaker CAN-FD controller, using Bosch M_CAN IP

compatible: "nuvoton,numaker"

include: ["can-fd-controller.yaml", "pinctrl-device.yaml"]

properties:
    reg:
      required: true

    interrupts:
      required: true

    reset:
      required: true
      type: int

    clocks:
      required: true

    pinctrl-0:
      required: true
```

## dts/bindings/can/nxp,flexcan.yaml
```yaml
# Copyright (c) 2019-2026 Vestas Wind Systems A/S
# SPDX-License-Identifier: Apache-2.0

description: |
  NXP FlexCAN controller

compatible: "nxp,flexcan"

include: ["can-controller.yaml", "pinctrl-device.yaml"]

properties:
  reg:
    required: true

  interrupts:
    required: true

  clocks:
    required: true

  clock-names:
    description: |
      Required if the "clk-source" property is present.

  clk-source:
    type: int
    enum:
      - 0
      - 1
    description: |
      CAN engine clock source. The value of this property, if present, selects the corresponding
      named clock from the "clocks" property. A value of "0" selects "clksrc0" whereas a value of
      "1" selects "clksrc1".

      The value of this property is written to the CLKSRC bit of the FlexCAN CTRL1 register for
      controlling the 1-bit, internal clock multiplexer.

      Omit this property for FlexCAN instances that do not have a 1-bit, internal multiplexer
      (FlexCAN CTRL1 register bit 13 is marked as "reserved").

  number-of-mb:
    type: int
    enum:
      - 16
      - 32
      - 64
      - 96
      - 128
    required: true
    description: |
      Number of 8-byte sized message buffers (MBs) supported by this FlexCAN instance. CAN FD mode,
      if supported, uses 64-byte sized MBs, resulting in fewer available MBs.

  max-filters:
    type: int
    description: |
      Maximum number of concurrently active RX filters. The allowed range value depends on the
      number of available message buffers for the FlexCAN instance.

      If this property is not set, the default maximum number of RX filters set via Kconfig will be
      used instead.

examples:
  - |
    flexcan0: can@40024000 {
      status = "okay";
      compatible = "nxp,flexcan";
      reg = <0x40024000 0x1000>;
      interrupts = <78 0>, <79 0>, <80 0>, <81 0>;
      interrupt-names = "warning", "error", "wake-up", "mb-0-15";
      clocks = <&scg KINETIS_SCG_BUS_CLK>;
      clock-names = "clksrc1";
      clk-source = <1>;
      number-of-mb = <16>;
      pinctrl-0 = <&pinmux_flexcan0>;
      pinctrl-names = "default";

      can-transceiver {
        max-bitrate = <1000000>;
      };
    };
```

## dts/bindings/can/nxp,kinetis-flexcan.yaml
```yaml
# Copyright (c) 2019 Vestas Wind Systems A/S
# SPDX-License-Identifier: Apache-2.0

description: NXP FlexCAN controller

compatible: "nxp,kinetis-flexcan"

include: ["can-controller.yaml", "pinctrl-device.yaml"]

properties:
  reg:
    required: true

  interrupts:
    required: true

  clocks:
    required: true

  clk-source:
    type: int
    required: true
    description: CAN engine clock source
```

## dts/bindings/can/nxp,lpc-mcan.yaml
```yaml
description: NXP LPC SoC series MCAN CAN FD controller

compatible: "nxp,lpc-mcan"

include: ["bosch,m_can-base.yaml", pinctrl-device.yaml, "reset-device.yaml"]

properties:
  reg:
    required: true

  interrupts:
    required: true

  interrupt-names:
    required: true

  clocks:
    required: true

  use-external-timestamp-counter:
    type: boolean
    description: |
      Use external 16-bit timestamp counter clocked by the CPUCLK.

  external-timestamp-counter-prescaler:
    type: int
    default: 1
    description: |
      Configure the prescaler for the external timestamp counter. Valid range is 1 to 2048. Default
      is 1, corresponding to the ETSCC register reset value.
```

## dts/bindings/can/nxp,s32-canxl.yaml
```yaml
# Copyright 2022 NXP
#
# SPDX-License-Identifier: Apache-2.0

description: NXP S32 CANXL controller

compatible: "nxp,s32-canxl"

include: ["can-fd-controller.yaml", "pinctrl-device.yaml"]

properties:
  reg:
    required: true

  interrupts:
    required: true

  clock-frequency:
    type: int
    required: true
    description: Module clock frequency in Hz.

  pinctrl-0:
    required: true

  pinctrl-names:
    required: true
```

## dts/bindings/can/realtek,bee-can.yaml
```yaml
# Copyright (c) 2026, Realtek Semiconductor Corporation
# SPDX-License-Identifier: Apache-2.0

description: |
  Bee CAN controller.

compatible: "realtek,bee-can"

include: [can-controller.yaml, pinctrl-device.yaml]

properties:
  reg:
    required: true

  interrupts:
    required: true

  clocks:
    required: true

  pinctrl-0:
    required: true

  pinctrl-names:
    required: true

  rx-timestamp-prescaler:
    type: int
    description: |
      Prescaler value for computing the RX timestamps of received frames.
      The timestamp counter is derived from the CAN source clock divided by this value.
      A value of 1 means the timestamp counter runs at the CAN source clock rate.
    min: 1
    max: 256
```

## dts/bindings/can/renesas,ra-canfd-global.yaml
```yaml
# Copyright (c) 2024 Renesas Electronics Corporation
# SPDX-License-Identifier: Apache-2.0

description: Renesas RA CANFD controller global

compatible: "renesas,ra-canfd-global"

include: [base.yaml]

properties:
  interrupts:
    required: true

  clocks:
    required: true

  dll-min-freq:
    type: int
    description: |
      Specifies the Data Link Layer clock limit on this device: DLL clock frequency > dll-min-freq.

  dll-max-freq:
    type: int
    description: |
      Specifies the Data Link Layer clock limit on this device: DLL clock frequency < dll-max-freq.
```

## dts/bindings/can/renesas,ra-canfd.yaml
```yaml
# Copyright (c) 2024 Renesas Electronics Corporation
# SPDX-License-Identifier: Apache-2.0

description: Renesas RA CANFD controller

compatible: "renesas,ra-canfd"

include: [can-fd-controller.yaml, pinctrl-device.yaml]

properties:
  interrupts:
    required: true

  interrupt-names:
    required: true
    description: |
      Interrupts must be given corresponding names so that the shim driver can recognize them.
        - "err": channel error
        - "tx": transmission completion from channel
        - "rx": successful reception in a Common FIFO in RX mode

  clocks:
    required: true

  channel:
    type: int
    required: true

  rx-max-filters:
    type: int
    description: |
      To determine the maximum rx filters can be added on this CAN device.
      Valid range: 0 - 16
```

## dts/bindings/can/renesas,rcar-can.yaml
```yaml
description: Renesas R-Car CAN controller

compatible: "renesas,rcar-can"

include: [can-controller.yaml, pinctrl-device.yaml]

properties:
    reg:
      required: true

    interrupts:
      required: true

    clocks:
      required: true
```

## dts/bindings/can/renesas,rcar-rscanfd-global.yaml
```yaml
# Copyright (c) 2026 BayLibre, SAS
# SPDX-License-Identifier: Apache-2.0

description: Renesas R-Car RS-CANFD controller global

compatible: "renesas,rcar-rscanfd-global"

include: [base.yaml]

properties:
  reg:
    required: true

  clocks:
    required: true
```

## dts/bindings/can/renesas,rcar-rscanfd.yaml
```yaml
# Copyright (c) 2026 BayLibre, SAS
# SPDX-License-Identifier: Apache-2.0

description: Renesas R-Car RS-CANFD channel

compatible: "renesas,rcar-rscanfd"

include: [can-controller.yaml, pinctrl-device.yaml]

properties:
  interrupts:
    required: true

  channel:
    type: int
    required: true
    min: 0
    max: 7
```

## dts/bindings/can/renesas,rz-canfd-global.yaml
```yaml
# Copyright (c) 2025 Renesas Electronics Corporation
# SPDX-License-Identifier: Apache-2.0

description: Renesas RZ CANFD controller global

compatible: "renesas,rz-canfd-global"

include: [base.yaml]

properties:
  interrupts:
    required: true
```

## dts/bindings/can/renesas,rz-canfd.yaml
```yaml
# Copyright (c) 2025 Renesas Electronics Corporation
# SPDX-License-Identifier: Apache-2.0

description: Renesas RZ CANFD controller

compatible: "renesas,rz-canfd"

include: [can-fd-controller.yaml, pinctrl-device.yaml]

properties:
  interrupts:
    required: true

  channel:
    type: int
    required: true

  clocks:
    required: true

  rx-max-filters:
    type: int
    required: true
    description: |
      To determine the maximum rx filters can be added on this CAN device.
      Valid range: 1 - 128
```

## dts/bindings/can/st,stm32-bxcan.yaml
```yaml
description: STM32 CAN controller

compatible: "st,stm32-bxcan"

include: [can-controller.yaml, pinctrl-device.yaml]

properties:
  reg:
    required: true

  interrupts:
    required: true

  clocks:
    required: true

  pinctrl-0:
    required: true

  pinctrl-names:
    required: true

  master-can-reg:
    type: int
    description: master can reg when different from current instance
```

## dts/bindings/can/st,stm32-can.yaml
```yaml
description: STM32 CAN controller

compatible: "st,stm32-can"

include: [can-controller.yaml, pinctrl-device.yaml]

properties:
    reg:
      required: true

    interrupts:
      required: true

    clocks:
      required: true

    pinctrl-0:
      required: true

    pinctrl-names:
      required: true

    master-can-reg:
      type: int
      required: false
      description: master can reg when different from current instance
```

## dts/bindings/can/st,stm32-fdcan.yaml
```yaml
title: STM32 FDCAN CAN FD controller

description: |
  STM32 Controller Area Network (CAN) controller with Flexible Data (FD) rate and fixed message RAM
  layout.

compatible: "st,stm32-fdcan"

include: ["bosch,m_can-base.yaml", "pinctrl-device.yaml"]

properties:
  clocks:
    required: true

  reg:
    required: true

  interrupts:
    required: true

  interrupt-names:
    required: true

  clk-divider:
    type: int
    enum:
      - 1
      - 2
      - 4
      - 6
      - 8
      - 10
      - 12
      - 14
      - 16
      - 18
      - 20
      - 22
      - 24
      - 26
      - 28
      - 30
    description: |
      FDCAN kernel/domain clock divider. The resulting clock is fed to the FDCAN time quanta
      clock. Note that the divisor is common to all 'st,stm32-fdcan' instances.

      The clock divider, which is set via the FDCAN_CKDIV register, defaults to divide by 1 unless
      this property is provided.

  external-timestamp-counter:
    type: phandle
    description: |
      Phandle to the counter device to be used as the external RX timestamp source.

      When this property is defined, the driver configures the FDCAN Timestamp
      Counter Configuration (TSCC) to use the External Timestamp (TSS=0x2).

      Hardware Constraint: The selected timer must be physically routed to the
      fdcan_ts input in the SoC interconnect. (e.g. TIM3 on STM32G4). The exact timer
      connected to the fdcan_ts input can be found in the reference manual of the specific SoC.

examples:
  - |
      fdcan1: can@40006400 {
        compatible = "st,stm32-fdcan";
        reg = <0x40006400 0x400>, <0x4000b400 0x350>;
        reg-names = "m_can", "message_ram";
        interrupts = <21 0>, <22 0>;
        interrupt-names = "int0", "int1";
        clocks = <&rcc STM32_CLOCK(APB1, 12)>,
                 <&rcc STM32_SRC_PLL_Q FDCAN_SEL(1)>;
        bosch,mram-cfg = <0x0 28 8 3 3 0 3 3>;
        status = okay";
      };
```

## dts/bindings/can/st,stm32-shared-can.yaml
```yaml
description: STM32 CAN controller

compatible: "st,stm32-shared-can"

include: stm32-base.yaml

properties:

    filter-controller:
      type: phandles
      required: false
      description: |
        Handle to the CAN controller that controls the filters (Master CAN)
```

## dts/bindings/can/st,stm32h7-fdcan.yaml
```yaml
title: STM32H7 series (and compatible) FDCAN CAN FD controller

description: |
  STM32 Controller Area Network (CAN) controller with Flexible Data (FD) rate and Clock Calibration
  Unit (CCU).

compatible: "st,stm32h7-fdcan"

include: ["bosch,m_can-base.yaml", "pinctrl-device.yaml"]

properties:
  clocks:
    required: true

  reg:
    required: true

  interrupts:
    required: true

  interrupt-names:
    required: true

  clk-divider:
    type: int
    enum:
      - 1
      - 2
      - 4
      - 6
      - 8
      - 10
      - 12
      - 14
      - 16
      - 18
      - 20
      - 22
      - 24
      - 26
      - 28
      - 30
    description: |
      FDCAN kernel/domain clock divider. The resulting clock is fed to the FDCAN time quanta
      clock. Note that the divisor is common to all 'st,stm32h7-fdcan' instances.

      The clock divider, which is set via the FDCAN_CCU->CCFG_CDIV register, defaults to divide by 1
      unless this property is provided.

examples:
  - |
      fdcan1: can@4000a000 {
        compatible = "st,stm32h7-fdcan";
        reg = <0x4000a000 0x400>, <0x4000ac00 0x350>;
        reg-names = "m_can", "message_ram";
        clocks = <&rcc STM32_CLOCK(APB1_2, 8)>,
                 <&rcc STM32_SRC_PLL2_Q FDCAN_SEL(2)>;
        interrupts = <19 0>, <21 0>, <63 0>;
        interrupt-names = "int0", "int1", "calib";
        bosch,mram-cfg = <0x0 28 8 3 3 0 3 3>;
        status = okay";
      };
```
