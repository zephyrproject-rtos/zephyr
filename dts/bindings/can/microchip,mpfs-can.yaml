## dts/bindings/can/stm32-base.yaml
```yaml
description: STM32 CAN controller base

include: can-controller.yaml

properties:
    reg:
      required: true

    interrupts:
      required: true

    clocks:
      required: true

    pinctrl-0:
      type: phandles
      required: false
      description: |
        GPIO pin configuration for CAN RX and TX. The phandles are
        expected to reference pinctrl nodes, e.g.

          pinctrl-0 = <&can1_rx_pa11 &can1_tx_pa12>;

    filter-banks:
      type: int
      required: true
      description: |
        Number of filter banks used by this can controller.
```

## dts/bindings/can/ti,mcan.yaml
```yaml
# Copyright (c) 2026 Texas Instruments
# SPDX-License-Identifier: Apache-2.0

description: Texas Instruments M_CAN CAN driver

compatible: "ti,mcan"

include: ["bosch,m_can-base.yaml", "pinctrl-device.yaml"]

properties:
  reg:
    required: true

  clocks:
    required: true

  interrupts:
    required: true

  interrupt-names:
    required: true
```

## dts/bindings/can/ti,mspm0-canfd.yaml
```yaml
# Copyright (c) 2026 Texas Instruments
# SPDX-License-Identifier: Apache-2.0

description: TI MSPM0 CANFD

compatible: "ti,mspm0-canfd"

include: ["bosch,m_can-base.yaml", "pinctrl-device.yaml"]

properties:
  reg:
    required: true

  interrupts:
    required: true

  clocks:
    required: true

  ti,divider:
    type: int
    required: true
    enum:
      - 1
      - 2
      - 4
    description: |
      CANCLK divider ratio for MCAN functional clock.
      Valid values are 1, 2, or 4. Default is 1 if omitted.
```
