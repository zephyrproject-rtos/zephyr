## dts/bindings/can/bosch,m-can-base.yaml
```yaml
description: Bosch m_can CAN-FD controller base

compatible: "bosch,m-can-base"

properties:
    std-filter-elements:
      type: int
      required: true

    ext-filter-elements:
      type: int
      required: true

    rx-fifo0-elements:
      type: int
      required: true

    rx-fifo1-elements:
      type: int
      required: true

    rx-buffer-elements:
      type: int
      required: true

    tx-buffer-elements:
      type: int
      required: true
```

## dts/bindings/can/bosch,m-can.yaml
```yaml
description: Bosch m_can CAN-FD controller

compatible: "bosch,m-can"

include: can-fd-controller.yaml

properties:
    reg:
      required: true

    interrupts:
      required: true

    one-shot:
      type: boolean
      required: false
      description: |
        Disable automatic retransmissions. A CAN frame will only be transmitted
        once, independently of the transmission result (successful, error, or
        arbitration lost).
```

## dts/bindings/can/bosch,m_can-base.yaml
```yaml
description: Bosch M_CAN CAN FD controller base

include: [can-fd-controller.yaml]

properties:
  bosch,mram-cfg:
    type: array
    required: true
    description: |
      Bosch M_CAN message RAM configuration. The cells in the array have the following format:

      <offset std-filter-elements ext-filter-elements rx-fifo0-elements rx-fifo1-elements
      rx-buffer-elements tx-event-fifo-elements tx-buffer-elements>

      The 'offset' is an address offset of the message RAM where the following elements start
      from. This is normally set to 0x0 when using a non-shared message RAM. The remaining cells
      specify how many elements are allocated for each filter type/FIFO/buffer.

      The Bosch M_CAN IP supports the following elements:
      11-bit Filter	 0-128 elements / 0-128 words
      29-bit Filter	  0-64 elements / 0-128 words
      Rx FIFO 0		    0-64 elements / 0-1152 words
      Rx FIFO 1		    0-64 elements / 0-1152 words
      Rx Buffers	    0-64 elements / 0-1152 words
      Tx Event FIFO	  0-32 elements / 0-64 words
      Tx Buffers	    0-32 elements / 0-576 words

  bosch,timestamp-counter-prescaler:
    type: int
    enum:
      - 1
      - 2
      - 3
      - 4
      - 5
      - 6
      - 7
      - 8
      - 9
      - 10
      - 11
      - 12
      - 13
      - 14
      - 15
      - 16
    default: 1
    description: |
      Configures the internal timestamp counter time unit in multiples of CAN bit times. Valid range
      is 1 to 16. The default value is a prescaler of 1, such that the time unit equals one CAN bit
      time.
```

## dts/bindings/can/bosch-mcan.yaml
```yaml
description: Bosch m_can CAN-FD controller

compatible: "bosch,m-can"

include: can-fd-controller.yaml

properties:
    reg:
      required: true

    interrupts:
      required: true
```

## dts/bindings/can/bosch\,m_can.yaml
```yaml
description: Bosch M_CAN CAN FD generic driver

compatible: "bosch,m_can"

include:
  - name: bosch,m_can-base.yaml
  - name: pinctrl-device.yaml

properties:
  reg:
    required: true

  clock-frequency:
    type: int
    description: |
      Optional frequency in Hertz to use if clocks are not defined

  interrupts:
    required: true

  interrupt-names:
    required: true
```

## dts/bindings/can/can-controller.yaml
```yaml
# Common fields for CAN controllers

include: base.yaml

properties:
  bus-speed:
    type: int
    deprecated: true
    description: |
      Deprecated. This property has been renamed to bitrate.

      Initial bitrate in bit/s. If this is unset, the initial bitrate is set to
      CONFIG_CAN_DEFAULT_BITRATE.
  bitrate:
    type: int
    description: |
      Initial bitrate in bit/s. If this is unset, the initial bitrate is set to
      CONFIG_CAN_DEFAULT_BITRATE.
  sample-point:
    type: int
    description: |
      Initial sample point in per mille (e.g. 875 equals 87.5%).

      If this is unset (or if it is set to 0), the initial sample point will default to 75.0% for
      bitrates over 800 kbit/s, 80.0% for bitrates over 500 kbit/s, and 87.5% for all other
      bitrates.
  phys:
    type: phandle
    description: |
      Actively controlled CAN transceiver.

      Example:
        transceiver0: can-phy0 {
          compatible = "nxp,tja1040", "can-transceiver-gpio";
          standby-gpios = <gpioa 0 GPIO_ACTIVE_HIGH>;
          max-bitrate = <1000000>;
          #phy-cells = <0>;
        };

        &can0 {
          status = "okay";

          phys = <&transceiver0>;
        };

child-binding:
  description: |
    Passive CAN transceiver. The child node must be named "can-transceiver".

    Example:
      &can0 {
        status = "okay";

        can-transceiver {
          max-bitrate = <1000000>;
        };
      };

  properties:
    min-bitrate:
      type: int
      description: |
        The minimum bitrate supported by the CAN transceiver in bits/s.

    max-bitrate:
      type: int
      required: true
      description: |
        The maximum bitrate supported by the CAN transceiver in bits/s.
```

## dts/bindings/can/can-device.yaml
```yaml
# Copyright (c) 2018 Alexander Wachter
# SPDX-License-Identifier: Apache-2.0

# Common fields for CAN devices

include: base.yaml

on-bus: can

properties:
    reg:
      required: true
    label:
      required: true
```

## dts/bindings/can/can-fd-controller.yaml
```yaml
# Common fields for CAN FD controllers

include: can-controller.yaml

properties:
  bus-speed-data:
    type: int
    deprecated: true
    description: |
      Deprecated. This property has been renamed to bitrate-data.

      Initial data phase bitrate in bit/s.  If this is unset, the initial data phase bitrate is set
      to CONFIG_CAN_DEFAULT_BITRATE_DATA.
  bitrate-data:
    type: int
    description: |
      Initial data phase bitrate in bit/s.  If this is unset, the initial data phase bitrate is set
      to CONFIG_CAN_DEFAULT_BITRATE_DATA.
  sample-point-data:
    type: int
    description: |
      Initial data phase sample point in per mille (e.g. 875 equals 87.5%).

      If this is unset (or if it is set to 0), the initial sample point will default to 75.0% for
      bitrates over 800 kbit/s, 80.0% for bitrates over 500 kbit/s, and 87.5% for all other
      bitrates.
```

## dts/bindings/can/can.yaml
```yaml
title: CAN Base Structure
version: 0.1

description: >
    This binding gives the base structures for all CAN devices

inherits:
    !include base.yaml

child:
    bus: can

properties:
    "#address-cells":
      type: int
      category: required
      description: should be 1.
    "#size-cells":
      type: int
      category: required
      description: should be 0.
    label:
      category: required
    bus-speed:
      type: int
      category: required
      description: bus speed in Baud/s
      generation: define
    sjw:
      type: int
      category: required
      description: Resynchronization jump width (ISO 11898-1)
      generation: define
    prop-seg:
      type: int
      category: required
      description: Time quantums of propagation segment (ISO 11898-1)
      generation: define
    phase-seg1:
      type: int
      category: required
      description: Time quantums of phase buffer 1 segment (ISO 11898-1)
      generation: define
    phase-seg2:
      type: int
      category: required
      description: Time quantums of phase buffer 2 segment (ISO 11898-1)
      generation: define
```

## dts/bindings/can/cast,can.yaml
```yaml
# Copyright (C) 2024 Alif Semiconductor
# SPDX-License-Identifier: Apache-2.0

description: Cast CAN

include: [can-controller.yaml, can-fd-controller.yaml, pinctrl-device.yaml]

compatible: "cast,can"

properties:
  reg:
    required: true

  reg-names:
    required: true

  interrupt-parent:
    required: true

  interrupts:
    required: true

  interrupt-names:
    required: true

  clocks:
    required: true
    description: Includes Clock Controller module

  clock-frequency:
    type: int
    required: true
    description:  Clock frequency the CAN controller is being driven at, in Hz.

  can-fd:
    type: boolean
    description: |
     Enable CAN FD support.
     When enabled, can-fd-ctrl-reg and can-fd-bit must be specified.

  can-fd-ctrl-reg:
    type: int
    description: |
      Address of the CAN FD control register.
      Required when can-fd is true.

  can-fd-bit:
    type: int
    description: |
      Bit position within can-fd-ctrl-reg that enables CAN FD mode.
      Required when can-fd is true.
```

## dts/bindings/can/espressif,esp32-twai.yaml
```yaml
# Copyright (c) 2022 Henrik Brix Andersen <henrik@brixandersen.dk>
# SPDX-License-Identifier: Apache-2.0

description: Espressif ESP32 Two-Wire Automotive Interface (TWAI)

compatible: "espressif,esp32-twai"

include: [can-controller.yaml, pinctrl-device.yaml]

properties:
  reg:
    required: true

  interrupts:
    required: true

  clocks:
    required: true

  pinctrl-0:
    required: true

  pinctrl-names:
    required: true

  clkout-divider:
    type: int
    description: |
      Clock divider for the CLKOUT signal. If not set, the CLKOUT signal is turned off.

      Valid values are 1 or any even number from 2 to 14 for ESP32 and 2 to 490 for newer
      Espressif MCUs like ESP32-C3.
```

## dts/bindings/can/espressif,esp32-twaifd.yaml
```yaml
# Copyright (c) 2026 Espressif Systems (Shanghai) Co., Ltd.
# SPDX-License-Identifier: Apache-2.0

description: |
  Espressif ESP32 TWAI-FD (CAN-FD capable Two-Wire Automotive Interface) controller.

compatible: "espressif,esp32-twaifd"

include: [can-fd-controller.yaml, pinctrl-device.yaml]

properties:
  reg:
    required: true

  interrupts:
    required: true

  clocks:
    required: true

  pinctrl-0:
    required: true

  pinctrl-names:
    required: true
```

## dts/bindings/can/gd,gd32-can-fd.yaml
```yaml
# Copyright (c) 2022 YuLong Yao <feilongphone@gmail.com>
# SPDX-License-Identifier: Apache-2.0

description: GigaDevice GD32 series CAN-FD module

compatible: "gd,gd32-can-fd"

include: ["gd,gd32-can.yaml", can-fd-controller.yaml]

properties:
  fd-standard:
    type: int
    required: true
    description: Select CAN-FD standard, ISO CAN or Non-ISO CAN.

  esi-mode:
    type: int
    required: true
    description: |
      Error state indicator mode
      0: Always displays the node error state. Transmit the dominant bit by error active
      nodes and transmit the recessive bit by error passive nodes.
      1: When the node is not in the error passive state:
      Displays the message buffer error state by configuring ESI bit in CAN_TMPx
      registers.
      When the node is in the error passive state:
      Displays the node error state.
```

## dts/bindings/can/gd,gd32-can-filter.yaml
```yaml
# Copyright (c) 2022 YuLong Yao <feilongphone@gmail.com>
# SPDX-License-Identifier: Apache-2.0

description: GigaDevice GD32 series CAN module

compatible: "gd,gd32-can-filter"

include: ["base.yaml"]

properties:
  size:
    required: true
    type: int
    description: Filter Size
```

## dts/bindings/can/gd,gd32-can.yaml
```yaml
# Copyright (c) 2022 YuLong Yao <feilongphone@gmail.com>
# SPDX-License-Identifier: Apache-2.0

description: GigaDevice GD32 series CAN module

compatible: "gd,gd32-can"

include: [can-controller.yaml, pinctrl-device.yaml]

properties:
  reg:
    required: true

  interrupts:
    required: true

  rcu-periph-clock:
    type: int
    description: Reset Control Unit Peripheral Clock ID
    required: true

  rcu-periph-reset:
    type: int
    description: Reset Control Unit Peripheral Reset ID
    required: true

  pinctrl-0:
    required: true

  pinctrl-names:
    required: true

  filter-size:
    required: false
    type: int
    default: 5
    description: Filter Size

  one-shot:
    type: boolean
    required: false
    description: |
      Disable automatic retransmissions. A CAN frame will only be transmitted
      once, independently of the transmission result (successful, error, or
      arbitration lost).

  main-controller:
    type: phandles
    required: false
```

## dts/bindings/can/infineon,can.yaml
```yaml
# Copyright (c) 2026 Linumiz
#
# SPDX-License-Identifier: Apache-2.0

description: Infineon MCAN Driver

compatible: "infineon,can"

include: ["bosch,m_can-base.yaml", "pinctrl-device.yaml"]

properties:
  reg:
    required: true

  clocks:
    required: true

  clk-dst:
    type: int
    required: true
    description: |
      Peripheral clock destination ID for this CAN instance.
      Maps to an en_clk_dst_t value used by the Infineon PDL to
      connect a peripheral clock divider to this CAN block.
```

## dts/bindings/can/infineon,canfd-controller.yaml
```yaml
# Copyright (c) 2026 Infineon Technologies AG,
# or an affiliate of Infineon Technologies AG.
#
# SPDX-License-Identifier: Apache-2.0

title: |
  Infineon CAN FD controller wrapper.

description: |
  This node represents the top-level Infineon CANFD IP block that contains
  shared resources (global control register, Message RAM, ECC) common to all
  CAN FD channels.  Individual CAN channels are child nodes of this controller.

  The controller driver powers on the Message RAM and configures optional
  wrapper-level features (timestamp counter, ECC) before any channel can
  operate.

compatible: "infineon,canfd-controller"

include: [base.yaml]

properties:
  reg:
    required: true
    description: |
      Two register regions:
        - wrapper: Base address and size of the CANFD controller wrapper
          registers (CTL, STATUS, TS_CTL, ECC_CTL).
        - mram: Base address and size of the shared Message RAM.

  "#address-cells":
    const: 1

  "#size-cells":
    const: 1

  shared-timestamp-counter:
    type: boolean
    description: |
      Enable the shared timestamp counter in the CAN FD wrapper.
      When set, the driver enables the wrapper's TS_CTL counter and
      configures each child M_CAN channel to use it as an external
      timestamp source.

  ecc-enabled:
    type: boolean
    description: |
      Enable ECC on the shared Message RAM.  When set, the driver
      activates single-bit error correction and double-bit error
      detection for all Message RAM accesses.
```

## dts/bindings/can/infineon,cat1-can.yaml
```yaml
# Copyright (c) 2026 Linumiz
#
# SPDX-License-Identifier: Apache-2.0

description: Infineon Cat1 Family MCAN Driver

compatible: "infineon,cat1-can"

include: ["bosch,m_can-base.yaml", "pinctrl-device.yaml", "infineon,system-interrupts.yaml"]

properties:
  reg:
    required: true

  clocks:
    required: true

  clock-frequency:
    type: int
    required: true
```

## dts/bindings/can/infineon,xmc4xxx-can-node.yaml
```yaml
# Copyright (c) 2023 Andriy Gelman
# SPDX-License-Identifier: Apache-2.0
#

description: |
  Infineon XMC4xxx CAN Node

compatible: "infineon,xmc4xxx-can-node"

include: ["can-controller.yaml", "pinctrl-device.yaml"]

properties:
  reg:
    required: true

  interrupts:
    required: true

  clock_div8:
    description: Option enables clock divide by a factor of 8.
    type: boolean

  input-src:
    description: Connects the CAN input line to a specific IO.
    type: string
    required: true
    enum:
      - "RXDA"
      - "RXDB"
      - "RXDC"
      - "RXDD"
      - "RXDE"
      - "RXDF"
      - "RXDG"
      - "RXDH"
```

## dts/bindings/can/infineon,xmc4xxx-can.yaml
```yaml
# Copyright (c) 2023 Andriy Gelman
# SPDX-License-Identifier: Apache-2.0
#

description: |
  Infineon XMC4xxx CAN

compatible: "infineon,xmc4xxx-can"

include: base.yaml

properties:
  reg:
    required: true

  clock-prescaler:
    type: int
    min: 1
    max: 1023
    required: true
    description: Clock divider for the input clock.

  message-objects:
    type: int
    required: true
    description: Number of total can messages supported by hardware.
```
