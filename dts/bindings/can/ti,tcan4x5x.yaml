## dts/bindings/charger/ti,bq24295.yaml
```yaml
# Copyright 2026 Sacra Systems Private Limited
# SPDX-License-Identifier: Apache-2.0

description: |
  BQ24295 family of charging ICs.

  BQ24295 I2C controlled, 1-cell, switch-mode battery charger with
  power-path management and USB OTG support.

include: [battery.yaml, i2c-device.yaml]

compatible: "ti,bq24295"

properties:
  constant-charge-current-max-microamp:
    required: true
    description: |
      The charge current target for the constant current phase of the
      charge profile. This value will be programmed during driver
      initialization.

  constant-charge-voltage-max-microvolt:
    required: true
    description: |
      The voltage regulation target for the constant voltage phase of the
      charge profile. This value will be programmed during driver
      initialization.

  watchdog-timeout-ms:
    type: int
    required: true
    enum:
      - 0
      - 40000
      - 80000
      - 160000
    description: |
      Watchdog timer timeout in milliseconds.

      A value of 0 disables the watchdog timer.

  ce-gpios:
    type: phandle-array
    description: |
      Active-low charge enable pin.

examples:
  - |
    charger: bq24295@6b {
      compatible = "ti,bq24295";
      reg = <0x6b>;
      status = "okay";

      constant-charge-current-max-microamp = <1000000>;
      constant-charge-voltage-max-microvolt = <4208000>;

      watchdog-timeout-ms = <40000>;

      ce-gpios = <&test_gpio 0 0>;
    };
```

## dts/bindings/charger/ti,bq25180.yaml
```yaml
# Copyright 2024 Google LLC
# SPDX-License-Identifier: Apache-2.0

description: |
  BQ25180 I2C Controlled, 1-Cell, 1-A Linear Battery Charger with Power Path
  and Ship Mode.

  The device has a single node for the charger. For example:

  bq25180@6a {
    compatible = "ti,bq25180";
    reg = <0x6a>;

    constant-charge-current-max-microamp = <500000>;
  };

compatible: "ti,bq25180"

include: ti,bq2518x-common.yaml
```

## dts/bindings/charger/ti,bq25186.yaml
```yaml
# Copyright 2025 Embeint Pty Ltd
# SPDX-License-Identifier: Apache-2.0

description: |
  BQ25186 I2C Controlled, 1-Cell, 1-A Linear Battery Charger with Power Path,
  Ship Mode, Shutdown Mode and Battery Tracking VINDPM.

  The device has a single node for the charger. For example:

  bq25186@6a {
    compatible = "ti,bq25186";
    reg = <0x6a>;

    constant-charge-current-max-microamp = <500000>;
  };

compatible: "ti,bq25186"

include: ti,bq2518x-common.yaml
```

## dts/bindings/charger/ti,bq25188.yaml
```yaml
# Copyright 2025 Embeint Pty Ltd
# SPDX-License-Identifier: Apache-2.0

description: |
  BQ25188 I2C Controlled, 1-Cell, 1-A Linear Battery Charger with Power Path,
  Ship Mode, Shutdown Mode, Battery Tracking VINDPM, and Wide WIN Support.

  The device has a single node for the charger. For example:

  bq25188@6a {
    compatible = "ti,bq25188";
    reg = <0x6a>;

    constant-charge-current-max-microamp = <500000>;
  };

compatible: "ti,bq25188"

include: ti,bq2518x-common.yaml
```

## dts/bindings/charger/ti,bq2518x-base.yaml
```yaml
# Copyright 2024 Google LLC
# SPDX-License-Identifier: Apache-2.0

include: [battery.yaml, i2c-device.yaml]

properties:
  constant-charge-current-max-microamp:
    type: int
    default: 0
    description: |
      Charge current set at init time in uA, available range is 5 mA to 1000 mA.
      The value specified will be rounded down to the closest implemented
      value. If set to 0 (default) skip setting the charge current value at
      driver initialization.

  constant-charge-voltage-max-microvolt:
    type: int
    default: 4200000
    description: |
      The maximum voltage that the battery will be charged at, defaults to
      4.2V, matching the device default reset configuration.

  precharge-voltage-threshold-microvolt:
    type: int
    default: 3000000
    description: |
      Threshold at which voltage to switch to constant current charge.
      Must be either 3.0V or 2.8V
```

## dts/bindings/charger/ti,bq2518x-common.yaml
```yaml
# Copyright 2024 Google LLC
# SPDX-License-Identifier: Apache-2.0

include: [battery.yaml, i2c-device.yaml]

properties:
  constant-charge-current-max-microamp:
    type: int
    default: 0
    description: |
      Charge current set at init time in uA, available range is 5 mA to 800 mA.
      The value specified will be rounded down to the closest implemented
      value. If set to 0 (default) skip setting the charge current value at
      driver initialization.

  constant-charge-voltage-max-microvolt:
    type: int
    default: 4200000
    description: |
      The maximum voltage that the battery will be charged at, defaults to
      4.2V, matching the device default reset configuration.

  re-charge-threshold-millivolt:
    type: int
    enum:
      - 100
      - 200
    default: 100
    description: |
      The voltage below the maximum charge voltage at which the battery will
      resume charging after falling from the max. Defaults to 100 mV, matching
      the device default reset configuration.

  precharge-voltage-threshold-microvolt:
    type: int
    enum:
      - 2800000
      - 3000000
    default: 3000000
    description: |
      Threshold at which voltage to switch to constant current charge.

  vsys-target-regulation:
    type: string
    enum:
      - "Battery Tracking"
      - "4V4"
      - "4V5"
      - "4V6"
      - "4V7"
      - "4V8"
      - "4V9"
      - "Vin Passthrough"
    default: "4V5"
    description: |
      Target voltage for the SYS regulation loop. Defaults to 4.5V, matching
      the device default reset configuration.

  battery-discharge-current-limit-milliamp:
    type: int
    enum:
      - 500
      - 1000
      - 1500
      - 3000
    default: 3000
    description:
      Battery discharge current limit. If the current through the battery FET
      exceeds this value, the discharge FET is turned off. Default matches the
      register reset value.

  battery-undervoltage-lockout-millivolt:
    type: int
    enum:
      - 3000
      - 2800
      - 2600
      - 2400
      - 2200
      - 2000
    default: 3000
    description:
      Battery undervoltage lockout threshold (falling). If the voltage on the
      BAT pin falls below this value, the BAT to SYS path will be disengaged.
      There is a 150 mV hysterisis before the path will be re-enabled. Default
      matches the register reset value.
```

## dts/bindings/charger/ti,bq2562x.yaml
```yaml
# Copyright 2025 Linumiz
# SPDX-License-Identifier: Apache-2.0

description: |
  BQ25620/BQ25622 is a single cell buck battery charger with OTG support.

  The device has a single child node for the charger. For example:

  bq25620@6b {
    compatible = "ti,bq2562x";
    reg = <0x6b>;

    ce-gpios = <&gpioa 3 GPIO_ACTIVE_LOW>;
    watchdog-timeout-ms = <50000>;
    constant-charge-current-max-microamp = <1040000>;
    constant-charge-voltage-max-microvolt = <4200000>;
    precharge-current-microamp = <100000>;
    charge-term-current-microamp = <60000>;
    input-current-limit-microamp = <1000000>;
    input-voltage-limit-microvolt = <4600000>;
  };

compatible: "ti,bq2562x"

include: [battery.yaml, i2c-device.yaml]

properties:
  constant-charge-current-max-microamp:
    type: int
    default: 1040000

  constant-charge-voltage-max-microvolt:
    type: int
    default: 4200000

  precharge-current-microamp:
    type: int
    default: 100000

  charge-term-current-microamp:
    type: int
    default: 60000

  ce-gpios:
    type: phandle-array
    description: Active low, charge enable pin

  int-gpios:
    type: phandle-array
    description: Interrupt pin

  ti,min-sys-voltage-microvolt:
    type: int
    default: 3600000
    description: |
      Minimum system voltage in micro volts with a 100000 micro volt step.

  ti,input-voltage-limit-microvolt:
    type: int
    default: 4800000
    description: |
      Minimum input voltage limit in micro volts with a 100000 micro volt step.

  ti,input-current-limit-microamp:
    type: int
    default: 4000000
    description: |
      Maximum input current limit in micro amps with a 100000 micro amp step.

  ti,thermal-regulation-threshold:
    type: int
    default: 1
    enum:
      - 0
      - 1
    description: |
      Charger control thermal regulation threshold
      0: 60 degree celsius
      1: 120 degree celsius

  ti,switching-converter-freq:
    type: int
    default: 0
    enum:
      - 0
      - 1
      - 2
    description: |
      Charger step-down converter switching frequency
      0: Nominal, 1.5 MHz
      1: -10%, 1.35 MHz
      2: +10%, 1.65 MHz

  ti,switching-converter-strength:
    type: int
    default: 0
    enum:
      - 0
      - 1
      - 3
    description: |
      Charger step-down converter drive strength for efficiency vs EMI
      0: weak
      1: normal
      3: strong
```

## dts/bindings/charger/ti,bq25713.yaml
```yaml
# Copyright 2025 Palta Tech, S.A
# SPDX-License-Identifier: Apache-2.0

description: |
  BQ25713 I2C battery charge controller IC.

  BQ25713 targets 1s to 4s Cell, USB Power Delivery/Adapter Charger with
  Narrow VDC Power Path Management and Processor Hot Monitor

  This charger is represented by device tree child node, e.g:

  charger: bq25713@6b {
      compatible = "ti,bq25713";
      reg = <0x6b>;
      status = "okay";

      constant-charge-current-max-microamp = <1000000>;
      constant-charge-voltage-max-microvolt = <3800000>;
      system-voltage-min-threshold-microvolt = <3328000>;
  };

include: [battery.yaml, i2c-device.yaml]

compatible: "ti,bq25713"

properties:
  constant-charge-current-max-microamp:
    required: true
    description: |
      The charge current target for the constant current phase of the charge profile.
      This value will be set at initialization time. Range: 0 mA to 8.128 A.
      The value specified will be rounded down to the closest implemented value.

  constant-charge-voltage-max-microvolt:
    required: true
    description: |
      The voltage regulation target for the constant voltage phase of the battery charging profile.
      This value will be set at initialization time. Range: 4.2 V 1S to 16.8 V 4S.
      The value specified will be rounded down to the closest implemented value.

  system-voltage-min-threshold-microvolt:
    type: int
    required: true
    description: |
      Minimum system voltage.
      Voltage that will be set above when the system voltage drops this level.
      This value will be set at initialization time. Range: 1.024 V to 16.128 V.
      The value specified will be rounded down to the closest implemented value.
```
