## dts/bindings/charger/maxim,max20335-charger.yaml
```yaml
# Copyright (c), 2023 Grinn
# SPDX-License-Identifier: Apache-2.0

description: Maxim MAX20335 battery charger

include: battery.yaml

compatible: "maxim,max20335-charger"

properties:
  constant-charge-voltage-max-microvolt:
    required: true
    enum:
      - 4050000
      - 4100000
      - 4150000
      - 4200000
      - 4250000
      - 4300000
      - 4350000
      - 4400000
      - 4450000
      - 4500000
      - 4550000
      - 4600000

  chgin-to-sys-current-limit-microamp:
    type: int
    required: true
    enum:
      - 0
      - 100000
      - 500000
      - 1000000
    description: |
      CHGIN to SYS path current limitter configuration.
      Refer to ILimCntl register description for details.

  system-voltage-min-threshold-microvolt:
    type: int
    required: true
    enum:
      - 3600000
      - 3700000
      - 3800000
      - 3900000
      - 4000000
      - 4100000
      - 4200000
      - 4300000
    description: |
      System voltage minimum threshold. When SYS path
      voltage drops to this level, the charger current
      is reduced to prevent battery damage.

  re-charge-threshold-microvolt:
    type: int
    required: true
    enum:
      - 70000
      - 120000
      - 170000
      - 220000
    description: |
      Recharge threshold in relation to BatReg.
      Refer to ChgCntlA register description for details.

  thermistor-monitoring-mode:
    type: string
    required: true
    enum:
      - "disabled"
      - "thermistor"
      - "JEITA-1"
      - "JEITA-2"
    description: |
      Thermistor monitoring mode.
      Refer to ThrmCfg register description and Table 2 for details.

  int-gpios:
    type: phandle-array
    required: true
    description: Interrupt pin
```

## dts/bindings/charger/nordic,npm10xx-charger.yaml
```yaml
# Copyright (c) 2026 Nordic Semiconductor
# SPDX-License-Identifier: Apache-2.0

description: Nordic's nPM10 Series PMIC battery charger

include: base.yaml

compatible: "nordic,npm10xx-charger"

properties:
  charging-enable:
    type: boolean
    description: Enable charging.

  charge-current-microamp:
    type: int
    description: |
      Charge current in uA.
      Available range is 0.5-128 mA in 0.5 mA steps and 129-256 mA in 1 mA steps.

  term-voltage-microvolt:
    type: int
    description: Charge termination voltage in uV. Available range is 3.5-4.65 V in 10 mV steps.

  term-current-percent:
    type: string
    enum:
      - "12.5%"
      - "100%"
      - "50%"
      - "25%"
      - "6.25%"
      - "3.125%"
      - "1.56%"
      - "0.78%"
    description: Charge termination current in percent of current-microamp.

  charge-current-warm-microamp:
    type: int
    description: |
      Charge current in uA for the NTC warm region. Same range as current-microamp.

  term-voltage-warm-microvolt:
    type: int
    description: |
      Charge termination voltage in uV for the NTC warm region. Same range as term-microvolt.

  charge-current-cool-microamp:
    type: int
    description: |
      Charge current in uA for the NTC cool region. Same range as current-microamp.

  term-voltage-cool-microvolt:
    type: int
    description: |
      Charge termination voltage in uV for the NTC cool region. Same range as term-microvolt.

  trickle-current-percent:
    type: string
    enum:
      - "12.5%"
      - "100%"
      - "50%"
      - "25%"
      - "6.25%"
      - "3.125%"
      - "1.56%"
      - "0.78%"
    description: Trickle charge current in percent of current-microamp.

  trickle-voltage-microvolt:
    type: int
    enum:
      - 2900000
      - 2500000
      - 2700000
      - 3100000
    description: Trickle charge voltage in uV.

  throttle-current-percent:
    type: string
    enum:
      - "100%"
      - "87.5%"
      - "75%"
      - "62.5%"
      - "50%"
      - "37.5%"
      - "25%"
      - "12.5%"
    description: Charge throttle current in percent of current-microamp.

  throttle-level-microvolt:
    type: int
    enum:
      - 25000
      - 50000
      - 75000
      - 100000
      - 125000
      - 150000
      - 175000
      - 200000
      - 225000
      - 250000
      - 275000
      - 300000
      - 325000
      - 350000
      - 375000
      - 400000
    description: |
      Charge throttle voltage level in uV.
      Vthrottle = term-voltage-{,-cool,-warm}microvolt- - throttle-level-microvolt.

  trickle-timeout-minute:
    type: int
    enum:
      - 10
      - 20
      - 30
      - 40
      - 50
      - 60
      - 70
      - 80
      - 90
      - 100
      - 110
      - 120
    description: Trickle charge timeout in minutes.

  charge-timeout-hour:
    type: int
    enum:
      - 1
      - 2
      - 3
      - 4
      - 5
      - 6
      - 7
      - 8
      - 9
      - 10
    description: Charge cycle timeout in hours.

  thermistor-beta:
    type: int
    description: Beta value of selected thermistor.

  thermistor-cold-degrees:
    type: int
    description: Thermistor cold threshold in degrees Celsius.

  thermistor-cool-degrees:
    type: int
    description: Thermistor cool threshold in degrees Celsius.

  thermistor-warm-degrees:
    type: int
    description: Thermistor warm threshold in degrees Celsius.

  thermistor-hot-degrees:
    type: int
    description: Thermistor hot threshold in degrees Celsius.

  dietemp-reduce-degrees:
    type: int
    description: |
      Die temperature current reduce threshold in degrees Celsius.
      When die temperature exceeds this threshold, charging current will be reduced.

  dietemp-resume-degrees:
    type: int
    description: |
      Die temperature resume threshold in degrees Celsius. When die temperature falls below this
      threshold, charging current will gradually increase. Recommended to be at least 10 degrees
      lower than dietemp-reduce-degrees.

  disable-batt-monitoring:
    type: boolean
    description: Disable battery temperature monitoring during charging.

  disable-recharge:
    type: boolean
    description: Disable automatic recharge.

  disable-warm-charging:
    type: boolean
    description: Disable charging of warm battery.

  disable-cool-charging:
    type: boolean
    description: Disable charging of cool battery.

  enable-advanced-profile:
    type: boolean
    description: |
      Use custom values for termination voltage and charge current in warm and cool termperature
      regions. The default JEITA values will be used otherwise.

  enable-throttle-charging:
    type: boolean
    description: Enable throttle charging.

  disable-lowbatt-charging:
    type: boolean
    description: Disable charging of battery below VBATLOW threshold (2.1 or 1.1 V).

  vbat-low-microvolt:
    type: int
    enum:
      - 2100000
      - 1100000
    description: VBATLOW threshold. Choose between 2.1 and 1.1 V.

  vbus-limit-microamp:
    type: int
    enum:
      - 100000
      - 10000
      - 225000
      - 300000
    description: VBUS input current limit to set during initialization.

  vbusdpm-microvolt:
    type: int
    enum:
      - 4350000
      - 4500000
      - 4650000
      - 4800000
    description: |
      The device monitors VBUS and limits SYSREG current to maintain the VBUS voltage above the
      selected level. Choose a level to set during initialization.

examples:
  - |
    npm1012: pmic@6a {
      reg = <0x6a>;
      compatible = "nordic,npm10xx";
      /* ... */

      charger {
        compatible = "nordic,npm10xx-charger";
        charging-enable;
        charge-current-microamp = <25000>;
        term-voltage-microvolt = <4200000>;
        term-current-percent = "3.125%";
        /* ... */
      };

      /* ... */
    };
```

## dts/bindings/charger/nxp,pca9422-charger.yaml
```yaml
# Copyright 2025 NXP
# SPDX-License-Identifier: Apache-2.0

description: NXP PCA9422 battery charger

include: battery.yaml

compatible: "nxp,pca9422-charger"

properties:
  constant-charge-current-max-microamp:
    type: int
    required: true
    default: 100000
    description: |
      Fast Charge current set at init time in uA, available range is 2.5mA to 640mA.
      The value specified will be rounded down to the closest implemented
      value. If set to 0 (default) skip setting the charge current value at
      driver initialization.

  constant-charge-voltage-max-microvolt:
    type: int
    required: true
    default: 4200000
    description: |
      The maximum voltage that the battery will be charged at, defaults to
      4.2V, matching the device default reset configuration.

  precharge-current-percent:
    type: int
    enum:
      - 7
      - 16
    default: 16
    description: |
      Precharge current as x%(7% or 16%) of Fast charge current.
      Refer to CHARGER_CNTL_1 register description for details.

  charge-termination-current-percent:
    type: int
    enum:
      - 25
      - 50
      - 75
      - 100
    default: 25
    description: |
      Topoff current as x%*10 (2.5%, 5.0%, 7.5%, or 10.0%)
      of Fast charge current. Charge will finish when charging
      current is less than topoff current.
      Refer to CHARGER_CNTL_4 register description for details.

  re-charge-threshold-microvolt:
    type: int
    enum:
      - 100000
      - 150000
      - 200000
    default: 100000
    description: |
      Recharge threshold in relation to Vbat_reg.
      Refer to CHARGER_CNTL_4 register description for details.

  input-current-limit-microamp:
    type: int
    default: 470000
    description: |
      Input current limit on VIN, available range is 45mA to 1195mA.

  system-voltage-min-threshold-microvolt:
    type: int
    default: 4550000
    description: |
      System regulation voltage. It is higher 200mV than Vbat_reg.
      Vbatreg will clamp by Vsys_reg - 200mV.
```

## dts/bindings/charger/nxp,pf1550-charger.yaml
```yaml
# Copyright (c), 2024 Arduino SA
# SPDX-License-Identifier: Apache-2.0

description: NXP PF1550 battery charger

include: battery.yaml

compatible: "nxp,pf1550-charger"

properties:
  constant-charge-voltage-max-microvolt:
    required: true

  constant-charge-current-max-microamp:
    required: true

  pf1550,vbus-current-limit-microamp:
    type: int
    required: true
    description: |
      VBUS current limit in microamperes.

  pf1550,system-voltage-min-threshold-microvolt:
    type: int
    required: true
    enum:
      - 3500000
      - 3700000
      - 4300000
    description: |
      System voltage minimum threshold.

  pf1550,thermistor-monitoring-mode:
    type: string
    required: true
    enum:
      - "disabled"
      - "thermistor"
      - "JEITA-1"
      - "JEITA-2"
    description: |
      Thermistor monitoring mode.
      Refer to ThrmCfg register description and Table 2 for details.

  pf1550,int-gpios:
    type: phandle-array
    required: true
    description: Interrupt pin

  pf1550,led-behaviour:
    type: string
    required: true
    enum:
      - "on-in-charging-flash-in-fault"
      - "flash-in-charging-on-in-fault"
      - "manual-off"
    description: |
      Behaviour for charger LED.
```

## dts/bindings/charger/renesas,isl92xx.yaml
```yaml
# Copyright (c) 2020 Intel Corporation
# SPDX-License-Identifier: Apache-2.0

description: ISL92XX series I2C-based charger

compatible: "renesas,isl92xx"

include: [i2c-device.yaml]

properties:
    label:
      required: true
```

## dts/bindings/charger/sbs,sbs-charger.yaml
```yaml
#
# Copyright 2023 Cirrus Logic, Inc.
#
# SPDX-License-Identifier: Apache-2.0
#

description: SBS 1.1 compliant charger (http://www.sbs-forum.org/specs)

compatible: "sbs,sbs-charger"

include: [i2c-device.yaml]
```

## dts/bindings/charger/silergy,sy6974b.yaml
```yaml
# SPDX-FileCopyrightText: Copyright The Zephyr Project Contributors
# SPDX-License-Identifier: Apache-2.0

title: Silergy SY6974B battery charger

description: |
  Silergy SY6974B 3A single-cell Li-Ion switching battery charger with I2C
  control, USB BC1.2 detection, OTG boost and power-path management.

compatible: "silergy,sy6974b"

include: [battery.yaml, i2c-device.yaml]

properties:
  constant-charge-current-max-microamp:
    required: true
    description: |
      Fast-charge current target applied at initialization.
      Range: 0-3000 mA (60 mA steps, values are rounded down to the nearest step).

  constant-charge-voltage-max-microvolt:
    required: true
    description: |
      Charge voltage regulation target applied at initialization.
      Range: 3.856-4.624V (32 mV steps, values are rounded down to the nearest step).
      Default value is 4.208V, matching the device default reset configuration.
    default: 4208000

examples:
  - |
    charger: sy6974b@6b {
        compatible = "silergy,sy6974b";
        reg = <0x6b>;
        constant-charge-current-max-microamp = <1500000>;
        constant-charge-voltage-max-microvolt = <4208000>;
    };
```

## dts/bindings/charger/ti,bq2407x.yaml
```yaml
# Copyright (c) 2023 Bjarki Arge Andreasen
# SPDX-License-Identifier: Apache-2.0

description: |
  TI BQ2407X charger IC
  example:
    bq2407x {
            compatible = "ti,bq2407x";
            status = "okay";
            ce-gpios = <&gpio0 1 GPIO_ACTIVE_HIGH>;
            pg-gpios = <&gpio0 2 GPIO_ACTIVE_LOW>;
            stat1-gpios = <&gpio0 3 GPIO_ACTIVE_LOW>;
            stat2-gpios = <&gpio0 4 GPIO_ACTIVE_LOW>;
    };

compatible: "ti,bq2407x"

include: charger-device.yaml

properties:
  ce-gpios:
    type: phandle-array
    description: Charge enable GPIO
    required: true

  pg-gpios:
    type: phandle-array
    description: Power good GPIO
    required: true

  stat1-gpios:
    type: phandle-array
    description: Status 1 GPIO
    required: true

  stat2-gpios:
    type: phandle-array
    description: Status 2 GPIO
    required: true
```

## dts/bindings/charger/ti,bq24190.yaml
```yaml
# Copyright 2023 Cirrus Logic, Inc.
# Copyright 2025 Palta Tech, S.A
# SPDX-License-Identifier: Apache-2.0

description: |
  BQ2419x family of charging ICs.

  BQ2419x I2C controlled, 1-Cell, 4.5-A, USB/Adapter Charger with Narrow VDC Power Path Management
  and USB OTG

  This charger is represented by device tree child node, e.g:

  charger: bq24190@6b {
      compatible = "ti,bq24190";
      reg = <0x6b>;
      status = "okay";

      constant-charge-current-max-microamp = <1000000>;
      constant-charge-voltage-max-microvolt = <3800000>;
  };

include: [battery.yaml, i2c-device.yaml]

compatible: "ti,bq24190"

properties:
  constant-charge-current-max-microamp:
    required: true
    description: |
      The charge current target for the constant current phase of the charge profile.
      This value will be set at initialization time. Range: 512 mA to 4.544 A.
      The value specified will be rounded down to the closest implemented value.

  constant-charge-voltage-max-microvolt:
    required: true
    description: |
      The voltage regulation target for the constant voltage phase of the battery charging profile.
      This value will be set at initialization time. Range: 3.504 V to 4.400 V.
      The value specified will be rounded down to the closest implemented value.

  ce-gpios:
    type: phandle-array
    description: Active low, charge enable pin
```
