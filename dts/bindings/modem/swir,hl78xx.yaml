## dts/bindings/modem/swir,hl78xx.yaml
```yaml
# Copyright (c) 2025, Netfeasa Ltd.
# SPDX-License-Identifier: Apache-2.0

description: Sierra Wireless HL78XX Modem

compatible: "swir,hl78xx"

include:
  - zephyr,cellular-modem-device.yaml

properties:
  mdm-pwr-on-gpios:
    type: phandle-array

  mdm-fast-shutd-gpios:
    type: phandle-array

  mdm-vgpio-gpios:
    type: phandle-array

  mdm-uart-dsr-gpios:
    type: phandle-array

  mdm-uart-cts-gpios:
    type: phandle-array

  mdm-gpio6-gpios:
    type: phandle-array

  mdm-gpio8-gpios:
    type: phandle-array

  mdm-sim-switch-gpios:
    type: phandle-array
```

## dts/bindings/modem/telit,lex10q1.yaml
```yaml
# Copyright(c) 2026 Telit Cinterion S.p.A. All rights reserved.
# SPDX-License-Identifier: Apache-2.0

description: Telit LEx10Q1 Modem

compatible: "telit,lex10q1"

include: zephyr,cellular-modem-device.yaml

properties:
  mdm-power-gpios:
    type: phandle-array
    required: true

  mdm-reset-gpios:
    type: phandle-array
    required: true
```

## dts/bindings/modem/telit,me310g1.yaml
```yaml
description: Telit ME310G1 Modem

compatible: "telit,me310g1"

include: zephyr,cellular-modem-device.yaml

properties:
  mdm-power-gpios:
    type: phandle-array
    required: true

  mdm-dtr-gpios:
    type: phandle-array
```

## dts/bindings/modem/telit,me910g1.yaml
```yaml
# Copyright(c) 2023 Jeff Welder (Ellenby Technologies, Inc.)
# SPDX-License-Identifier: Apache-2.0

description: Telit ME910G1 Modem

compatible: "telit,me910g1"

include: uart-device.yaml

properties:
  mdm-power-gpios:
    type: phandle-array
    required: true

  mdm-reset-gpios:
    type: phandle-array
    required: true

  mdm-dtr-gpios:
    type: phandle-array

  mdm-ri-gpios:
    type: phandle-array
```

## dts/bindings/modem/trasna,lexi-r10.yaml
```yaml
# Copyright (c) 2026, Trasna.io
# SPDX-License-Identifier: Apache-2.0

description: Trasna LEXI-R10 modem

compatible: "trasna,lexi-r10"

include: zephyr,cellular-modem-device.yaml

properties:
  mdm-power-gpios:
    type: phandle-array
    required: true
```

## dts/bindings/modem/u-blox,lara-r6.yaml
```yaml
# Copyright (c) 2024, lindq.gr
# SPDX-License-Identifier: Apache-2.0

description: u-blox LARA-R6 modem

compatible: "u-blox,lara-r6"

include: zephyr,cellular-modem-device.yaml

properties:
  mdm-power-gpios:
    type: phandle-array
    required: true

  target-speed:
    type: int
    default: 3000000
    description:
      UART baudrate which will be requested using AT commands and to which
      UART interface will be reconfigured during initialization phase.
```

## dts/bindings/modem/u-blox,sara-r4.yaml
```yaml
# Copyright (c) 2019, Foundries.io
# SPDX-License-Identifier: Apache-2.0

description: u-blox SARA-R4 modem

compatible: "u-blox,sara-r4"

include: uart-device.yaml

properties:
  mdm-power-gpios:
    type: phandle-array
    required: true

  mdm-reset-gpios:
    type: phandle-array

  mdm-vint-gpios:
    type: phandle-array
```

## dts/bindings/modem/u-blox,sara-r5.yaml
```yaml
# Copyright (c) 2023 Emil Lindqvist
# SPDX-License-Identifier: Apache-2.0

description: u-blox SARA-R5 modem

compatible: "u-blox,sara-r5"

include: zephyr,cellular-modem-device.yaml

properties:
  zephyr,mdm-reset-behavior:
    default: ["toggle_on_recovery"]
```

## dts/bindings/modem/ublox,sara-n310.yaml
```yaml
# Copyright (c) 2021, Abel Sensors
# SPDX-License-Identifier: Apache-2.0

description: u-blox SARA-N310 modem

compatible: "ublox,sara-n310"

include: uart-device.yaml

properties:
    label:
      required: true

    mdm-power-gpios:
      type: phandle-array
      required: true

    mdm-reset-gpios:
      type: phandle-array
      required: false

    mdm-vint-gpios:
      type: phandle-array
      required: true
```

## dts/bindings/modem/ublox,sara-r4.yaml
```yaml
# Copyright (c) 2019, Foundries.io
# SPDX-License-Identifier: Apache-2.0

description: u-blox SARA-R4 modem

compatible: "ublox,sara-r4"

include: uart-device.yaml

properties:
    label:
      required: true

    mdm-power-gpios:
      type: phandle-array
      required: true

    mdm-reset-gpios:
      type: phandle-array
      required: false

    mdm-vint-gpios:
      type: phandle-array
      required: false
```

## dts/bindings/modem/wnc,m14a2a.yaml
```yaml
# Copyright (c) 2018, Foundries.io
# SPDX-License-Identifier: Apache-2.0

description: WNC-M14A2A LTE-M modem

compatible: "wnc,m14a2a"

include: uart-device.yaml

properties:
    label:
      required: true

    mdm-boot-mode-sel-gpios:
      type: phandle-array
      required: true

    mdm-power-gpios:
      type: phandle-array
      required: true

    mdm-keep-awake-gpios:
      type: phandle-array
      required: true

    mdm-reset-gpios:
      type: phandle-array
      required: true

    mdm-shld-trans-ena-gpios:
      type: phandle-array
      required: true

    mdm-send-ok-gpios:
      type: phandle-array
      required: false
      description: UART RTS pin if no HW flow control (set to always enabled)
```

## dts/bindings/modem/zephyr,cellular-modem-device.yaml
```yaml
# Copyright 2025 Nordic Semiconductor ASA
# SPDX-License-Identifier: Apache-2.0

description: Common properties for Zephyr cellular modems

include: uart-device.yaml

properties:
  mdm-power-gpios:
    type: phandle-array
    description: GPIO for modem power control

  mdm-reset-gpios:
    type: phandle-array
    description: GPIO for modem reset

  mdm-wake-gpios:
    type: phandle-array
    description: GPIO for modem wake

  mdm-ring-gpios:
    type: phandle-array
    description: GPIO for modem ring indicator

  mdm-dtr-gpios:
    type: phandle-array
    description: |
      GPIO for modem data terminal ready.

      Asserted (logical high) when UART is active and
      deasserted (logical low) when UART is inactive, powered down or in low power mode.

  cmux-enable-runtime-power-save:
    type: boolean
    description: |
      Enable runtime power saving using CMUX PSC commands.
      This requires modem to support CMUX and PSC commands while keeping the data
      connection active.

  cmux-close-pipe-on-power-save:
    type: boolean
    description: |
      Close the modem pipe when entering power save mode.
      When runtime power management is enabled, this closes the UART.
      This requires modem to support waking up the UART using RING signal.

  cmux-idle-timeout-ms:
    type: int
    description: Time in milliseconds after which CMUX will enter power save mode.
    default: 10000

  zephyr,use-default-pdp-ctx:
    type: int
    enum:
      - 0
      - 1
    default: 0
    description: |
      Modem automatically configures and connects the default PDP context (cid=0) when
      registered to the network.
      If this is set to 1, the modem driver will not configure any APN or activate any
      PDP contexts with AT+CGACT command.

      Use enum to allow specific device bindings to override the default value.

  zephyr,use-default-apn:
    type: int
    enum:
      - 0
      - 1
    default: 0
    description: |
      Modem automatically configures the APN name when registering to the network.
      If this is set to 1, the modem driver will supply empty string as APN name when
      configuring the PDP context with AT+CGDCONT=1,"IP","" command.

      Use enum to allow specific device bindings to override the default value.
```

## dts/bindings/modem/zephyr,cellular-modem.yaml
```yaml
# Copyright (c) 2026 Nordic Semiconductor ASA
# SPDX-License-Identifier: Apache-2.0

description: |
    Generic Cellular dial-up modem

    This driver implements a generic cellular dial-up PPP modem using a small subset
    of AT commands from 3GPP TS 27.007.

    UART is configured into a CMUX (3GPP TS 27.010) mode and one CMUX channel
    is used for PPP data connection, while another CMUX channel is used for
    sending AT commands to the modem.

    It can be used with any modem that supports the required AT commands.

compatible: "zephyr,cellular-modem"

include: zephyr,cellular-modem-device.yaml

properties:
  zephyr,init-chat-script:
    type: string-array
    default:
      - "ATE0"
      - "AT+CMUX=0,0,5,127"
    description: |
      Chat script to run during modem initialization.

      This is executed once during modem initialization, after the modem is powered on
      and the UART is ready.

      The chat script can be used to configure the modem into a CMUX mode, for example,
      or to set up other modem features that are required for the modem to operate correctly.

      Each command is expected to reply with "OK".

  zephyr,dial-chat-script:
    type: string-array
    default:
      - "AT+CEREG=1"
      - "AT+CGEREP=1"
      - "AT+CFUN=1"
      - "ATD*99#"
    description: |
      Chat script to run when connecting to the network.

      This is executed on the DLCI channel 1 to establish the PPP connection.

      Last command is expected to reply with "CONNECT", while other commands reply with "OK".

  zephyr,periodic-chat-script:
    type: string-array
    description: |
      Chat script to run periodically while the modem is active.

      This is executed repeatedly at a configurable interval while the modem is active
      and registered to the network.
      The periodic chat script can be used to monitor the modem's status, for example by
      querying the network registration status (AT+CREG?) or signal quality (AT+CSQ).
      This is only required for modems that do not support unsolicited network
      registration status reports on the second DLCI channel.

      This script runs on the DLCI channel 2.

  zephyr,shutdown-chat-script:
    type: string-array
    default:
    description: |
      Chat script to run during modem shutdown.

      This is executed when the modem is being shut down, after the CMUX channel is closed
      and before the modem is powered off.

      Shutdown script is alternative to using modem power control GPIOs, when left empty,
      modem power control GPIOs are expected to be used for shutting down the modem.
      When shutdown chat script is provided, modem power control GPIOs are not used for
      shutting down the modem.
```

## dts/bindings/modem/zephyr,gsm-ppp.yaml
```yaml
# Copyright (c) 2021 G-Technologies Sdn. Bhd.
# SPDX-License-Identifier: Apache-2.0

description: GSM PPP modem

compatible: "zephyr,gsm-ppp"

include: uart-device.yaml

properties:
  mdm-power-gpios:
    type: phandle-array

  mdm-reset-gpios:
    type: phandle-array
```

## dts/bindings/modem/zephyr,modem-uart.yaml
```yaml
# Copyright (c) 2025 Nordic Semiconductor
# SPDX-License-Identifier: Apache-2.0

description: |
  Generic modem model on UART bus

  Example:

    &uart0 {
            compatible = "zephyr,modem-uart";
            mdm-power-gpios = <gpio0 0 GPIO_ACTIVE_LOW>;
            mdm-power-pulse-ms = <900>;
            mdm-startup-time-ms = <5000>;
            mdm-shutdown-time-ms = <5000>;
    };

compatible: "zephyr,modem-uart"

include:
  - modem-device.yaml
  - uart-device.yaml
```

## dts/bindings/morse/zephyr,morse-gpio-rx.yaml
```yaml
# Copyright (c) 2025 Freedom Veiculos Eletricos
# Copyright (c) 2025 O.S. Systems Software LTDA.
# SPDX-License-Identifier: Apache-2.0

description: Morse Code bitbang RX driver

compatible: "zephyr,morse-gpio-rx"

include:
  - name: base.yaml

properties:
  gpios:
    type: phandle-array
    required: true
    description: The GPIO configuration which will be used as rx interface.
```

## dts/bindings/morse/zephyr,morse-gpio-tx.yaml
```yaml
# Copyright (c) 2025-2026 Freedom Veiculos Eletricos
# Copyright (c) 2025-2026 O.S. Systems Software LTDA.
# SPDX-License-Identifier: Apache-2.0

description: |
  Morse Code bit-banged transmitter backend driven by a GPIO output.

  The referenced GPIO is configured as an output and left in the
  inactive (space) state at initialization. As the Morse engine clocks
  the encoded symbol stream, this backend toggles the pin between the
  logical ON (mark) and OFF (space) states one dot time unit at a time.

  Typical targets are an LED, a relay, an opto-coupler, a radio PTT/
  keyer line, or any digital input that accepts simple on/off keying.

compatible: "zephyr,morse-gpio-tx"

include: base.yaml

properties:
  gpios:
    type: phandle-array
    required: true
    description: |
      GPIO pin driven for Morse output. The keyed (mark) polarity is
      selected through the GPIO flags (GPIO_ACTIVE_HIGH or GPIO_ACTIVE_LOW)
      so the wire idles in the inactive state.

examples:
  - |
    / {
      /* LED at PA5 */
      morse_tx: transmitter {
        compatible = "zephyr,morse-gpio-tx";

        gpios = <&gpioa 5 GPIO_ACTIVE_HIGH>;
      };
    };
```

## dts/bindings/morse/zephyr,morse-pwm-tx.yaml
```yaml
# Copyright (c) 2025-2026 Freedom Veiculos Eletricos
# Copyright (c) 2025-2026 O.S. Systems Software LTDA.
# SPDX-License-Identifier: Apache-2.0

description: |
  Morse Code transmitter backend driven by a PWM channel.

  This backend uses a PWM peripheral to produce the Morse signal. While
  the Morse engine holds the keyed (mark) state, the PWM runs at the
  configured period with a 50% duty cycle; while it holds the unkeyed
  (space) state, the duty cycle is forced to 0%. The PWM period thus
  selects the carrier/tone frequency that is gated on and off by the
  dot/dash timing.

  Typical uses are driving a piezo buzzer or speaker to render Morse as
  an audible tone (side-tone), generating a sub-carrier for a radio
  modulator, or dimming an LED to a comfortable brightness.

compatible: "zephyr,morse-pwm-tx"

include: base.yaml

properties:
  pwms:
    type: phandle-array
    required: true
    description: |
      PWM channel driven for Morse output. The period encoded in the
      PWM specifier selects the tone/carrier frequency: for an audible
      side-tone choose a period in the audio band (for example PWM_USEC(500)
      for 2 kHz). The polarity flag controls the idle level of the channel.

examples:
  - |
    / {
      /* LED-0 => PB0 */
      morse_tx: transmitter {
        compatible = "zephyr,morse-pwm-tx";

        pwms = <&pwm3 3 PWM_MSEC(80) PWM_POLARITY_NORMAL>;
      };
    };

    &timers3 {
      st,prescaler = <10000>;
      status = "okay";

      pwm3: pwm {
        status = "okay";
        pinctrl-0 = <&tim3_ch3_pb0>;
        pinctrl-names = "default";
      };
    };
```
