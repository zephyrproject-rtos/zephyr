## dts/bindings/morse/zephyr,morse.yaml
```yaml
# Copyright (c) 2024-2026 Freedom Veiculos Eletricos
# Copyright (c) 2024-2026 O.S. Systems Software LTDA.
# SPDX-License-Identifier: Apache-2.0

description: |
  Morse Code subsystem controller.

  This binding describes a Morse Code engine that encodes ASCII text into
  the dot/dash symbols defined by ITU-R M.1677-1 and serializes them over
  a TX backend (for example GPIO bitbang or PWM), and/or deserializes
  them from an RX backend (for example a GPIO edge interrupt). At least
  one of tx-drv or rx-drv must be provided.

  A hardware Counter is used to generate the dot time base. Separate
  alarm channels are used for transmit and receive, so the same Counter
  instance can serve both directions simultaneously in a full-duplex
  configuration.

  Symbol timing follows ITU-R M.1677-1: a "dot" is one time unit, a
  "dash" is three time units, the space between elements of the same
  letter is one time unit, the space between letters is three time
  units, and the space between words is seven time units.

compatible: "zephyr,morse"

include: base.yaml

properties:
  speed:
    type: int
    default: 20
    description: |
      Transmission speed in Words Per Minute (WPM), measured against the
      standard reference word "PARIS ". The word "PARIS " is 50 time
      units long, represented as ".--. .- .-. .. .../" where:

        10 dits (.)               10 units
         4 dahs (-)               12 units
         9 intra-character spaces  9 units
         4 inter-character spaces 12 units
         1 word space (/)          7 units

      The driver derives the dot time unit as 60 / (50 * speed) seconds.
      With the default of 20 WPM the dot time unit is 60 ms.

  tmr:
    type: phandle
    required: true
    description: |
      Phandle to the Counter device used as the time base for serializing
      and deserializing Morse symbols. The Counter frequency must be high
      enough to resolve one dot time unit with adequate precision at the
      configured speed (the engine applies a 0.5% tolerance when matching
      RX pulse/blank lengths).

  tx-tmr-chan:
    type: int
    description: |
      Counter alarm channel dedicated to transmission. Required when
      tx-drv is provided; the engine uses this channel to clock each bit
      of the encoded stream onto the TX backend.

  rx-tmr-chan:
    type: int
    description: |
      Counter alarm channel dedicated to reception. Required when rx-drv
      is provided; the engine uses this channel to time pulse/blank
      phases and to detect end-of-letter, end-of-word and end-of-
      transmission timeouts. Must differ from tx-tmr-chan when both
      directions are enabled so the alarms do not collide.

  rx-drv:
    type: phandle
    description: |
      Phandle to the RX backend device (for example a node compatible
      with "zephyr,morse-gpio-rx") that reports bit-state transitions to
      the Morse engine for symbol decoding. Omit this property to build
      a transmit-only instance.

  tx-drv:
    type: phandle
    description: |
      Phandle to the TX backend device (for example a node compatible
      with "zephyr,morse-gpio-tx" or "zephyr,morse-pwm-tx") that drives
      the physical medium ON/OFF following the serialized bit stream.
      Omit this property to build a receive-only instance.

examples:
  - |
    /*
     * nucleo_g474re GPIO-RX/TX configuration
     * Note: that a jumper must be made between the PA5~6 pins.
     */
    / {
      /* arduino.pd12 */
      morse_rx: receiver {
        compatible = "zephyr,morse-gpio-rx";

        gpios = <&gpioa 6 GPIO_ACTIVE_HIGH>;
      };

      /* arduino.pd13 */
      morse_tx: transmitter {
        compatible = "zephyr,morse-gpio-tx";

        gpios = <&gpioa 5 GPIO_ACTIVE_HIGH>;
      };

      morse: morse {
        compatible = "zephyr,morse";
        status = "okay";

        speed = <20>;
        tmr = <&morse_counter>;

        rx-tmr-chan = <0>;
        tx-tmr-chan = <1>;

        rx-drv = <&morse_rx>;
        tx-drv = <&morse_tx>;
      };
    };

    &timers2 {
      st,prescaler = <10000>;
      status = "okay";

      morse_counter: counter {
        status = "okay";
      };
    };

  - |
    /*
     * sam_v71_xult/samv71q21 GPIO-RX/TX configuration
     */
    / {
      morse_rx: receiver {
        compatible = "zephyr,morse-gpio-rx";

        gpios = <&pioc 9 GPIO_ACTIVE_LOW>;
      };

      morse_tx: transmitter {
        compatible = "zephyr,morse-gpio-tx";

        gpios = <&pioc 9 GPIO_ACTIVE_LOW>;
      };

      morse: morse {
        compatible = "zephyr,morse";
        status = "okay";

        speed = <20>;

        tmr = <&tc0>;
        tx-tmr-chan = <0>;
        rx-tmr-chan = <1>;

        tx-drv = <&morse_tx>;
        rx-drv = <&morse_rx>;
      };
    };

    &tc0 {
      clk = <4>;
      status = "okay";
    };

  - |
    /*
     * nucleo_h753zi PWM-TX configuration
     */
    / {
      /* zio.d33 */
      morse_tx: transmitter {
        compatible = "zephyr,morse-pwm-tx";

        pwms = <&pwm12 1 PWM_MSEC(80) PWM_POLARITY_NORMAL>;
      };

      morse: morse {
        compatible = "zephyr,morse";
        status = "okay";

        speed = <2>;
        tmr = <&morse_counter>;

        tx-tmr-chan = <0>;

        tx-drv = <&morse_tx>;
      };
    };

    &timers2 {
      st,prescaler = <10000>;
      status = "okay";

      morse_counter: counter {
        status = "okay";
      };
    };
```

## dts/bindings/mspi/ambiq,mspi-controller.yaml
```yaml
# Copyright (c) 2025, Ambiq Micro Inc. <www.ambiq.com>
# SPDX-License-Identifier: Apache-2.0

description: Ambiq MSPI controller

compatible: "ambiq,mspi-controller"

include: [mspi-controller.yaml, pinctrl-device.yaml]

properties:
  reg:
    required: true

  interrupts:
    required: true

  ce-gpios:
    required: true

  cmdq-buffer-location:
    type: string
    description: |
      Define the DMA command queue buffer location section

  cmdq-buffer-size:
    type: int
    description: |
      Define the DMA command queue buffer size in (4-byte) words

  ambiq,rbx:
    type: boolean
    description: |
      Define the Ambiq MSPI controller read boundary crossing feature enable.

  ambiq,wbx:
    type: boolean
    description: |
      Define the Ambiq MSPI controller write boundary crossing feature enable.

  ambiq,apmemory:
    type: boolean
    description: |
      Define the Ambiq MSPI controller APMemory specific support enable.

  ambiq,hyperbus:
    type: boolean
    description: |
        Define the Ambiq MSPI controller HyperBus specific support enable.

  ambiq,clkond4:
    type: boolean
    description: |
        Define the Ambiq MSPI controller clock on D4 feature enable.
```

## dts/bindings/mspi/ambiq,mspi-device.yaml
```yaml
# Copyright (c) 2024, Ambiq Micro Inc. <www.ambiq.com>
# SPDX-License-Identifier: Apache-2.0

description: Ambiq MSPI device

compatible: "ambiq,mspi-device"

include: [mspi-device.yaml, "jedec,jesd216.yaml"]
```

## dts/bindings/mspi/cdns,mspi-controller.yaml
```yaml
# SPDX-FileCopyrightText: Copyright The Zephyr Project Contributors
# SPDX-FileCopyrightText: Copyright (c) 2025 - 2026 Siemens Mobility GmbH
#
# SPDX-License-Identifier: Apache-2.0

description: Cadence MSPI Controller

compatible: "cdns,mspi-controller"

include: [mspi-controller.yaml, pinctrl-device.yaml]

properties:
  reg:
    required: true
    description: |
      Address and length of the MSPI configuration register and the indirect
      write FIFO location

  clock-frequency:
    required: true

  read-buffer-size:
    required: true
    type: int
    description: |
      Amount of address bits of the internal peripheral SRAM bus that are used
      for indirects reads. The other address bits are used for indirect write
      operations. The amount of available bits is dependent on the SRAM depth
      configuration used inside the peripheral and the resulting amount of bytes
      depends on the bus width, which may be specified in the SoC datasheet.

      It is recommended to look at the SoC datasheet/TRM and set this to half of
      the maximum of the "SRAM Partition Configuration Register" value (which is
      also its reset value), leading to half of the locations being used for
      indirect reads and the other half for indirect writes
```

## dts/bindings/mspi/microchip,xec-qmspi-mspi-controller.yaml
```yaml
# Copyright (c) 2026 Microchip Technology Inc. and its subsidiaries.
# SPDX-License-Identifier: Apache-2.0

description: Microchip XEC QMSPI MSPI controller

compatible: "microchip,xec-qmspi-mspi-controller"

include: [mspi-controller.yaml, pinctrl-device.yaml]

properties:
  reg:
    required: true

  interrupts:
    required: true

  pinctrl-0:
    required: true

  pinctrl-names:
    required: true

  clock-frequency:
    type: int
    required: true
    description: |
      QMSPI input clock frequency in Hz. For MEC175x this is 96000000.

  pcr:
    type: int
    required: true
    description: |
      PCR sleep control register encoding for power gating this peripheral.

  girqs:
    type: array
    required: true
    description: |
      GIRQ and bit-position encoding for this peripheral interrupt source.

  num-hw-ce:
    type: int
    default: 1
    description: |
      Number of hardware chip selects available (1 or 2).
      This value can vary by the SPI port. The Shared SPI
      port has two HW chip enables. The Private and Internal
      SPI ports only have one HW chip enable.
```

## dts/bindings/mspi/microchip,xec-qmspi-mspi-device.yaml
```yaml
# Copyright (c) 2026, Microchip Technology Inc.
# SPDX-License-Identifier: Apache-2.0

description: Microchip MSPI device for QMSPI controller

compatible: "microchip,xec-qmspi-mspi-device"

include: [mspi-device.yaml, "jedec,jesd216.yaml"]

properties:
  mspi-io-mode:
    required: true

  mspi-data-rate:
    required: true

  mspi-hardware-ce-num:
    type: int
    required: true
    default: 0
    description: |
      It can be only CE0 or CE1,
      but there could be multiple of CE0 or CE1 for a controller

  rx-dummy:
    required: true

  tx-dummy:
    required: true

  read-command:
    required: true

  write-command:
    required: true

  command-length:
    required: true

  address-length:
    required: true

  microchip,timing-config-mask:
    type: int
    default: 0x06060406
    description: |
      It must be defined in the board DTS based on Soc series.

  microchip,timing-config:
    type: array
    default: [0, 0, 0, 0, 0, 0, 0, 0]
    description: |
      Array of tuples to configure the timing parameters
      default =
      <
        .dly_cs_on_to_sck_start = 6,
        .dly_sck_stop_to_cs_off = 4,
        .dly_last_data_hold = 0,
        .dly_cs_off_to_cs_on = 0,
        .sck_tap     = 0,
        .cr_tap      = 0,
        .sck_tap_adj = 0,
        .cr_tap_adj  = 0,
      >
```

## dts/bindings/mspi/mspi-controller.yaml
```yaml
# Copyright (c) 2024, Ambiq Micro Inc. <www.ambiq.com>
# SPDX-License-Identifier: Apache-2.0

# Common fields for MSPI controllers

include: base.yaml

bus: mspi

properties:
  clock-frequency:
    type: int
    description: |
      Clock frequency the MSPI peripheral is being driven at, in Hz.
  "#address-cells":
    required: true
    const: 1
  "#size-cells":
    required: true
    const: 0

  op-mode:
    type: string
    enum:
      - "MSPI_CONTROLLER"
      - "MSPI_PERIPHERAL"
    description: |
      Indicate MSPI controller or peripheral mode of the controller.
      The controller driver may use this during initialization.

  duplex:
    type: string
    enum:
      - "MSPI_HALF_DUPLEX"
      - "MSPI_FULL_DUPLEX"
    description: |
      Indicate MSPI Duplex mode, full or half.
      The controller driver may check this setting against its
      capabilities.

  dqs-support:
    type: boolean
    description: |
      Indicate whether the hardware supports DQS.
      The controller driver may check this setting against its
      capabilities.

  software-multiperipheral:
    type: boolean
    description: |
      Indicate whether the controller driver enables support for
      software managed multi peripheral feature.
      At the minimum, the controller driver should use it to allow
      or disallow calling mspi_dev_config with MSPI_DEVICE_CONFIG_NONE.

  ce-gpios:
    type: phandle-array
    description: |
      An array of chip select GPIOs to use. Each element
      in the array specifies a GPIO. The index in the array
      corresponds to the child node that the CE gpio controls.

      Example:

        mspi@... {
                ce-gpios = <&gpio0 23 GPIO_ACTIVE_LOW>,
                              <&gpio1 10 GPIO_ACTIVE_LOW>,
                              ...;

                mspi-device@0 {
                        reg = <0>;
                        ...
                };
                mspi-device@1 {
                        reg = <1>;
                        ...
                };
                ...
        };

      The child node "mspi-device@0" specifies a mspi device with
      chip select controller gpio0, pin 23, and devicetree
      GPIO flags GPIO_ACTIVE_LOW. Similarly, "mspi-device@1" has CE GPIO
      controller gpio1, pin 10, and flags GPIO_ACTIVE_LOW. Additional
      devices can be configured in the same way.

      If unsure about the flags cell, GPIO_ACTIVE_LOW is generally a safe
      choice for a typical "CEn" pin. GPIO_ACTIVE_HIGH may be used if
      intervening hardware inverts the signal to the peripheral device or
      the line itself is active high.

      Regardless of whether the CE pin may need software control or MSPI
      controller has dedicated CE pin, this field should be defined to
      help manage multiple devices on the same MSPI controller.
```
