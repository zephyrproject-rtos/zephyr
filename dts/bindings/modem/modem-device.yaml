## dts/bindings/modem/modem-device.yaml
```yaml
# Copyright (c) 2025 Nordic Semiconductor
# SPDX-License-Identifier: Apache-2.0

description: Modem device common bindings

include: base.yaml

properties:
  mdm-power-gpios:
    type: phandle-array

  mdm-power-pulse-ms:
    type: int

  mdm-reset-gpios:
    type: phandle-array

  mdm-reset-pulse-ms:
    type: int

  mdm-autostarts:
    type: boolean

  mdm-startup-time-ms:
    type: int

  mdm-shutdown-time-ms:
    type: int
```

## dts/bindings/modem/murata,1sc.yaml
```yaml
# Copyright (c) 2023 T-Mobile USA, Inc.
# SPDX-License-Identifier: Apache-2.0

description: murata 1sc modem

compatible: "murata,1sc"

include: uart-device.yaml

properties:
  mdm-wake-host-gpios:
    type: phandle-array

  mdm-wake-mdm-gpios:
    type: phandle-array

  mdm-reset-gpios:
    type: phandle-array

  mdm-rst-done-gpios:
    type: phandle-array

  mdm-rx-gpios:
    type: phandle-array

  mdm-tx-gpios:
    type: phandle-array
```

## dts/bindings/modem/nordic,nrf91-slm.yaml
```yaml
description: Nordic nRF91 series running the Serial LTE Modem application

compatible: "nordic,nrf91-slm"

include: zephyr,cellular-modem-device.yaml

properties:
  zephyr,use-default-pdp-ctx:
    default: 1

  zephyr,mdm-reset-behavior:
    default: ["toggle_on_recovery"]
```

## dts/bindings/modem/nordic,nrf9160.yaml
```yaml
# Copyright (c) Sendrato B.V. 2023
# SPDX-License-Identifier: Apache-2.0

description: Nordic nRF9160 modem

compatible: "nordic,nrf9160"

include: uart-device.yaml

properties:
  mdm-power-gpios:
    type: phandle-array

  mdm-reset-gpios:
    type: phandle-array
```

## dts/bindings/modem/nordic,nrf93m1.yaml
```yaml
# Copyright (c) 2026 Nordic Semiconductor ASA
# SPDX-License-Identifier: Apache-2.0

description: Nordic nRF93M1 module

compatible: "nordic,nrf93m1"

include: zephyr,cellular-modem-device.yaml

properties:
  zephyr,mdm-reset-behavior:
    default: ["toggle_on_recovery"]

  mdm-power-gpios:
    type: phandle-array
    required: true
```

## dts/bindings/modem/openisa,rv32m1-genfsk.yaml
```yaml
# Copyright 2019, NXP
# SPDX-License-Identifier: Apache-2.0

description: RV32M1 Generic FSK programmable modem node

compatible: "openisa,rv32m1-genfsk"

include: base.yaml

properties:
  reg:
    required: true

  interrupts:
    required: true
```

## dts/bindings/modem/quectel,bc66.yaml
```yaml
# SPDX-License-Identifier: Apache-2.0
#
# SPDX-FileCopyrightText: Copyright The Zephyr Project Contributors
# SPDX-FileCopyrightText: Copyright 2026 Giovanni Piccari <giopiccari@outlook.com>
# SPDX-FileCopyrightText: Copyright 2026 M31 srl <info@m31.com>

description: Quectel BC66 NB-IoT modem

compatible: "quectel,bc66"

include: quectel,bc66x.yaml
```

## dts/bindings/modem/quectel,bc660k.yaml
```yaml
# SPDX-License-Identifier: Apache-2.0
#
# SPDX-FileCopyrightText: Copyright The Zephyr Project Contributors
# SPDX-FileCopyrightText: Copyright 2026 Giovanni Piccari <giopiccari@outlook.com>
# SPDX-FileCopyrightText: Copyright 2026 M31 srl <info@m31.com>

description: Quectel BC660K NB-IoT modem

compatible: "quectel,bc660k"

include: quectel,bc66x.yaml
```

## dts/bindings/modem/quectel,bc66x.yaml
```yaml
# SPDX-License-Identifier: Apache-2.0
#
# SPDX-FileCopyrightText: Copyright The Zephyr Project Contributors
# SPDX-FileCopyrightText: Copyright 2026 Giovanni Piccari <giopiccari@outlook.com>
# SPDX-FileCopyrightText: Copyright 2026 M31 srl <info@m31.com>

description: Quectel BC660K-GL or BC66 NB-IoT modem

compatible: "quectel,bc66x"

include: zephyr,cellular-modem-device.yaml

properties:
  mdm-boot-gpios:
    type: phandle-array
    required: true
    description: BOOT pin (PWRKEY)

  mdm-rst-gpios:
    type: phandle-array
    required: true
    description: RST pin

  mdm-psm-gpios:
    type: phandle-array
    required: true
    description: PSM pin (PSM_EINT)
```

## dts/bindings/modem/quectel,bg95.yaml
```yaml
# Copyright (c) 2023 Bjarki Arge Andreasen
# SPDX-License-Identifier: Apache-2.0

description: Quectel BG95 modem

compatible: "quectel,bg95"

include: zephyr,cellular-modem-device.yaml

properties:
  mdm-power-gpios:
    type: phandle-array

  zephyr,mdm-reset-behavior:
    default: ["toggle_on_recovery"]
```

## dts/bindings/modem/quectel,bg96.yaml
```yaml
# Copyright (c) 2025 Guilherme Costa
# SPDX-License-Identifier: Apache-2.0

description: quectel BG96 modem

compatible: "quectel,bg96"

include: uart-device.yaml

properties:
  mdm-power-gpios:
    type: phandle-array

  mdm-reset-gpios:
    type: phandle-array

  autostarts:
    type: boolean
    description: |
      Set for modem variants or carrier boards that start the module
      automatically when supply voltage is applied—that is, the modem
      asserts PWRKEY internally and does not require an external PWRKEY
      pulse.
```

## dts/bindings/modem/quectel,bg9x.yaml
```yaml
# Copyright (c) 2020 Analog Life LLC
# SPDX-License-Identifier: Apache-2.0

description: quectel BG9x modem

compatible: "quectel,bg9x"

include: zephyr,cellular-modem-device.yaml

properties:
  mdm-power-gpios:
    type: phandle-array
    required: true

  mdm-dtr-gpios:
    type: phandle-array

  mdm-wdisable-gpios:
    type: phandle-array
```

## dts/bindings/modem/quectel,eg800q.yaml
```yaml
description: Quectel EG800Q modem

compatible: "quectel,eg800q"

include: zephyr,cellular-modem-device.yaml

properties:
  mdm-power-gpios:
    type: phandle-array
    required: true

  zephyr,mdm-reset-behavior:
    default: ["toggle_on_recovery"]
```

## dts/bindings/modem/quectel,eg915u.yaml
```yaml
description: Quectel EG915U modem

compatible: "quectel,eg915u"

include: uart-device.yaml

properties:
  mdm-power-gpios:
    type: phandle-array
    required: true

  mdm-reset-gpios:
    type: phandle-array
    required: true
```

## dts/bindings/modem/simcom,a76xx.yaml
```yaml
# Copyright (C) 2025 Olivier Lalonde
# SPDX-License-Identifier: Apache-2.0

description: Simcom A76XX modem

compatible: "simcom,a76xx"

include: zephyr,cellular-modem-device.yaml

properties:
  mdm-power-gpios:
    type: phandle-array
    required: true
```

## dts/bindings/modem/simcom,sim7080.yaml
```yaml
# Copyright (C) 2021 metraTec GmbH
# SPDX-License-Identifier: Apache-2.0

description: Simcom Sim7080 modem

compatible: "simcom,sim7080"

include: uart-device.yaml

properties:
  label:
    required: true

  mdm-power-gpios:
    type: phandle-array
    required: true
```

## dts/bindings/modem/sqn,gm02s.yaml
```yaml
# Copyright (c) 2024 DPTechnics bv
# SPDX-License-Identifier: Apache-2.0

description: Sequans Monarch 2 GM02S Modem

compatible: "sqn,gm02s"

include: zephyr,cellular-modem-device.yaml

properties:
  mdm-reset-gpios:
    type: phandle-array
    required: true
```

## dts/bindings/modem/st,87mxx.yaml
```yaml
# Copyright (c) 2025 STMicroelectronics
# SPDX-License-Identifier: Apache-2.0

description: ST87MXX NBIoT modem

compatible: "st,87mxx"

include: uart-device.yaml

properties:
  mdm-reset-gpios:
    type: phandle-array
    required: true

  mdm-ring-gpios:
    type: phandle-array
    required: true
```

## dts/bindings/modem/st,st87mxx.yaml
```yaml
# Copyright (c) 2025 STMicroelectronics
# SPDX-License-Identifier: Apache-2.0

description: ST87MXX NBIoT modem

compatible: "st,st87mxx"

include: uart-device.yaml

properties:
  mdm-reset-gpios:
    type: phandle-array
    required: true
    description: GPIO for modem reset

  mdm-ring-gpios:
    type: phandle-array
    required: true
    description: GPIO for modem wake
```

## dts/bindings/modem/swir,hl7800.yaml
```yaml
#
# Copyright (c) 2020, Laird Connectivity
#
# SPDX-License-Identifier: Apache-2.0
#

description: Sierra Wireless HL7800 Modem

compatible: "swir,hl7800"

include: uart-device.yaml

properties:
    label:
      required: true

    mdm-wake-gpios:
        type: phandle-array
        required: true

    mdm-reset-gpios:
        type: phandle-array
        required: true

    mdm-pwr-on-gpios:
        type: phandle-array
        required: true

    mdm-fast-shutd-gpios:
        type: phandle-array
        required: true

    mdm-uart-dtr-gpios:
        type: phandle-array
        required: true

    mdm-vgpio-gpios:
        type: phandle-array
        required: true

    mdm-uart-dsr-gpios:
        type: phandle-array
        required: true

    mdm-uart-cts-gpios:
        type: phandle-array
        required: true

    mdm-gpio2-gpios:
        type: phandle-array
        required: false

    mdm-gpio6-gpios:
        type: phandle-array
        required: true
```

## dts/bindings/modem/swir,hl7812-gnss.yaml
```yaml
description: |
  Binding for a modem offload child node that indicates the modem
  supports socket offload functionality. This node is intended to be a
  child of a modem device node (for example, `modem: hl_modem { ... };`).

  The binding is intentionally small and extensible; it documents a
  presence node (compatible = "swir,hl7812-offload") and may be extended
  in future with additional properties that the driver may consume.

compatible: "swir,hl7812-gnss"

include: swir,hl78xx-gnss.yaml
```

## dts/bindings/modem/swir,hl7812-offload.yaml
```yaml
# Copyright (c) 2025, Netfeasa Ltd.
# SPDX-License-Identifier: Apache-2.0

description: Sierra Wireless HL7812 Modem offload

compatible: "swir,hl7812-offload"

include: swir,hl78xx-offload.yaml
```

## dts/bindings/modem/swir,hl7812.yaml
```yaml
# Copyright (c) 2025, Netfeasa Ltd.
# SPDX-License-Identifier: Apache-2.0

description: Sierra Wireless HL7812 Modem

compatible: "swir,hl7812"

include: swir,hl78xx.yaml
```

## dts/bindings/modem/swir,hl78xx-gnss.yaml
```yaml
description: |
  Binding for a modem child node that indicates the modem supports
  GNSS functionality. This node is intended to be a child of a modem
  device node (for example, `modem: hl_modem { ... };`).

  The binding is intentionally small and extensible; it documents a
  presence node (compatible = "swir,hl78xx-gnss") and may be extended
  in future with additional properties that the driver may consume.

compatible: "swir,hl78xx-gnss"

include:
  - uart-device.yaml
  - gnss-nmea-generic.yaml
  - gnss-pps.yaml

properties:
  fix-rate:
    type: int
    default: 1000
    description: |
      Initial fix-rate GNSS modem will be operating on. May be adjusted at
      run-time through GNSS APIs. Must be greater than 50-ms.
      Default is power-on setting.
```

## dts/bindings/modem/swir,hl78xx-offload.yaml
```yaml
description: |
  Binding for a modem child node that indicates the modem supports
  socket offloading. This node is intended to be a child of a modem
  device node (for example, `modem: hl_modem { ... };`).

  The binding is intentionally small and extensible; it documents a
  presence node (compatible = "net,offload-modem-sockets") and a couple
  of optional integer properties that the driver may consume.

compatible: "swir,hl78xx-offload"

properties:
  max-data-length:
    type: int
    description: |
      "Maximum length of a single data payload (bytes) that
      the modem can send/receive in one offload operation."
    enum:
      - 512
      - 1024
      - 2048
      - 4096
      - 8192

  offload-priority:
    type: int
    description: |
      "Priority of this offload modem compared to other offload
      modems in the system. Lower values indicate higher priority.
      The system will prefer to use the offload modem with the
      highest priority (lowest value) when multiple offload modems
      are available."
```
