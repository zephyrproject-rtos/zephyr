## dts/bindings/espi/nuvoton,npcx-host-pm-channel.yaml
```yaml
# Copyright (c) 2026 Nuvoton Technology Corporation.
# SPDX-License-Identifier: Apache-2.0

description: |
  Nuvoton NPCX Host Sub-Module - Power Management (PM) channel.
  Used for host I/O and host command channels.

compatible: "nuvoton,npcx-host-pm-channel"

include: [base.yaml]

properties:
  reg:
    required: true

  clocks:
    description: Clock configuration for the PM channel module.

  interrupts:
    description: |
      Optional interrupts for the PM channel. The primary channel provides
      "pmch_ibf" (Input Buffer Full) and "pmch_obe" (Output Buffer Empty).

  interrupt-names:
    description: |
      Names for the PM channel interrupts: "pmch_ibf" and/or "pmch_obe".

  ldn:
    type: int
    required: true
    description: |
      Logical Device Number for this PM channel.

  host-io-data-addr:
    type: int
    description: |
      Host I/O data port address for this PM channel.

  host-io-cmd-addr:
    type: int
    description: |
      Host I/O command/status port address for this PM channel.
```

## dts/bindings/espi/nuvoton,npcx-host-shm.yaml
```yaml
# Copyright (c) 2020 Nuvoton Technology Corporation.
# SPDX-License-Identifier: Apache-2.0

description: Nuvoton NPCX Host Sub-Module - Shared Memory (SHM)

compatible: "nuvoton,npcx-host-shm"

include: [base.yaml]

properties:
  reg:
    required: true

  interrupts:
    required: true

  interrupt-names:
    required: true
    description: |
      Interrupt names for the SHM module. Must contain "shm" for
      the SHM semaphore interrupt.

  ldn:
    type: int
    required: true
    description: |
      Logical Device Number for SHM module.
```

## dts/bindings/espi/nuvoton,npcx-host-sub-v2.yaml
```yaml
# Copyright (c) 2026 Nuvoton Technology Corporation.
# SPDX-License-Identifier: Apache-2.0

description: Nuvoton, NPCX Host Sub-Modules container node with child devices

compatible: "nuvoton,npcx-host-sub-v2"

include: [base.yaml]

properties:
  "#address-cells":
    type: int
    const: 1

  "#size-cells":
    type: int
    const: 1

  host-acc-wui:
    type: phandle
    required: true
    description: |
      Mapping table between Wake-Up Input (WUI) and any legacy host
      access transactions.

      For example the WUI mapping on NPCX7 would be
         host-acc-wui = <&wui_host_acc>;

child-binding:
  description: Host sub-module child node
```

## dts/bindings/espi/nxp,espi-taf.yaml
```yaml
# Copyright 2026 NXP
# SPDX-License-Identifier: Apache-2.0

description: |
  NXP MCX A series eSPI Target Attached Flash (TAF) controller.

  This node is a child of the nxp,espi controller node. It shares the
  parent's register block and hardware interrupt; the parent eSPI driver
  owns the sole interrupt and forwards host flash requests to this driver
  through an internal bridge. The TAF driver binds the standard
  espi_saf_driver_api so it can interface with espi_saf_* upper layers.

  Representation:

    espi0: espi@1f000 {
        compatible = "nxp,espi";
        ...

        espi_taf: espi-taf {
            compatible = "nxp,espi-taf";
            flash-dev = <&espi_taf_sim_flash>;
            status = "okay";
        };
    };

compatible: "nxp,espi-taf"

include: [base.yaml]

properties:
  flash-dev:
    type: phandle
    required: true
    description: |
      Reference to the local flash device that backs Target Attached
      Flash. Host-initiated read/write/erase requests over the eSPI
      flash channel are serviced against this device.

  max-read-size:
    type: int
    default: 64
    description: |
      Maximum completion payload size in bytes used when returning data
      for host read requests. Bounded by the hardware port RAM buffer and
      the OMFLEN length field.
```

## dts/bindings/espi/nxp,espi.yaml
```yaml
# Copyright 2025-2026 NXP
# SPDX-License-Identifier: Apache-2.0

description: |
  NXP MCX A series eSPI target controller.

  The peripheral has up to 5 configurable I/O ports.
  Each port is described by a child node whose reg property gives
  the hardware port index (0-4).

compatible: "nxp,espi"

include: [espi-controller.yaml, pinctrl-device.yaml]

properties:
  reg:
    required: true

  interrupts:
    required: true

  clocks:
    required: true

  pinctrl-0:
    required: true

  pinctrl-names:
    required: true

  ram-base-addr:
    type: int
    required: true
    description: |
      SRAM base address used by the eSPI hardware for mailbox and
      OOB DMA buffers. Must be naturally aligned and accessible
      by the eSPI bus-master engine.

  map-base0-addr:
    type: int
    default: 0
    description: |
      Upper 16-bit base address for ports that select BASE0
      addressing via the PnADDR register. Combined with the
      port's io-addr to form the full host-side address.

  map-base1-addr:
    type: int
    default: 0
    description: |
      Upper 16-bit base address for ports that select BASE1
      addressing via the PnADDR register. Combined with the
      port's io-addr to form the full host-side address.

  max-oob-payload-size:
    type: int
    default: 64
    enum: [64, 128, 256]
    description: |
      Maximum OOB channel payload size in bytes advertised to the host
      through the ESPICAP.OOBMX capability field. This is a capability
      ceiling: the host can only negotiate a value less than or equal to
      this. The default matches the hardware/HAL reset capability.

  max-flash-payload-size:
    type: int
    default: 64
    enum: [64, 128, 256, 512]
    description: |
      Maximum flash channel payload size in bytes advertised to the host
      through the ESPICAP.FLASHMX capability field. This is a capability
      ceiling: the host can only negotiate a value less than or equal to
      this. The default matches the hardware/HAL reset capability.

  max-peripheral-payload-size:
    type: int
    default: 64
    enum: [64, 128, 256]
    description: |
      Maximum peripheral channel payload size in bytes advertised to the host
      through the ESPICAP.MEMMX capability field. This is a capability
      ceiling: the host can only negotiate a value less than or equal to
      this. The default matches the hardware/HAL reset capability.

  max-taf-read-req-size:
    type: int
    default: 64
    enum: [64, 128, 256, 512, 1024, 2048, 4096]
    description: |
      Maximum target read request size in bytes advertised to the host
      through the ESPICAP.TRGT_REQ_SIZE_SUPP capability field. This is a
      capability ceiling: the host can only negotiate a value less than or
      equal to this. The default matches the hardware/HAL reset capability.

  taf-erase-size:
    type: int
    default: 2
    enum: [2, 4, 8, 16]
    description: |
      Target-Attached-Flash minimum erase sector size in kilobytes advertised
      to the host through the ESPICAP.SAFERA capability field. The default
      matches the hardware/HAL reset capability.

child-binding:
  description: eSPI port configuration.

  properties:
    reg:
      type: int
      required: true
      description: |
        Hardware port index. The driver maps each child node to the hardware
        port at that index in declaration order, so child nodes must cover
        every index from 0 up to the highest used port without gaps.
        Use port-type = <0x0> as a placeholder for any index in that range
        that requires no active function.

    port-type:
      type: int
      required: true
      enum: [0x0, 0x1, 0x2, 0x4, 0x5, 0x8, 0x9, 0xA, 0xB, 0xC]
      description: |
        Port function type. The hardware port slot number equals the position
        of this child node in the sorted child list, so all indices from 0 to
        the highest active port must be present.
          0x0 = Unconfigured
          0x1 = ACPI Endpoint
          0x2 = ACPI Index-Data
          0x4 = Bus Master Memory
          0x5 = Bus Master Flash
          0x8 = Mailbox Shared
          0x9 = Mailbox Single
          0xA = Mailbox Split
          0xB = Mailbox OOB Split
          0xC = Mailbox OEM

    io-addr:
      type: int
      default: 0
      description: Host-side I/O address offset for this port.

    ram-offset:
      type: int
      default: 0
      description: Byte offset from ram-base-addr for this port's DMA buffer.

    ram-size:
      type: int
      default: 4
      enum: [4, 8, 16, 32, 64, 128, 256, 512]
      description: RAM buffer size in bytes for this port's DMA buffer.

    idx-offset:
      type: int
      default: 0
      description: Index register offset for ACPI Index-Data ports.
```

## dts/bindings/ethernet/alif,ensemble-eth.yaml
```yaml
# SPDX-FileCopyrightText: Copyright Alif Semiconductor
# SPDX-License-Identifier: Apache-2.0

title: Alif Ensemble Ethernet MAC

description: |
  Synopsys DesignWare Ethernet QoS MAC of the Alif Ensemble SoCs, limited to
  10/100 Mbps over RMII.

compatible: "alif,ensemble-eth"

include:
  - snps,dwmac.yaml
  - pinctrl-device.yaml

properties:
  reg:
    required: true

  interrupts:
    required: true

  clocks:
    required: true
    description: |
      The RMII reference clock source selection, either the ETH_REFCLK pin
      (ALIF_ETH_RMII_REFCLK) or the internal 50 MHz PLL output
      (ALIF_ETH_RMII_PLL_50M), the RMII clock gate (ALIF_ETH_RMII_CLK), the
      CSR clock (ALIF_ETH_SYST_HCLK), from whose rate the MDIO clock range is
      derived, and the PTP reference clock (ALIF_ETH_PTP_100M_CLK), which
      drives the timestamp counter.

  clock-names:
    required: true
    description: |
      Must be "rmii-src" for the source selection, "rmii" for the gate, "csr"
      for the CSR clock and "ptp" for the PTP reference clock.

  pinctrl-0:
    required: true

  pinctrl-names:
    required: true

  phy-connection-type:
    required: true

examples:
  - |
    eth: ethernet@48100000 {
        compatible = "alif,ensemble-eth", "snps,dwmac";
        reg = <0x48100000 0x2000>;
        interrupts = <148 0>;
        clocks = <&clockctrl ALIF_ETH_RMII_REFCLK>,
                 <&clockctrl ALIF_ETH_RMII_CLK>,
                 <&clockctrl ALIF_ETH_SYST_HCLK>,
                 <&clockctrl ALIF_ETH_PTP_100M_CLK>;
        clock-names = "rmii-src", "rmii", "csr", "ptp";
        pinctrl-0 = <&eth_default>;
        pinctrl-names = "default";
        phy-connection-type = "rmii";
        phy-handle = <&phy>;
    };
```

## dts/bindings/ethernet/cdns,gem.yaml
```yaml
# SPDX-FileCopyrightText: Copyright The Zephyr Project Contributors
# SPDX-License-Identifier: Apache-2.0

description: |
  Cadence GEM (Gigabit Ethernet MAC), also known as MACB.

  This is the generic binding for the MAC, SoC integrations add a more
  specific compatible in front of it, for example:

    gem0: ethernet@e000b000 {
      compatible = "xlnx,zynq-gem", "cdns,gem";
      reg = <0xe000b000 0x1000>, <0xf8000140 0x4>;
      reg-names = "mac", "clkc";
      interrupts = <GIC_SPI 22 IRQ_TYPE_LEVEL IRQ_DEFAULT_PRIORITY>;
      clocks = <&cpu_1x>, <&cpu_1x>, <&iopll>;
      clock-names = "pclk", "hclk", "pll";
      phy-handle = <&gem0_phy>;
      phy-connection-type = "rgmii";

      mdio {
        compatible = "cdns,macb-mdio";
        #address-cells = <1>;
        #size-cells = <0>;

        gem0_phy: phy@0 {
          compatible = "ethernet-phy";
          reg = <0>;
        };
      };
    };

  The MAC configuration is derived from the design configuration registers
  of the core; the phy-connection-type property selects the PHY interface,
  MII when it is absent.

compatible: "cdns,gem"

include: ethernet-controller.yaml

properties:
  reg:
    required: true

  interrupts:
    required: true

  phy-handle:
    required: true

  clocks:
    required: true

  clock-names:
    required: true
    description: |
      Names of the clocks, as in the Linux binding of the MAC. The driver
      enables all of them.

      - "pclk": peripheral clock, required. Its rate selects the divider
        of the management clock MDC.
      - "hclk": AHB clock.
      - "tx_clk": transmit clock. Unless the PHY interface is MII or RMII,
        the driver sets its rate to 125 MHz, 25 MHz or 2.5 MHz to match the
        link speed, with the rate in Hz passed by value as the rate
        argument of clock_control_set_rate(). A clock controller that does
        not implement the call is taken as a fixed clock. SoC integrations
        may provide this clock themselves, see their bindings.
      - "rx_clk": receive clock.
      - "tsu_clk": clock of the 1588 time stamp unit. Without it the unit
        is taken to run from "pclk".
```

## dts/bindings/ethernet/cdns,macb-ptp-clock.yaml
```yaml
# SPDX-FileCopyrightText: Copyright The Zephyr Project Contributors
# SPDX-License-Identifier: Apache-2.0

description: |
  PTP clock of the Cadence MACB/GEM Ethernet MAC, its 1588 time stamp unit.
  A child node named ptp-clock of the MAC node, whose registers it uses.
  The unit runs from the "tsu_clk" clock of the MAC node, from "pclk" when
  there is none.

    &eth0 {
      eth0_ptp: ptp-clock {
        compatible = "cdns,macb-ptp-clock";
      };
    };

compatible: "cdns,macb-ptp-clock"

include: base.yaml
```
