## dts/bindings/ethernet/davicom,dm9000.yaml
```yaml
# Copyright (c) 2026 Fuyu Fei
# SPDX-License-Identifier: Apache-2.0

description: |
  Davicom DM9000 10/100BASE-T Ethernet controller with parallel host
  interface.

  The controller exposes an index (address) port and a data port, both
  mapped through a parallel/external memory bus and described with two reg
  regions named "addr" and "data".

  The host interface width (8-, 16- or 32-bit) is selected by the DM9000's
  pin strapping at reset. This driver supports the 16-bit interface only.

  The integrated MII PHY is reached through the controller's EPCR/EPAR/EPDR
  registers. Describe it as an "ethernet-phy" node (reg = <1>) on a
  "davicom,dm9000-mdio" child bus and point phy-handle at it; the generic
  phy_mii driver then manages link state over that bus. For example:

    eth0: ethernet@... {
            compatible = "davicom,dm9000";
            phy-handle = <&dm9000_phy>;
            ...
            mdio {
                    compatible = "davicom,dm9000-mdio";
                    #address-cells = <1>;
                    #size-cells = <0>;
                    dm9000_phy: ethernet-phy@1 {
                            compatible = "ethernet-phy";
                            reg = <1>;
                    };
            };
    };

compatible: "davicom,dm9000"

include: [ethernet-controller.yaml, base.yaml]

properties:
  reg:
    required: true

  phy-handle:
    required: true

  reg-names:
    required: true
    description: |
      Names of the two register regions: "addr" for the index port and
      "data" for the data port.

  int-gpios:
    type: phandle-array
    required: true
    description: |
      Interrupt pin of the DM9000.

  reset-gpios:
    type: phandle-array
    description: |
      RESET pin of the DM9000 (optional). When present, the driver pulses it
      during initialization to hardware-reset the controller. Omit it on
      boards that tie the DM9000 reset to the SoC reset line.

  host-clock-frequency:
    type: int
    default: 100000000
    description: |
      Frequency in Hz of the host bus clock driving the DM9000's parallel
      interface. The driver uses it to select the controller's bus timing.
      Defaults to 100 MHz.

  direct-io:
    type: boolean
    description: |
      Access the DM9000 index and data ports with plain volatile pointer
      dereferences instead of sys_read16()/sys_write16(). This omits the
      data memory barrier those helpers emit on some architectures, which
      speeds up the per-frame FIFO copy loops.

      Because the accessors are compiled in globally, this property must be
      present on every davicom,dm9000 instance or on none of them. Enable it
      only when every instance sits on a strongly ordered, non-speculative
      device-memory region (the normal case for an external parallel bus
      such as the STM32 FMC).
```

## dts/bindings/ethernet/ethernet-controller.yaml
```yaml
# Copyright (c) 2018, Linaro Limited
# SPDX-License-Identifier: Apache-2.0

# Common fields for Ethernet devices

include:
  - name: base.yaml
  - name: ethernet-mac-address.yaml

properties:
  max-speed:
    type: int
    description: |
      Specifies the maximum supported speed of the Ethernet controller in Mbit/s.

  phy-handle:
    type: phandle
    dependency-mode: ignore
    description: |
      Specifies a reference to a node representing a PHY device.

  phy-connection-type:
    type: string
    description: |
      Specifies the interface connection type between ethernet MAC and PHY.
    enum:
      - "mii"
      - "rmii"
      - "gmii"
      - "rgmii"
      - "rgmii-id"
      - "rgmii-txid"
      - "rgmii-rxid"
      - "tbi"
      - "rtbi"
      - "smii"
      - "sgmii"
      - "rev-mii"
      - "xgmii"
      - "moca"
      - "qsgmii"
      - "trgmii"
      - "internal"

  pcs-handle:
    type: phandles
    dependency-mode: ignore
    description: |
      Physical coding sublayer (PCS) devices used by this Ethernet controller,
      for example on an MDIO bus. An external PHY behind the PCS is described
      by phy-handle.

  pcs-handle-names:
    type: string-array
    description: |
      Names for the pcs-handle entries, in the same order.

  ptp-clock:
    type: phandle
    description: |
      Corresponding ptp clock device.

  rx-fifo-depth:
    type: int
    description: |
      Specifies the depth of the receive FIFO buffer.

  tx-fifo-depth:
    type: int
    description: |
      Specifies the depth of the transmit FIFO buffer.

  rx-internal-delay-ps:
    type: int
    description: |
      Specifies the internal delay of the receive path in picoseconds.
      Only for RGMII interfaces. Applied by the MAC.

  tx-internal-delay-ps:
    type: int
    description: |
      Specifies the internal delay of the transmit path in picoseconds.
      Only for RGMII interfaces. Applied by the MAC.
```

## dts/bindings/ethernet/infineon,cat1c-gem.yaml
```yaml
# SPDX-FileCopyrightText: Copyright The Zephyr Project Contributors
# SPDX-License-Identifier: Apache-2.0

description: |
  Cadence GEM in the Infineon CAT1C (TRAVEO T2G) MCUs.

  The GEM sits behind a wrapper whose control register, the second register
  range, selects the PHY interface and derives the transmit clock of the
  RGMII, GMII and RMII interfaces from a reference clock through an integer
  divider. The driver provides the transmit clock of the MAC itself from that
  register and retunes the divider to the link speed.

  The clocks are:

  - "pclk": the clock of the peripheral bus, the clk_peri node of the SoC.
  - "ref_clk": the source of the reference clock divider, either a
    fixed-clock node describing the oscillator on the REF_CLK pin of the
    MAC, or a clk_hf root clock for the internal source. The internal
    source is only available for RMII.
  - "tsu_clk": the clk_hf root clock of the 1588 time stamp unit, clk_hf5
    on the CYT4DN.

  Example:

    eth0: ethernet@40481000 {
      compatible = "infineon,cat1c-gem", "cdns,gem";
      reg = <0x40481000 0x800>, <0x40480000 0x8>;
      reg-names = "mac", "ctl";
      interrupt-parent = <&intmux_ch1>;
      interrupts = <83 0>;
      clocks = <&clk_peri>, <&eth0_refclk>, <&clk_hf5>;
      clock-names = "pclk", "ref_clk", "tsu_clk";
      phy-handle = <&eth0_phy>;
      phy-connection-type = "rgmii-id";
    };

compatible: "infineon,cat1c-gem"

include: "cdns,gem.yaml"

properties:
  pinctrl-0:
    required: true

  pinctrl-names:
    required: true

  reg-names:
    required: true
    description: |
      Names of the register ranges: "mac" for the GEM itself and "ctl" for
      the control register of the wrapper.
```

## dts/bindings/ethernet/infineon,pse84-gem.yaml
```yaml
# SPDX-FileCopyrightText: Copyright (c) 2026 Infineon Technologies AG,
# SPDX-FileCopyrightText: or an affiliate of Infineon Technologies AG. All rights reserved.
#
# SPDX-License-Identifier: Apache-2.0

description: |
  Cadence GEM in the Infineon PSOC Edge E84 (PSE84) MCUs.

  The GEM sits behind a wrapper whose control register, the second register
  range, selects the PHY interface (MII or RMII) and enables the MAC. The
  driver provides the clocks of the MAC itself.

  The clocks are:

  - "pclk": the clk_hf root clock of the PERI group of the MAC, the bus
    clock is derived from it by the divider of the group.
  - "ref_clk": optional, the peripheral clock divider of REF_CLK_INT, which
    must be a PERI0 group 3 divider ([00 03]), the internal source of the
    RMII reference clock. Without it, the reference clock comes from the
    REF_CLK pin. Not used for MII.
  - "tsu_clk": optional, the peripheral clock divider of CLK_TSU, which must
    be a PERI0 group 4 divider ([00 04]), the clock of the 1588 time stamp
    unit. An enabled tsu_clk divider is required when PTP is enabled.

  A clock divider is only used when its node is enabled.

  Example:

    ethernet0: ethernet@42c11000 {
      compatible = "infineon,pse84-gem", "cdns,gem";
      reg = <0x42c11000 0x800>, <0x42c10000 0x4>;
      reg-names = "mac", "ctl";
      interrupts = <171 4>;
      clocks = <&clk_hf0>, <&peri0_group4_8bit_0>;
      clock-names = "pclk", "tsu_clk";
      phy-handle = <&eth_phy>;
      phy-connection-type = "mii";
    };

compatible: "infineon,pse84-gem"

include: "cdns,gem.yaml"

properties:
  pinctrl-0:
    required: true

  pinctrl-names:
    required: true

  reg-names:
    required: true
    description: |
      Names of the register ranges: "mac" for the GEM itself and "ctl" for
      the control register of the wrapper.
```

## dts/bindings/ethernet/litex,liteeth-1000basex-phy.yaml
```yaml
# Copyright (c) 2025 Vogl Electronic GmbH
# SPDX-License-Identifier: Apache-2.0

description: LiteX Ethernet 1000BASE-X PHY

compatible: "litex,liteeth-1000basex-phy"

include: [phy.yaml]

properties:
  reg:
    required: true

  interrupts:
    required: true
```

## dts/bindings/ethernet/mdio/cdns,macb-mdio.yaml
```yaml
# SPDX-FileCopyrightText: Copyright The Zephyr Project Contributors
# SPDX-License-Identifier: Apache-2.0

description: |
  MDIO controller of the Cadence MACB/GEM Ethernet MAC, a child node of
  the MAC node whose registers it uses.

compatible: "cdns,macb-mdio"

include: mdio-controller.yaml
```

## dts/bindings/ethernet/mdio/infineon,xmc4xxx-mdio.yaml
```yaml
# Copyright (c) 2023 SLB
# SPDX-License-Identifier: Apache-2.0

description: Infineon xmc4xxx Family MDIO Driver node

compatible: "infineon,xmc4xxx-mdio"

include:
  - name: mdio-controller.yaml
  - name: pinctrl-device.yaml

properties:
  pinctrl-0:
    required: true

  pinctrl-names:
    required: true
```

## dts/bindings/ethernet/mdio/microchip,gmac-g2-mdio.yaml
```yaml
# SPDX-FileCopyrightText: Copyright The Zephyr Project Contributors
# SPDX-License-Identifier: Apache-2.0

title: Microchip G2 GMAC MDIO controller

description: |
  The MDIO management interface of the Microchip G2 GMAC (PIC32CZ CA "ETH").

  Must be a child of a "microchip,gmac-g2-eth" node: it has no registers of
  its own and uses the parent's reg and clocks. It is usable on its own, before
  or without the Ethernet driver, so the PHY can be probed at boot.

compatible: "microchip,gmac-g2-mdio"

include:
  - name: mdio-controller.yaml
  - name: pinctrl-device.yaml

properties:
  pinctrl-0:
    required: true

  pinctrl-names:
    required: true
```
