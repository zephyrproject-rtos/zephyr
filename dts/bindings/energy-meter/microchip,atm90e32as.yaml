## dts/bindings/energy-meter/microchip,atm90e32as.yaml
```yaml
# Copyright (c) 2025 Pedro Ramos
# SPDX-License-Identifier: Apache-2.0

description: |
  Microchip ATM90E32AS poly-phase energy metering IC (formerly Atmel M90E32AS)
  on a 4-wire SPI bus, mode 3 (CPOL=1, CPHA=1).

  Register properties hold 16-bit register values and default to the
  datasheet power-on values. Properties with one value per phase are ordered
  <phase-A phase-B phase-C>.

compatible: "microchip,atm90e32as"

include: spi-device.yaml

examples:
  - |
    &spi0 {
      meter@0 {
        compatible = "microchip,atm90e32as";
        reg = <0>;
        spi-max-frequency = <1000000>;
        meter-constant = <3200>;
        mmode0 = <0x0185>;
        u-gain = <0x8000 0x8000 0x8000>;
        i-gain = <0x8000 0x8000 0x8000>;
        irq0-gpios = <&gpio0 10 GPIO_ACTIVE_HIGH>;
        pm0-gpios = <&gpio0 11 GPIO_ACTIVE_HIGH>;
        pm1-gpios = <&gpio0 12 GPIO_ACTIVE_HIGH>;
      };
    };

properties:
  meter-constant:
    type: int
    default: 3200
    description: |
      Meter constant (MC) in pulses per kWh: one CF pulse is 1 kWh / MC.
      It must match the value pl-constant was derived from.

  current-scale:
    type: array
    default: [1, 1]
    min-len: 2
    max-len: 2
    description: |
      Ratio <numerator denominator> of the actual current to the current
      the chip is calibrated to read. Each value is from 1 to 65535.

      The RMS current registers stop at 65.535 A and the power registers
      overflow with it. For larger currents the chip is calibrated (i-gain
      and pq-gain) to read a fraction of the actual current, as the
      datasheet suggests in section 6.2.2, Table-17 note 1, and this
      property is the inverse of that fraction. The ratio applies to
      current, current peak, power and energy, not to voltage, power
      factor, angles or frequency. meter-constant and pl-constant keep
      their calibrated values.

      For example, a meter calibrated to read one tenth of a 400 A load
      uses <10 1>, and one calibrated to read 40% of the load uses <5 2>.

  pm0-gpios:
    type: phandle-array
    description: |
      PM0 power mode pin. With pm1-gpios, selects Normal or Idle mode.
      Without both pins, the board holds the chip in Normal mode.

  pm1-gpios:
    type: phandle-array
    description: PM1 power mode pin. See pm0-gpios.

  irq0-gpios:
    type: phandle-array
    description: IRQ0 interrupt output.

  irq1-gpios:
    type: phandle-array
    description: IRQ1 interrupt output.

  wrn-out-gpios:
    type: phandle-array
    description: WarnOut fatal error warning output.

  cf1-gpios:
    type: phandle-array
    description: CF1 active energy pulse output.

  cf2-gpios:
    type: phandle-array
    description: CF2 reactive/apparent energy pulse output.

  cf3-gpios:
    type: phandle-array
    description: CF3 active fundamental energy pulse output.

  cf4-gpios:
    type: phandle-array
    description: CF4 active harmonic energy pulse output.

  # Status and special registers

  channel-map-i:
    type: int
    default: 0x0210
    description: ChannelMapI (01h), current channel mapping.

  channel-map-u:
    type: int
    default: 0x0654
    description: ChannelMapU (02h), voltage channel mapping.

  sag-peak-det-cfg:
    type: int
    default: 0x143f
    description: SagPeakDetCfg (05h), sag and peak detector period.

  ov-th-cfg:
    type: int
    default: 0xc000
    description: OVthCfg (06h), over voltage threshold.

  zx-config:
    type: int
    default: 0x0001
    description: ZXConfig (07h), zero-crossing pin configuration.

  sag-th:
    type: int
    default: 0x1000
    description: SagTh (08h), voltage sag threshold.

  phase-loss-th:
    type: int
    default: 0x0400
    description: PhaseLossTh (09h), voltage phase losing threshold.

  in-warn-th:
    type: int
    default: 0xffff
    description: INWarnTh (0Ah), calculated neutral current warning threshold.

  oi-th:
    type: int
    default: 0xc000
    description: OIth (0Bh), over current threshold.

  freq-lo-th:
    type: int
    default: 0x1324
    description: FreqLoTh (0Ch), low frequency threshold.

  freq-hi-th:
    type: int
    default: 0x13ec
    description: FreqHiTh (0Dh), high frequency threshold.

  pm-pwr-ctrl:
    type: int
    default: 0x010f
    description: PMPwrCtrl (0Eh), partial measurement mode power control.

  irq0-merge-cfg:
    type: int
    default: 0x0000
    description: IRQ0MergeCfg (0Fh), IRQ0 merge configuration.

  emm-int-en:
    type: array
    default: [0x0000, 0x0000]
    min-len: 2
    max-len: 2
    description: |
      EMMIntEn0 (75h) and EMMIntEn1 (76h), sources routed to the IRQ0 and
      IRQ1 pins.

  # Low power mode and segment compensation registers

  detect-ctrl:
    type: int
    default: 0x0000
    description: DetectCtrl (10h), current detect control.

  detect-th:
    type: array
    default: [0x0000, 0x0000, 0x0000]
    min-len: 3
    max-len: 3
    description: DetectTh1..3 (11h-13h), current thresholds in Detection mode.

  idc-offset:
    type: array
    default: [0x0000, 0x0000, 0x0000]
    min-len: 3
    max-len: 3
    description: IDCoffsetA..C (14h-16h), current DC offsets.

  udc-offset:
    type: array
    default: [0x0000, 0x0000, 0x0000]
    min-len: 3
    max-len: 3
    description: UDCoffsetA..C (17h-19h), voltage DC offsets.

  u-gain-tab:
    type: int
    default: 0x0000
    description: UGainTAB (1Ah), voltage gain temperature compensation, phases A/B.

  u-gain-tc:
    type: int
    default: 0x0000
    description: UGainTC (1Bh), voltage gain temperature compensation, phase C.

  phi-freq-comp:
    type: int
    default: 0x0000
    description: PhiFreqComp (1Ch), phase compensation for frequency.

  log-irms:
    type: array
    default: [0x0000, 0x0000]
    min-len: 2
    max-len: 2
    description: LOGIrms0 and LOGIrms1 (20h-21h), segment compensation thresholds.

  f0:
    type: int
    default: 5000
    description: F0 (22h), nominal frequency in 0.01 Hz.

  t0:
    type: int
    default: 25
    description: T0 (23h), nominal temperature in degrees Celsius.

  phi-irms01:
    type: array
    default: [0x0000, 0x0000, 0x0000]
    min-len: 3
    max-len: 3
    description: PhiAIrms01, PhiBIrms01, PhiCIrms01 (24h/28h/2Ch).

  phi-irms2:
    type: array
    default: [0x0000, 0x0000, 0x0000]
    min-len: 3
    max-len: 3
    description: PhiAIrms2, PhiBIrms2, PhiCIrms2 (25h/29h/2Dh).

  gain-irms01:
    type: array
    default: [0x0000, 0x0000, 0x0000]
    min-len: 3
    max-len: 3
    description: GainAIrms01, GainBIrms01, GainCIrms01 (26h/2Ah/2Eh).

  gain-irms2:
    type: array
    default: [0x0000, 0x0000, 0x0000]
    min-len: 3
    max-len: 3
    description: GainAIrms2, GainBIrms2, GainCIrms2 (27h/2Bh/2Fh).

  # Configuration registers

  pl-constant:
    type: int
    default: 0x0861c468
    description: PL_Constant, split across PLconstH (31h) and PLconstL (32h).

  mmode0:
    type: int
    default: 0x0087
    description: MMode0 (33h), metering method configuration.

  mmode1:
    type: int
    default: 0x0000
    description: MMode1 (34h), PGA gain configuration.

  p-start-th:
    type: int
    default: 0x0000
    description: PStartTh (35h), active startup power threshold.

  q-start-th:
    type: int
    default: 0x0000
    description: QStartTh (36h), reactive startup power threshold.

  s-start-th:
    type: int
    default: 0x0000
    description: SStartTh (37h), apparent startup power threshold.

  p-phase-th:
    type: int
    default: 0x0000
    description: PPhaseTh (38h), per-phase active energy accumulation threshold.

  q-phase-th:
    type: int
    default: 0x0000
    description: QPhaseTh (39h), per-phase reactive energy accumulation threshold.

  s-phase-th:
    type: int
    default: 0x0000
    description: SPhaseTh (3Ah), per-phase apparent energy accumulation threshold.

  # Energy calibration registers

  p-offset:
    type: array
    default: [0x0000, 0x0000, 0x0000]
    min-len: 3
    max-len: 3
    description: PoffsetA..C (41h/43h/45h), active power offsets.

  q-offset:
    type: array
    default: [0x0000, 0x0000, 0x0000]
    min-len: 3
    max-len: 3
    description: QoffsetA..C (42h/44h/46h), reactive power offsets.

  pq-gain:
    type: array
    default: [0x0000, 0x0000, 0x0000]
    min-len: 3
    max-len: 3
    description: PQGainA..C (47h/49h/4Bh), calibration gains.

  phi:
    type: array
    default: [0x0000, 0x0000, 0x0000]
    min-len: 3
    max-len: 3
    description: PhiA..C (48h/4Ah/4Ch), calibration phase angles.

  p-offset-fund:
    type: array
    default: [0x0000, 0x0000, 0x0000]
    min-len: 3
    max-len: 3
    description: PoffsetAF..CF (51h-53h), fundamental active power offsets.

  p-gain-fund:
    type: array
    default: [0x0000, 0x0000, 0x0000]
    min-len: 3
    max-len: 3
    description: PGainAF..CF (54h-56h), fundamental calibration gains.

  # Measurement calibration registers

  u-gain:
    type: array
    default: [0x8000, 0x8000, 0x8000]
    min-len: 3
    max-len: 3
    description: UgainA..C (61h/65h/69h), voltage RMS gains.

  i-gain:
    type: array
    default: [0x8000, 0x8000, 0x8000]
    min-len: 3
    max-len: 3
    description: IgainA..C (62h/66h/6Ah), current RMS gains.

  u-offset:
    type: array
    default: [0x0000, 0x0000, 0x0000]
    min-len: 3
    max-len: 3
    description: UoffsetA..C (63h/67h/6Bh), voltage RMS offsets.

  i-offset:
    type: array
    default: [0x0000, 0x0000, 0x0000]
    min-len: 3
    max-len: 3
    description: IoffsetA..C (64h/68h/6Ch), current RMS offsets.
```

## dts/bindings/ethernet/renesas,ra-eswm-dsa.yaml
```yaml
# Copyright The Zephyr Project Contributors
# SPDX-License-Identifier: Apache-2.0

description: |
  Renesas RA Ethernet Switch Module (ESWM) used as a DSA switch.

  The node is the switch core and the conduit network device. The switch
  ports are described in a renesas,ra-eswm-switch child node.

compatible: "renesas,ra-eswm-dsa"

include:
  - name: base.yaml
  - name: pinctrl-device.yaml
  - name: ethernet-controller.yaml
    property-allowlist:
      - local-mac-address
      - zephyr,random-mac-address

properties:
  interrupts:
    required: true

  clocks:
    required: true

  clock-names:
    required: true
    enum:
      - "gwcaclk"
      - "pclk"
      - "eswclk"
      - "eswphyclk"
      - "ethphyclk"
    description: |
      "gwcaclk": operating clock for gateway CPU agent
      "pclk": peripheral clock for COMA and PTP timer
      "eswclk": operating clock for ethernet switch module
      "eswphyclk": operating clock for xMII interface
      "ethphyclk": operating clock for ETHPHYCLK pin output

  renesas,ethphyclk-output:
    type: boolean
    description: |
      Output the PHY reference clock on the ETHPHYCLK pin. Set this when a
      PHY uses ETHPHYCLK as its clock source.
```

## dts/bindings/ethernet/renesas,ra-gptp-timer.yaml
```yaml
# Copyright The Zephyr Project Contributors
# SPDX-License-Identifier: Apache-2.0

description: |
  Renesas RA Ethernet Generic PTP Timer (GPTP) timer.

  One timer of the gPTP timer block, exposed as a PTP (Precision Time
  Protocol) clock. The node must be a child of the "renesas,ra-gptp" node,
  and both nodes must be enabled.

compatible: "renesas,ra-gptp-timer"

include: [base.yaml]

properties:
  reg:
    required: true
    description: Timer number within the gPTP timer block.
```

## dts/bindings/ethernet/renesas,ra-gptp.yaml
```yaml
# Copyright The Zephyr Project Contributors
# SPDX-License-Identifier: Apache-2.0

description: |
  Renesas RA Ethernet Generic PTP Timer (GPTP) block.

  gPTP timer block of the Layer 3 Ethernet Switch Module (ESWM). The node must
  be a child of the "renesas,ra-eswm" node.

  Each timer of the block is described by a "renesas,ra-gptp-timer" child node.

  Example:

    gptp: gptp@403e0000 {
        compatible = "renesas,ra-gptp";
        reg = <0x403e0000 0x10c4>;
        #address-cells = <1>;
        #size-cells = <0>;

        gptp_timer0: timer@0 {
            compatible = "renesas,ra-gptp-timer";
            reg = <0>;
        };
    };

compatible: "renesas,ra-gptp"

include: [base.yaml]

properties:
  reg:
    required: true

  "#address-cells":
    required: true
    const: 1

  "#size-cells":
    required: true
    const: 0
```

## dts/bindings/ethernet/renesas,rz-ethernet-gmac.yaml
```yaml
# SPDX-FileCopyrightText: Copyright (c) 2026 Renesas Electronics Corporation
# SPDX-License-Identifier: Apache-2.0

description: Renesas RZ Ethernet GMAC

compatible: "renesas,rz-ethernet-gmac"

include:
  - name: snps,dwmac.yaml
  - name: pinctrl-device.yaml

properties:
  reg:
    required: true

  interrupts:
    required: true

  interrupt-names:
    required: true

  pinctrl-0:
    required: true

  pinctrl-names:
    required: true

  phy-connection-type:
    required: true

  phy-handle:
    required: true
```

## dts/bindings/ethernet/zephyr,cdc-ncm-ethernet.yaml
```yaml
# Copyright (c) 2024 Nordic Semiconductor ASA
# SPDX-License-Identifier: Apache-2.0

description: USB CDC NCM virtual Ethernet controller

compatible: "zephyr,cdc-ncm-ethernet"

include: ethernet-controller.yaml

properties:
  remote-mac-address:
    type: string
    required: true
    description: |
      Remote MAC address of the virtual Ethernet connection.
      Should not be the same as local-mac-address property.
      Twelve hexadecimal digits, for example "00005E005301".
      Can be replaced at runtime with usbd_cdc_ncm_set_remote_mac().
```

## dts/bindings/flash_controller/alif,mram-flash-controller.yaml
```yaml
# Copyright (c) 2025 Alif Semiconductor
# SPDX-License-Identifier: Apache-2.0

description: |
  Alif on-chip MRAM flash controller

  The MRAM is memory mapped and programmed in 128-bit words. The controller
  node has a soc-nv-flash child node describing the MRAM array.

compatible: "alif,mram-flash-controller"

include: flash-controller.yaml
```

## dts/bindings/flash_controller/realtek,rts5817-flash-controller.yaml
```yaml
# Copyright (c) 2026 Realtek Semiconductor, Inc.
# SPDX-License-Identifier: Apache-2.0

description: Realtek RTS5817 flash controller

compatible: "realtek,rts5817-flash-controller"

include: flash-controller.yaml

properties:
  reg:
    description: |
      Register blocks, in this order:
      - qspi_ctrl: QSPI controller registers
      - auto_ctrl: auto-mode SPI command register, which is outside of the
        QSPI block and must be written directly

  reg-names:
    required: true
    description: |
      Names of the register blocks: "qspi_ctrl" and "auto_ctrl".

  clocks:
    required: true

  bus-width:
    type: int
    description: |
      Width of the QSPI data bus to the flash, which sets the read mode:
      1 (1-1-1), 2 (1-1-2) or 4 (1-1-4). Defaults to 4, the quad read
      mode the RTS5817 boot ROM configures.
    enum:
      - 1
      - 2
      - 4
    default: 4

  syscon-sys:
    type: phandle
    required: true
    description: |
      phandle of the dlink_sys node.
```
