## dts/bindings/flash_controller/st,stm32-flash-controller.yaml
```yaml
description: STM32 Family flash controller

compatible: "st,stm32-flash-controller"

include: flash-controller.yaml

properties:
  st,rdp1-enable-byte:
    type: int
    default: 0x55
    description: |
      This property provides a byte which should used to enable non-permanent
      readout protection (RDP1). Actually, any byte except 0xAA and 0xCC
      (which are used by RDP0 and RDP2 respectively) can be used to enable
      RDP1 but in multi-image environment, some other image could check if
      RDP1 is enabled by comparing it to some hardcoded value. The byte has to
      be different than 0xAA and 0xCC.

  st,flash-latency:
    type: int
    description: |
      Number of wait states to use as flash latency.

      If this property is not set, the appropriate number of wait states is
      computed automatically, but the algorithm used assumes nominal operating
      conditions (e.g., VDD supply voltage) which may not hold on certain boards.
      This property can be used in such cases to override the algorithm when it
      would compute an incorrect amount of wait states.

      No build-time validation is performed against HCLK or VDD supply voltage
      or any other parameter on which the number of wait states depends. The
      board author is expected to provide a correct value based on the relevant
      documentation applicable to the SoC used (Reference Manual / Data Sheet,
      e.g. RM0090 Rev 22, Section 3.5.1 for STM32F405xx/407xx/415xx/417xx).
      CONFIG_STM32_FLASH_PREFETCH is not touched by this property.
```

## dts/bindings/flash_controller/wch,x03x-flash-controller.yaml
```yaml
# Copyright (c) 2026 Chen Ren
# SPDX-License-Identifier: Apache-2.0

description: |
  WCH X03x flash controller. The register block follows the WCH FPEC
  layout (ACTLR, KEYR, OBKEYR, STATR, CTLR, ADDR, OBR, WPR, MODEKEYR)
  with the X035-specific BOOT_MODEKEYR added at offset 0x28. The flash
  programming model is 256-byte page based (fast page program/erase).

compatible: "wch,x03x-flash-controller"

include: base.yaml
```

## dts/bindings/gnss/u-blox,m10.yaml
```yaml
# Copyright (c) 2026 CampOS
# SPDX-License-Identifier: Apache-2.0

description: |
  U-BLOX M10 GNSS Module

  When the receiver can enter backup on its own (power-save-mode other than
  "full", extint-backup or extint-inactivity-timeout-ms), the driver stores
  its receiver configuration in both the RAM and the battery-backed RAM (BBR)
  layers, as the receiver restarts from BBR when it leaves backup.

compatible: "u-blox,m10"

include:
  - uart-device.yaml
  - u-blox,common.yaml

properties:
  extint-gpios:
    type: phandle-array
    description: |
      GPIO connected to the receiver's EXTINT input. The GPIO's active level
      must be the receiver's "high" level, normally GPIO_ACTIVE_HIGH.
      The driver drives it active during initialization, keeping the
      receiver awake, and applications set it with
      gnss_u_blox_m10_set_extint(). With device power management, the driver
      selects EXTINT as the wakeup source on suspend and generates two edges
      on it on resume. Without this property, the driver wakes the receiver
      through UART RX activity instead.

  extint-wake:
    type: boolean
    description: |
      Keep the receiver awake while EXTINT is high (CFG-PM-EXTINTWAKE).
      Requires extint-gpios.

  extint-backup:
    type: boolean
    description: |
      Put the receiver into backup mode while EXTINT is low
      (CFG-PM-EXTINTBACKUP). With extint-wake, the host controls the
      receiver's power state through EXTINT. Requires extint-gpios.

  extint-inactivity-timeout-ms:
    type: int
    default: 0
    description: |
      Put the receiver into backup mode when EXTINT does not change for
      longer than this time (CFG-PM-EXTINTINACTIVE and
      CFG-PM-EXTINTINACTIVITY). 0 disables it. Requires extint-gpios.

  power-save-mode:
    type: string
    default: "full"
    enum:
      - "full"
      - "psmoo"
      - "psmct"
    description: |
      Receiver mode of operation (CFG-PM-OPERATEMODE): continuous operation,
      power save ON/OFF operation or power save cyclic tracking.

  psm-update-period-seconds:
    type: int
    default: 10
    description: |
      Time between position fix attempts in ON/OFF operation
      (CFG-PM-POSUPDATEPERIOD). 0 or at least 5. With 0, the receiver only
      wakes up on a wakeup event, such as an EXTINT edge.

  psm-acquisition-period-seconds:
    type: int
    default: 10
    description: |
      Time between acquisition attempts after a failed fix attempt
      (CFG-PM-ACQPERIOD). With 0, the receiver only retries on a wakeup event.

  psm-on-time-seconds:
    type: int
    default: 0
    description: |
      Time the receiver stays in tracking state and outputs fixes
      (CFG-PM-ONTIME). With 0, it returns to inactive right after a fix.

  psm-max-acquisition-time-seconds:
    type: int
    default: 0
    description: |
      Maximum time spent in acquisition state (CFG-PM-MAXACQTIME), up to 255.
      0 disables the bound.
```

## dts/bindings/gpio/flipper,gpio-header.yaml
```yaml
# SPDX-FileCopyrightText: Copyright The Zephyr Project Contributors
# SPDX-License-Identifier: Apache-2.0

title: GPIO pins exposed on the Flipper Zero GPIO header

description: |
    The Flipper Zero exposes an 18-pin GPIO header on its top edge. This
    binding provides a nexus mapping where the parent index is the pin number
    of the header, as printed on the device. Power and ground pins have no
    GPIO and are not mapped.

    Pin  Signal           Pin  Signal
     1   5V                10  PA14 (SWCLK)
     2   PA7               11  GND
     3   PA6               12  PA13 (SWDIO)
     4   PA4               13  PB6 (USART1 TX)
     5   PB3               14  PB7 (USART1 RX)
     6   PB2               15  PC1
     7   PC3               16  PC0
     8   GND               17  PB14 (1-Wire)
     9   3V3               18  GND

    PA13 and PA14 carry the serial wire debug interface after reset, and
    PB6 and PB7 carry USART1, which can be configured as a serial console.

compatible: "flipper,gpio-header"

include: [gpio-nexus.yaml, base.yaml]
```

## dts/bindings/gpio/microchip,gpio-g1-gpio.yaml
```yaml
# SPDX-FileCopyrightText: Copyright (c) 2026 Microchip Technology Inc.
# SPDX-License-Identifier: Apache-2.0

title: Microchip GPIO G1 GPIO

description: |
  GPIO controller for the Microchip GPIO Group 1 (G1)

  GPIO driver for GPIO Group g1 supports following hardware peripherals:
    - module name="GPIO" id="02467" version="1.0"

compatible: "microchip,gpio-g1-gpio"

include: [gpio-controller.yaml, base.yaml]

properties:
  reg:
    required: true

  "#gpio-cells":
    const: 2

gpio-cells:
  - pin
  - flags
```

## dts/bindings/gpio/mikroe,quail-edge-header.yaml
```yaml
# Copyright The Zephyr Project Contributors
# SPDX-License-Identifier: Apache-2.0

description: |
  GPIO nexus mapping for the screw terminals on the edges of the MikroE
  Quail for STM32 board. Each GPIO specifier index maps to the
  microcontroller pin as follows:

        0   PC5        15  PC11 (SPI3)
        1   PB0        16  PC12 (SPI3)
        2   PE7        17  PD10
        3   PE8        18  PA15
        4   PE11       19  PC13
        5   PC4        20  PE6
        6   PE13       21  PE5
        7   PE14       22  PD2
        8   PB10       23  PD3
        9   PB11       24  PD4
        10  PB12       25  PD7
        11  PB13       26  PE2
        12  PB6 (I2C1) 27  PE3
        13  PB7 (I2C1) 28  PE4
        14  PC10 (SPI3)

  See the Quail for STM32 User Manual for the terminal layout.

compatible: "mikroe,quail-edge-header"

include: [gpio-nexus.yaml, base.yaml]
```

## dts/bindings/gpio/nuvoton,npcm-gpio.yaml
```yaml
# Copyright (c) 2024 Nuvoton Technology Corporation.
# SPDX-License-Identifier: Apache-2.0

description: |
  Nuvoton NPCM GPIO port.

  Each node represents an 8-bit port and its direction, level, pull-resistor, and output-type
  registers.

  This binding does not configure pin multiplexing. To reclaim a pin whose reset function is
  not GPIO, reference its pin_gpioNN_gpio function from a pin group and assign that group to
  this node's pinctrl-0 property. The driver applies the state during initialization.

  Example, port 6 with GPIO62 and GPIO65 reclaimed from RSTOUT0 and SLP_S5:

    &pinctrl {
      gpio62_65_gpio: gpio62-65-gpio {
        g62 { pinmux = <&pin_gpio62_gpio>; };
        g65 { pinmux = <&pin_gpio65_gpio>; };
      };
    };

    &gpio6 {
      pinctrl-0 = <&gpio62_65_gpio>;
      pinctrl-names = "default";
    };

  Pull resistors on output pins take effect only in open-drain mode. The driver enables
  GPIO_OUT_PULLEN in SCFG during initialization so GPIO_PULL_UP with GPIO_OPEN_DRAIN works
  as defined by the GPIO API.

compatible: "nuvoton,npcm-gpio"

include: [gpio-controller.yaml, pinctrl-device.yaml, base.yaml]

properties:
  reg:
    required: true

  nuvoton,scfg:
    type: phandle
    required: true
    description: System Configuration block that holds GPIO_OUT_PULLEN.

  "#gpio-cells":
    const: 2

gpio-cells:
  - pin
  - flags
```

## dts/bindings/gpio/renesas,rtk0eg0019b01002bj-cn1.yaml
```yaml
# Copyright The Zephyr Project Contributors
# SPDX-License-Identifier: Apache-2.0

description: |
  GPIO nexus mapping for Application Header 1 (CN1) of the
  RTK0EG0019B01002BJ Capacitive Touch Application Shield, as wired on
  the host board. The GPIO specifier index is the CN1 pin number:

        4   LED_COL0        11  LED_ROW2
        5   LED_COL1        12  LED_ROW3
        6   LED_COL2        13  LED_ROW0
        7   LED_COL3        14  LED_ROW1

  Pins 1, 2, 3, 8, 9 and 10 are not connected, 15 is VCC and 16 is GND.

  Use RTK0EG0019B01002BJ_CN1_* constants in
  <include/zephyr/dt-bindings/gpio/renesas-rtk0eg0019b01002bj.h>
  to refer to specific pins using convenient constant names.

include: [gpio-nexus.yaml, base.yaml]
```

## dts/bindings/gpio/rockchip,rk3588-gpio.yaml
```yaml
# SPDX-FileCopyrightText: Copyright (c) 2026 Process Mission
# SPDX-License-Identifier: Apache-2.0

title: Rockchip RK3588 GPIO controller

description: |
  Rockchip RK3588 GPIO bank controller (GPIO v2 register layout).

  Each bank provides up to 32 pins with upper-16-bit write-enable masks
  for data, direction, and interrupt control registers.

compatible: "rockchip,rk3588-gpio"

include: [gpio-controller.yaml, base.yaml]

properties:
  reg:
    required: true

  interrupts:
    description: Shared bank interrupt line routed to the GIC.

  clocks:
    description: Peripheral bus clock and debounce clock for the GPIO bank.

  clock-names:
    description: Clock names corresponding to the clocks property ("bus", "dbclk").

  "#gpio-cells":
    const: 2

gpio-cells:
  - pin
  - flags
```

## dts/bindings/gpio/st,clt01-38sq7.yaml
```yaml
# Copyright (c) 2026 Sebastian Balling
# SPDX-License-Identifier: Apache-2.0

description: |
  ST CLT01-38SQ7 octal digital input current limiter / termination array.

  The chip is used in 16-bit SPI mode (SPM = GND) and exposed as a GPIO
  controller with 8 input-only pins (pin 0 = IN1 ... pin 7 = IN8). Every
  port read is one SPI transfer; the driver checks the fixed bits and the
  check bits of the frame and reports the undervoltage and over-temperature
  alarms. The chip has no interrupt output, inputs have to be polled.

compatible: "st,clt01-38sq7"

include: [gpio-controller.yaml, spi-device.yaml]

properties:
  "#gpio-cells":
    const: 2

  ngpios:
    const: 8

gpio-cells:
  - pin
  - flags
```

## dts/bindings/gpio/st,vni8200xp.yaml
```yaml
# Copyright (c) 2026 Sebastian Balling
# SPDX-License-Identifier: Apache-2.0

description: |
  ST VNI8200XP octal high-side smart power solid state relay.

  The chip is used in 16-bit SPI mode (SEL2 = H, SEL1 = H) and exposed as a
  GPIO controller with 8 output-only pins (pin 0 = OUT1 ... pin 7 = OUT8).
  The driver adds the command parity bits and checks the fault frame that is
  returned on every write.

  If the watchdog of the chip is enabled (WD_EN), its WD input must see a
  falling edge at least every watchdog period (40, 80 or 160 ms), otherwise
  all outputs are switched off. On the X-NUCLEO-PLC01A1, WD is wired to the
  chip select of the CLT01-38SQ7 input chip, so the inputs must be read
  periodically.

  Example (X-NUCLEO-PLC01A1 on an Arduino R3 header):

    &arduino_spi {
        vni8200xp: gpio@0 {
            compatible = "st,vni8200xp";
            reg = <0>;
            spi-max-frequency = <5000000>;
            gpio-controller;
            #gpio-cells = <2>;
            ngpios = <8>;
            out-en-gpios = <&arduino_header ARDUINO_HEADER_R3_D6 GPIO_ACTIVE_HIGH>;
        };
    };

compatible: "st,vni8200xp"

include: [gpio-controller.yaml, spi-device.yaml]

properties:
  "#gpio-cells":
    const: 2

  ngpios:
    const: 8

  out-en-gpios:
    type: phandle-array
    description: |
      OUT_EN input of the VNI8200XP. While inactive, all outputs are off.
      The driver keeps it inactive until a defined all-off state has been
      programmed and reprograms the chip after asserting it.

gpio-cells:
  - pin
  - flags
```

## dts/bindings/gpio/ti,davinci-gpio.yaml
```yaml
# Copyright (C) 2023 BeagleBoard.org Foundation
# Copyright (C) 2023 S Prashanth
#
# SPDX-License-Identifier: Apache-2.0

description: |
  GPIO Controller for Davinci and Keystone devices.

  Each node covers one 32-line register set of a GPIO module, which holds
  two 16-line banks. The module raises one interrupt per bank and enables
  banks in its GPIO_BINTEN register. To use pin interrupts, give the node
  one interrupt per bank it covers and a second reg entry for GPIO_BINTEN:

    reg = <0x00600038 0x28>, <0x00600008 0x4>;
    reg-names = "port", "binten";
    interrupts = <GIC_SPI 262 IRQ_TYPE_EDGE IRQ_DEFAULT_PRIORITY>,
                 <GIC_SPI 263 IRQ_TYPE_EDGE IRQ_DEFAULT_PRIORITY>;

  Only edge triggers exist in hardware; level interrupts return -ENOTSUP.
  With GPIO_INT_MODE_DISABLE_ONLY, edges that arrive while a pin is disabled
  are lost. Pulls and open-drain are pad settings: set them in pinctrl, not
  in GPIO specifier flags.

compatible: "ti,davinci-gpio"

include: [base.yaml, gpio-controller.yaml, pinctrl-device.yaml]

properties:
  reg:
    required: true

  reg-names:
    description: |
      "port" for the register set, then "binten" for the module's
      GPIO_BINTEN register. Required when the node has interrupts.

  "#gpio-cells":
    const: 2

gpio-cells:
  - pin
  - flags
```

## dts/bindings/gpio/ti,k3-gpio-nexus.yaml
```yaml
# Copyright (C) 2023 BeagleBoard.org Foundation
# Copyright (C) 2023 S Prashanth
#
# SPDX-License-Identifier: Apache-2.0

description: |
  Line numbering of a TI K3 GPIO module.

  The GPIO modules of K3 SoCs use the DaVinci/Keystone GPIO IP and have up
  to 144 lines, named GPIOn_m in the datasheet and technical reference
  manual. Each module is described by one "ti,davinci-gpio" node per 32-line
  register set, as a GPIO port holds at most 32 lines.

  This nexus restores the numbering of the whole module: line m maps to
  register set m / 32, pin m % 32. The first specifier cell is m, the second
  one holds the GPIO flags. For example, on AM64x,
  <&main_gpio0 42 GPIO_ACTIVE_LOW> refers to GPIO0_42 and resolves to
  <&main_gpio0_1 10 GPIO_ACTIVE_LOW>.

compatible: "ti,k3-gpio-nexus"

include: [base.yaml, gpio-nexus.yaml]

properties:
  "#gpio-cells":
    const: 2

gpio-cells:
  - pin
  - flags
```
