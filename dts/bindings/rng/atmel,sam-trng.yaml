## dts/bindings/rng/atmel,sam-trng.yaml
```yaml
# Copyright (c) 2018, Aurelien Jarno
# SPDX-License-Identifier: Apache-2.0

description: Atmel SAM RNG

compatible: "atmel,sam-trng"

include: base.yaml

properties:
  reg:
    required: true

  interrupts:
    required: true
```

## dts/bindings/rng/atmel,sam0-trng.yaml
```yaml
#
# Copyright (c) 2019 ML!PA Consulting GmbH
#
# SPDX-License-Identifier: Apache-2.0
#
---
title: Atmel SAM0 TRNG (True Random Number Generator)

description: >
    This binding gives a base representation of the Atmel SAM0 RNG

compatible: "atmel,sam0-trng"

include: base.yaml

properties:
    reg:
      required: true

    interrupts:
      required: true

    label:
      required: true
```

## dts/bindings/rng/atmosic,atm-trng.yaml
```yaml
# Copyright (c) 2023 Atmosic
# SPDX-License-Identifier: Apache-2.0

description: Atmosic TRNG

compatible: "atmosic,atm-trng"

include: base.yaml

properties:
  reg:
    required: true

  interrupts:
    required: true
```

## dts/bindings/rng/brcm,bcm2835-rng.yaml
```yaml
# Copyright (c) 2026 Jonathan Elliot Peace <jep@alphabetiq.com>
# SPDX-License-Identifier: Apache-2.0

description: |
  Broadcom BCM2835 simple hardware RNG block.

  Present on the BCM2835/BCM2836/BCM2837/BCM2710 SoCs (Raspberry Pi
  1/2/3/Zero family). Distinct from the iProc RNG200 on BCM2711 (Pi 4),
  which uses the "brcm,iproc-rng200" compatible.

compatible: "brcm,bcm2835-rng"

include: base.yaml

properties:
  reg:
    required: true
```

## dts/bindings/rng/brcm,iproc-rng200.yaml
```yaml
# Copyright (c) 2025 TOKITA Hiroshi
# SPDX-License-Identifier: Apache-2.0

description: Broadcom iProc RNG200 Random Number Generator

compatible: "brcm,iproc-rng200"

include: base.yaml

properties:
  reg:
    required: true
```

## dts/bindings/rng/espressif,esp32-trng.yaml
```yaml
# Copyright (c) 2019, Mohamed ElShahawi <ExtremeGTX@hotmail.com>
# SPDX-License-Identifier: Apache-2.0

description: |
    Espressif ESP32 TRNG (True Random Number Generator).

    The TRNG uses the noise in the Wi-Fi/BT RF system. When Wi-Fi and BT are
    disabled, the random number generator will give out pseudo-random numbers.

compatible: "espressif,esp32-trng"

include: base.yaml

properties:
    reg:
      required: true

    interrupts:
      required: false
```

## dts/bindings/rng/gd,gd32-trng.yaml
```yaml
# Copyright (c) 2025 Aleksandr Senin <al@meshium.net>
#
# SPDX-License-Identifier: Apache-2.0

description: GigaDevice GD32 TRNG (True Random Number Generator)

compatible: "gd,gd32-trng"

include: base.yaml

properties:
  reg:
    required: true

  clocks:
    required: true

  resets:
    type: phandle-array
    description: Optional reset line for the TRNG peripheral.
```

## dts/bindings/rng/litex,prbs.yaml
```yaml
# Copyright (c) 2019 Antmicro <www.antmicro.com>
# SPDX-License-Identifier: Apache-2.0

description: LiteX PRBS

compatible: "litex,prbs"

include: base.yaml

properties:
    reg:
        required: true
```

## dts/bindings/rng/microchip,ateccx08-entropy.yaml
```yaml
# Copyright (c) 2024 Vogl Electronic GmbH
# SPDX-License-Identifier: Apache-2.0

description: Microchip ATECCx08 entropy binding

compatible: "microchip,ateccx08-entropy"

include: base.yaml

on-bus: ateccx08
```

## dts/bindings/rng/microchip,pic32cxsg-trng.yaml
```yaml
# Copyright (c) 2024 Microchip
# SPDX-License-Identifier: Apache-2.0

description: Microchip PIC32CXSG RNG

compatible: "microchip,pic32cxsg-trng"

include: base.yaml

properties:
  reg:
    required: true

  interrupts:
    required: true
```

## dts/bindings/rng/microchip,trng-g1-entropy.yaml
```yaml
# Copyright (c) 2025, Microchip Technologies Inc.
# SPDX-License-Identifier: Apache-2.0

title: Microchip TRNG G1 entropy driver

description: |
  Microchip TRNG driver bindings.

  Group g1 TRNG driver supports following hardware peripherals:
    - module name="TRNG" id="U2242" version="1.1.0"

compatible: "microchip,trng-g1-entropy"

include: base.yaml

properties:
  reg:
    required: true

  interrupts:
    required: true

  run-in-standby-en:
    type: int
    enum:
      - 0
      - 1
    default: 1
    description: |
      Enable (1) or disable (0) run in standby mode for TRNG.
```

## dts/bindings/rng/microchip,trng-g2-entropy.yaml
```yaml
# Copyright (C) 2026 Microchip Technology Inc. and its subsidiaries
#
# SPDX-License-Identifier: Apache-2.0
#

title: Microchip G2 TRNG entropy driver

description: |
  Microchip SAM Random Number Generator (TRNG).

  Group g2 TRNG driver supports following hardware peripherals:
    - module name="TRNG" id="6334" version="305"

compatible: "microchip,trng-g2-entropy"

include: [base.yaml]

properties:
  reg:
    required: true

  clocks:
    required: true

  interrupts:
    required: true
```

## dts/bindings/rng/neorv32-trng.yaml
```yaml
description: NEORV32 True Random Number Generator (TRNG)

compatible: "neorv32-trng"

include: base.yaml

properties:
  reg:
    required: true

  syscon:
    type: phandle
    required: true
    description: |
      phandle to syscon (NEORV32 SYSINFO) node.
```

## dts/bindings/rng/nordic,nrf-cracen-ctrdrbg.yaml
```yaml
# Copyright (c) 2025, Nordic Semiconductor ASA
# SPDX-License-Identifier: Apache-2.0

description: |
    Nordic nRF CRACEN CTR_DRBG based (Random Number Generator)

    This driver is only compatible with 54L devices, and may only be used from one processor
    core. This driver cannot be used in conjunction with the nRF security PSA solution, as both
    would attempt to use the CRACEN HW exclusively; When that is enabled, zephyr,psa-crypto-rng
    should be selected instead.

compatible: "nordic,nrf-cracen-ctrdrbg"

include: base.yaml
```

## dts/bindings/rng/nordic,nrf-prng.yaml
```yaml
# Copyright (c) 2024 Nordic Semiconductor ASA
# SPDX-License-Identifier: LicenseRef-Nordic-5-Clause

description: This is a super simple PRNG

compatible: "nordic,entropy-prng"

include: base.yaml
```

## dts/bindings/rng/nordic,nrf-rng.yaml
```yaml
# Copyright (c) 2019 Nordic Semiconductor ASA
# SPDX-License-Identifier: Apache-2.0

description: Nordic nRF family RNG (Random Number Generator)

compatible: "nordic,nrf-rng"

include: base.yaml

properties:
    reg:
      required: true

    interrupts:
      required: true
```

## dts/bindings/rng/nuvoton,npcx-drbg.yaml
```yaml
# Copyright (c) 2024 Nuvoton Technology Corporation.
# SPDX-License-Identifier: Apache-2.0

description: NPCX Deterministic Random Bit Generator

compatible: "nuvoton,npcx-drbg"

include: base.yaml

properties:
  reg:
    required: true

  context-buffer-size:
    type: int
    required: true
    description: |
      Size of the pre-allocated buffer for the DRBG ROM API to store the
      intermediate/final computation result.
```

## dts/bindings/rng/nxp,css-v2.yaml
```yaml
# Copyright 2022 NXP
# SPDX-License-Identifier: Apache-2.0

description: CSSv2 (Crypto Subsystem)

compatible: "nxp,css-v2"

include: base.yaml

properties:
  reg:
    required: true
```

## dts/bindings/rng/nxp,ele-trng.yaml
```yaml
# Copyright (c) 2025, NXP
# SPDX-License-Identifier: Apache-2.0

description: NXP ELE (EdgeLock secure enclave) TRNG (True Random Number Generator)

compatible: "nxp,ele-trng"

include: base.yaml
```

## dts/bindings/rng/nxp,els-trng.yaml
```yaml
# Copyright 2025 NXP
# SPDX-License-Identifier: Apache-2.0

description: NXP EdgeLock Secure Subsystem TRNG

compatible: "nxp,els-trng"
```

## dts/bindings/rng/nxp,imx-caam.yaml
```yaml
# Copyright 2022, NXP
# SPDX-License-Identifier: Apache-2.0

description: IMX CAAM (Cryptographic Acceleration and Assurance Module)

compatible: "nxp,imx-caam"

include: base.yaml

properties:
    reg:
      required: true

    interrupts:
      required: true
```

## dts/bindings/rng/nxp,kinetis-rnga.yaml
```yaml
# Copyright (c) 2018, Linaro Limited
# SPDX-License-Identifier: Apache-2.0

description: Kinetis RNGA (Random Number Generator Accelerator)

compatible: "nxp,kinetis-rnga"

include: base.yaml

properties:
    reg:
      required: true

    interrupts:
      required: true
```

## dts/bindings/rng/nxp,kinetis-trng.yaml
```yaml
# Copyright (c) 2018, Linaro Limited
# SPDX-License-Identifier: Apache-2.0

description: Kinetis TRNG (True Random Number Generator)

compatible: "nxp,kinetis-trng"

include: base.yaml

properties:
  reg:
    required: true

  interrupts:
    required: true
```

## dts/bindings/rng/nxp,lpc-rng.yaml
```yaml
# Copyright (c) 2020, Linaro Limited
# SPDX-License-Identifier: Apache-2.0

description: LPC RNG (Random Number Generator)

compatible: "nxp,lpc-rng"

include: base.yaml

properties:
    reg:
      required: true

    interrupts:
      required: false
```

## dts/bindings/rng/nxp,mcxw-trng.yaml
```yaml
# Copyright (c) 2025, NXP
# SPDX-License-Identifier: Apache-2.0

description: NXP MCXW TRNG (True Random Number Generator)

compatible: "nxp,mcxw-trng"

include: base.yaml
```
