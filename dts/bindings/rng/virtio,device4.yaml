## dts/bindings/rng/virtio,device4.yaml
```yaml
# Copyright (c) 2025 TOKITA Hiroshi
# SPDX-License-Identifier: Apache-2.0

description: VIRTIO Entropy device (ID:4)

compatible: "virtio,device4"

include: base.yaml
```

## dts/bindings/rng/virtio,entropy.yaml
```yaml
# Copyright (c) 2025 TOKITA Hiroshi
# SPDX-License-Identifier: Apache-2.0

description: VirtIO Entropy device

compatible: "virtio,entropy"

include: base.yaml
```

## dts/bindings/rng/wch,rng.yaml
```yaml
# Copyright (c) 2025 James Bennion-Pedley
# SPDX-License-Identifier: Apache-2.0

description: |
    WCH CH32 RNG (Random Number Generator).

    The TRNG is based on a LFSR with analogue noise as a seed

compatible: "wch,rng"

include: base.yaml

properties:
  reg:
    required: true
```

## dts/bindings/rng/zephyr,native-posix-rng.yaml
```yaml
# Copyright (c) 2020, Linaro Limited
# SPDX-License-Identifier: Apache-2.0

description: Native POSIX RNG/Entropy

compatible: "zephyr,native-posix-rng"

include: base.yaml

# This binding is deprecated in favor of zephyr,native-sim-rng
```

## dts/bindings/rng/zephyr,native-sim-rng.yaml
```yaml
# Copyright (c) 2025, Nordic Semiconductor ASA
# SPDX-License-Identifier: Apache-2.0

description: Native simulator RNG/Entropy

compatible: "zephyr,native-sim-rng"

include: base.yaml
```

## dts/bindings/rng/zephyr,psa-crypto-rng.yaml
```yaml
# Copyright (c) 2022 Nordic Semiconductor ASA
# SPDX-License-Identifier: Apache-2.0

description: PSA Crypto RNG/Entropy

compatible: "zephyr,psa-crypto-rng"
```

## dts/bindings/rohm,bh1749.yaml
```yaml
#
# Copyright (c) 2019 Nordic Semiconductor ASA
#
# SPDX-License-Identifier: Apache-2.0
#
---
title: BH1749 Digital 16bit Serial Output Type Color Sensor IC
version: 0.1

description: >
    This is a representation of the BH1749 sensor

inherits:
    !include i2c-device.yaml

properties:
    compatible:
      constraint: "rohm,bh1749"

    int-gpios:
      type: compound
      category: required
      generation: define, use-prop-name
...
```

## dts/bindings/root/root.yaml
```yaml
# Copyright (c) 2022 Intel Corporation
# SPDX-License-Identifier: Apache-2.0

# Common fields for acpi bus driver

description: Root node

compatible: "root"

include: base.yaml
```

## dts/bindings/rtc/adi,max31329.yaml
```yaml
# Copyright (c) 2024 Wimansha Wijekoon <Wimanshahb@gmail.com>
# SPDX-License-Identifier: Apache-2.0

description: Analog Device MAX31329 RTC

compatible: "adi,max31329"

include:
  - name: rtc-device.yaml
  - name: i2c-device.yaml
  - name: pm.yaml
    property-allowlist:
      - wakeup-source

properties:
  rtc-inta-gpios:
    type: phandle-array
    description: |
      GPIO connected to the max31329 INTA interrupt output. This pin should be pull high to rtc_vcc
  pvft:
    type: int
    enum:
      - 0x0 # Threshold voltage disabled
      - 0x1 # 1.85V
      - 0x2 # 2.15V
      - 0x3 # 2.40V
    description: |
      Power Fail Threshold to switch to Vbat.
  trickle:
    type: int
    enum:
      - 0x0 # 3kΩ in series with a Schottky diode
      - 0x1 # 3kΩ in series with a Schottky diode
      - 0x2 # 6kΩ in series with a Schottky diode
      - 0x3 # 11kΩ in series with a Schottky diode
      - 0x4 # 3kΩ in series with a diode + Schottky diode
      - 0x5 # 3kΩ in series with a diode + Schottky diode
      - 0x6 # 6kΩ in series with a diode + Schottky diode
      - 0x7 # 11kΩ in series with a diode + Schottky diode
    description: |
      Sets Trickle charging path
  digital-in-enable:
    type: boolean
    description: |
      Enable the Digital IN (DIN)
```

## dts/bindings/rtc/adi,max31331.yaml
```yaml
# Copyright (c) 2025 Analog Devices Inc.
# SPDX-License-Identifier: Apache-2.0
#
# This file contains the binding for MAX31331 RTC from Analog Devices.

description: MAX31331, an Ultra-Low-Power, I2C Real-Time Clock.

compatible: "adi,max31331"

include: [rtc-device.yaml, i2c-device.yaml]

properties:
  reg:
    required: true

  interrupt-gpios:
    description: "GPIO connected to the INT pin of the MAX31331."
    type: phandle-array

  ts-enable:
    description: "Enable the timestamping feature of the MAX31331."
    type: boolean

  ts-vbat-enable:
    description: "Enable timestamping in VBAT mode."
    type: boolean

  ts-din:
    description: "Data input for timestamping."
    type: boolean

  ts-overwrite:
    description: "Enable overwriting of the timestamp register."
    type: boolean

  ts-power-supply-switch:
    description: "Enable power supply switch for timestamping."
    type: boolean

  din-polarity:
    description: "Polarity of the data input for timestamping."
    type: boolean

  din-en-io:
    description: "Enable data input as IO."
    type: boolean
```

## dts/bindings/rtc/adi,max32-rtc.yaml
```yaml
# Copyright (c) 2024 Analog Devices, Inc.
#
# SPDX-License-Identifier: Apache-2.0

description: ADI MAX32 compatible Real Timer Clock

compatible: "adi,max32-rtc"

include:
  - name: rtc-device.yaml
```

## dts/bindings/rtc/ambiq,am1805.yaml
```yaml
# SPDX-License-Identifier: Apache-2.0
# Copyright (c) 2023 Linumiz
# Author: Sri Surya <srisurya@linumiz.com>

description: AMBIQ AM1805 RTC

compatible: "ambiq,am1805"

include:
  - name: rtc-device.yaml
  - name: i2c-device.yaml

properties:
  reg:
    required: true

  am1805-gpios:
    type: phandle-array
    description: |
         GPIO connected to the AM1805 INT1 interrupt output. This signal is open-drain, active low.
```

## dts/bindings/rtc/ambiq,rtc.yaml
```yaml
# SPDX-License-Identifier: Apache-2.0
# Copyright (c) 2024 Ambiq Micro

description: AMBIQ RTC

compatible: "ambiq,rtc"

include: rtc-device.yaml

properties:
  reg:
    required: true
  clock:
    type: string
    default: "XTAL"
    enum:
      - "XTAL"
      - "LFRC"
```

## dts/bindings/rtc/atmel,sam-rtc.yaml
```yaml
# Copyright (c) 2023 Bjarki Arge Andreasen
# SPDX-License-Identifier: Apache-2.0

description: Atmel SAM family RTC device

compatible: "atmel,sam-rtc"

include: rtc-device.yaml

properties:
  reg:
    required: true

  interrupts:
    required: true

  clocks:
    required: true
```

## dts/bindings/rtc/atmel,sam0-rtc.yaml
```yaml
# Copyright (c) 2018 omSquare s.r.o.
# Copyright (c) 2024-2025 Gerson Fernando Budke <nandojve@gmail.com>
# SPDX-License-Identifier: Apache-2.0

description: Atmel SAM0 RTC

compatible: "atmel,sam0-rtc"

include:
  - name: rtc-device.yaml
  - name: pinctrl-device.yaml
  - name: atmel,assigned-clocks.yaml

properties:
  reg:
    required: true

  clocks:
    required: true

  clock-names:
    required: true

  atmel,assigned-clocks:
    required: true

  atmel,assigned-clock-names:
    required: true

  systimer:
    type: boolean
    description: |
      Selects RTC peripheral to be used as a system timer and replace
      the ARM systick. When this option is selected the normal RTC
      functionality is in exclusive mode and the normal RTC functions
      will not be available.

      The systimer exclusive functionality can be enabled using the
      following devicetree entry:

        &rtc {
          status = "okay";
          systimer;
        };

  cal-constant:
    type: int
    required: true
    description: |
      Define the constant used to calculate the calibration. More
      information can be found in the datasheet of each SoC series
      at RTC Frequency Correction topic.

      Example:
        Correction in ppm = (FREQCORR.VALUE * 1e6 ppm) / (8192 * 128)

        &rtc {
          cal-constant = <8192 * 128>;
        };

  counter-mode:
    type: string
    enum:
      - "count-32"
      - "count-16"
      - "clock"
    description: |
      Configure the RTC counter operating mode. In mode 0, the counter
      register is configured as a 32-bit counter. In mode 1, simmilar
      to mode 0, the counter register is only 16-bit counter. In mode
      2 the counter register is configured as a clock/calendar.

        &rtc {
          status = "okay";
          counter-mode = "clock";
          prescaler = <1024>;
        };

  prescaler:
    type: int
    enum:
      - 1
      - 2
      - 4
      - 8
      - 16
      - 32
      - 64
      - 128
      - 256
      - 512
      - 1024
    description: |
      Enable CLKOUT at given frequency. When disabled, CLKOUT pin is LOW.
      The default is 0 and corresponds to the disable the CLKOUT signal.

        &rtc {
          status = "okay";
          counter-mode = "clock";
          prescaler = <1024>;
        };

  event-control-msk:
    type: int
    default: 0
    description: |
      Enable peripheral event sources by bitmask. By default all the channels
      are always disabled.

      Event Table:

        bit   Event Source
         0    Periodic Interval 0 Event Output
         1    Periodic Interval 1 Event Output
         2    Periodic Interval 2 Event Output
         3    Periodic Interval 3 Event Output
         4    Periodic Interval 4 Event Output
         5    Periodic Interval 5 Event Output
         6    Periodic Interval 6 Event Output
         7    Periodic Interval 7 Event Output
         8    Compare/Alarm 0 Event Output
         9    Compare/Alarm 1 Event Output
        14    Tamper Event Output
        15    Overflow Event Output
        16    Tamper Event Input

      Example how to enable Compare/Alarm 0 Event Output:
        &rtc {
          event-control-msk = <100>;
        };
```

## dts/bindings/rtc/epson,rx8130ce.yaml
```yaml
# Copyright (c) 2025 Måns Ansgariusson <mansgariusson@gmail.com>
# SPDX-License-Identifier: Apache-2.0

description: RX8130CE RTC

compatible: "epson,rx8130ce-rtc"
include: [i2c-device.yaml, rtc-device.yaml]

properties:
  irq-gpios:
    type: phandle-array

  clockout-frequency:
    type: int
    description: |
      Specify the ociillator frequency in Hz, if not specified the clockout will be disabled.
      - 1 # 1 Hz oscillator
      - 1024 # 1 kHz oscillator
      - 32768 # 32 kHz oscillator
    enum: [1, 1024, 32768]

  battery-switchover:
    type: int
    description: |
      Enable the battery backup feature and specify the switchover mode.
      If not specified the battery backup feature will be disabled.

      - 1 # Non-rechargeable battery backup i2c & FOUT are disabled when VDD is below Vdet1
      - 2 # Non-rechargeable battery backup i2c & FOUT are always on
      - 3 # Rechargeable battery backup i2c & FOUT are disabled when VDD is below Vdet1
      - 4 # Rechargeable battery backup i2c & FOUT are always on
    enum: [1, 2, 3, 4]
```

## dts/bindings/rtc/espressif,esp32-rtc.yaml
```yaml
# Copyright (c) 2025 Espressif Systems (Shanghai) Co., Ltd.
# SPDX-License-Identifier: Apache-2.0

description: Espressif RTC

compatible: "espressif,esp32-rtc"

include: base.yaml
```

## dts/bindings/rtc/infineon,cat1-rtc.yaml
```yaml
# Copyright (c) 2024 Cypress Semiconductor Corporation (an Infineon company) or
# an affiliate of Cypress Semiconductor Corporation
#
# SPDX-License-Identifier: Apache-2.0

description: Infineon CAT1 family RTC device

compatible: "infineon,cat1-rtc"

include: rtc-device.yaml

properties:
  reg:
    required: true

  interrupts:
    required: true
```

## dts/bindings/rtc/infineon,xmc4xxx-rtc.yaml
```yaml
# Copyright (c) 2023 Andriy Gelman
# SPDX-License-Identifier: Apache-2.0

description: Infineon XMC4xxx family RTC device

compatible: "infineon,xmc4xxx-rtc"

include: rtc-device.yaml

properties:
  reg:
    required: true

  interrupts:
    required: true
```

## dts/bindings/rtc/intel,qmsi-rtc.yaml
```yaml
# Copyright (c) 2018 Intel Corporation
# SPDX-License-Identifier: Apache-2.0

title: Intel QMSI RTC

description: >
    This is a representation of the Intel QMSI RTC nodes

compatible: "intel,qmsi-rtc"

include: rtc.yaml

properties:
    reg:
      required: true
```

## dts/bindings/rtc/ite,it8xxx2-rtc.yaml
```yaml
# Copyright (c) 2026 ITE Corporation. All Rights Reserved.
# SPDX-License-Identifier: Apache-2.0

description: ITE Real Time Clock (RTC)

compatible: "ite,it8xxx2-rtc"

include: rtc.yaml

properties:
  reg:
    required: true

  interrupts:
    required: true

  alarms-count:
    type: int
    description: |
      Number of alarms supported by the RTC device.
      For IT8XXX2 series chips, the RTC hardware supports two alarms
      (Alarm0 and Alarm1).
```

## dts/bindings/rtc/maxim,ds1302.yaml
```yaml
# SPDX-License-Identifier: Apache-2.0
# Copyright (c) 2026 Harpreet Saini
# Author: Harpreet Saini <sainiharpreet29@yahoo.com>

description: Maxim DS1302 RTC

compatible: "maxim,ds1302"

include:
  - name: rtc-device.yaml
  - name: spi-device.yaml
```

## dts/bindings/rtc/maxim,ds1307.yaml
```yaml
# SPDX-License-Identifier: Apache-2.0
#
# Copyright (c) 2023 Arunmani Alagarsamy
# Author: Arunmani Alagarsamy <arunmani27100@gmail.com>
#
# Copyright (c) 2025 Marcin Lyda <elektromarcin@gmail.com>

description: Maxim DS1307 RTC

compatible: "maxim,ds1307"

include:
  - name: rtc-device.yaml
  - name: i2c-device.yaml

properties:
  sqw-frequency:
    type: int
    description: |
      SQW frequency value [Hz]
      This field enables to select output frequency on
      SQW pin.
    enum:
      - 1
      - 4096
      - 8192
      - 32768
```

## dts/bindings/rtc/maxim,ds1337.yaml
```yaml
# Copyright (c) 2025 Marcin Lyda <elektromarcin@gmail.com>
# SPDX-License-Identifier: Apache-2.0

description: Maxim DS1337 RTC

compatible: "maxim,ds1337"

include:
  - name: rtc-device.yaml
  - name: i2c-device.yaml

properties:
  int-gpios:
    type: phandle-array
    description: |
      INTA interrupt output
      GPIO pin to handle chip's INTA interrupt output,
      used to notify about alarm events.

  sqw-frequency:
    type: int
    description: |
      SQW/INTB frequency value [Hz]
      This field enables to select output frequency at
      SQW/INTB pin.
    enum:
      - 1
      - 4096
      - 8192
      - 32768
```

## dts/bindings/rtc/maxim,ds3231.yaml
```yaml
#
# Copyright (c) 2019 Peter Bigot Consulting, LLC
#
# SPDX-License-Identifier: Apache-2.0
#

title: Maxim DS3231

description: >
    This binding gives a base representation of the Maxim DS3231 I2C RTC/TCXO

inherits:
    !include i2c-device.yaml

properties:
    compatible:
      constraint: "maxim,ds3231"
    reg:
      category: required

    32k-gpios:
      type: compound
      category: optional
      description: 32 KiHz open drain output

    isw-gpios:
      type: compound
      category: optional
      description: interrupt/square wave open drain output
```
