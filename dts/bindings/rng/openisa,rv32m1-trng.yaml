## dts/bindings/rng/openisa,rv32m1-trng.yaml
```yaml
# Copyright (c) 2020, Linaro Limited
# SPDX-License-Identifier: Apache-2.0

description: OpenISA TRNG (True Random Number Generator)

compatible: "openisa,rv32m1-trng"

include: base.yaml

properties:
    reg:
      required: true

    interrupts:
      required: true
```

## dts/bindings/rng/raspberrypi,pico-rng.yaml
```yaml
# Copyright (c) 2024 Xudong Zheng
# SPDX-License-Identifier: Apache-2.0

description: Raspberry Pi Pico RNG/Entropy

compatible: "raspberrypi,pico-rng"

include: base.yaml
```

## dts/bindings/rng/raspberrypi,rp2040-rng.yaml
```yaml
# Copyright (c) 2023, Xudong Zheng
# SPDX-License-Identifier: Apache-2.0

description: Raspberry Pi RP2040 RNG/Entropy

compatible: "raspberrypi,rp2040-rng"

include: base.yaml
```

## dts/bindings/rng/realtek,ameba-trng.yaml
```yaml
# Copyright (c) 2026 Realtek Semiconductor Corp.
# SPDX-License-Identifier: Apache-2.0

description: Ameba TRNG (True Random Number Generator)

compatible: "realtek,ameba-trng"

include: base.yaml

properties:
  reg:
    required: true
```

## dts/bindings/rng/realtek,bee-trng.yaml
```yaml
# Copyright(c) 2026, Realtek Semiconductor Corporation.
# SPDX-License-Identifier: Apache-2.0

description: Realtek Bee TRNG

compatible: "realtek,bee-trng"

include: base.yaml

properties:
  reg:
    required: true
```

## dts/bindings/rng/renesas,ra-rsip-e50d-trng.yaml
```yaml
# Copyright (c) 2025 Renesas Electronics Corporation
# SPDX-License-Identifier: Apache-2.0

description: Renesas RA RSIP-E51A TRNG

compatible: "renesas,ra-rsip-e50d-trng"

include: base.yaml
```

## dts/bindings/rng/renesas,ra-rsip-e51a-trng.yaml
```yaml
# Copyright (c) 2024 Renesas Electronics Corporation
# SPDX-License-Identifier: Apache-2.0

description: Renesas RA RSIP-E51A TRNG

compatible: "renesas,ra-rsip-e51a-trng"

include: base.yaml
```

## dts/bindings/rng/renesas,ra-sce5-rng.yaml
```yaml
# Copyright (c) 2024 Renesas Electronics Corporation
# SPDX-License-Identifier: Apache-2.0

description: Renesas RA SCE5 TRNG

compatible: "renesas,ra-sce5-rng"

include: base.yaml
```

## dts/bindings/rng/renesas,ra-sce7-rng.yaml
```yaml
# Copyright (c) 2024 Renesas Electronics Corporation
# SPDX-License-Identifier: Apache-2.0

description: Renesas RA SCE7 TRNG

compatible: "renesas,ra-sce7-rng"

include: base.yaml
```

## dts/bindings/rng/renesas,ra-sce9-rng.yaml
```yaml
# Copyright (c) 2024 Renesas Electronics Corporation
# SPDX-License-Identifier: Apache-2.0

description: Renesas RA SCE9 TRNG

compatible: "renesas,ra-sce9-rng"

include: base.yaml
```

## dts/bindings/rng/renesas,ra-trng.yaml
```yaml
# Copyright (c) 2024 Renesas Electronics Corporation
# SPDX-License-Identifier: Apache-2.0

description: Renesas RA TRNG

compatible: "renesas,ra-trng"

include: base.yaml
```

## dts/bindings/rng/renesas,ra8-rsip7-trng.yaml
```yaml
# Copyright (c) 2024 Renesas Electronics Corporation
# SPDX-License-Identifier: Apache-2.0

description: Renesas RA8 RSIP7 TRNG

compatible: "renesas,ra8-rsip7-trng"

include: base.yaml
```

## dts/bindings/rng/renesas,smartbond-trng.yaml
```yaml
# Copyright (c) 2023 Renesas Electronics Corporation
# SPDX-License-Identifier: Apache-2.0

description: Renesas Smartbond TRNG

compatible: "renesas,smartbond-trng"

include: base.yaml

properties:
  reg:
    required: true

  interrupts:
    required: true
```

## dts/bindings/rng/sensry,sy1xx-trng.yaml
```yaml
# Copyright (c) 2025 sensry.io
# SPDX-License-Identifier: Apache-2.0

description: Sensry SY1XX TRNG

compatible: "sensry,sy1xx-trng"

include: base.yaml

properties:
  reg:
    required: true
```

## dts/bindings/rng/sifli,sf32lb-trng.yaml
```yaml
# Copyright (c) 2025, Qingsong Gou <gouqs@hotmail.com>
# SPDX-License-Identifier: Apache-2.0

description: Sifli SF32LB TRNG (True Random Number Generator).

compatible: "sifli,sf32lb-trng"

include: base.yaml

properties:
  reg:
    required: true

  interrupts:
    required: true

  clocks:
    required: true
```

## dts/bindings/rng/silabs,gecko-trng.yaml
```yaml
# Copyright (c) 2020, Lemonbeat GmbH
# SPDX-License-Identifier: Apache-2.0

description: |
    GECKO TRNG (True Random Number Generator).

    The TRNG module is a non-deterministic randomnumber generator based on a full hardware solution.

compatible: "silabs,gecko-trng"

include: base.yaml

properties:
    reg:
      required: true

    interrupts:
      required: true

    label:
      required: true
```

## dts/bindings/rng/silabs,siwx91x-rng.yaml
```yaml
# Copyright (c) 2024 Silicon Laboratories Inc.
# SPDX-License-Identifier: Apache-2.0

description: Hardware Random Number Generator embedded on Silabs SiWx91x chips

compatible: "silabs,siwx91x-rng"

include: base.yaml

properties:
  reg:
    required: true
```

## dts/bindings/rng/st,stm32-rng-noirq.yaml
```yaml
# Copyright (c) 2025 STMicroelectronics
# SPDX-License-Identifier: Apache-2.0

description: STM32 Random Number Generator without interrupt line

compatible: "st,stm32-rng-noirq"

include:
  - name: st,stm32-rng.yaml
    property-blocklist:
      - interrupts

properties:
  generation-delay-ns:
    type: int
    description: |
      Delay between the generation of two random samples, in nanoseconds.
```

## dts/bindings/rng/st,stm32-rng.yaml
```yaml
# Copyright (c) 2020, Linaro Limited
# SPDX-License-Identifier: Apache-2.0

description: STM32 Random Number Generator

compatible: "st,stm32-rng"

include: base.yaml

properties:
  reg:
    required: true

  clocks:
    required: true
    description: |
         Specifies the clock line to be enabled in clock controller as well as
         the clock domain used, for instance:
                   <&rcc STM32_SRC_MSI CLK48_SEL(3)> /* RNG clock domain set to MSI */
         A correctly configured domain clock is required to allow the integrated low
         sampling clock detection mecanism to behave properly.
         In provided example, MSI should be configured to provide 48Mhz clock.

  nist-config:
    type: int
    description: |
         This property is used to configure the RNG_CR for the NIST certification
         The validation conditions are following the refMan
         to certify NIST SP800-90B. RNG clock source must be 48MHz.
         This config is valid with some STM32 families
         and when Conditioning Soft Reset (RNG_CR_CONDRST bit) exists.
         The value is directly mapped from the RNG configuration (A) table.
         The Health Register (health-test-config property) must correspond
         to this table configuration.
         On the stm32U5, the ARDIS bit7 is also written.

  health-test-magic:
    type: int
    description: |
         Magic Number to be written to Health Test Configuration Register (HTCR)
         prior to real configuration, if any.

  health-test-config:
    type: int
    description: |
         Heath Test Configuration, necessary to have proper RNG behavior,
         when available.
```

## dts/bindings/rng/st,stm32wb09-rng.yaml
```yaml
# Copyright (c) 2024 STMicroelectronics
# SPDX-License-Identifier: Apache-2.0

description: STM32WB09 True Random Number Generator

compatible: "st,stm32wb09-rng"

include: base.yaml

properties:
  reg:
    required: true

  clocks:
    required: true
```

## dts/bindings/rng/telink,b91-trng.yaml
```yaml
# Copyright (c) 2021, Telink Semiconductor
# SPDX-License-Identifier: Apache-2.0

description: Telink B91 RNG

compatible: "telink,b91-trng"

include: base.yaml

properties:
  reg:
    required: true
```

## dts/bindings/rng/telink,b9x-trng.yaml
```yaml
# Copyright (c) 2021-2023, Telink Semiconductor
# SPDX-License-Identifier: Apache-2.0

description: Telink B9x-series RNG

compatible: "telink,b9x-trng"

include: base.yaml

properties:
  reg:
    required: true
```

## dts/bindings/rng/telink,tlx-trng.yaml
```yaml
# Copyright (c) 2024, Telink Semiconductor
# SPDX-License-Identifier: Apache-2.0

description: Telink TLx-series RNG

compatible: "telink,tlx-trng"

include: base.yaml

properties:
  reg:
    required: true
```

## dts/bindings/rng/telink,w91-trng.yaml
```yaml
# Copyright (c) 2024, Telink Semiconductor
# SPDX-License-Identifier: Apache-2.0

description: Telink W91-series RNG

compatible: "telink,w91-trng"

include: base.yaml
```

## dts/bindings/rng/ti,cc13xx-cc26xx-trng.yaml
```yaml
# Copyright (c) 2019 Brett Witherspoon
# SPDX-License-Identifier: Apache-2.0

description: TI SimpleLink CC13xx / CC26xx TRNG (True Random Number Generator)

compatible: "ti,cc13xx-cc26xx-trng"

include: base.yaml

properties:
    reg:
      required: true

    interrupts:
      required: true

    label:
      required: true
```
