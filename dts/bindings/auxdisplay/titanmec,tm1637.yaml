## dts/bindings/auxdisplay/titanmec,tm1637.yaml
```yaml
# SPDX-License-Identifier: Apache-2.0
# Copyright (c) 2025 Siratul Islam

description: TM1637 7-segment LED display controller

compatible: "titanmec,tm1637"

include: base.yaml

properties:
  clk-gpios:
    type: phandle-array
    required: true
    description: Clock GPIO pin

  dio-gpios:
    type: phandle-array
    required: true
    description: Data I/O GPIO pin

  bit-delay-us:
    type: int
    default: 100
    description: |
      Bit delay in microseconds for GPIO bit-banging protocol.
      TM1637 datasheet specifies minimum timings of 100ns (setup/hold)
      and 400ns (clock pulse width). Default of 100µs provides safe
      margin for software GPIO operations across different platforms.

  aux-columns:
    type: int
    required: true
    enum: [1, 2, 3, 4, 5, 6]
    description: |
      Ammount of digits used. The TM1637 support up to 6 of 7-segment
      digits.
```

## dts/bindings/auxdisplay/titanmicro,tm1637.yaml
```yaml
# SPDX-License-Identifier: Apache-2.0
# Copyright (c) 2025 Siratul Islam

description: TM1637 7-segment LED display controller

compatible: "titanmicro,tm1637"

include: auxdisplay-device.yaml

properties:
  clk-gpios:
    type: phandle-array
    required: true
    description: Clock GPIO pin

  dio-gpios:
    type: phandle-array
    required: true
    description: Data I/O GPIO pin

  bit-delay-us:
    type: int
    default: 100
    description: Bit delay in microseconds (default 100 µs)

  columns:
    type: int
    default: 4
    description: Number of digit columns (always 4 for TM1637)

  rows:
    type: int
    default: 1
    description: Number of rows (always 1 for TM1637)
```

## dts/bindings/base/base.yaml
```yaml
# Common fields for all devices

include: [pm.yaml]

properties:
  status:
    type: string
    description: |
      Indicates the operational status of the hardware or other
      resource that the node represents. In particular:

        - "okay" means the resource is operational and, for example,
          can be used by device drivers
        - "disabled" means the resource is not operational and the system
          should treat it as if it is not present

      For details, see "2.3.4 status" in Devicetree Specification v0.4.
    enum:
      - "ok" # Deprecated form
      - "okay"
      - "disabled"
      - "reserved"
      - "fail"
      - "fail-sss"

  compatible:
    type: string-array
    required: true
    description: |
      This property is a list of strings that essentially define what
      type of hardware or other resource this devicetree node
      represents. Each device driver checks for specific compatible
      property values to find the devicetree nodes that represent
      resources that the driver should manage.

      The recommended format is "vendor,device", The "vendor" part is
      an abbreviated name of the vendor. The "device" is usually from
      the datasheet.

      The compatible property can have multiple values, ordered from
      most- to least-specific. Having additional values is useful when the
      device is a specific instance of a more general family, to allow the
      system to match the most specific driver available.

      For details, see "2.3.1 compatible" in Devicetree Specification v0.4.

  reg:
    type: array
    description: |
      Information used to address the device. The value is specific to
      the device (i.e. is different depending on the compatible
      property).

      The "reg" property is typically a sequence of (address, length) pairs.
      Each pair is called a "register block". Values are
      conventionally written in hex.

      For details, see "2.3.6 reg" in Devicetree Specification v0.4.

  reg-names:
    type: string-array
    description: |
      Optional names given to each register block in the "reg" property.
      For example:

        / {
             soc {
                 #address-cells = <1>;
                 #size-cells = <1>;

                 uart@1000 {
                     reg = <0x1000 0x2000>, <0x3000 0x4000>;
                     reg-names = "foo", "bar";
                 };
             };
        };

      The uart@1000 node has two register blocks:

        - one with base address 0x1000, size 0x2000, and name "foo"
        - another with base address 0x3000, size 0x4000, and name "bar"

  interrupts:
    type: array
    description: |
      Information about interrupts generated by the device, encoded as an array
      of one or more interrupt specifiers. The format of the data in this property
      varies by where the device appears in the interrupt tree. Devices with the same
      "interrupt-parent" will use the same format in their interrupts properties.

      For details, see "2.4 Interrupts and Interrupt Mapping" in
      Devicetree Specification v0.4.

  # Does not follow the 'type: phandle-array' scheme, but gets type-checked
  # by the code. Declare it here just so that other bindings can make it
  # 'required: true' easily if they want to.
  interrupts-extended:
    type: compound
    description: |
      Extended interrupt specifier for device, used as an alternative to
      the "interrupts" property.

      For details, see "2.4 Interrupts and Interrupt Mapping" in
      Devicetree Specification v0.4.

  interrupt-names:
    type: string-array
    description: |
      Optional names given to each interrupt generated by a device.
      The interrupts themselves are defined in either "interrupts" or
      "interrupts-extended" properties.

      For details, see "2.4 Interrupts and Interrupt Mapping" in
      Devicetree Specification v0.4.

  interrupt-parent:
    type: phandle
    description: |
      If present, this refers to the node which handles interrupts generated
      by this device.

      For details, see "2.4 Interrupts and Interrupt Mapping" in
      Devicetree Specification v0.4.

  # description of label should be given in bindings inheriting base.yaml
  # label property is included here to help enforce its type being string
  label:
    type: string
    description: |
      Human readable string describing the device. Use of this property is
      deprecated except as needed on a case-by-case basis.

      For details, see "4.1.2 Miscellaneous Properties" in Devicetree
      Specification v0.4.

  clocks:
    type: phandle-array
    description: |
      Information about the device's clock providers. In general, this property
      should follow conventions established in the dt-schema binding:

        https://github.com/devicetree-org/dt-schema/blob/main/dtschema/schemas/clock/clock.yaml

  clock-names:
    type: string-array
    description: |
      Optional names given to each clock provider in the "clocks" property.

  "#address-cells":
    type: int
    description: |
      This property encodes the number of <u32> cells used by address fields
      in "reg" properties in this node's children.

      For details, see "2.3.5 #address-cells and #size-cells" in Devicetree
      Specification v0.4.

  "#size-cells":
    type: int
    description: |
      This property encodes the number of <u32> cells used by size fields in
      "reg" properties in this node's children.

      For details, see "2.3.5 #address-cells and #size-cells" in Devicetree
      Specification v0.4.

  dmas:
    type: phandle-array
    description: |
      DMA channel specifiers relevant to the device.

  dma-names:
    type: string-array
    description: |
      Optional names given to the DMA channel specifiers in the "dmas" property.

  io-channels:
    type: phandle-array
    description: |
      IO channel specifiers relevant to the device.

  io-channel-names:
    type: string-array
    description: |
      Optional names given to the IO channel specifiers in the "io-channels" property.

  mboxes:
    type: phandle-array
    description: |
      Mailbox / IPM channel specifiers relevant to the device.
    specifier-space: mbox

  mbox-names:
    type: string-array
    description: |
      Optional names given to the mbox specifiers in the "mboxes" property.

  power-domains:
    type: phandle-array
    description: |
      Power domain specifiers relevant to the device.

  power-domain-names:
    type: string-array
    description: |
      Optional names given to the power domain specifiers in the "power-domains" property.

  "#power-domain-cells":
    type: int
    description: |
      Number of cells in power-domains property

  zephyr,deferred-init:
    type: boolean
    description: |
      Do not initialize device automatically on boot. Device should be manually
      initialized using device_init().
```

## dts/bindings/base/mem-region.yaml
```yaml
# Copyright (c) 2021, CSIRO
# SPDX-License-Identifier: Apache-2.0
# Common fields for devices resulting in linker memory regions

properties:
  zephyr,memory-region:
    type: string
    required: false
    description: |
      Signify that this node should result in a dedicated linker script
      memory region in the final executable. The region address and size
      is taken from the <reg> property, while the name is the value of
      this property.
```

## dts/bindings/base/mpu-region.yaml
```yaml
# Copyright (c) 2021, Carlo Caione <ccaione@baylibre.com>
# SPDX-License-Identifier: Apache-2.0

description: MPU region

compatible: "mpu-region"

include: [base.yaml, mem-region.yaml]

properties:
  zephyr,memory-region:
    required: true

  zephyr,memory-region-mpu:
    type: string
    required: true
    description: |
      Signify that this node should result in a dedicated MPU region. The
      region address and size are taken from the <reg> property, while the MPU
      attribute is the value of this property.
```

## dts/bindings/base/mutable.yaml
```yaml
# Copyright (c) 2023, Meta
# SPDX-License-Identifier: Apache-2.0

# Properties for Mutable devices

properties:
  zephyr,mutable:
    type: boolean
    description: |
      True if and only if the device structure may be mutated.

      Inherit this binding for devices that are runtime-modifiable, in-place.
      This places the device structure into SRAM rather than Flash.
```

## dts/bindings/base/node.yaml
```yaml
# Common fields for all devices

properties:
  status:
    type: string
    description: |
      In the context of a device node:

        Zephyr's use of the status property in the context of a device node
        deviates slightly from the semantics defined in the devicetree standard.

        Rather than representing an operational state, it configures application
        specific driver instantiation requirements: A value of "okay" indicates
        that a device driver SHALL be instantiated and initialized for this
        device at boot time, i.e. it is intended that the driver instance be
        "ready" at the time `main()` is called.

        A device driver can only be instantiated if exactly one driver is
        included in the build that binds to the compatible value of the device.
        This is usually done by setting a corresponding Kconfig variable like
        `CONFIG_ADC=y`.

        A value of "disabled" indicates that a device driver instance SHALL not
        be instantiated for this device. This is useful for devices that are not
        used by the application and for which no driver needs to be included in
        the build.

        Other values are included for compatibility with the devicetree
        specification but are not used by Zephyr.

      In the context of a non-device node:

        A value of "disabled" indicates that the configuration (including all
        subnodes) SHALL be disregarded as if it was not part of the tree. A
        value of "okay" indicates that the configuration SHALL be used.

      Note: By the devicetree specification, the lack of a status property will
      be treated as if the property existed with the value of "okay".

      Note: Using "ok" instead of "okay" is deprecated.
    enum:
      - "ok" # deprecated
      - "okay"
      - "disabled"
      - "reserved"
      - "fail"
      - "fail-sss"

  compatible:
    type: string-array
    required: true
    description: |
      The compatible property value consists of one or more strings that define
      the specific programming model for the device. In Zephyr this list of
      strings will be used for device driver and devicetree binding file
      selection.

      The property value consists of a concatenated list of strings, from most
      specific to most general. In the context of a device node this allows a
      device to express its compatibility with a family of similar devices,
      potentially allowing a single device driver to match against several
      devices.

      The recommended format is "manufacturer,model", where manufacturer is a
      string describing the name of the manufacturer (such as a stock ticker
      symbol), and model specifies the model number. The compatible string SHALL
      consist only of lowercase letters, digits and dashes, and SHALL start with
      a letter. A single comma MAY only be used following a vendor prefix.
      Underscores SHALL not be used.

      Note: These are SHOULD-requirements in the original specifications but in
      Zephyr they were upgraded to SHALL-requirements.

      Example:
        `compatible = "fsl,mpc8641", "ns16550";`

      In this example, Zephyr would first try to locate a device driver that
      supported fsl,mpc8641. If a driver was not found, it would then try to
      locate a driver that supported the more general ns16550 device type.

      Note: You can search for compatible drivers in the tree by replacing any
      non-alphanumeric character (namely commas and dashes) of a compatible
      string by an underscore (`_`) combined with the macro `DT_DRV_COMPAT`.

      Example:
        `DT_DRV_COMPAT fsl_mpc8641`

      You can locate corresponding binding files, by searching for *.y[a]ml
      files including one of the compatible strings with a colon rather than an
      equality sign.

      Example:
        `compatible: "fsl,mpc8641"`
```

## dts/bindings/base/power.yaml
```yaml
# Copyright (c) 2020, Nordic Semiconductor ASA
# SPDX-License-Identifier: Apache-2.0

# Properties for nodes with controllable power supplies.

properties:
  supply-gpios:
    type: phandle-array
    description: |
      GPIO specifier that controls power to the device.

      This property should be provided when the device has a dedicated
      switch that controls power to the device.  The supply state is
      entirely the responsibility of the device driver.

      Contrast with vin-supply.
```

## dts/bindings/base/zephyr,device.yaml
```yaml
# Common fields for zephyr devices

properties:
    zephyr,no-lock:
        type: boolean
        required: false
        description: |
            Unset by default, it enables the possibility to avoid allocating a lock
            on the device instance.

    zephyr,no-sync:
        type: boolean
        required: false
        description: |
            Unset by default, it enables the possibility to avoid allocating
            a synchronization object on the device instance. This can be useful if
            the device driver works on polling mode only.
```

## dts/bindings/base/zephyr,memory-attr.yaml
```yaml
# Copyright (c) 2023, Carlo Caione <ccaione@baylibre.com>
# SPDX-License-Identifier: Apache-2.0

include: [base.yaml]

properties:
  zephyr,memory-attr:
    type: string
    enum:
      - "RAM"
      - "RAM_NOCACHE"
      - "FLASH"
      - "PPB"
      - "IO"
      - "EXTMEM"
    description: |
      Attribute for the memory region.

  reg:
    required: true
```
