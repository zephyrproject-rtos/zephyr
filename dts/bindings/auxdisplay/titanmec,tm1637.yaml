## dts/bindings/base/zephyr,memory-common.yaml
```yaml
# Copyright (c) 2023, Carlo Caione <ccaione@baylibre.com>
# SPDX-License-Identifier: Apache-2.0

include: [base.yaml]

properties:
  zephyr,memory-region:
    type: string
    description: |
      Signify that this node should result in a dedicated linker script
      memory region in the final executable. The region address and size
      is taken from the <reg> property, while the name is the value of
      this property.

  zephyr,memory-region-flags:
    type: string
    description: |
      Set attributes such as read-only or executable for the linker script
      memory region. The string set here will be specified in parentheses
      after the area name in the linker script.

  zephyr,memory-region-mpu:
    type: string
    deprecated: true
    description: |
      Signify that this node should result in a dedicated MPU region.
      Deprecated in favor of 'zephyr,memory-attr'.

  zephyr,memory-attr:
    type: int
    description: |
      Attribute or set of attributes (bitmask) for the memory region. See
      'include/zephyr/dt-bindings/memory-attr/memory-attr.h' for a
      comprehensive list with description of possible values.
      Used by MMU/MPU systems to configure memory regions with specific
      attributes. This property should only be used on nodes with
      compatible = "zephyr,memory-region" to define separate memory-region
      nodes rather than annotating device nodes directly.

  reg:
    required: true
```

## dts/bindings/base/zephyr,memory-region.yaml
```yaml
# Copyright (c) 2021, CSIRO
# SPDX-License-Identifier: Apache-2.0

description: Compatible for devices resulting in linker memory regions

compatible: "zephyr,memory-region"

include: [base.yaml, "zephyr,memory-common.yaml"]

properties:
  zephyr,memory-region:
    required: true
```

## dts/bindings/battery/battery.yaml
```yaml
# Copyright 2023 Cirrus Logic, Inc.
# SPDX-License-Identifier: Apache-2.0

description: |
  Static Battery Characteristics

  Properties are inherited from Linux. See
  linux/Documentation/devicetree/bindings/power/supply/battery.yaml

properties:
  device-chemistry:
    type: string
    description: This describes the chemical technology of the battery.
      The "lithium-ion" value is a blanket type for all lithium-ion batteries.
      If the specific chemistry is unknown, this value can be used instead of
      the precise "lithium-ion-X" options.
    enum:
      - "nickel-cadmium"
      - "nickel-metal-hydride"
      - "lithium-ion"
      - "lithium-ion-polymer"
      - "lithium-ion-iron-phosphate"
      - "lithium-ion-manganese-oxide"

  ocv-capacity-table-0:
    type: array
    description: |
      An array providing the open circuit voltage (OCV) , which is used to look
      up battery capacity according to current OCV value. The OCV unit is
      microvolts.

      Unlike the linux equivalent this array is required to be 11 elements
      long, representing the voltages for 0-100% charge in 10% steps.

  charge-full-design-microamp-hours:
    type: int
    description: battery design capacity

  re-charge-voltage-microvolt:
    type: int
    description: limit to automatically start charging again

  precharge-current-microamp:
    type: int
    description: current for pre-charge phase

  charge-term-current-microamp:
    type: int
    description: current for charge termination phase

  constant-charge-current-max-microamp:
    type: int
    description: maximum constant input current

  constant-charge-voltage-max-microvolt:
    type: int
    description: maximum constant input voltage
```

## dts/bindings/battery/intel,sbs_battery.yaml
```yaml
# Copyright (c) 2020 Intel Corporation
# SPDX-License-Identifier: Apache-2.0

description: SBS series I2C-based battery

compatible: "intel,sbs_battery"

include: [i2c-device.yaml]

properties:
    label:
      required: true
```

## dts/bindings/binding-template.yaml
```yaml
title: Short description of the node

description: >
    Longer free-form description of the node.
    Can go over multiple lines.

# Bindings are often based on other bindings, which are given in 'inherits'.
# The resulting binding is the union of the inherited bindings and this binding
# (internally, it's a recursive dictionary merge).
#
# If a field appears both in this binding and in a binding it inherits, then
# the value in this binding takes precedence. This can be used to change a
# 'category: optional' from an inherited binding to a 'category: required' (see
# the 'properties' description below).
inherits:
    !include other.yaml # or [other1.yaml, other2.yaml]

# If the node describes a bus, then the bus type should be given, like below
child:
    bus: <string describing bus type, e.g. "i2c">

# If the node appears on a bus, then the bus type should be given, like below.
#
# When looking for a binding for a node, the code checks if the binding for the
# parent node contains 'child: bus: <bus type>'. If it does, then only bindings
# with a matching 'parent: bus: <bus type>' are considered. This allows the
# same type of device to have different bindings depending on what bus it
# appears on.
parent:
    bus: <string describing bus type, e.g. "i2c">

# 'sub-node' is used to simplify cases where a node has children that can all
# use the same binding. The contents of 'sub-node' becomes the binding for each
# child node.
#
# The example below is for a binding for pwm-leds where the child nodes are
# required to have a 'pwms' property.
sub-node:
    properties:
        pwms:
          type: compound
          category: required

# 'properties' describes properties on the node, e.g.
#
#   reg = <1 2>;
#   current-speed = <115200>;
#   label = "foo";
#
# This is used to check that required properties appear, and to
# control the format of output generated for them. Except for some
# special-cased properties like 'reg', only properties listed here will
# generate output.
#
# A typical property entry looks like this:
#
#   <property name>:
#     category: <required | optional>
#     type: <string | int | boolean | array | uint8-array | string-array | phandle | compound>
#     description: <description of the property>
#     enum:
#       - <item1>
#       - <item2>
#       ...
#       - <itemN>
#
# 'type: uint8-array' is for what the device tree specification calls
# 'bytestring'. Properties of type 'uint8-array' should be set like this:
#
#   foo = [89 AB CD];
#
# Each value is a byte in hex.
#
# 'phandle' is for properties that are assigned a single phandle, like this:
#
#   foo = <&label>;
#
# 'compound' is a catch-all for more complex types, e.g.
#
#   foo = <&label1 1 2 &label2 7>;
properties:
    # An entry for 'compatible' must appear, as it's used to map nodes to
    # bindings
    compatible:
        constraint: "foo-company,bar-device"

    # Describes a property like 'current-speed = <115200>;'. We pretend that
    # it's obligatory for the example node and set 'category: required'.
    current-speed:
        type: int
        category: required
        description: Initial baud rate for bar-device

    # Describes an optional property like 'keys = "foo", "bar";'
    keys:
        type: string-array
        category: optional
        description: Keys for bar-device

    # Describes an optional property like 'maximum-speed = "full-speed";
    # the enum specifies known values that the string property may take
    maximum-speed:
      type: string
      category: optional
      description: Configures USB controllers to work up to a specific speed.
      enum:
         - "low-speed"
         - "full-speed"
         - "high-speed"
         - "super-speed"

# If the binding describes an interrupt controller, GPIO controller, pinmux
# device, or any other device referenced via a phandle plus a specifier (some
# additional data besides the phandle), then the cells in the specifier must be
# listed in '#cells', like below.
#
# If the specifier is empty (e.g. '#clock-cells = <0>'), then '#cells' can
# either be omitted (recommended) or set to an empty array. Note that an empty
# array is specified as '"#cells": []' in YAML.
#
# For example, say that some node has 'foo-gpios = <&gpio1 1 2>'. The <1 2>
# part of the property value is the specifier, with two cells. The node pointed
# at by &gpio1 is expected to have '#gpio-cells = <2>', and its binding should
# have two elements in '#cells', corresponding to the 1 and 2 values above.
"#cells":
  - cell0    # name of first cell
  - cell1    # name of second cell
  - cell2    # name of third cell
  - and so on and so forth
```

## dts/bindings/biometrics/adh-tech,gt5x.yaml
```yaml
# SPDX-License-Identifier: Apache-2.0
# Copyright (c) 2025 Siratul Islam

description: |
  ADH GT5X Series Optical Fingerprint Sensor

  This binding supports fingerprint sensor modules from ADH Technology,
  including GT-511C1R, GT-511C3, GT-521F32, and GT-521F52 models.

  These sensors use a fixed 12-byte command/response protocol over UART
  and support 3-stage enrollment. Model-specific parameters must be
  configured via device tree properties to match the hardware variant.

compatible: "adh-tech,gt5x"

include: [uart-device.yaml]

properties:
  max-templates:
    type: int
    required: true
    description: |
      Maximum number of fingerprint templates the device can store.
      - GT-511C1R: 20
      - GT-511C3: 200
      - GT-521F32: 200
      - GT-521F52: 3000

  template-size:
    type: int
    required: true
    description: |
      Size of each fingerprint template in bytes.
      - GT-511C1R: 506 bytes
      - GT-511C3/GT-521F32/GT-521F52: 498 bytes
```

## dts/bindings/biometrics/synochip,as608.yaml
```yaml
# SPDX-License-Identifier: Apache-2.0
# Copyright (c) 2025 Siratul Islam

description: AS608 Optical Fingerprint Sensor

compatible: "synochip,as608"

include: [uart-device.yaml]

properties:
  comm-addr:
    type: int
    default: 0xFFFFFFFF
    description: |
      Device communication address used in AS608 protocol packets.
      Default is 0xFFFFFFFF. Can be changed via system parameter commands.

  password:
    type: int
    default: 0x00000000
    description: |
      AS608 sensor password. All sensors ship with default
      password 0x00000000. Only change if you've modified
      the sensor's password using the password change command.
```

## dts/bindings/biometrics/zephyr,biometrics-emul.yaml
```yaml
# Copyright (c) 2025 Siratul Islam
# SPDX-License-Identifier: Apache-2.0

description: Zephyr emulated biometrics device for testing

compatible: "zephyr,biometrics-emul"

include: base.yaml
```

## dts/bindings/biometrics/zhiantec,zfm-x0.yaml
```yaml
# SPDX-License-Identifier: Apache-2.0
# Copyright (c) 2025 Siratul Islam

description: |
  ZFM-x0 Series Optical Fingerprint Sensor

  This binding supports fingerprint sensor modules using the Zhiantec/Synochip
  ZFM protocol, including optical sensors like ZFM-20, ZFM-60, ZFM-70, R30x,
  JM-101, DY-50, FPM10A, capacitive sensors like Hi-Link HLK-ZW3021, HLK-ZW0623,
  HLK-ZW0642 and other compatible modules.

compatible: "zhiantec,zfm-x0"

include: [uart-device.yaml]

properties:
  comm-addr:
    type: int
    default: 0xFFFFFFFF
    description: |
      Module address for device identification in ZFM protocol packets.
      The module only responds to packets with matching addresses. Defaults
      to the factory-programmed value 0xFFFFFFFF. Override only if changed
      via the SetAdder command.

  password:
    type: int
    default: 0x00000000
    description: |
      Module password for authentication. Defaults to the factory-programmed
      value 0x00000000, which causes password verification to be skipped at
      power-on. Override only if changed via the SetPwd command.
```

## dts/bindings/bluetooth/ambiq,bt-hci-spi.yaml
```yaml
# Copyright (c) 2023, Ambiq Micro Inc.
# SPDX-License-Identifier: Apache-2.0

description: |
    Bluetooth module that uses Ambiq's Bluetooth Host Controller Interface SPI
    driver (e.g. Apollo4 Blue Plus).

compatible: "ambiq,bt-hci-spi"

include: [spi-device.yaml, bt-hci.yaml]

properties:
  reg:
    type: array
    required: true

  irq-gpios:
    type: phandle-array
    description: |
      This irq gpio is used to indicate there is packet ready to send to host
      from controller.

  reset-gpios:
    type: phandle-array
    description: |
      This reset gpio is used to reset the Bluetooth controller.

  clkreq-gpios:
    type: phandle-array
    description: |
      This clkreq gpio is used to send the XO32MHz clock request to host from
      controller. The host needs to enable XO32MHz when receiving low to high
      edge interrupts and disable XO32MHz when receiving high to low edge
      interrupts.

  bt-hci-name:
    default: "ambiq hci"

  bt-hci-bus:
    default: "spi"
```

## dts/bindings/bluetooth/atmosic,ble.yaml
```yaml
# Copyright 2018-2024 Atmosic
# SPDX-License-Identifier: Apache-2.0

description: |
    This binding gives a base representation of the Atmosic BLE

compatible: "atmosic,ble"

include: bt-hci.yaml

properties:
  bt-hci-name:
    default: "Atmosic BLE"
  bt-hci-bus:
    default: "virtual"

  reg:
      type: array
      description: mmio register space
      required: true

  interrupts:
      type: array
      description: required interrupts
      required: true
```

## dts/bindings/bluetooth/bflb,bl70x-bt-hci.yaml
```yaml
# Copyright The Zephyr Project Contributors
# SPDX-License-Identifier: Apache-2.0

description: Bluetooth HCI for Bouffalo Lab BL70X

compatible: "bflb,bl70x-bt-hci"

include: bt-hci.yaml

properties:
  bt-hci-name:
    default: "BT BL70X"
  bt-hci-bus:
    default: "virtual"
  bt-hci-quirks:
    default: ["no-auto-dle"]
```

## dts/bindings/bluetooth/bflb,bt-hci.yaml
```yaml
# Copyright The Zephyr Project Contributors
# SPDX-License-Identifier: Apache-2.0

description: Bluetooth HCI for Bouffalo Lab on-chip BLE controllers

compatible: "bflb,bt-hci"

include: bt-hci.yaml

properties:
  bt-hci-name:
    default: "BT BFLB"
  bt-hci-bus:
    default: "virtual"
  bt-hci-quirks:
    default: ["no-auto-dle"]

  pwr-table-ble:
    type: int
    description: BLE TX power target in quarter-dBm (0-15 dBm range).

  pwr-table-bt:
    type: array
    description: |
      Bluetooth classic TX power targets (BR 1M, EDR 2M, EDR 3M).
      3 entries, quarter-dBm.

  pwr-offset-bz:
    type: array
    description: |
      Per-channel BLE/BT TX power offset.
      Encoding: 16 = 0 dBm, step 0.25 dBm.
      5 entries.
```

## dts/bindings/bluetooth/ble-radio.yaml
```yaml
# Copyright (c) 2025 Nordic Semiconductor ASA
# Copyright (c) 2025 Silicon Laboratories Inc.
# SPDX-License-Identifier: Apache-2.0

description: |
  Base binding for Bluetooth LE radio hardware capabilities.

  These properties describe hardware-supported Bluetooth features based on
  the Bluetooth Core Specification. They are read-only and indicate what
  the hardware is capable of, not what features are currently enabled.

properties:
  # Bluetooth 5.0
  ble-2mbps-supported:
    type: boolean
    description: |
      2 Mbps PHY support (Bluetooth 5.0 specification).

  ble-coded-phy-supported:
    type: boolean
    description: |
      Coded PHY support for Long Range (Bluetooth 5.0 specification).

  # Bluetooth 5.1
  ble-cte-tx-supported:
    type: boolean
    description: |
      Constant Tone Extension transmission for Direction Finding in Angle
      of Departure mode (Bluetooth 5.1 specification).

  ble-cte-rx-supported:
    type: boolean
    description: |
      Constant Tone Extension reception with IQ sampling for Direction Finding
      in Angle of Arrival mode. Requires ble-cte-tx-supported capability
      (Bluetooth 5.1 specification).

  # Bluetooth 6.0
  ble-cs-supported:
    type: boolean
    description: |
      BLE Channel Sounding feature support (Bluetooth 6.0 specification).
```
