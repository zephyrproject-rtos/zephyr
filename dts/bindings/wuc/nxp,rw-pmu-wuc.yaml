## kernel/Kconfig.process
```kconfig
# Copyright The Zephyr Project Contributors
# SPDX-License-Identifier: Apache-2.0

menu "Process support"

config PROCESS
	bool "Process (thread group) support [EXPERIMENTAL]"
	select EXPERIMENTAL
	help
	  Select 'y' to enable kernel process (thread group) support: every
	  thread belongs to a process, processes form a parent/child tree
	  rooted in the three kernel-reserved processes (swapper, init,
	  kthreadd), and process termination can be observed with k_waitpid().

	  Process support does not require CONFIG_USERSPACE: without it,
	  processes provide identity, lifetime, and wait semantics for
	  supervisor-mode threads; memory isolation between processes
	  additionally requires CONFIG_USERSPACE.

if PROCESS

config PROCESS_STOP
	bool "Process stop and continue (job control)"
	depends on PROCESS && SIGNAL
	help
	  Give the stop signals their POSIX default action: delivery of
	  K_SIG_STOP, K_SIG_TSTP, K_SIG_TTIN, or K_SIG_TTOU suspends every
	  member thread of the receiving process, K_SIG_CONT resumes them,
	  and k_waitpid() reports the transitions to waiters passing
	  K_PROCESS_WUNTRACED or K_PROCESS_WCONTINUED.

config PROCESS_VM
	bool "Per-process virtual address space duplication (experimental)"
	depends on PROCESS && USERSPACE && ARCH_HAS_PROCESS_VM
	# kernel-mode reads of the TLS-cached current thread would alias the
	# parent's physical memory through the shared kernel page tables
	depends on !CURRENT_THREAD_USE_TLS
	select SYS_THREAD
	help
	  Enable address-space duplication for the fork() model: a cloned
	  child receives copies of the calling process's writable memory at
	  the same virtual addresses. Requires architecture support
	  (z_mem_domain_clone_remap()). Experimental.

config MAX_PROCESS_BYTES
	int "Bytes to use to track process permissions to kernel objects"
	default 1
	depends on USERSPACE
	help
	  Every kernel object stores one permission bit per process (a thread
	  holds permissions through the process it belongs to). This is the
	  size of that per-object bitmap in bytes, bounding the number of
	  simultaneously live processes.

config PROCESS_INIT
	bool "Start the init process with an initial thread"
	help
	  Give the reserved init process a running initial thread at boot,
	  independent of the image main(). The thread runs
	  z_process_init_entry(), a weak function the application overrides to
	  act as the system's init process; the default implementation sleeps
	  forever. Without this option, the init process exists but has no
	  thread of its own until one is created in it.

config PROCESS_INIT_STACK_SIZE
	int "init process initial thread stack size"
	depends on PROCESS_INIT
	default 1024
	help
	  Stack size of the init process's initial thread.

config PROCESS_INIT_PRIORITY
	int "init process initial thread priority"
	depends on PROCESS_INIT
	default 0
	help
	  Scheduling priority of the init process's initial thread.

config PROCESS_SIGCHLD_NOTIFIER_STACK_SIZE
	int "SIGCHLD notifier thread stack size"
	depends on SIGNAL
	default 1024
	help
	  Stack size of the thread that emits K_SIG_CHLD to a parent process
	  when one of its children becomes a zombie. Signal generation cannot
	  run in the scheduler's thread-halt path, so it is deferred to this
	  thread.+
config SIGNAL_SET_SIZE_MIN_PROCESS
	int
	depends on SIGNAL
	default 18
	help
	  Child-status notification uses K_SIG_CHLD (17), which must be
	  representable in the kernel signal set: processes require a set of
	  at least 18 signals.

config SIGNAL_QUEUE_SIZE_ADD_PROCESS
	int
	depends on SIGNAL
	default 4
	help
	  Queue headroom for child-status signals: each zombie child may hold
	  one pending K_SIG_CHLD element alongside ordinary signal traffic,
	  so a queue sized only for the latter can drop signals or leave
	  sigtimedwait() callers hung.

endif # PROCESS

endmenu
```

## kernel/Kconfig.scope
```kconfig
# Kernel feature scope

# Copyright The Zephyr Project Contributors
# SPDX-License-Identifier: Apache-2.0

choice KERNEL_SCOPE
	prompt "Kernel feature scope"
	default KERNEL_SCOPE_FULL
	help
	  Restricts the kernel features a build may enable. Features outside
	  the selected scope cannot be turned on: their Kconfig symbols depend
	  on the scope, their sources are not compiled and kernel/scope.c
	  rejects a build in which a select bypasses those dependencies.

config KERNEL_SCOPE_FULL
	bool "All kernel features"

config KERNEL_SCOPE_UP
	bool "Uniprocessor, supervisor mode only"
	help
	  One CPU with every thread in supervisor mode: no SMP, no user mode
	  threads and no MMU-based virtual memory. MPU stack guards and other
	  memory protection that does not create user mode threads remain
	  available.

config KERNEL_SCOPE_UP_USERSPACE
	bool "Uniprocessor with user mode threads"
	help
	  One CPU with user mode threads isolated by MPU or PMP regions: no
	  SMP, no MMU-based virtual memory and no kernel objects allocated at
	  run time.

endchoice

config KERNEL_SCOPE_DEFINITION
	string
	default "kernel/scopes/up.yaml" if KERNEL_SCOPE_UP
	default "kernel/scopes/up_userspace.yaml" if KERNEL_SCOPE_UP_USERSPACE
	help
	  Scope description, relative to the Zephyr base, that
	  scripts/build/check_kernel_scope.py audits the final link against.

config KERNEL_SCOPE_SMP
	bool
	default y if KERNEL_SCOPE_FULL
	help
	  Symmetric multiprocessing is within the selected kernel scope.

config KERNEL_SCOPE_USERSPACE
	bool
	default y if KERNEL_SCOPE_FULL || KERNEL_SCOPE_UP_USERSPACE
	help
	  User mode threads are within the selected kernel scope.

config KERNEL_SCOPE_MMU
	bool
	default y if KERNEL_SCOPE_FULL
	help
	  MMU-based virtual memory is within the selected kernel scope.

config KERNEL_SCOPE_DYNAMIC_OBJECTS
	bool
	default y if KERNEL_SCOPE_FULL
	help
	  Kernel objects allocated at run time are within the selected kernel
	  scope.
```

## lib/cmis/Kconfig
```kconfig
# Copyright The Zephyr Project Contributors
#
# SPDX-License-Identifier: Apache-2.0

config CMIS
	bool "CMIS pluggable optical module management decoding"
	help
	  Enable decoding of the Common Management Interface Specification
	  (CMIS) Page 00h used by high-speed pluggable transceivers such as
	  QSFP-DD, OSFP, SFP-DD and DSFP: the module-level monitors in Lower
	  Memory and the administrative information in Upper Page 00h.
```

## lib/elastipool/Kconfig
```kconfig
# SPDX-License-Identifier: Apache-2.0

config SYS_ELASTIPOOL
	bool "Elastic memory pool"
	help
	  Say 'y' here to enable the elastic memory pool ("elastipool") API.

	  The elastic memory pool API supports allocation of fixed-size objects from either
	  a statically allocated pool of objects, or dynamically allocation from the heap, or
	  both, up to a maximum number of allocations.
```

## lib/libc/xclib/Kconfig
```kconfig
# Copyright (c) 2026 Antmicro <www.antmicro.com>
#
# SPDX-License-Identifier: Apache-2.0

if XTENSA_LIBC

config XTENSA_LIBC_DYNAMIC_REENT
	bool "Xtensa C library dynamic reentrancy support"
	help
	  Enable dynamic reentrancy support for the Xtensa C library (xclib).

endif # XTENSA_LIBC
```

## lib/memref/Kconfig
```kconfig
# Copyright (c) 2026 Måns Ansgariusson <mansgariusson@gmail.com>
# SPDX-License-Identifier: Apache-2.0

menu "Memref: shared memory references"

config MEMREF
	bool "Shared memory references"
	help
	  This option enables the shared memory references API, which
	  allows multiple threads to share ownership of a memory block
	  through reference counting.

config MEMREF_DESTROY_CB
	bool "Destroy callback support"
	depends on MEMREF
	help
	  Store a per-allocation destroy callback in the memref control
	  block, invoked with the user pointer just before the block is
	  returned to its backend. Costs one pointer per allocation.

endmenu
```

## lib/net_buf/Kconfig
```kconfig
# Network buffer configuration options

# Copyright (c) 2015 Intel Corporation
# SPDX-License-Identifier: Apache-2.0

menuconfig NET_BUF
	bool "Network buffer support"
	help
	  This option enables support for generic network protocol
	  buffers.

if NET_BUF

config NET_BUF_LOG
	bool "Network buffer logging"
	select LOG
	help
	  Enable logs and checks for the generic network buffers.

module = NET_BUF
module-str = net_buf
source "subsys/logging/Kconfig.template.log_config"

if NET_BUF_LOG

config NET_BUF_WARN_ALLOC_INTERVAL
	int "Interval of Network buffer allocation warnings"
	default 1
	range 0 60
	help
	  Interval in seconds of Network buffer allocation warnings which are
	  generated when a buffer cannot immediately be allocated with K_FOREVER
	  which may lead to deadlocks. A warning is printed when the allocation
	  starts to wait and then at this interval, and the time it was blocked
	  is printed when it gets a buffer. Setting it to 0 disables the
	  periodic warnings, leaving the first and the last one.

config NET_BUF_SIMPLE_LOG
	bool "Network buffer memory debugging"
	select LOG
	help
	  Enable extra debug logs and checks for the generic network buffers.

endif # NET_BUF_LOG

config NET_BUF_POOL_USAGE
	bool "Network buffer pool usage tracking"
	help
	  Enable network buffer pool tracking. This means that:
	  * amount of free buffers in the pool is remembered
	  * maximum amount of buffers in use at the same time is remembered
	  * total size of the pool is calculated
	  * pool name is stored and can be shown in debugging prints

config NET_BUF_HARDENING
	bool "Network buffer runtime integrity checks"
	help
	  Enable always-on (not assert-gated) integrity checks on the network
	  buffer length/pointer fields before mutating a buffer. A buffer whose
	  len/data have been corrupted so that they no longer fit within the
	  buffer's own storage (e.g. len wrapped to a large value, or data moved
	  outside __buf..__buf+size) is rejected fail-closed: the mutating
	  operation returns NULL instead of reading or writing out of bounds.
	  Operations that return a value return 0 and operations that return
	  nothing do not write, so the caller cannot always tell that an
	  operation was rejected.

	  This turns a would-be out-of-bounds access (in particular the
	  tailroom-underflow -> net_buf_add() overflow) into a controlled
	  failure. It adds a small runtime cost to net_buf_simple_add()/push()/
	  pull()/remove() and is intended for security-sensitive builds; leave
	  disabled to keep the fast path assert-only.

config NET_BUF_ALIGNMENT
	int "Network buffer alignment restriction"
	default 0
	help
	  Alignment restriction for network buffers. This is useful for
	  some hardware IP with DMA that requires the buffers to be aligned
	  to a certain byte boundary, or dealing with cache line restrictions.
	  Default value of 0 means the alignment will be the size of a void pointer,
	  any other value will force the alignment of a net buffer in bytes.

endif # NET_BUF
```

## lib/offloader/Kconfig
```kconfig
# Copyright (c) 2026 Måns Ansgariusson <mansgariusson@gmail.com>
# SPDX-License-Identifier: Apache-2.0

config OFFLOADER
	bool "Call offloader"
	help
	  Run calls to stack-hungry APIs on dedicated threads instead of on the calling thread, so
	  that only the engine threads need a stack large enough for them.
```

## lib/os/Kconfig.sys_mutex
```kconfig
# SPDX-FileCopyrightText: Copyright The Zephyr Project Contributors
# SPDX-License-Identifier: Apache-2.0

config SYS_MUTEX_PRIO_INHERIT
	bool "Priority inheritance for sys_mutex"
	depends on MULTITHREADING
	select MUTEX_OPTIONS
	select SYS_ELASTIPOOL
	select SYS_HASH_MAP
	select SYS_HASH_FUNC32
	help
	  Support the K_MUTEX_PRIO_INHERIT option of sys_mutex_init_ext() and
	  SYS_MUTEX_DEFINE_EXT(). Such a mutex is backed by a kernel mutex that
	  the kernel associates with the address of the user object, so every
	  operation on it is a system call and the owner inherits the priority
	  of the highest-priority waiter.

if SYS_MUTEX_PRIO_INHERIT

config SYS_MUTEX_PRIO_INHERIT_MIN
	int "Minimum number of priority-inheritance sys_mutex objects"
	default 0
	help
	  Number of kernel mutexes statically reserved for backing
	  priority-inheritance sys_mutex objects.

config SYS_MUTEX_PRIO_INHERIT_MAX
	int "Maximum number of priority-inheritance sys_mutex objects"
	default SYS_MUTEX_PRIO_INHERIT_MIN
	help
	  Maximum number of priority-inheritance sys_mutex objects in use at
	  once. Backing kernel mutexes beyond SYS_MUTEX_PRIO_INHERIT_MIN come
	  from the kernel heap.

endif # SYS_MUTEX_PRIO_INHERIT
```
