## dts/bindings/wuc/nxp,rw-pmu-wuc.yaml
```yaml
# SPDX-FileCopyrightText: Copyright 2026 NXP
# SPDX-License-Identifier: Apache-2.0

description: |
  NXP RW6xx Power Management Unit wakeup controller.

  This device is a child of the nxp,rw-pmu node and adapts the SDK Power
  driver's wakeup APIs to WUC. The wakeup source ID is the peripheral
  IRQn_Type value in the RW61x device header, without the Cortex-M
  exception offset of 16. For example, RTC_IRQn is ID 32, not vector
  index 48; PIN1_INT_IRQn is ID 101, not WAKEUP_MASK bit index 1.
  The same IRQn numbering applies to wakeup-ctrls and the WUC runtime API.

  Source IDs are supplied by the SoC devicetree and passed to the SDK
  Power driver without validation. The Power driver defines the supported
  sources and maps each IRQn to its wakeup registers. The SoC provides
  consumer specifiers for wakeup sources used by in-tree samples.

  The driver only routes wakeup requests; it does not configure the
  peripheral, pin polarity, clocks, or NVIC. Availability
  depends on the power mode and powered domains. PM1 can wake on any
  enabled interrupt without PMU routing. PM3/PM4 have fewer sources
  than PM2; WLAN/BLE routes cannot wake a powered-off radio.

compatible: "nxp,rw-pmu-wuc"

include: [base.yaml, wuc-controller.yaml]

properties:
  '#wakeup-ctrl-cells':
    const: 1

wakeup-ctrl-cells:
  - id
```

## dts/bindings/wuc/realtek,rts5817-wuc.yaml
```yaml
# Copyright (c) 2026 Realtek Semiconductor, Inc.
# SPDX-License-Identifier: Apache-2.0

description: |
  Realtek RTS5817 Wakeup Controller (WUC).

  The RTS5817 WUC manages wakeup sources for the SoC's power management
  controller. It provides the ability to enable/disable wakeup sources and
  check which source triggered a wakeup after S2RAM (Suspend-to-RAM).

  Wakeup sources include GPIO-AL0/1/2, sensor GPIO, sensor CS, GPI_WAKE1/2,
  RC timer, USB host, and OCP (over-current protection).

  Each wakeup source is identified by an integer ID matching the
  RTS5817_WKUP_SRC_* constants defined in
  include/zephyr/dt-bindings/wuc/wuc_rts5817.h.

  Child nodes define the configuration (wakeup mode, substate, RC timer
  timeout) for each wakeup source.

  Example:
    wuc: wakeup-controller@401e2000 {
        compatible = "realtek,rts5817-wuc";
        reg = <0x401e2000 0x200>;
        #wakeup-ctrl-cells = <1>;

        gpio_al0_wakeup {
            wkup-src = <3>;        // RTS5817_WKUP_SRC_GPIO_AL0
            wkup-mode = <0>;       // rising edge
            wkup-state = <&suspend>;
        };
    };

compatible: "realtek,rts5817-wuc"

include: [base.yaml, wuc-controller.yaml]

properties:
  syscon-sys:
    type: phandle
    required: true
    description: |
      phandle to dlink_sys node.

  syscon-ldo:
    type: phandle
    required: true
    description: |
      phandle to dlink_ldo node.

  '#wakeup-ctrl-cells':
    type: int
    const: 1
    description: |
      Number of cells in the wakeup-ctrls property.
      The 'id' cell is the wakeup source identifier (RTS5817_WKUP_SRC_*).

wakeup-ctrl-cells:
  - id

child-binding:
  description: |
    Wakeup source configuration node.

  properties:
    id:
      type: int
      required: true
      description: |
        Wakeup source identifier. Must be one of the RTS5817_WKUP_SRC_*
        values from wuc_rts5817.h.

    mode:
      type: int
      description: |
        Wakeup trigger mode for GPIO-type sources. Must be one of
        the RTS5817_WAKEUP_MODE_* values from wuc_rts5817.h
      enum: [0, 1, 2, 3]

    time:
      type: int
      description: |
        Wakeup time in milliseconds for RC timer wakeup source.
        Valid range is [0, 41943].

    substate-id:
      type: int
      required: true
      description: |
        The substate_id of S2RAM that wakeup source is active for.
```

## dts/bindings/wuc/silabs,siwx91x-wuc.yaml
```yaml
# Copyright (c) 2026 Silicon Laboratories Inc.
# SPDX-License-Identifier: Apache-2.0

description: |
  Silicon Labs SiWx91x wake-up controller.

  The controller routes always-on peripheral events to the MCU power-state
  controller so that they can wake the SoC from low-power states.

compatible: "silabs,siwx91x-wuc"

include:
  - base.yaml
  - wuc-controller.yaml

properties:
  "#wakeup-ctrl-cells":
    const: 1

wakeup-ctrl-cells:
  - id
```

## kernel/Kconfig.nanobe
```kconfig
# Copyright (c) 2016-2026 Vinayak Kariappa Chettimada
# SPDX-License-Identifier: Apache-2.0

menuconfig USE_NANOBE_SWITCH
	bool "Nanobe threads [EXPERIMENTAL]"
	depends on (CPU_CORTEX_M && ARMV7_M_ARMV8_M_MAINLINE && !USE_SWITCH && \
		    !ARM_STORE_EXC_RETURN && !ARM_PAC_PER_THREAD) || \
		   (RISCV && !RISCV_S_MODE && !SMP && !FPU)
	depends on MULTITHREADING
	select EXPERIMENTAL
	help
	  Use nanobes, minimal execution contexts with their own stack, as
	  the Zephyr threads. The kernel thread APIs and the Zephyr scheduler
	  are unchanged, the thread context switch is a nanobe switch: it
	  saves only the callee-saved registers on the outgoing thread's
	  stack and swaps the stack pointer, in thread mode.

	  All scheduling decisions are taken in thread mode. Interrupt
	  service routines that ready or halt threads only defer the
	  decision; interrupt exit then injects a reschedule into the
	  interrupted thread, which decides and switches in thread mode.
	  PendSV is not used and interrupt entry has no scheduling code.

	  On RISC-V, the thread context switch is the arch_switch() of
	  USE_SWITCH, done in thread mode; no context switch is done on
	  interrupt exit nor through ecall (RISCV_ALWAYS_SWITCH_THROUGH_ECALL
	  is not used). The injected call returns to the interrupted code
	  using mret. On the Nordic VPR, interrupt hardware stacking is
	  disabled and the interrupt frame is saved in software, unless
	  NANOBE_HW_STACKING is enabled.

	  Nanobes may also be used directly, inside one Zephyr thread (the
	  nanobe owner thread), with a simple round robin nanobe scheduler
	  with a lock, sleep and semaphores.

	  Time slicing (TIMESLICING) is disabled by default; if enabled, time
	  slice expiry is handled in thread mode.

	  The nanobe stacks are not covered by hardware stack limit checking
	  (PSPLIM on Arm Cortex-M) and nanobes run privileged, hence enabling
	  USE_NANOBE_SWITCH disables BUILTIN_STACK_GUARD and USERSPACE.
	  On RISC-V, USE_NANOBE_SWITCH also disables the PMP and custom stack
	  guards (PMP_STACK_GUARD, CUSTOM_STACK_GUARD), and of the SoCs with
	  hardware ISR stacking (RISCV_SOC_HAS_ISR_STACKING) only the Nordic
	  VPR is supported.

	  See include/zephyr/kernel/nanobe.h.

if USE_NANOBE_SWITCH

config NANOBE_INJECTION
	bool "Nanobe ISR call injection"
	help
	  Enable nanobe_isr_inject(), which lets an interrupt service routine
	  redirect its exception return to execute a call (e.g.
	  nanobe_sched_yield()) in thread mode on the interrupted nanobe owner
	  thread's stack, before transparently resuming the interrupted code.
	  This provides interrupt driven pre-emptive nanobe scheduling.

config NANOBE_FPU
	bool
	default y if FPU && CPU_HAS_FPU
	depends on CPU_CORTEX_M
	help
	  Save and restore the callee-saved FP registers on nanobe switch and
	  the caller-saved FP context around injected calls.

config NANOBE_HW_STACKING
	bool "Nordic VPR interrupt hardware stacking"
	depends on RISCV_CORE_NORDIC_VPR
	help
	  Keep the Nordic VPR interrupt hardware stacking enabled: the VPR
	  stacks the caller-saved registers, mcause and mepc on interrupt
	  entry and unstacks them on mret (RISCV_SOC_HAS_ISR_STACKING), and
	  the injection syringe returns to the interrupted code through a
	  hardware stacking frame.

	  By default, hardware stacking is disabled at boot
	  (VPRNORDICFEATURESDISABLE.INTHWSTACKING = NOAUTOSTACK) and the
	  interrupt frame is saved and restored in software, including mcause
	  (CLIC_SUPPORT_INTERRUPT_LEVEL); the injection syringe is the generic
	  RISC-V one.

endif # USE_NANOBE_SWITCH
```

## kernel/Kconfig.obj_core
```kconfig
# Copyright (c) 2024 Intel Corp.
# SPDX-License-Identifier: Apache-2.0
#
menuconfig OBJ_CORE
	bool "Object core framework"
	default n
	select THREAD_STACK_INFO
	help
	  This option enables the object core framework. This will link
	  participating kernel objects and their respective types together
	  in a way that allows them to both have common information stored
	  together and for that information to be easily retrieved by
	  automated means.

if OBJ_CORE
config OBJ_CORE_MAX_DYNAMIC_OBJECTS
	int "Maximum number of registered objects"
	default 128
	help
	  Size of the registry of objects that are initialized at run time,
	  such as kernel objects embedded in driver data. Statically defined
	  objects (K_SEM_DEFINE() and the like) are enumerated in place and do
	  not use a registry entry, and objects located in a thread's stack or
	  in the interrupt stack are never registered. When the registry is
	  full, further objects are not tracked and the object type's dropped
	  count is incremented.

config OBJ_CORE_EVICT_ON_FREE
	bool "Unregister objects located in released memory"
	default y
	select SYS_HEAP_RELEASE_HOOK
	help
	  When memory is returned to a sys_heap or a memory slab, unregister
	  every object located in it so that it stops being reported at once.
	  The cost is a scan of the registry on each release.

config OBJ_CORE_CONDVAR
	bool "Integrate condition variables into object core framework"
	default y
	help
	  When enabled, this option integrates condition variables into the
	  object core framework.

config OBJ_CORE_EVENT
	bool "Integrate events into object core framework"
	default y if EVENTS
	help
	  When enabled, this option integrate kernel events into the object
	  core framework.

config OBJ_CORE_FIFO
	bool "Integrate FIFOs into object core framework"
	default y
	help
	  When enabled, this option integrates FIFOs into the object core
	  framework.

config OBJ_CORE_LIFO
	bool "Integrate LIFOs into object core framework"
	default y
	help
	  When enabled, this option integrates LIFOs into the object core
	  framework.

config OBJ_CORE_MAILBOX
	bool "Integrate mailboxes into object core framework"
	default y
	help
	  When enabled, this option integrates mailboxes into the object core
	  framework.

config OBJ_CORE_MEM_SLAB
	bool "Integrate memory slabs into object core framework"
	default y
	help
	  When enabled, this option integrates memory slabs into the object
	  core framework.

config OBJ_CORE_MUTEX
	bool "Integrate mutexes into object core framework"
	default y
	help
	  When enabled, this option integrates mutexes into the object core
	  framework.

config OBJ_CORE_MSGQ
	bool "Integrate message queues into object core framework"
	default y
	help
	  When enabled, this option integrates message queues into the object
	  core framework.

config OBJ_CORE_PIPE
	bool "Integrate pipe into object core framework"
	default y
	help
	  When enabled, this option integrates pipes into the object core
	  framework.

config OBJ_CORE_QUEUE
	bool "Integrate queues into object core framework"
	default y
	help
	  When enabled, this option integrates queues into the object core
	  framework.

config OBJ_CORE_SEM
	bool "Integrate semaphores into object core framework"
	default y
	help
	  When enabled, this option integrates semaphores into the object core
	  framework.

config OBJ_CORE_STACK
	bool "Integrate stacks into object core framework"
	default y
	help
	  When enabled, this option integrates stacks into the object core
	  framework.

config OBJ_CORE_THREAD
	bool "Integrate threads into object core framework"
	default y
	help
	  When enabled, this option integrates threads into the object core
	  framework.

config OBJ_CORE_TIMER
	bool "Integrate timers into object core framework"
	default y
	help
	  When enabled, this option integrates timers into the object core
	  framework.

config OBJ_CORE_SYSTEM
	bool
	default y
	help
	  When enabled, this option integrates the internal CPU and kernel
	  system objects into the object core framework. As these are internal
	  structures, this option is hidden by default and only available to
	  advanced users.

menuconfig OBJ_CORE_STATS
	bool "Object core statistics"
	default n
	help
	  This option integrates statistics gathering into the object core
	  framework.

if OBJ_CORE_STATS
config OBJ_CORE_STATS_MEM_SLAB
	bool "Object core statistics for memory slabs"
	default y if OBJ_CORE_MEM_SLAB
	help
	  When enabled, this allows memory slab statistics to be integrated
	  into kernel objects.

config OBJ_CORE_STATS_THREAD
	bool "Object core statistics for threads"
	default y if OBJ_CORE_THREAD
	select THREAD_RUNTIME_STATS
	help
	  When enabled, this integrates thread runtime statistics into the
	  object core statistics framework.

config OBJ_CORE_STATS_SYSTEM
	bool "Object core statistics for system level objects"
	default y if OBJ_CORE_SYSTEM
	select SCHED_THREAD_USAGE_ALL
	help
	  When enabled, this integrates thread runtime statistics at the
	  CPU and system level into the object core statistics framework.

endif  # OBJ_CORE_STATS

endif  # OBJ_CORE
```
