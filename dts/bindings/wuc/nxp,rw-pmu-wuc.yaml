## lib/os/Kconfig.sys_process
```kconfig
# Copyright (c) 2026, Friedt Professional Engineering Services, Inc.
# SPDX-License-Identifier: Apache-2.0

config SYS_PROCESS
	bool "System-layer process services"
	depends on PROCESS
	select SYS_ELASTIPOOL
	imply SYS_HASH_MAP
	imply SYS_HASH_FUNC32
	help
	  Everything allocation-adjacent that kernel process support
	  deliberately does not own: integer process/group/session numbering
	  (sys_process_id() and friends), dynamic process records beyond the
	  kernel's static minimum, and the group/session cell pools backing
	  runtime k_setsid()/k_setpgid(). Without this option the kernel serves
	  statically defined processes only: records up to the built-in
	  minimum, build-time topology, no runtime group or session creation,
	  and no numeric IDs.

if SYS_PROCESS

config SYS_PROCESS_MIN
	int "Minimum size of the process record pool"
	default 4
	help
	  Minimum number of process records guaranteed to be allocatable for
	  k_spawn() children (including zombies not yet reaped), provided to
	  the kernel from a static pool in the system layer. Applications and
	  libraries contribute additional guaranteed records by defining int
	  symbols named CONFIG_SYS_PROCESS_MIN_ADD_<NAME>; the build system
	  sums this option with all such contributions and, for technical
	  reasons, provides the result to code as the un-prefixed
	  SYS_PROCESS_MIN compile definition.

config SYS_PROCESS_MAX
	int "Maximum number of heap-provided process records"
	default 0
	help
	  Number of process records that may be provided to the kernel from the
	  heap, in addition to the statically guaranteed minimum (the sum of
	  CONFIG_SYS_PROCESS_MIN and all CONFIG_SYS_PROCESS_MIN_ADD_*
	  contributions).
	  The kernel itself never allocates: records beyond the minimum come
	  from the system layer (lib/os), without guarantees, and require a
	  system heap. The default (0) disables dynamic process records
	  entirely.

config SYS_PROCESS_ARG_BYTES
	int "Argument budget of a process-tier clone, in bytes"
	default 512
	help
	  Upper bound on the argument and environment vectors sys_clone()
	  copies into a child created with argv set: the pointer tables and
	  the strings together. The copy is placed at the base of the
	  leader's stack and reduces its usable size by that much. Larger
	  vectors fail with -E2BIG.

config SYS_PROCESS_EXEC
	bool "Load process images from the file system"
	depends on LLEXT && FILE_SYSTEM
	select LLEXT_REGION_BLOCKS if USERSPACE
	help
	  sys_exec_load(): load a linkable loadable extension from the file
	  system as the image of a paused child created by sys_clone() with
	  staged arguments and no entry point. The image's regions join the
	  child's memory domain and the extension is unloaded when the process
	  is reaped.

config SYS_PROCESS_STATE_AREA
	int "Per-process state area of an image process, in bytes"
	depends on SYS_PROCESS_EXEC && USERSPACE
	default 0
	help
	  Size of the writable area appended to a user-mode image process's
	  RW block for the C library's per-process state: its malloc arena
	  and standard streams. 0 leaves image processes sharing the boot
	  image's C library state.

config SYS_PROCESS_EXEC_PATH_MAX
	int "Maximum image path length for sys_exec_load()"
	depends on SYS_PROCESS_EXEC
	default 128

config SYS_PROCESS_IDS
	int "Maximum number of simultaneously numbered processes"
	default 16
	help
	  Size of the system-layer numbering tables behind sys_process_id(),
	  sys_pgrp_id(), and sys_session_id(). Must cover the three reserved
	  processes plus every statically defined and runtime process that can
	  exist at once (including zombies not yet reaped).

endif # SYS_PROCESS
```

## lib/os/Kconfig.sys_thread
```kconfig
# Copyright (c) 2026, Friedt Professional Engineering Services, Inc
# SPDX-License-Identifier: Apache-2.0

config SYS_THREAD
	bool "Support shared pools of threading primitives"
	select DYNAMIC_OBJECTS if USERSPACE
	select THREAD_ABORT_NEED_CLEANUP
	select SIGNAL
	select SYS_ELASTIPOOL
	select THREAD_MONITOR
	select THREAD_STACK_INFO
	# to support heap-based allocation by default, can be disabled
	imply SYS_HASH_MAP
	imply SYS_HASH_FUNC32
	help
	  Select 'y' here to support shared system pools of threading primitives such as
	    - k_thread_stack_t
	    - k_thread

if SYS_THREAD

config SYS_THREAD_STACK_MAX
	int "Maximum size of system k_thread_stack_t pool"
	default SYS_THREAD_STACK_MIN
	help
	  This value represents the maximum number of thread stacks that may be available to
	  kernel or user threads in the system stack pool. If this value is equal to
	  SYS_THREAD_STACK_MIN, then only static allocations are permitted via the system
	  stack pool. If this value is greater than SYS_THREAD_STACK_MIN, then
	  maximally CONFIG_SYS_THREAD_STACK_MAX - SYS_THREAD_STACK_MIN stacks
	  may be allocated from the heap.

	  CONFIG_SYS_THREAD_STACK_MAX must be >= SYS_THREAD_STACK_MIN.

config SYS_THREAD_STACK_MIN
	int "Minimum size of system k_thread_stack_t pool"
	default 0
	help
	  This value represents the minimum number of thread stacks that are guaranteed to be
	  available to kernel or user threads in the system stack pool. The minimum
	  number is guaranteed via static allocation.

	  SYS_THREAD_STACK_MIN must be >= 0.

config SYS_THREAD_STACK_ALLOC_ANON
	bool
	depends on !ARCH_POSIX
	default y if MMU
	help
	  On systems where an MMU is present, anonymously mapped pages of memory may be used
	  for allocating thread stacks. Allocation is performed using `k_mem_map()`. The size
	  of those thread stacks are rouded up to a multiple of CONFIG_MMU_PAGE_SIZE. Two
	  additional guard pages accompany the anonymous mapping; one before the thread stack,
	  and the other after the thread stack.

config SYS_THREAD_STACK_ALLOC_HEAP
	bool
	default y if !MMU
	help
	  Allocate thread stacks from the heap.

config SYS_THREAD_STACK_SIZE
	int "Size of system thread stacks"
	default 4096 if COVERAGE_GCOV
	default 4096 if MMU
	default 2048 if !MMU && 64BIT
	default 1024
	help
	  Size of each thread stack in the system thread stack pool.

config SYS_THREAD_THREAD_MAX
	int "Maximum size of system k_thread pool"
	default SYS_THREAD_THREAD_MIN
	help
	  This value represents the maximum number of threads that may be available to
	  kernel or user threads in the system thread pool. If this value is equal to
	  SYS_THREAD_THREAD_MIN, then only static allocations are permitted via the system
	  thread pool. If this value is greater than SYS_THREAD_THREAD_MIN, then
	  maximally CONFIG_SYS_THREAD_THREAD_MAX - SYS_THREAD_THREAD_MIN threads
	  may be allocated from the heap.

	  CONFIG_SYS_THREAD_THREAD_MAX must be >= SYS_THREAD_THREAD_MIN.

config SYS_THREAD_THREAD_MIN
	int "Minimum size of system k_thread pool"
	default 0
	help
	  This value represents the minimum number of threads that are guaranteed to be
	  available to kernel or user threads in the system thread pool. The minimum
	  number is guaranteed via static allocation.

	  SYS_THREAD_THREAD_MIN must be >= 0.

module = SYS_THREAD
module-str = Log level for system thread library
module-help = Enables system thread logging.
source "subsys/logging/Kconfig.template.log_config"

endif # SYS_THREAD
```

## lib/os/Kconfig.sys_timer
```kconfig
# SPDX-FileCopyrightText: Copyright The Zephyr Project Contributors
# SPDX-License-Identifier: Apache-2.0

config SYS_TIMER
	bool "Support an OS-managed pool of kernel timers"
	select DYNAMIC_OBJECTS if USERSPACE
	select SYS_ELASTIPOOL
	select TIMER_CLOCK
	# to support heap-based allocation by default, can be disabled
	imply SYS_HASH_MAP
	imply SYS_HASH_FUNC32
	help
	  Select 'y' here to support an OS-managed pool of k_timer objects,
	  allocated and released with the sys_timer_create() and
	  sys_timer_delete() system calls. This is the substrate for POSIX
	  timers (timer_create()/timer_delete()).

if SYS_TIMER

config SYS_TIMER_DISPATCH_PRIO
	int "Priority of the function-notification dispatcher thread"
	depends on TIMER_SIGNAL && SYS_THREAD && THREAD_DETACH
	default 0
	help
	  Priority of the system timer dispatcher thread. Must be a preemptible
	  priority: the dispatcher shares the kernel signal queue's readiness
	  signal with every other signal waiter and must not starve them.

config SYS_TIMER_DISPATCH_STACK_SIZE
	int "Stack size of the function-notification dispatcher thread"
	depends on TIMER_SIGNAL && SYS_THREAD && THREAD_DETACH
	default 1024
	help
	  Stack size of the system timer dispatcher, the kernel service thread
	  that accepts function-notification timer expiries and spawns one
	  detached thread per notification. Started on first use; notification
	  threads themselves draw from the system thread pool
	  (CONFIG_SYS_THREAD_STACK_SIZE and friends).

config SYS_TIMER_MAX
	int "Maximum size of the system timer pool"
	default 2147483647
	help
	  This value represents the maximum number of timers that may be
	  allocated from the system timer pool. The first SYS_TIMER_MIN (the
	  sum of CONFIG_SYS_TIMER_MIN and all CONFIG_SYS_TIMER_MIN_ADD_*
	  contributions) are statically allocated and guaranteed; the remainder
	  come from the heap, without guarantees.

	  The default (INT_MAX) effectively does not limit dynamic allocation.
	  Set this equal to the accumulated minimum to prohibit dynamic
	  allocation entirely.

	  CONFIG_SYS_TIMER_MAX must be >= the accumulated SYS_TIMER_MIN.

config SYS_TIMER_MIN
	int "Minimum size of the system timer pool"
	default 0
	help
	  This value represents the minimum number of timers that are
	  guaranteed to be available from the system timer pool. The minimum
	  number is guaranteed via static allocation.

	  Applications and libraries contribute additional guaranteed timers by
	  defining int symbols named CONFIG_SYS_TIMER_MIN_ADD_<NAME>; the build
	  system sums CONFIG_SYS_TIMER_MIN with all such contributions and, for
	  technical reasons, provides the result to code as the un-prefixed
	  SYS_TIMER_MIN compile definition.

endif # SYS_TIMER
```

## lib/os/zassert/Kconfig
```kconfig
# Copyright (c) 2026 Måns Ansgariusson <mansgariusson@gmail.com>
# SPDX-License-Identifier: Apache-2.0

config ASSERT
	bool "Runtime assertion checking (ZASSERT)"
	default y if TEST
	depends on !FORCE_NO_ASSERT
	help
	  This enables the ZASSERT macros.

	  Disabling this option will cause all assertions to compile to nothing,
	  improving performance and system footprint.

config ASSERT_LEVEL
	int "__ASSERT() level [DEPRECATED]"
	default 2
	range 0 2
	help
	  This option specifies the assertion level used by the __ASSERT()
	  macro. It can be set to one of three possible values:

	  Level 0: off
	  Level 1: on + warning in every file that includes __assert.h
	  Level 2: on + no warning

	  Deprecated: configure the DEFAULT ZASSERT module instead
	  (CONFIG_ASSERT_MODULE_DEFAULT_LEVEL_OFF/ON/VERBOSE).


config FORCE_NO_ASSERT
	bool "Force-disable no assertions [DEPRECATED]"
	select DEPRECATED
	help
	  This boolean option disables Zephyr assertion testing even
	  in circumstances (twister) where it is enabled via
	  CFLAGS and not Kconfig.  Added solely to be able to work
	  around compiler bugs for specific tests.

	  Deprecated: use CONFIG_ASSERT=n to disable all ZASSERT modules.

config ASSERT_VERBOSE
	bool "Verbose assertions [DEPRECATED]"
	select DEPRECATED
	help
	  This option enables printing an assert message with information about
	  the assertion that occurred. This includes printing the location,
	  the conditional expression and additional message specific to the
	  assert.

	  Deprecated: sets the DEFAULT ZASSERT module to Verbose. Configure it
	  directly with CONFIG_ASSERT_MODULE_DEFAULT_LEVEL_VERBOSE instead.

config ASSERT_NO_FILE_INFO
	bool "Disable file info for asserts [DEPRECATED]"
	select DEPRECATED
	help
	  This option removes the name and the path of the source file
	  in which the assertion occurred. Enabling this will save
	  target code space, and thus may be necessary for tiny targets.

	  Deprecated: the ZASSERT path always reports the location. This option
	  has no effect.

config ASSERT_NO_COND_INFO
	bool "Disable condition info for asserts [DEPRECATED]"
	select DEPRECATED
	help
	  This option removes the assert condition from the printed assert
	  message. Enabling this will save target code space, and thus may be
	  necessary for tiny targets. It is recommended to disable condition
	  info before disabling file info since the condition can be found in
	  the source using file info.

	  Deprecated: sets the DEFAULT ZASSERT module to On (no message).
	  Configure it directly with CONFIG_ASSERT_MODULE_DEFAULT_LEVEL_ON instead.

config ASSERT_NO_MSG_INFO
	bool "Disable message for asserts [DEPRECATED]"
	select DEPRECATED
	help
	  This option removes the additional message from the printed assert.
	  Enabling this will save target code space, and thus may be
	  necessary for tiny targets. It is recommended to disable message
	  before disabling file info since the message can be found in the
	  source using file info.

	  Deprecated: sets the DEFAULT ZASSERT module to On (no message).
	  Configure it directly with CONFIG_ASSERT_MODULE_DEFAULT_LEVEL_ON instead.


# when the deprecation period is over this file will source the Kconfig template
# and define the default module instead. For now this is needed to keep the backward compatibility
# with the __ASSERT() macros and their legacy Kconfig symbols.

# The DEFAULT ZASSERT module (used by ZASSERT_MODULE(DEFAULT) and the __ASSERT()
# compatibility shim). Its default level is derived from the deprecated legacy
# CONFIG_ASSERT* symbols above: ASSERT_VERBOSE maps to Verbose; ASSERT_NO_COND_INFO
# and ASSERT_NO_MSG_INFO map to On; a disabled or level-0 ASSERT leaves it Off.
# The level stays overridable from prj.conf via the choice below.
choice
	prompt "Assertion level for the DEFAULT assert module"
	depends on ASSERT
	default ASSERT_MODULE_DEFAULT_LEVEL_VERBOSE if ASSERT && ASSERT_VERBOSE && \
		!ASSERT_NO_COND_INFO && !ASSERT_NO_MSG_INFO
	default ASSERT_MODULE_DEFAULT_LEVEL_ON

config ASSERT_MODULE_DEFAULT_LEVEL_OFF
	bool "Off"
	help
	  ZASSERT_OFF: assertions for the DEFAULT module are compiled out.

config ASSERT_MODULE_DEFAULT_LEVEL_ON
	bool "On (no message)"
	help
	  ZASSERT_ON: assertions are checked, but the message and its arguments
	  are not compiled in.

config ASSERT_MODULE_DEFAULT_LEVEL_VERBOSE
	bool "Verbose (with message)"
	help
	  ZASSERT_VERBOSE: assertions are checked and the message and its
	  arguments are compiled in.

endchoice

config ASSERT_MODULE_DEFAULT_LEVEL
	int
	default 0 if !ASSERT
	default 0 if ASSERT_MODULE_DEFAULT_LEVEL_OFF
	default 1 if ASSERT_MODULE_DEFAULT_LEVEL_ON
	default 2 if ASSERT_MODULE_DEFAULT_LEVEL_VERBOSE

config ASSERT_TEST
	bool "Assert test mode"
	help
	  This option enables the assert test mode, which allows the assert
	  post action handler to return (i.e. not abort) when the asserted
	  condition is false. The tests that validate the assert feature may
	  select this option to allow the test to proceed by implementing a
	  custom assert post action hook.
```
