## lib/os/zvfs/Kconfig
```kconfig
# Copyright (c) 2020 Tobias Svehagen
# Copyright (c) 2023 Meta
#
# SPDX-License-Identifier: Apache-2.0

menuconfig ZVFS
	bool "Zephyr virtual filesystem (ZVFS) support [EXPERIMENTAL]"
	select EXPERIMENTAL
	help
	  ZVFS is a central, Zephyr-native library that provides a common interoperable API for all
	  types of file descriptors such as those from the non-virtual FS, sockets, eventfds, FILE *'s
	  and more. It is designed to be used by all Zephyr subsystems that need to work with files.

if ZVFS

config ZVFS_FDTABLE
	bool "ZVFS file descriptor table"
	default y
	help
	  This file provides generic file descriptor table implementation, suitable
	  for any I/O object implementing POSIX I/O semantics (i.e. read/write +
	  aux operations).

if ZVFS_FDTABLE

config ZVFS_DEFAULT_FILE_VMETHODS
	bool "ZVFS default virtual methods for files"
	help
	  Provide typical file operations, which can be referenced in a struct fd_op_vtable
	  and subsequently called by ZVFS functions.

endif

config ZVFS_LIBC_FILE_SIZE
	int
	default -1
	help
	  Override for the size, in bytes, of a C library FILE object as stored in the ZVFS FILE
	  store. When positive, zvfs_libc.h exposes this value as ZVFS_LIBC_FILE_SIZE; otherwise
	  ZVFS_LIBC_FILE_SIZE defaults to sizeof(FILE). Picolibc and newlib override this when the
	  active FILE representation (including any embedded stdio buffer and lock) is larger than
	  sizeof(FILE).

config ZVFS_LIBC_FILE_ALIGN
	int
	default -1
	help
	  Override for the alignment, in bytes, of C library FILE objects in the ZVFS FILE store.
	  When positive, zvfs_libc.h exposes this value as ZVFS_LIBC_FILE_ALIGN; otherwise
	  ZVFS_LIBC_FILE_ALIGN defaults to _Alignof(FILE).

config ZVFS_FS
	bool "ZVFS path open via Zephyr file system"
	depends on FILE_SYSTEM
	select SYS_ELASTIPOOL
	default y
	help
	  Build the ZVFS path opener (zvfs_open) that wraps Zephyr fs_open() and
	  registers a file in the fd table. Required for ISO C fopen() and for POSIX
	  open() when a mounted file system is present.

config ZVFS_PATH_MAX
	int "Maximum ZVFS path length"
	depends on ZVFS_FS
	range 16 512
	default 64
	help
	  Longest path, including the terminating NUL, accepted by the ZVFS
	  path system calls. Each system call verifier places this many bytes
	  on the privileged stack (twice for zvfs_rename()), so large values
	  need a matching CONFIG_PRIVILEGED_STACK_SIZE.

config ZVFS_LIBC_FILE
	bool
	default y if ZVFS_FS && !MINIMAL_LIBC
	help
	  Build the C library's statically-allocated FILE-object store
	  (lib/libc/common/source/stdio/zvfs_libc_file.c), in the C library's memory partition.
	  It provides the allocation-free backing storage that each C library's zvfs_libc_fdopen()
	  hook draws from to bind a FILE to a ZVFS file descriptor, usable from user mode.

	  Minimal libc encodes a FILE directly as an fd and does not use this store, so it is not
	  selected there.

	  Every C library that uses the store must provide the two non-POSIX hooks:

	  - FILE *zvfs_libc_fdopen(int fd, const char *mode);
	  - int zvfs_libc_fileno(FILE *fp);

config ZVFS_FS_DESC_MAX
	int
	depends on ZVFS_FS
	default ZVFS_OPEN_MAX if ZVFS_OPEN_MAX > 0
	default 16
	help
	  Maximum concurrent Zephyr FS objects tracked by the ZVFS FS descriptor
	  pool (open files and directory streams).

config ZVFS_FS_RECORD_LOCK_MAX
	int
	depends on ZVFS_FS
	default 4
	range 1 32
	help
	  Maximum POSIX record locks (fcntl F_SETLK/F_GETLK) stored per open file
	  description backed by zvfs_fs_desc.

config ZVFS_UNLINK_ON_CLOSE
	bool
	depends on ZVFS_FS
	help
	  Allow marking an open descriptor (zvfs_unlink_on_close()) so that its
	  path is removed from the file system on the final close of its open
	  file description, wherever that close happens - an explicit close or
	  the descriptor sweep at process exit.

config ZVFS_UNLINK_ON_CLOSE_MAX
	int "Maximum descriptions marked unlink-on-close"
	depends on ZVFS_UNLINK_ON_CLOSE
	default 4
	range 1 64
	help
	  Maximum open file descriptions concurrently marked for removal on
	  their final close.

config ZVFS_OPEN_ADD_SIZE_FS
	int
	depends on ZVFS_FS
	default 4
	help
	  Number of file descriptors reserved for ZVFS path opens via zvfs_open()
	  (ISO C fopen()/freopen() and POSIX open() on a mounted file system).

config ZVFS_DIR_MAX
	int "Maximum number of ZVFS directory streams"
	depends on ZVFS_FS
	default 2
	help
	  Number of statically allocated directory stream objects returned by
	  zvfs_opendir(). Each open stream also consumes one file descriptor
	  and one ZVFS_FS_DESC_MAX slot. Under CONFIG_USERSPACE the storage
	  lives in zvfs_dir_partition, which a user thread's memory domain
	  must include.

config ZVFS_OPEN_ADD_SIZE_DIR
	int
	depends on ZVFS_FS
	default ZVFS_DIR_MAX
	help
	  Number of file descriptors reserved for ZVFS directory streams in
	  the fd table size calculation.

config ZVFS_RESERVE_STDIO_FDS
	bool
	help
	  Pre-reserve fd slots 0, 1, and 2 for stdin, stdout, and stderr in the ZVFS fd
	  table so dynamically allocated descriptors start at fd 3.

config ZVFS_OPEN_ADD_SIZE_STDIO
	int
	default 3 if ZVFS_RESERVE_STDIO_FDS
	default 0
	help
	  Number of file descriptors reserved for stdin, stdout, and stderr in the ZVFS
	  fd table size calculation.

config ZVFS_MMAP
	bool "ZVFS memory mappings"
	depends on ZVFS_FDTABLE
	select SYS_ELASTIPOOL
	help
	  Map file descriptors and anonymous memory into the address space with
	  zvfs_mmap(), and manage the mappings with zvfs_munmap(), zvfs_msync()
	  and zvfs_mprotect(). A mapping keeps its file open like a descriptor
	  does, belongs to the thread that creates it, and is released when
	  that thread exits.

if ZVFS_MMAP

config ZVFS_MMAP_MAX
	int "Maximum number of concurrent ZVFS memory mappings"
	default 8
	range 1 1024

config ZVFS_MMAP_DIRTY_TRACK
	bool "Track the modified pages of shared file mappings"
	default y
	depends on MMU && ARCH_HAS_MEM_WRITE_FAULT
	select MEM_WRITE_FAULT_HOOK
	help
	  Write-protect the pages of a shared, writable file mapping and let the
	  first write to each page fault: the page is recorded as modified and
	  made writable, so zvfs_msync() writes back only the pages that changed
	  and leaves the rest of the file alone. Without this, the whole range
	  is written back.

config ZVFS_MLOCK
	bool "ZVFS memory locking"
	help
	  Lock pages into memory with zvfs_mlock() and release them with
	  zvfs_munlock(): a range of pages, the caller's mappings and the memory
	  its domain grants, or every mapping it creates from then on. Locking
	  keeps pages resident under CONFIG_DEMAND_PAGING; without it every page
	  is resident already and the calls succeed without effect.

endif # ZVFS_MMAP

config ZVFS_SHM
	bool "ZVFS shared memory objects"
	depends on ZVFS_FDTABLE
	select SYS_ELASTIPOOL
	help
	  Named, system-wide memory objects reached through file descriptors:
	  zvfs_shm_open() and zvfs_shm_unlink(). An object is sized once with
	  zvfs_ftruncate(), read and written at offsets, and mapped in place by
	  zvfs_mmap(), so every mapping of it aliases the same pages.

if ZVFS_SHM

config ZVFS_SHM_MAX
	int "Maximum number of shared memory objects"
	default 4
	range 1 1024

config ZVFS_SHM_NAME_MAX
	int "Maximum shared memory object name length, including the terminator"
	default 32
	range 8 256

config ZVFS_SHM_DESC_MAX
	int
	default ZVFS_OPEN_MAX if ZVFS_OPEN_MAX > 0
	default 8
	help
	  Maximum concurrent opens of shared memory objects: every zvfs_shm_open()
	  gets an open description of its own, with its own file position.

endif # ZVFS_SHM

config ZVFS_MMAP_PAGE_SIZE
	hex
	depends on ZVFS_MMAP || ZVFS_SHM
	default MMU_PAGE_SIZE if MMU
	default 0x40
	help
	  Granularity of mapping lengths, file offsets and shared memory object
	  sizes: the MMU page size, or 64 bytes when the storage is carved out
	  of the kernel heap.

config ZVFS_EVENTFD
	bool "ZVFS event file descriptor support"
	imply ZVFS_POLL
	select ZVFS_FDTABLE
	help
	  Enable support for ZVFS event file descriptors. An eventfd can
	  be used as an event wait/notify mechanism together with POSIX calls
	  like read, write and poll.

if ZVFS_EVENTFD

config ZVFS_EVENTFD_MAX
	int "Maximum number of ZVFS eventfd's"
	default 1
	range 1 4096
	help
	  Maximum number of supported event file descriptors. If subsystems
	  specify ZVFS_EVENTFD_ADD_SIZE_* options, these will be added together
	  and the sum will be compared to the ZVFS_EVENTFD_MAX value.
	  If the sum is greater than the ZVFS_EVENTFD_MAX option, then the actual
	  eventfd count will be rounded up to the sum of the individual
	  requirements (unless the ZVFS_EVENTFD_IGNORE_MIN option is enabled).

config ZVFS_EVENTFD_IGNORE_MIN
	bool "Ignore the minimum eventfd count requirement"
	help
	  This option can be set to force setting a smaller eventfd count than
	  what's specified by enabled subsystems via ZVFS_EVENTFD_ADD_SIZE_*
	  options. This can be useful when optimizing memory usage and a more
	  precise minimum eventfd count is known for a given application. When
	  enabled, the ZVFS_EVENTFD_MAX value is used as-is.

config ZVFS_OPEN_ADD_SIZE_EVENTFD
	int
	default ZVFS_EVENTFD_MAX

endif # ZVFS_EVENTFD

config ZVFS_POLL
	bool "ZVFS poll"
	select POLL
	select ZVFS_FDTABLE
	help
	  Enable support for zvfs_poll().

if ZVFS_POLL

config ZVFS_POLL_MAX
	int "Max number of supported zvfs_poll() entries"
	default 8 if NRF70_ENABLE_DUAL_VIF
	default 6 if WIFI_NM_WPA_SUPPLICANT
	default 4 if SHELL_BACKEND_TELNET
	default 3
	help
	  Maximum number of entries supported for poll() call.

config ZVFS_SELECT
	bool "ZVFS select"
	help
	  Enable support for zvfs_select().

endif # ZVFS_POLL

endif # ZVFS
```

## lib/sff/Kconfig
```kconfig
# Copyright The Zephyr Project Contributors
#
# SPDX-License-Identifier: Apache-2.0

config SFF8472
	bool "SFF-8472 (SFP/SFP+) module management decoding"
	help
	  Enable decoding of the SFF-8472 management memory map used by SFP,
	  SFP+ and SFP28 pluggable transceivers: the serial ID page (A0h) and
	  the real-time digital diagnostic monitoring page (A2h).
```

## lib/utils/Kconfig
```kconfig
# Copyright (c) 2016 Intel Corporation
# SPDX-License-Identifier: Apache-2.0

menu "Utility Library"

config JSON_LIBRARY
	bool "Build JSON library"
	help
	  Build a minimal JSON parsing/encoding library. Used by sample
	  applications such as the NATS client.

config JSON_LIBRARY_FP_SUPPORT
	bool "Floating point support in JSON library"
	depends on JSON_LIBRARY
	select CBPRINTF_FP_SUPPORT
	select REQUIRES_FULL_LIBC
	help
	  Build the JSON library with support for floating point types.

	  Requires a libc implementation with support for floating point
	  functions: strtof(), strtod(), isnan() and isinf().

config JSON_FLOAT_PRECISION
	int "Maximum number of decimal places for an encoded float value"
	depends on JSON_LIBRARY_FP_SUPPORT
	default 9
	help
	  Sets the precision value in the printf style format string
	  for a float.

config JSON_DOUBLE_PRECISION
	int "Maximum number of decimal places for an encoded double value"
	depends on JSON_LIBRARY_FP_SUPPORT
	default 16
	help
	  Sets the precision value in the printf style format string
	  for a double.

config RING_BUFFER
	bool "[DEPRECATED] Restore legacy claim/finish and item ring buffer APIs"
	select DEPRECATED
	help
	  This option is deprecated and slated for removal. It switches the ring
	  buffer to the legacy implementation, restoring several deprecated APIs
	  that do not exist in the default (slim) ring buffer header:

	  - the zero-copy claim/finish API (ring_buf_put_claim(),
	    ring_buf_put_finish() and their get counterparts), superseded by the
	    non-stacking ring_buf_put_ptr() / ring_buf_get_ptr();
	  - the fixed-size item API (ring_buf_item_init(), ring_buf_item_put(),
	    ring_buf_item_get(), ring_buf_item_space_get(), RING_BUF_ITEM_DECLARE*
	    and RING_BUF_ITEM_SIZEOF()), superseded by sys_ringq;
	  - ring_buf_internal_reset().

	  Because none of these symbols exist in the slim header, out-of-tree code
	  using them fails to compile with no other hint; enabling this option is
	  the switch that brings them back. Provided only to keep legacy code
	  building until it migrates to the replacement APIs.

config RING_BUFFER_LARGE
	bool "Allow large ring buffer sizes"
	help
	  Increase maximum buffer size from 32KB to 2GB. When this is enabled,
	  all struct ring_buf instances become 12 bytes bigger.

config NOTIFY
	bool "Asynchronous Notifications"
	help
	  Use this API to support async transactions.

config BASE64
	bool "Base64 encoding and decoding"
	help
	  Enable base64 encoding and decoding functionality

config ONOFF
	bool "On-Off Manager"
	select NOTIFY
	help
	  An on-off manager supports an arbitrary number of clients of a
	  service which has a binary state.  Example applications are power
	  rails, clocks, and binary device power management.

config WINSTREAM
	bool "Lockless shared memory window byte stream"
	help
	  Winstream is a byte stream IPC for use in shared memory
	  "windows", generally for transmit to non-Zephyr contexts that
	  can't share Zephyr APIs or data structures.

if WINSTREAM
config WINSTREAM_STDLIB_MEMCOPY
	bool "Use standard memcpy() in winstream"
	help
	  The sys_winstream utility is sometimes used in early boot
	  environments before the standard library is usable.  By
	  default it uses a simple internal bytewise memcpy().  Set
	  this to use the one from the standard library.
endif

config UTF8
	bool "UTF-8 string operation supported"
	help
	  Enable the utf8 API. The API implements functions to specifically
	  handle UTF-8 encoded strings.

config COBS
	bool "Consistent overhead byte stuffing"
	help
	  Enable consistent overhead byte stuffing

config GETOPT
	bool "Getopt library support"
	help
	  This option adds support of the sys_getopt API.

config GETOPT_LONG
	bool "Getopt long library support"
	depends on GETOPT
	help
	  This option adds support of the getopt long.
	  Different shell backends are using their own instance of getopt to
	  not interfere with each other.
	  All not shell threads share one global instance of getopt state, hence
	  apart from shell this library is not thread safe. User can add support
	  for other threads by extending function sys_getopt_state_get in
	  getopt_common.c file.

config TIMEUTIL_APPLY_SKEW
	bool "Support applying clock skew corrections in conversion functions"
	default y
	help
	  Accurately applying clock skew correction in timeutil_sync_ref_from_local
	  and timeutil_sync_local_from_ref requires double-precision floating point
	  operations. If this is the only usage of double precision logic in the
	  build, but clocks skews are not used, this can be a significant ROM
	  overhead. Disabling this option can save ~2.4 kB of ROM.

endmenu
```

## modules/Kconfig.adi
```kconfig
# Analog Devices MSDK HAL configuration

# SPDX-FileCopyrightText: Copyright The Zephyr Project Contributors
# SPDX-License-Identifier: Apache-2.0

config ZEPHYR_ADI_MODULE
	bool

config ZEPHYR_ADI_MODULE_ACTIVE
	bool
	depends on ZEPHYR_ADI_MODULE

config HAS_MAX32_HAL
	bool
	select ZEPHYR_ADI_MODULE_ACTIVE
	help
	  The MAX32xxx peripheral drivers and register headers. Selected by the
	  SoC family, whose sources and drivers are built against them.
```

## modules/Kconfig.atmel
```kconfig
# Atmel SDK

# Copyright (c) 2016 Piotr Mienkowski
# SPDX-License-Identifier: Apache-2.0

config ZEPHYR_ATMEL_MODULE
	bool

config ZEPHYR_ATMEL_MODULE_ACTIVE
	bool
	depends on ZEPHYR_ATMEL_MODULE

config ASF
	bool
	select HAS_CMSIS_CORE
	depends on SOC_FAMILY_ATMEL_SAM || SOC_FAMILY_ATMEL_SAM0
	select ZEPHYR_ATMEL_MODULE_ACTIVE

config ATMEL_WINC1500
	bool
	select ZEPHYR_ATMEL_MODULE_ACTIVE
```
