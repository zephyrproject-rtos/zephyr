## dts/bindings/misc/verisilicon,vglite.yaml
```yaml
# Copyright (c) 2025 Felipe Neves
# SPDX-License-Identifier: Apache-2.0

description: Verisilicon GC series of compatible GPUS

compatible: "verisilicon,vglite"

include: base.yaml

properties:
  variant:
    type: string
    required: true
    description: GPU2D variant string.

  revision:
    type: string
    required: true
    description: GPU2D variant revision implementation.
```

## dts/bindings/misc/zephyr,addr-translation.yaml
```yaml
# Copyright 2025 NXP
# SPDX-License-Identifier: Apache-2.0

description: Address translation support for OpenAMP

compatible: "zephyr,addr-translation"

include: base.yaml

properties:
  dma-ranges:
    type: array
    required: true
    description: |
      Driver and device addresses.
```

## dts/bindings/misc/zephyr,boot-info-base.yaml
```yaml
# Copyright (c) 2023 Laczen
# SPDX-License-Identifier: Apache-2.0

# Common fields for boot-info
include: base.yaml

properties:
  backend:
    type: phandle
    required: true
    description: |
      phandle to the backend.
  size:
    type: int
    description: |
      When only a part of the backend is to be used to store the boot
      information the size can be set using this parameter. When unset the
      size is calculated from the backend size taking into account the offset
      parameter.
  offset:
    type: int
    description: |
      When only a part of the backend is to be used to store the boot
      information the offset in the backend can be set using this parameter.
      When unset the offset in the backend is 0.
```

## dts/bindings/misc/zephyr,boot-info-bbram.yaml
```yaml
# Copyright (c) 2023 Laczen
# SPDX-License-Identifier: Apache-2.0

description: |
  Boot information area stored on bbram, the backend property should be a
  phandle to a bbram device

compatible: "zephyr,boot-info-bbram"

include: zephyr,boot-info-base.yaml
```

## dts/bindings/misc/zephyr,boot-info-eeprom.yaml
```yaml
# Copyright (c) 2023 Laczen
# SPDX-License-Identifier: Apache-2.0

description: |
  Boot information area stored on eeprom, the backend property should be a
  phandle to a eeprom device

compatible: "zephyr,boot-info-eeprom"

include: zephyr,boot-info-base.yaml
```

## dts/bindings/misc/zephyr,boot-info-flash.yaml
```yaml
# Copyright (c) 2023 Laczen
# SPDX-License-Identifier: Apache-2.0

description: |
  Boot information area stored on flash, the backend property should be a
  phandle to a fixed-partition on flash.

compatible: "zephyr,boot-info-flash"

include: zephyr,boot-info-base.yaml
```

## dts/bindings/misc/zephyr,boot-info-ram.yaml
```yaml
# Copyright (c) 2023 Laczen
# SPDX-License-Identifier: Apache-2.0

description: Boot information area stored on ram

compatible: "zephyr,boot-info-ram"

include: base.yaml

properties:
  backend:
    type: phandle
    required: true
    description: |
      Memory region used to store the bootinfo.
```

## dts/bindings/misc/zephyr,boot-info-retained-mem.yaml
```yaml
# Copyright (c) 2023 Laczen
# SPDX-License-Identifier: Apache-2.0

description: |
  Boot information area stored on retained_mem, the backend property should be a
  phandle to a retained_mem device.

compatible: "zephyr,boot-info-retained-mem"

include: zephyr,boot-info-base.yaml
```

## dts/bindings/misc/zephyr,devmux.yaml
```yaml
# Copyright (c) 2023, Meta
# SPDX-License-Identifier: Apache-2.0

description: Generic Device Multiplexer

compatible: "zephyr,devmux"

include: [base.yaml, mutable.yaml]

properties:

  devices:
    type: phandles
    required: true
    description: |
      Devices to be multiplexed.

  selected:
    type: int
    default: 0
    description: |
      Initial multiplexer selection.

      This must be in the range [0, N-1], where N is the length of the
      'devices' phandle list.

      If unspecified, the default selection is zero in order to ensure that
      the multiplexer is ready for use (i.e. one of the [0, N-1] multiplexed
      devices is selected). Zero is, necessarily, the only possible valid
      default value since the phandle list must have length >= 1.

      Note: Specifying a value of 'selected' outside the range [0, N-1]
      results in a compile-time error.
```

## dts/bindings/misc/zephyr,disk.yaml
```yaml
# Copyright (c) 2022 Nordic Semiconductor ASA
# SPDX-License-Identifier: Apache-2.0

description: Block storage device description

compatible: "zephyr,disk"

include: base.yaml

properties:
    storage-dev:
      type: phandle
      required: true
      description: |
        A reference to the storage device.

    disk-name:
      type: string
      required: true
      description: |
        Disk name.
```

## dts/bindings/misc/zephyr,dmx-uart-isr.yaml
```yaml
# SPDX-FileCopyrightText: Copyright (c) 2026 Perry Naseck, MIT Media Lab <pnaseck@media.mit.edu>
# SPDX-License-Identifier: Apache-2.0

description: |
  DMX512-A interface using interrupt-driven UART reception.

  Break detection uses framing-error reporting via uart_err_check()
  in the UART IRQ callback. Portable across all platforms with
  interrupt-driven UART support.

  The parent UART must set the framing-error-reporting property
  (see uart-controller.yaml) so the driver knows the correct
  drain strategy after a break.

  The device must be a child of a UART controller node. The UART is
  configured at runtime to 250000 baud, 8N2 when the interface is
  enabled.

  Example:

    &uart1 {
        dmx0: dmx {
            compatible = "zephyr,dmx-uart-isr";
            de-gpios = <&gpio0 5 GPIO_ACTIVE_HIGH>;
            re-gpios = <&gpio0 6 GPIO_ACTIVE_LOW>;
        };
    };

compatible: "zephyr,dmx-uart-isr"

include: uart-device.yaml

properties:
  de-gpios:
    type: phandle-array
    description: |
      Driver-enable pin of the RS-485 transceiver.
      Active high when transmitting. Optional.

  re-gpios:
    type: phandle-array
    description: |
      Receiver-enable pin of the RS-485 transceiver.
      Active low to enable reception. Optional.

  rx-buf-size:
    type: int
    description: |
      Size in bytes of the per-interface receive ring buffer.
      Overrides the global CONFIG_DMX_RX_BUF_SIZE for this instance.
```

## dts/bindings/misc/zephyr,eeprom-nvmp-fixed-partitions.yaml
```yaml
description: |
  This binding is used to describe fixed non volatile partitions on eeprom.
  Here is an example:
    &eeprom0 {
            nvmp_partitions {
                    compatible = "zephyr,eeprom-nvmp-fixed-partitions";
                    #address-cells = <1>;
                    #size-cells = <1>;
                    partition0: partition@0 {
                            reg = <0x00000000 0x0000C000>;
                    };
                    partition1: partition@c000 {
                            reg = <0x0000C000 0x00076000>;
                    };
            };
    };

compatible: "zephyr,eeprom-nvmp-fixed-partitions"

include: zephyr,nvmp-fixed-partitions.yaml
```

## dts/bindings/misc/zephyr,flash-disk.yaml
```yaml
# Copyright (c) 2022 Nordic Semiconductor ASA
# SPDX-License-Identifier: Apache-2.0

description: Block storage device on flash partition

compatible: "zephyr,flash-disk"

include: base.yaml

properties:
  partition:
    type: phandle
    required: true
    description: |
      Backing storage flash map partition.

  disk-name:
    type: string
    required: true
    description: |
      Disk name.

  sector-size:
    type: int
    default: 512
    description: |
      Emulated block device sector size in bytes.

  cache-size:
    type: int
    required: true
    description: |
      Size of statically allocated buffer size in bytes. The size should be
      adequately chosen. On storage backends with uniform erase-blocks it
      should be at least the erase-block-size, on storage backends with
      non-uniform erase-blocks it should be at least the largest
      erase-block-size. The cache-size property is ignored if the partition
      is read-only.
```

## dts/bindings/misc/zephyr,flash-no-erase.yaml
```yaml
# Copyright (c) 2024 Laczen
# SPDX-License-Identifier: Apache-2.0

description: Compatible describing that a flash device has no erase.

compatible: "zephyr,flash-no-erase"
```

## dts/bindings/misc/zephyr,flash-nvmp-fixed-partitions.yaml
```yaml
description: |
  This binding is used to describe fixed non volatile partitions on flash.
  Here is an example:
    &flash0 {
            nvmp_partitions {
                    compatible = "zephyr,flash-nvmp-fixed-partitions";
                    #address-cells = <1>;
                    #size-cells = <1>;
                    partition0: partition@0 {
                            reg = <0x00000000 0x0000C000>;
                    };
                    partition1: partition@c000 {
                            reg = <0x0000C000 0x00076000>;
                    };
            };
    };

compatible: "zephyr,flash-nvmp-fixed-partitions"

include: zephyr,nvmp-fixed-partitions.yaml
```

## dts/bindings/misc/zephyr,gpio-switch.yaml
```yaml
# Copyright (c) 2025 Mario Paja
# SPDX-License-Identifier: Apache-2.0

description: |
  Generic GPIO controlled switch

compatible: "zephyr,gpio-switch"

child-binding:
  description: GPIO switch child node
  properties:
    gpios:
      type: phandle-array
      required: true

    label:
      type: string
      description: Descriptive name of the switch
```

## dts/bindings/misc/zephyr,ipi-plic.yaml
```yaml
# Copyright (c) 2024 Meta Platforms
# SPDX-License-Identifier: Apache-2.0

description: IPI PLIC pseudo device

compatible: "zephyr,ipi-plic"

include: [base.yaml]

properties:
  interrupt-parent:
    required: true

  interrupts:
    required: true
```

## dts/bindings/misc/zephyr,log-uart.yaml
```yaml
# Copyright (c) 2023 Meta
# SPDX-License-Identifier: Apache-2.0

description: Log Backend UART

compatible: "zephyr,log-uart"

include: [base.yaml]

properties:

  uarts:
    type: phandles
    required: true
    description: |
      UART devices to be used by the UART log backend.
```

## dts/bindings/misc/zephyr,lvgl-gpu-common.yaml
```yaml
# Copyright 2026 Felipe Neves <ryukokki.felipe@gmail.com>
# SPDX-License-Identifier: Apache-2.0

# Common fields for gpu lvgl pseudo devices

properties:
  gpu:
    type: phandle
    required: true
    description: |
      gpu device phandle.
```

## dts/bindings/misc/zephyr,lvgl-gpu-vglite.yaml
```yaml
description: |
  LVGL VGLite GPU binding

  Example configuration:

  lvgl_vglite {
          compatible = "zephyr,lvgl-gpu-vglite";
          gpu = <&gpu2d>;
          variant = "gc355";
          revision = "0x13";
  };

compatible: "zephyr,lvgl-gpu-vglite"

include: zephyr,lvgl-gpu-common.yaml

properties:
  variant:
    type: string
    required: true
    description: GPU2D variant string.

  revision:
    type: string
    required: true
    description: GPU2D variant revision implementation.
```

## dts/bindings/misc/zephyr,morse-code.yaml
```yaml
# Copyright (c) 2024 Freedom Veiculos Eletricos
# Copyright (c) 2024 OS Systems
# SPDX-License-Identifier: Apache-2.0

description: Morse Code

compatible: "zephyr,morse-code"

include:
  - name: base.yaml

properties:
  speed:
    type: int
    default: 20
    description: Define the number of Words Per Minute (wps) should be send
      per minute. This is defined using the standard word "PARIS". In the
      default case means that "20 wpm" send the word "PARIS" (or precisely
      "PARIS ") is sent 20 times in a minute.

      In morse the "PARIS " is 50 units long and represented by
      ".--. .- .-. .. .../" were

        10 dits (.)              10 units
        4 dahs (-)               12 units
        9 intra-character spaces  9 units
        4 inter-character spaces 12 units
        1 word space (/)          7 units

      In this case, the driver defines the time unit as 60/(50 * Speed). With a
      default speed of 20 wps the time unit is equal to 0.06s.

  gpios:
    type: phandle-array
    required: true
    description: The GPIO configuration which will be used to send the morse code.

  timer-unit:
    type: phandle
    required: true
    description: The Counter Timer compatible that will be used to serialize
      the data into morse code at "tone-out" output.
```

## dts/bindings/misc/zephyr,mtp.yaml
```yaml
# Copyright (c) 2025 Mohamed ElShahawi <ExtremeGTX@hotmail.com>
# SPDX-License-Identifier: Apache-2.0

description: Expose stored files over USB MTP (Media Transfer Protocol)

compatible: "zephyr,mtp"

include: base.yaml

properties:
  fstab-entry:
    type: phandle
    required: true
    description: |
      phandle of the fstab entry to be exposed over MTP.
```

## dts/bindings/misc/zephyr,nvmp-eeprom.yaml
```yaml
# Copyright (c) 2023 Laczen
# SPDX-License-Identifier: Apache-2.0

# Compatible used to describe nvmp on eeprom

include: base.yaml
```

## dts/bindings/misc/zephyr,nvmp-fixed-partitions.yaml
```yaml
description: |
  This binding is used to describe non volatile partitions.

properties:
  "#address-cells":
    type: int
    description: |
      Number of cells required to represent a child node's
      reg property address. This must be large enough to
      represent the start offset of each partition.
  "#size-cells":
    type: int
    description: |
      Number of cells required to represent a child node's
      reg property address. This must be large enough to
      represent the size of each partition in bytes.
child-binding:
  description: |
    Each child node of the fixed-partitions node represents
    an individual partition. These should usually look like
    this:
      partition_nodelabel: partition@START_OFFSET {
              label = "human-readable-name";
              reg = <0xSTART_OFFSET 0xSIZE>;
      };
  properties:
    label:
      type: string
      description: |
        Human readable string describing the partition.
    read-only:
      type: boolean
      description: set this property if the partition is read-only
    block-size:
      type: int
      description: set this property to specify a block-size
    write-block-size:
      type: int
      description: set this property to specify a write-block-size
    reg:
      type: array
      description: |
        This should be in the format <OFFSET SIZE>, where OFFSET
        is the offset of the partition relative to the base
        address of the parent memory, and SIZE is the size of
        the partition in bytes.
      required: true

include: base.yaml
```

## dts/bindings/misc/zephyr,nvmp-flash.yaml
```yaml
# Copyright (c) 2023 Laczen
# SPDX-License-Identifier: Apache-2.0

# Compatible used to describe nvmp on flash

include: base.yaml
```
