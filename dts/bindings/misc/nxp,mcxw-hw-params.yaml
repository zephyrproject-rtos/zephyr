## dts/bindings/misc/nxp,mcxw-hw-params.yaml
```yaml
# Copyright 2026 NXP
# SPDX-License-Identifier: Apache-2.0

description: NXP MCXW7x HW_PARAMS node

compatible: "nxp,mcxw-hw-params"

include: [base.yaml, nvmem-consumer.yaml]

properties:
  nvmem-cells:
    required: true
    description: |
      HW PARAMS contains some NVMEM cells for factory settings stored in IFR0 section 1.

  nvmem-cell-names:
    required: true
```

## dts/bindings/misc/nxp,rdc-policy.yaml
```yaml
# Copyright 2024 NXP
# SPDX-License-Identifier: Apache-2.0

properties:
  rdc:
    type: int
    description: |
      Set the RDC permission for specified peripheral: Resource Domain Controller (RDC)
      supports flexible configuration on IP’s access permission, each individual IP can,
      for example, be configured as A-core only or M-core only. This property uses some
      macros defined in 'include/zephyr/dt-bindings/rdc/imx_rdc.h' to configure current
      peripheral's access permission.
      For example to allow both A53 and M7 Core to have read/write permission to current
      peripheral:
      rdc = <(RDC_DOMAIN_PERM(A53_DOMAIN_ID, RDC_DOMAIN_PERM_RW)|\
              RDC_DOMAIN_PERM(M7_DOMAIN_ID, RDC_DOMAIN_PERM_RW))>;
```

## dts/bindings/misc/nxp,rdc.yaml
```yaml
# Copyright 2024 NXP
# SPDX-License-Identifier: Apache-2.0

description: |
  NXP i.MX Resource Domain Controller (RDC).
  The RDC provides robust support for the isolation of destination
  memory mapped locations such as peripherals and memory to a single
  core, a bus master, or set of cores and bus masters.

compatible: "nxp,rdc"

include: [base.yaml]

properties:
  reg:
    required: true
```

## dts/bindings/misc/nxp,rt600-dsp-ctrl.yaml
```yaml
# Copyright (c) 2025 NXP
# SPDX-License-Identifier: Apache-2.0

include: ["nxp,rtxxx-dsp-ctrl.yaml"]

compatible: "nxp,rt600-dsp-ctrl"
description: NXP i.MX RTxxx DSP control driver (i.MX RT600 HiFi 4 DSP)
```

## dts/bindings/misc/nxp,rt700-dsp-ctrl-hifi4.yaml
```yaml
# Copyright (c) 2025 NXP
# SPDX-License-Identifier: Apache-2.0

include: ["nxp,rtxxx-dsp-ctrl.yaml"]

compatible: "nxp,rt700-dsp-ctrl-hifi4"
description: NXP i.MX RTxxx DSP control driver (i.MX RT700 HiFi 4 DSP)
```

## dts/bindings/misc/nxp,rtxxx-adsp-ctl.yaml
```yaml
# Copyright (c) 2023 NXP
# SPDX-License-Identifier: Apache-2.0

include: [base.yaml]

compatible: "nxp,rtxxx-adsp-ctl"
description: NXP i.MX RTxxx DSP control driver

properties:
  "#address-cells":
    const: 1
  "#size-cells":
    const: 1
  sysctl:
    required: true
    type: phandle
    description: phandle to a SYSCTL node

child-binding:
  description: Memory region definition

  properties:
    reg:
      required: true
      type: array
      description: Base address and length of a memory region

    type:
      required: true
      type: int
      description: Memory region type (NXP_RTXXX_ADSP_REGION_*)
```

## dts/bindings/misc/nxp,s32-emios.yaml
```yaml
# Copyright 2023 NXP
# SPDX-License-Identifier: Apache-2.0

description: |
  NXP S32 Enhanced Modular IO SubSystem (eMIOS) node for S32 SoCs.
  eMIOS provides independent unified channels (UCs), some of channels
  have internal counter that either can be used independently or used
  as a reference timebase (master bus) for other channels.

compatible: "nxp,s32-emios"

include: [base.yaml]

properties:
  reg:
    required: true

  interrupts:
    required: true

  interrupt-names:
    required: true

  clocks:
    required: true

  clock-divider:
    type: int
    required: true
    description: |
      Clock divider value for the global prescaler. Could be in range [1 ... 256]

  internal-cnt:
    type: int
    required: true
    description: |
      A mask for channels that have internal counter, lsb is channel 0.

child-binding:
  child-binding:
    description: |
      Node for eMIOS master bus. Each channel is capable to become a master bus has
      a node defined in root devicetree but is disabled by default. To allow using
      the master bus, the devicetree node should be enabled and dts properties
      should be configured as required by application.

      For example, to enable bus A of eMIOS instance 0 that can be used as timebase
      for channels from 0 to 22, freezed in debug mode:
        master_bus {
          emios0_bus_a: emios0_bus_a {
            channel = <23>;
            bus-type = "BUS_A";
            channel-mask = <0x07FFFFF>;
            prescaler = <1>;
            period = <65535>;
            mode = <MCB_UP_COUNTER>;
            freeze;
            status = "okay";
          };
        };

    properties:
      channel:
        type: int
        required: true
        description: |
          Channel identifier for the master bus.

      channel-mask:
        type: int
        required: true
        description: |
          A channel mask for channels that by hardware design can use this master bus
          as timebase for the operation, lsb is channel 0. The mask bit for this master bus
          must always 0 because a master bus should not do other thing than a base timer.

      prescaler:
        type: int
        required: true
        description: |
          Clock divider value for internal UC prescaler.
          Clock for internal counter = (eMIOS clock / global prescaler) / internal prescaler.
        enum: [1, 2, 3, 4, 5, 6, 7, 8, 9, 10, 11, 12, 13, 14, 15, 16]

      bus-type:
        type: string
        required: true
        description: |
          Master bus type.
        enum:
          - "BUS_A"
          - "BUS_B"
          - "BUS_C"
          - "BUS_D"
          - "BUS_E"
          - "BUS_F"

      mode:
        type: string
        required: true
        description: |
          Master bus mode.
        enum:
          - "MCB_UP_COUNTER"
          - "MCB_UP_DOWN_COUNTER"

      period:
        type: int
        required: true
        description: |
          Default period (in ticks) for master bus at boot time. This determines PWM period
          for channels use this bus as reference timebase. Could be in range [2 ... 65535]

      freeze:
        type: boolean
        description: Freeze internal counter when the chip enters Debug mode.
```

## dts/bindings/misc/nxp,s32-lcu.yaml
```yaml
# Copyright 2023 NXP
# SPDX-License-Identifier: Apache-2.0

description: |
  NXP S32 Logic control Unit node for S32 SoCs.
  LCU selects multiple inputs from timers, Pulse Width Modulation
  signals, and Input/Output (I/O) pads, and combines them
  using a programmable logic function to create output waveforms

compatible: "nxp,s32-lcu"

include: [base.yaml]

properties:
  reg:
    required: true
```

## dts/bindings/misc/nxp,s32-trgmux.yaml
```yaml
# Copyright 2023 NXP
# SPDX-License-Identifier: Apache-2.0

description: |
  Trigger Multiplexing Control for NXP S32 SoCs.
  The device supports the triggering scheme between peripherals.
  The supported trigger sources and destination can be found in
  the device Ref Manual

compatible: "nxp,s32-trgmux"

include: [base.yaml]

properties:
  reg:
    required: true
```

## dts/bindings/misc/nxp,xbar.yaml
```yaml
# Copyright (c) 2023, Prevas A/S
# Copyright 2026 NXP
# SPDX-License-Identifier: Apache-2.0

description: NXP Crossbar Switch (XBAR/XBARA/XBARB)

compatible: "nxp,xbar"

include: [base.yaml]

properties:
  reg:
    required: true

  clocks:
    required: true

  num-outputs:
    type: int
    required: true
    description: Number of XBAR output signals

  num-inputs:
    type: int
    required: true
    description: Number of XBAR input signals

  num-ctrl-regs:
    type: int
    required: true
    description: Number of XBAR Control Registers

  has-write-protect:
    type: boolean
    description: |
      Indicates whether this XBAR instance supports write protection
      for SEL and CTRL registers.

  "#xbar-cells":
    type: int
    const: 2

xbar-cells:
  - output
  - input
```

## dts/bindings/misc/rapidsi,ofe.yaml
```yaml
# Copyright (c) 2024 Rapid Silicon
# SPDX-License-Identifier: Apache-2.0

description: Rapid Silicon FPGA driver bindings

compatible: "rapidsi,ofe"

include: [base.yaml, pinctrl-device.yaml]
```

## dts/bindings/misc/raspberrypi,bcm2711-videocore.yaml
```yaml
# Copyright (c) 2026 Muhammad Waleed Badar
# SPDX-License-Identifier: Apache-2.0

description: Raspberry Pi VideoCore

compatible: "raspberrypi,bcm2711-videocore"

include: [base.yaml]

properties:
  mboxes:
    required: true
    description: Phandle to the Broadcom BCM2711 Mailbox controller.

  mbox-names:
    required: true
    description: Mailbox channel specifier names.
```

## dts/bindings/misc/raspberrypi,pico-pio-device.yaml
```yaml
# Copyright (c) 2023, TOKITA Hiroshi
# Copyright (c) 2023, Yonatan Schachter
# SPDX-License-Identifier: Apache-2.0

description: Raspberry Pi Pico PIO device

compatible: "raspberrypi,pico-pio-device"

include: pinctrl-device.yaml
```

## dts/bindings/misc/raspberrypi,pico-sio.yaml
```yaml
# Copyright (c) 2025 Igalia S.L.
# SPDX-License-Identifier: Apache-2.0

description: Raspberry Pi Pico SIO

compatible: "raspberrypi,pico-sio"

include: base.yaml
```

## dts/bindings/misc/raspberrypi,rp2-cpu1.yaml
```yaml
# Copyright (c) 2024 Nordic Semiconductor ASA
# Copyright (c) 2025 Dmitrii Sharshakov <d3dx12.xx@gmail.com>
# SPDX-License-Identifier: Apache-2.0

compatible: "raspberrypi,rp2-cpu1"

description: |
  Secondary CPU launcher for Raspberry Pi RP2 SoCs.

  RP2040 and RP2350 SoCs have a secondary CPU (CPU1) that can be used
  for launching AMP applications. This driver can load the CPU1 image
  from a specified memory area or partition and start the CPU1 execution.

include: [base.yaml]

properties:
  execution-memory:
    type: phandle
    description: |
      Memory area from which CPU1 will execute its core.
      If not specified, the secondary CPU will not be started,
      for example when the application is built for CPU1.
      Please only set this property in the DT for CPU0.

  image-source:
    type: phandle
    description: |
      Memory area or partition from which the CPU1 code will be loaded.
      Only specify this property if you want to run CPU1 not from the
      memory its image is stored in, for example when the CPU0
      needs RW access to flash. When not specified, the CPU1
      will just be started from the executeion-memory.

  memory-region:
    type: phandle
    description: |
      Optional: on CPU0, pass the memory region CPU1 must execute in.
      Used to validate that CPU1 stack is within the allowed memory region.
      Only used if CONFIG_IPM_LOG_LEVEL is debug or more verbose.
```

## dts/bindings/misc/renesas,ra-agt.yaml
```yaml
# Copyright (c) 2024 Renesas Electronics Corporation
# SPDX-License-Identifier: Apache-2.0

description: Renesas RA AGT

compatible: "renesas,ra-agt"

include: base.yaml

properties:
  reg:
    required: true

  channel:
    type: int
    required: true

  renesas,count-source:
    description: AGT clock source.
    type: string
    required: true
    enum:
      - "AGT_CLOCK_PCLKB"
      - "AGT_CLOCK_LOCO"

  renesas,prescaler:
    description: |
      AGT clock divider for LOCO and SUBCLOCK. timer clock = (clock-source / (1 << prescaler))
      For LOCO and SUBCLOCK, prescler could be in range [0 .. 7].
      For PCLKB, prescler could be in 0, 1, and 3.
    type: int
    required: true
    enum:
      - 0
      - 1
      - 2
      - 3
      - 4
      - 5
      - 6
      - 7

  renesas,resolution:
    type: int
    required: true

  interrupts:
    required: true

  interrupt-names:
    required: true
```

## dts/bindings/misc/renesas,ra-drw.yaml
```yaml
# Copyright (c) 2025 Renesas Electronics Corporation
# SPDX-License-Identifier: Apache-2.0

description: Renesas RA DRW

compatible: "renesas,ra-drw"

include: base.yaml

properties:
  interrupts:
    required: true
```

## dts/bindings/misc/renesas,ra-elc.yaml
```yaml
# Copyright (c) 2025 Renesas Electronics Corporation
# SPDX-License-Identifier: Apache-2.0

description: Renesas RA Event Link Controller

compatible: "renesas,ra-elc"

include: [base.yaml]

properties:
  reg:
    required: true

  clocks:
    required: true

  "#renesas-elc-cells":
    type: int
    const: 2

renesas-elc-cells:
  - peripheral
  - event
```

## dts/bindings/misc/renesas,ra-external-interrupt.yaml
```yaml
# Copyright (c) 2024 Renesas Electronics Corporation
# SPDX-License-Identifier: Apache-2.0

description: Renesas RA External Interrupt

compatible: "renesas,ra-external-interrupt"

include: [base.yaml]

properties:
  interrupts:
    required: true

  reg:
    required: true

  channel:
    type: int
    required: true

  renesas,trigger:
    type: string
    enum:
      - "falling"
      - "rising"
      - "both-edges"
      - "low-level"
    description: |
      Select the signal edge or state that triggers an interrupt

  renesas,digital-filtering:
    type: boolean
    description: |
      Select if data noise filter should be enabled.

  renesas,sample-clock-div:
    type: int
    enum:
      - 1
      - 8
      - 32
      - 64
    description: |
      Select the clock divider for the digital noise filter. Clock source is system clock.
```

## dts/bindings/misc/renesas,ra-sau-channel.yaml
```yaml
# Copyright (c) 2026 Renesas Electronics Corporation
# SPDX-License-Identifier: Apache-2.0

description: Renesas RA Serial Array Unit Channel (SAU channel)

compatible: "renesas,ra-sau-channel"

include: [base.yaml, pinctrl-device.yaml]

properties:
  reg:
    required: true
    description: |
      SAU channel index.

  "#sau-channel-cells":
    type: int
    const: 0
```

## dts/bindings/misc/renesas,ra-sau.yaml
```yaml
# Copyright (c) 2026 Renesas Electronics Corporation
# SPDX-License-Identifier: Apache-2.0

description: Renesas RA Serial Array Unit (SAU)

compatible: "renesas,ra-sau"

include: [base.yaml, pinctrl-device.yaml]

properties:
  unit:
    type: int
    required: true
    description: |
      SAU unit index.

  reg:
    required: true
```

## dts/bindings/misc/renesas,ra-sci.yaml
```yaml
# Copyright (c) 2023 TOKITA Hiroshi <tokita.hiroshi@fujitsu.com>
# SPDX-License-Identifier: Apache-2.0

description: Renesas RA SCI controller

compatible: "renesas,ra-sci"

include: [base.yaml, pinctrl-device.yaml]

properties:
  reg:
    required: true

  clocks:
    required: true

  interrupts:
    required: true

  interrupt-names:
    required: true
    enum: ["rxi", "txi", "tei", "eri", "aed", "bfd"]
    description: |
      The interrupt names for the SCI controller. The order of the names must
      match the order of the interrupts in the "interrupts" property.
      - "rxi": Receive interrupt
      - "txi": Transmit interrupt
      - "tei": Transmit end interrupt
      - "eri": Error interrupt
      - "aed": Address match error interrupt (SCI LIN responder mode only)
      - "bfd": Break detection interrupt (SCI LIN responder mode only)

  channel:
    type: int
    description: |
      The channel number of the SCI controller. This is used to identify the
      specific instance of the controller in the system.
```
