## dts/bindings/misc/renesas,ra-ulpt.yaml
```yaml
# Copyright (c) 2025-2026 Renesas Electronics Corporation
# SPDX-License-Identifier: Apache-2.0

description: Renesas RA Ultra-Low Power Timer (ULPT)

compatible: "renesas,ra-ulpt"

include: base.yaml

properties:
  reg:
    required: true

  channel:
    type: int
    required: true
    description: |
      ULPT channel number.

  interrupts:
    description: |
      IRQ number and priority to use for ULPT.

  interrupt-names:
    enum:
      - "ulpti"
      - "ulptcmai"
      - "ulptcmbi"
    description: |
      Interrupts must be given corresponding names so that the timer driver can recognize them.

  count-source:
    type: string
    required: true
    enum:
      - "ULPT_CLOCK_LOCO"
      - "ULPT_CLOCK_SUBCLOCK"
    description: |
      Clock source driving the ULPT counter.

  prescaler:
    type: int
    required: true
    enum: [0, 1, 2, 3, 4, 5, 6, 7]
    description: |
      Clock prescaler exponent applied to the selected count-source.
      The effective timer frequency is:
        f_timer = f_source / (1 << prescaler)
```

## dts/bindings/misc/renesas,ra8-sci.yaml
```yaml
# Copyright (c) 2024 TOKITA Hiroshi
# SPDX-License-Identifier: Apache-2.0

description: Renesas RA8 SCI controller

compatible: "renesas,ra8-sci"

include: [base.yaml, pinctrl-device.yaml]

properties:
  reg:
    required: true

  channel:
    type: int
    required: true

      #  pinctrl-0:
      #    required: true

      #  pinctrl-names:
      #    required: true

  interrupts:
    required: true

  interrupt-names:
    required: true
```

## dts/bindings/misc/renesas,rx-dtc.yaml
```yaml
# Copyright (c) 2025 Renesas Electronics Corporation
# SPDX-License-Identifier: Apache-2.0

description: Renesas RX Data Transfer Controller (DTC)

compatible: "renesas,rx-dtc"

include: [base.yaml]
```
