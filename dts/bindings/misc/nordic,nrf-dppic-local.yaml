## dts/bindings/misc/nxp,imx-igf.yaml
```yaml
# SPDX-FileCopyrightText: Copyright 2026 NXP
# SPDX-License-Identifier: Apache-2.0

description: |
  NXP i.MX Input Glitch Filter (IGF).

  The IGF is a single-instance peripheral with 32 independent channels that
  filter glitches/noise out of input signals before they propagate to the
  on-chip interconnect. Each used channel is described by a child node and is
  configured statically by the driver at init time; the peripheral has no
  runtime configuration API.

  Example:

      &igf {
          status = "okay";

          channel@5 {
              reg = <5>;
              rising-filter = "integrating";
              falling-filter = "integrating";
              rising-threshold = <4>;
              falling-threshold = <4>;
              status = "okay";
          };
      };

compatible: "nxp,imx-igf"

include: [base.yaml]

properties:
  reg:
    required: true

  clocks:
    required: true

  "#address-cells":
    const: 1

  "#size-cells":
    const: 0

child-binding:
  description: |
    Static configuration for a single IGF channel. The driver applies the
    configuration and enables the channel during initialization.

  properties:
    reg:
      type: array
      required: true
      description: IGF channel index (0..31).

    rising-filter:
      type: string
      default: "bypass"
      enum:
        - "bypass"
        - "windowing"
        - "integrating"
        - "integrating-hold"
        - "windowing-post-sample"
      description: Filter type applied to the rising edge.

    falling-filter:
      type: string
      default: "bypass"
      enum:
        - "bypass"
        - "windowing"
        - "integrating"
        - "integrating-hold"
        - "windowing-post-sample"
      description: Filter type applied to the falling edge.

    rising-threshold:
      type: int
      default: 4
      min: 0
      max: 16777215
      description: Rising-edge filter threshold (RTHR.RTH, 24-bit field).

    falling-threshold:
      type: int
      default: 4
      min: 0
      max: 16777215
      description: Falling-edge filter threshold (FTHR.FTH, 24-bit field).

    prescaler:
      type: int
      default: 0
      min: 0
      max: 1023
      description: Filter prescaler value (PRESR.FPRE, 10-bit field).

    invert-output:
      type: boolean
      description: Invert the filtered output polarity (MCR.POL).

    immediate-propagation:
      type: boolean
      description: Propagate edges immediately instead of through the prescaler (MCR.IMM).

    external-prescaler:
      type: boolean
      description: Use the external prescaler source instead of the internal one (MCR.PSSEL).
```

## dts/bindings/misc/nxp,imx93-mediamix.yaml
```yaml
#
# Copyright 2025 NXP
#
# SPDX-License-Identifier: Apache-2.0
#

description: NXP MCUX i.MX93 MEDIAMIX Block Control

compatible: "nxp,imx93-mediamix"

include: base.yaml
```

## dts/bindings/misc/nxp,imx93-video-pll.yaml
```yaml
#
# Copyright 2025 NXP
#
# SPDX-License-Identifier: Apache-2.0
#

description: NXP i.MX93 Video PLL controller

compatible: "nxp,imx93-video-pll"

include: base.yaml

properties:
  rdiv:
    type: int
    required: true
    description: Reference divider value.

  mfi:
    type: int
    required: true
    description: Integer multiplier factor.

  mfn:
    type: int
    required: true
    description: Fractional numerator.

  mfd:
    type: int
    required: true
    description: Fractional denominator.

  odiv:
    type: int
    required: true
    description: Output divider value.

  pll-frequency:
    type: int
    required: true
    description: Target PLL output frequency in Hz.
```

## dts/bindings/misc/nxp,inputmux.yaml
```yaml
# Copyright 2024 NXP
# SPDX-License-Identifier: Apache-2.0

include: [base.yaml]

compatible: "nxp,inputmux"
description: NXP i.MX INPUTMUX driver. Routes internal SoC signals.

properties:
  reg:
    required: true

child-binding:
  description: |
    INPUTMUX attachment or signal enablement.

    For signal enablement, specify the "signal" property and use "MUX_*_ENA"
    constants defined in used device's DT binding for this driver. For example:

    flexcomm12_dma0_rx {
        signal = <MUX_FLEXCOMM12_RX_TO_DMAC0_CH34_REQUEST_ENA>;
    };

    For signal attachment (routing), specify the "selector" and "source"
    properties. The "selector" property specifies which signal is to be
    assigned and the "source" property specifies the source to which the
    assignment will be made. For example:

    dsp_int0 {
       selector = <0>;
       source = <MUX_FLEXCOMM0_TO_DSP_INTERRUPT>;
    };

  properties:
    selector:
      type: int
      description: Multiplexer signal selector.
    source:
      type: int
      description: Multiplexer signal source.
    signal:
      type: int
      description: Signal to enable.
```
