## dts/bindings/misc/nordic,nrf-dppic-local.yaml
```yaml
# Copyright (c) 2024 Nordic Semiconductor ASA
# SPDX-License-Identifier: Apache-2.0

description: |
  Nordic Local DPPIC
  (Distributed Programmable Peripheral Interconnect Controller)

  Updated DPPIC binding set for Nordic products that have local DPPIC instances
  with inter-bridge functionality.

compatible: "nordic,nrf-dppic-local"

include: ["nordic,nrf-dppic.yaml", "nordic,nrf-dppic-links.yaml"]
```

## dts/bindings/misc/nordic,nrf-dppic.yaml
```yaml
# Copyright (c) 2019 Nordic Semiconductor ASA
# SPDX-License-Identifier: Apache-2.0

description: |
    Nordic DPPIC (Distributed Programmable Peripheral Interconnect Controller)

compatible: "nordic,nrf-dppic"

include: base.yaml

properties:
  reg:
    required: true

  channels:
    type: int
    required: true
    description: Number of channels implemented by the DPPIC instance.

  groups:
    type: int
    required: true
    description: Number of channel groups implemented by the DPPIC instance.
```

## dts/bindings/misc/nordic,nrf-ficr.yaml
```yaml
description: Nordic FICR (Factory Information Configuration Registers)

compatible: "nordic,nrf-ficr"

include: base.yaml

properties:
  reg:
    required: true

  "#nordic,ficr-cells":
    type: int
    required: true
    const: 1

nordic,ficr-cells:
  - offset
```

## dts/bindings/misc/nordic,nrf-lrcconf.yaml
```yaml
description: Nordic local configuration registers

compatible: "nordic,nrf-lrcconf"

include: base.yaml
```

## dts/bindings/misc/nordic,nrf-memconf.yaml
```yaml
# Copyright (c) 2024 Nordic Semiconductor ASA
# SPDX-License-Identifier: Apache-2.0

description: Nordic MEMCONF (Memory Configuration Registers)

compatible: "nordic,nrf-memconf"

include:
  - base.yaml
  - nordic-nrf-ficr-client.yaml

properties:
  reg:
    required: true

  nordic,ficrs:
    required: true
```

## dts/bindings/misc/nordic,nrf-micr.yaml
```yaml
# Copyright (c) 2026 Nordic Semiconductor ASA
# SPDX-License-Identifier: Apache-2.0

description: Nordic MICR (Module Information Configuration Registers)

compatible: "nordic,nrf-micr"

include: base.yaml

properties:
  reg:
    required: true
```

## dts/bindings/misc/nordic,nrf-mpc.yaml
```yaml
description: Nordic Memory Privilege Controller (MPC)

compatible: "nordic,nrf-mpc"

include: base.yaml

properties:
  reg:
    required: true

  override-num:
    type: int
    description: Number of override regions supported by the MPC instance.

  override-granularity:
    type: int
    description: Override region addresses must be aligned to this value.
```

## dts/bindings/misc/nordic,nrf-pad-groups.yaml
```yaml
# Copyright 2025 Nordic Semiconductor ASA
# SPDX-License-Identifier: Apache-2.0

description: |
  Nordic nRF pad groups.

  The pad groups describe groups of pads connected to
  package pins of the SoC. A pad group will have a
  combination of IO, VDD and GND pads. A pad group
  will have a single supply and belong to a single
  power domain.

compatible: "nordic,nrf-pad-groups"

child-binding:
  description: Nordic nRF GPIO pad group.

  properties:
    power-domains:
      type: phandle-array
      description: Pad group's power domain.

    data-pads-mask:
      type: int
      description: Mask of data pads.

    clock-pads-mask:
      type: int
      description: Mask of clock pads.

    fast-pads-mask:
      type: int
      description: Mask of fast pads.
```

## dts/bindings/misc/nordic,nrf-ppib.yaml
```yaml
# Copyright (c) 2026 Nordic Semiconductor ASA
# SPDX-License-Identifier: Apache-2.0

description: |
    Nordic PPIB (Programmable Peripheral Interconnect Bridge)

compatible: "nordic,nrf-ppib"

include: base.yaml

properties:
  reg:
    required: true

  channels:
    type: int
    required: true
    description: Number of channels implemented by the PPIB instance.

  offset:
    type: int
    description: |
      Optional offset used in connection within a pair of PPIBs. Offset need to be
      applied to the central PPIB connected to the current PPIB.
```

## dts/bindings/misc/nordic,nrf-tbm.yaml
```yaml
# Copyright (c) 2024 Nordic Semiconductor ASA
# SPDX-License-Identifier: Apache-2.0

description: Nordic TBM (Trace Buffer Monitor)

compatible: "nordic,nrf-tbm"

include: base.yaml

properties:
  reg:
    required: true

  interrupts:
    required: true
```

## dts/bindings/misc/nordic,split-channel-groups.yaml
```yaml
# Copyright (c) 2024 Nordic Semiconductor ASA
# SPDX-License-Identifier: Apache-2.0

description: Nordic Split Channel Groups

properties:
  owned-channel-groups:
    type: array
    description: |
      List of channel groups of a split-ownership peripheral that are to be
      owned for use by the compiled domain.

  nonsecure-channel-groups:
    type: array
    description: |
      List of channel groups in a split-ownership, split-security peripheral
      that are to be configured as nonsecure. In Trustzone systems, this
      property is only evaluated for secure peripherals, as nonsecure channels
      are implicitly specified through the owned-channels property. This
      property is ignored in non-Trustzone systems.
```

## dts/bindings/misc/nordic,split-channels.yaml
```yaml
#
# Copyright (c) 2024 Nordic Semiconductor ASA
#
# SPDX-License-Identifier: Apache-2.0
#

description: |
  Nordic Split Channels

  Some of Nordic's peripherals support split ownership feature that allows to
  be used by independent owners. As an example the configuration of the
  Global Real Time Counter (GRTC) is shown below:
    owned-channels = <0 1 2 3 4 5 6 7 8 9 10 11>;
    child-owned-channels = <7 8 9 10 11>;

  Which means that channels 0-11 will be assigned to the particular CPU.
  Other CPUs cannot use those and another set must be defined for them.
  In addition, `child-owned-channels` property allows to use channels
  7-11 only by child subprocessor. If the CPU you're configuring has no
  subprocessor(s) assigned, the `child-owned-channels` property
  should not be defined.

properties:
  owned-channels:
    type: array
    description: |
      List of channels in a split-ownership peripheral that are to be owned
      for use by the compiled CPU.

  nonsecure-channels:
    type: array
    description: |
      List of channels in a split-ownership, split-security peripheral that
      are to be configured as nonsecure. In Trustzone systems, this property
      is only evaluated for secure peripherals, as nonsecure channels are
      implicitly specified through the owned-channels property. This property
      is ignored in non-Trustzone systems.

  child-owned-channels:
    type: array
    description: |
      List of channels in a split-ownership peripheral that are officially
      owned by the compiled CPU but intended to be used by its child
      subprocessor(s).
```

## dts/bindings/misc/nordic-nrf-ficr-client.yaml
```yaml
# Copyright (c) 2024 Nordic Semiconductor ASA
# SPDX-License-Identifier: Apache-2.0

properties:
  nordic,ficrs:
    type: phandle-array
    description: |
      FICR entries, e.g. <&ficr OFFSET>. Available offsets (or FICR entries) are
      available at <zephyr/dt-bindings/misc/nordic-nrf-ficr-*.h>.

  nordic,ficr-names:
    type: string-array
    description: |
      Names of each nordic,ficrs entry.
```

## dts/bindings/misc/nordic-nrf-seriobox.yaml
```yaml
# Copyright 2024 Nordic Semiconductor ASA
# SPDX-License-Identifier: Apache-2.0

description: |
  Common properties for the Nordic nRF serial-based peripheral (TWI[M/S],
  SPI[M/S], UART[E]).

properties:
  nordic,spi-max-frequency:
    type: int
    description: |
      Maximum SPI frequency supported by the peripheral.

  nordic,easydma-maxcnt-bits:
    type: int
    description: |
      Maximum number of bits available in the EasyDMA MAXCNT register.
```

## dts/bindings/misc/nuvoton,nct-c2h.yaml
```yaml
# Copyright (c) 2025 Nuvoton Technology Corporation.
# SPDX-License-Identifier: Apache-2.0

description: Nuvoton, NCT Core to Host module

compatible: "nuvoton,nct-c2h"

include: [base.yaml]

properties:
  reg:
    required: true
```

## dts/bindings/misc/nuvoton,npcm-c2h.yaml
```yaml
# Copyright (c) 2024 Nuvoton Technology Corporation.
# SPDX-License-Identifier: Apache-2.0

description: Nuvoton, NPCM Core to Host module

compatible: "nuvoton,npcm-c2h"

include: [base.yaml]

properties:
  reg:
    required: true
```

## dts/bindings/misc/nuvoton,npcx-booter-variant.yaml
```yaml
# Copyright (c) 2021 Nuvoton Technology Corporation.
# SPDX-License-Identifier: Apache-2.0

description: Nuvoton, NPCX booter variant options

compatible: "nuvoton,npcx-booter-variant"

properties:
    hif-type-auto:
        type: boolean
        required: false
        description: |
            The host interface type (LPC/eSPI/SHI) is configured by booter
            if true; otherwise, it should be configured by the firmware.
```

## dts/bindings/misc/nuvoton,npcx-soc-id.yaml
```yaml
# Copyright (c) 2021 Nuvoton Technology Corporation.
# SPDX-License-Identifier: Apache-2.0

description: Nuvoton, NPCX soc ID node

compatible: "nuvoton,npcx-soc-id"

properties:
  family-id:
    type: int
    required: true
    description: NPCX family ID

  chip-id:
    type: int
    required: true
    description: NPCX chip ID

  device-id:
    type: int
    required: true
    description: NPCX device ID

  revision-reg:
    type: array
    required: true
    description: NPCX revision register address & length in byte
```

## dts/bindings/misc/nxp,evtg.yaml
```yaml
# SPDX-FileCopyrightText: Copyright 2026 NXP
# SPDX-License-Identifier: Apache-2.0

description: |
  NXP EVTG (Event Generator) peripheral.

  The EVTG combines up to four inputs (A, B, C, D) through two AND/OR/INVERT
  (AOI) blocks and an optional flip-flop to produce an event-generator output.
  Each AOI block ORs up to four product terms, and each product term ANDs the
  four inputs after a per-input role (pass, invert, ignore or force-0) is
  applied.

  The inputs are routed from the on-chip INPUTMUX and the output drives the
  interconnect (for example PWM faults, timer or ADC triggers) or a device pin.
  This binding only programs the AOI/flip-flop logic; the input and output
  routing must be set up separately through INPUTMUX and pinctrl.

  One EVTG peripheral instantiates several EVTG instances (EVTG_INST[]). Each
  instance that is used is described by a child node and is programmed
  statically by the Zephyr driver at init time from the properties below; the
  peripheral has no runtime configuration API. The driver enables the EVTG bus
  clock through the clock controller before programming the instances.

  Example (AOI0 output = A AND B):

      #include <zephyr/dt-bindings/misc/nxp-evtg.h>

      &evtg0 {
          status = "okay";

          instance@0 {
              reg = <0>;
              flip-flop-mode = "bypass";
              aoi0-term0 = <EVTG_PASS EVTG_PASS EVTG_IGNORE EVTG_IGNORE>;
          };
      };

compatible: "nxp,evtg"

include: base.yaml

properties:
  reg:
    required: true

  clocks:
    required: true

  "#address-cells":
    const: 1

  "#size-cells":
    const: 0

child-binding:
  description: |
    Static configuration for a single EVTG instance. The driver applies the
    configuration and programs the instance during initialization.

  properties:
    reg:
      type: array
      required: true
      description: EVTG instance index (0-3) within EVTG_INST[].

    flip-flop-mode:
      type: string
      default: "bypass"
      enum:
        - "bypass"
        - "rs-trigger"
        - "t-ff"
        - "d-ff"
        - "jk-ff"
        - "latch"
      description: |
        Flip-flop mode applied to the instance (EVTG_CTRL.MODE_SEL). Enum order
        matches the fsl_evtg evtg_flipflop_mode_t values. "bypass" routes the
        two AOI expressions directly to the outputs.

    flip-flop-init-output:
      type: int
      enum: [0, 1]
      description: |
        When present, force the flip-flop initial positive output value
        (EVTG_CTRL.FF_INIT). Omit to leave the flip-flop output uninitialized.

    input-a-sync:
      type: boolean
      description: Synchronize input A to the bus clock (EVTG_CTRL.SYNC_CTRL).

    input-b-sync:
      type: boolean
      description: Synchronize input B to the bus clock (EVTG_CTRL.SYNC_CTRL).

    input-c-sync:
      type: boolean
      description: Synchronize input C to the bus clock (EVTG_CTRL.SYNC_CTRL).

    input-d-sync:
      type: boolean
      description: Synchronize input D to the bus clock (EVTG_CTRL.SYNC_CTRL).

    aoi0-term0:
      type: array
      description: |
        AOI0 product term 0 as four cells giving the role of inputs A, B, C, D.
        Use EVTG_PASS / EVTG_INVERT / EVTG_IGNORE / EVTG_FORCE0 from
        dt-bindings/misc/nxp-evtg.h. The AOI output ORs its four product terms;
        omit a term property to disable that term.

    aoi0-term1:
      type: array
      description: AOI0 product term 1; see aoi0-term0.

    aoi0-term2:
      type: array
      description: AOI0 product term 2; see aoi0-term0.

    aoi0-term3:
      type: array
      description: AOI0 product term 3; see aoi0-term0.

    aoi1-term0:
      type: array
      description: AOI1 product term 0; see aoi0-term0.

    aoi1-term1:
      type: array
      description: AOI1 product term 1; see aoi0-term0.

    aoi1-term2:
      type: array
      description: AOI1 product term 2; see aoi0-term0.

    aoi1-term3:
      type: array
      description: AOI1 product term 3; see aoi0-term0.
```

## dts/bindings/misc/nxp,flexio.yaml
```yaml
# Copyright (c) 2024, STRIM, ALC
# SPDX-License-Identifier: Apache-2.0

description: NXP FlexIO controller

compatible: "nxp,flexio"

include: base.yaml


properties:
  reg:
    required: true

  interrupts:
    required: true

  clocks:
    required: true
```

## dts/bindings/misc/nxp,gpu2d.yaml
```yaml
# Copyright (c) 2025 Felipe Neves
# SPDX-License-Identifier: Apache-2.0

description: NXP GPU2D graphics accelerator

compatible: "nxp,gpu2d"

include: [reset-device.yaml, base.yaml]

properties:
  reg:
    required: true

  interrupts:
    required: true
```
