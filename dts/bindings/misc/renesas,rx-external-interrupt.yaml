## dts/bindings/misc/st,vnd7050aj.yaml
```yaml
# Copyright (c) 2024, Eduard Iten
# SPDX-License-Identifier: Apache-2.0

description: |
  STMicroelectronics VND7050AJ dual-channel high-side driver.
  This is a GPIO and ADC controlled device.

compatible: "st,vnd7050aj"

include: base.yaml

properties:
  input0-gpios:
    type: phandle-array
    required: true
    description: GPIO to control output channel 0.

  input1-gpios:
    type: phandle-array
    required: true
    description: GPIO to control output channel 1.

  select0-gpios:
    type: phandle-array
    required: true
    description: GPIO for MultiSense selection bit 0.

  select1-gpios:
    type: phandle-array
    required: true
    description: GPIO for MultiSense selection bit 1.

  sense-enable-gpios:
    type: phandle-array
    required: true
    description: GPIO to enable the MultiSense output.

  fault-reset-gpios:
    type: phandle-array
    required: true
    description: GPIO to reset a latched fault (active-low).

  io-channels:
    type: phandle-array
    required: true
    description: |
      ADC channel connected to the MultiSense pin. This should be an
      io-channels property pointing to the ADC controller and channel number.

  r-sense-ohms:
    type: int
    required: true
    description: |
      Value of the external sense resistor connected from the MultiSense
      pin to GND, specified in Ohms. This is critical for correct
      conversion of the analog readings.

  k-factor:
    type: int
    required: false
    default: 1500
    description: |
      Factor between PowerMOS and SenseMOS.

  k-vcc:
    type: int
    required: false
    default: 8000
    description: |
      VCC sense ratio multiplied by 1000. Used for supply voltage calculation.

  t-sense-0:
    type: int
    required: false
    default: 25
    description: |
      Temperature sense reference temperature in degrees Celsius.

  v-sense-0:
    type: int
    required: false
    default: 2070
    description: |
      Temperature sense reference voltage in millivolts.

  k-tchip:
    type: int
    required: false
    default: -5500
    description: |
      Temperature sense gain coefficient multiplied by 1000.
      Used for chip temperature calculation.
```

## dts/bindings/misc/syna,aon-event-gpio.yaml
```yaml
# Copyright (c) 2025 Synaptics, Inc.
# SPDX-License-Identifier: Apache-2.0

description: Synaptics AON Event GPIO driver

compatible: "syna,aon-event-gpio"

include: [base.yaml, pinctrl-device.yaml]

properties:
  reg:
    required: true

child-binding:
  description: Event GPIO configuration

  properties:
    event:
      type: int
      required: true
      description: |
        Event identifier that will be assigned to the GPO. Note that the GPOs
        have different supported events.

    pulse-width:
      type: int
      required: true
      description: |
        Specifies the width of the pulse in units of 32kHz that is generated on
        the GPO when an event occurs.

        Valid range: 0 to 15.

    polarity:
      type: int
      enum: [0, 1]
      required: true
      description: |
        Specifies the GPO polarity (GPIO_ACTIVE_HIGH, GPIO_ACTIVE_LOW) at idle.
        When an event occurs, a pulse is generated with the opposite polarity.
```

## dts/bindings/misc/test,scope-pins.yaml
```yaml
#
# Copyright (c) 2019 Nordic Semiconductor ASA
#
# SPDX-License-Identifier: Apache-2.0
#

title: GPIO pin definitions for tests

description: >
    Identify accessible board pins that can be used for GPIO signals.

    Most development boards expose several GPIO pins on a header.  These
    may be used as signals to a logic analyzer, or to simulate an
    external device.  This binding provides a board-independent
    description of pins that can be made available for this purpose.

compatible: "test,scope-pins"

properties:
    gpios:
        type: compound
        required: true
        description: >
          Accessible pins used for GPIO-based instrumentation and
          testing.

          Any number of pins may be provided, on multiple GPIO devices.
          However at least two entries must be present, and the first
          two must be on the same GPIO device.
```

## dts/bindings/misc/ti,tdp2004.yaml
```yaml
# Copyright (c) 2026 BayLibre, SAS
# SPDX-License-Identifier: Apache-2.0

description: TI Four-Channel 20Gbps DisplayPort 2.1 and 12Gbps HDMI2.1 Linear Redriver.

compatible: "ti,tdp2004"

include: i2c-device.yaml

properties:
  pd-gpios:
    type: phandle-array
    description: Phandle to the GPIO used to power down/up the redriver.
    required: true

examples:
  - |
    #include <zephyr/dt-bindings/gpio/gpio.h>
    #include <zephyr/dt-bindings/i2c/i2c.h>

    &i2c5 {
      dp_redriver_0: displayport-redriver@18 {
        compatible = "ti,tdp2004";
        reg = <0x18>;
        pd-gpios = <&gpio9 14 GPIO_ACTIVE_HIGH>;
      };
    };
```

## dts/bindings/misc/tm,tm1637.yaml
```yaml
description: |
  TM1637 4-digit 7-segment display driver with serial interface.
  This binding supports the TM1637 chip connected via two GPIO pins for CLK and DIO.
compatible: "hw,tm1637"

include: base.yaml

properties:
  clk-gpios:
    type:  phandle-array
    required:  true
    description:  GPIO pin for TM1637 clock line.

  dio-gpios:
    type: phandle-array
    required: true
    description: GPIO pin for TM1637 data line.
```
