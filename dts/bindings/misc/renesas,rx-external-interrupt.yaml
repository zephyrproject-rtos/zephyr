## dts/bindings/misc/renesas,rx-external-interrupt.yaml
```yaml
# Copyright (c) 2025 Renesas Electronics Corporation
# SPDX-License-Identifier: Apache-2.0

description: Renesas RX External Interrupt

compatible: "renesas,rx-external-interrupt"

include: [base.yaml]

properties:
  interrupts:
    required: true

  reg:
    required: true

  channel:
    type: int
    required: true

  renesas,trigger:
    type: string
    enum:
      - "low-level"
      - "falling"
      - "rising"
      - "both-edges"
    description: |
      Select the signal edge or state that triggers an interrupt

  renesas,digital-filtering:
    type: boolean
    description: |
      Select if data noise filter should be enabled.

  renesas,sample-clock-div:
    type: int
    enum:
      - 1
      - 8
      - 32
      - 64
    description: |
      Select the clock divider for the digital noise filter. Clock source is system clock.
```

## dts/bindings/misc/renesas,rx-lvd.yaml
```yaml
# Copyright (c) 2025 Renesas Electronics Corporation
# SPDX-License-Identifier: Apache-2.0

description: RX LVD voltage monitor

compatible: "renesas,rx-lvd"

include: [base.yaml, pinctrl-device.yaml]

properties:
  reg:
    required: true

  channel:
    type: int
    description: RX LVD channel

  lvd-action:
    required: true
    type: string
    enum:
      - "reset"
      - "non-maskable-interrupt"
      - "maskable-interrupt"
      - "no-action"
    description: |
      Choose the action to be taken when the LVD is detected.

  voltage-level:
    required: true
    type: int
    description: |
      Specifies the voltage detection level for each channel, as an integer
      value that represents the voltage in hundredths of a volt.
      Example:
        - To set the voltage detection level to 3.00 V, specify '300'.
        - To set the voltage detection level to 3.84 V, specify '384'.
        - To set the voltage detection level to default value, specify '0xFFFF'
      For specific voltage detection support levels of each RX MCU series,
      please refer to the HWM.

  lvd-support-cmpa2:
    type: boolean
    description: |
      Specifies whether the RX LVD supports CMPA pin as target.
      Note: For RX130 series, CMPA pin is available only for channel 1.

  vdet-target:
    required: true
    type: string
    enum:
      - vcc
      - cmpa
    description: |
      Specifies the target to be monitored for each channel.
      Note: For RX130 series, CMPA pin is available only for channel 1.

  lvd-trigger:
    required: true
    type: string
    enum:
      - "rising"
      - "falling"
      - "both"
    description: |
      Specifies the voltage detection conditions and influences interrupt conditions

  lvd-stabilization:
    type: int
    enum: [0, 1]
    description: |
      Specifies the reset negation timing for each channel, with reset selected as processing.
        - 0: After a LVD reset, negation occurs when a certain period elapses after the
          monitored voltage goes above the voltage detection level.
        - 1: Negation occurs when a certain period elapses after the LVD reset assertion.
      Note: "a certain period" here means a wait time after a voltage monitoring reset.
            Refer to the User's Manual: Hardware for details.

  pinctrl-0:
    description: Pin control for LVD when using CMPA pin as target

  pinctrl-names:
    description: Pin control names for LVD when using CMPA pin as target
```

## dts/bindings/misc/renesas,rx-mtu.yaml
```yaml
# Copyright (c) 2025 Renesas Electronics Corporation
# SPDX-License-Identifier: Apache-2.0

description: Renesas RX MTU controller

compatible: "renesas,rx-mtu"

include: [base.yaml, pinctrl-device.yaml]

properties:
  channel:
    type: int
    description: channel MTU

  reg:
    required: true

  reg-names:
    required: true

  clocks:
    required: true

  counter-clear-channel:
    type: int
    description:
      Choose one channel to act as counter clear channel. Not required in synchronous
      mode if another synchronous MTU has a counter clear channel defined. If neither a channel
      nor synchronous mode is chosen, it is not possible to set a period, but the MTU will use a
      constant period of 0xffff cycles.

  synchronous:
    type: boolean
    description:
      if set, the device will operate in synchronous mode. All MTU devices in
      synchronous mode have the same period (in cycles, but subject to different prescaler
      settings). Only one of the synchronous devices has to specify a counter clear channel.

  bit-idx:
    type: int
    required: true
    description:
      which bit of the common timer start register (TSTR) and timer synchronous
      register (TSYR) to set for this device.
```

## dts/bindings/misc/renesas,rx-sci.yaml
```yaml
# Copyright (c) 2024-2025 Renesas Electronics Corporation
# SPDX-License-Identifier: Apache-2.0

description: Renesas RX SCI controller

compatible: "renesas,rx-sci"

include: [base.yaml, pinctrl-device.yaml]

properties:
  reg:
    required: true

  channel:
    type: int
    required: true

  dtc:
    type: phandle
    description: DTC controller
```

## dts/bindings/misc/renesas,rz-sci-b.yaml
```yaml
# Copyright (c) 2025 Renesas Electronics Corporation
# SPDX-License-Identifier: Apache-2.0

description: Renesas RZ SCI-B controller

compatible: "renesas,rz-sci-b"

include: [base.yaml, pinctrl-device.yaml]

properties:
  reg:
    required: true

  channel:
    type: int
    required: true

  interrupts:
    required: true
```

## dts/bindings/misc/renesas,rz-sci.yaml
```yaml
# Copyright (c) 2025 Renesas Electronics Corporation
# SPDX-License-Identifier: Apache-2.0

description: Renesas RZ SCI controller

compatible: "renesas,rz-sci"

include: [base.yaml, pinctrl-device.yaml]

properties:
  reg:
    required: true

  channel:
    type: int
    required: true

  interrupts:
    required: true
```

## dts/bindings/misc/seeed,grove-lcd-rgb.yaml
```yaml
# Copyright (c) 2022 Nordic Semiconductor ASA
# SPDX-License-Identifier: Apache-2.0

description: Seeed Grove LCD RGB

compatible: "seeed,grove-lcd-rgb"

include: i2c-device.yaml
```

## dts/bindings/misc/skyworks,sky13317.yaml
```yaml
# Copyright (c) 2022 Stancu Florin
# Copyright (c) 2024 Ayush Singh, BeagleBoard.org Foundation
# SPDX-License-Identifier: Apache-2.0

description: Skyworks SKY13317 pHEMT GaAs SP3T Antenna Switch

compatible: "skyworks,sky13317"

include: [pinctrl-device.yaml, base.yaml]

properties:
  gpios:
    type: phandle-array
    required: true
    description: Antenna mux control pins. Length 1-3
  pinctrl-0:
    required: true
```

## dts/bindings/misc/skyworks,sky13335.yaml
```yaml
# Copyright (c) 2023, Caspar Friedrich <c.s.w.friedrich@gmail.com>
# SPDX-License-Identifier: Apache-2.0

description: Output selectors for Skyworks SKY13335 GaAs SPDT Switch

compatible: "skyworks,sky13335"

include: [base.yaml]

properties:
  vctl1-gpios:
    type: phandle-array
    description: DC control voltage input. Active high.

  vctl2-gpios:
    type: phandle-array
    description: DC control voltage input. Active high.
```

## dts/bindings/misc/skyworks,sky13348.yaml
```yaml
# Copyright (c) 2025 Nordic Semiconductor ASA
# SPDX-License-Identifier: Apache-2.0

description: Output selectors on the SKY13348 GaAs SPDT FET I/C switch

compatible: "skyworks,sky13348"

include: base.yaml

properties:
  v1-gpios:
    type: phandle-array
    required: true
    description: V1 pin
  v2-gpios:
    type: phandle-array
    required: true
    description: V2 pin
```

## dts/bindings/misc/skyworks,sky13351.yaml
```yaml
# Copyright (c) 2019, Peter Bigot Consulting, LLC
# SPDX-License-Identifier: Apache-2.0

description: Output selectors on the SKY13351 GaAs SPDT FET I/C switch

compatible: "skyworks,sky13351"

include: base.yaml

properties:
  vctl1-gpios:
    type: phandle-array
    required: true
    description: VCTL1 pin
  vctl2-gpios:
    type: phandle-array
    required: true
    description: VCTL2 pin
```

## dts/bindings/misc/snps,arc-iot-sysconf.yaml
```yaml
# Copyright (c) 2022 Nordic Semiconductor ASA
# SPDX-License-Identifier: Apache-2.0

description: ARC IoT SoC System Configuration Module

compatible: "snps,arc-iot-sysconf"

include: base.yaml

properties:
    reg:
      required: true
```

## dts/bindings/misc/snps,archs-ici.yaml
```yaml
# Copyright (c) 2022 Nordic Semiconductor ASA
# SPDX-License-Identifier: Apache-2.0

description: Inter-Core Interrupt Unit (ICI)

compatible: "snps,archs-ici"

include: base.yaml
```

## dts/bindings/misc/st,stm32-bootloader-flash.yaml
```yaml
# SPDX-License-Identifier: Apache-2.0
# Copyright (c) 2026 Alex Fabre

description: |
  Flash adapter exposing a region of an STM32 target mcu as a Zephyr
  flash device. 
  Must be a child node of an 'st,stm32-bootloader' node, as the
  adapter delegates every flash_read/write/erase call to the parent's
  read_memory/write_memory/erase_pages. 
  The reg addresses are absolute on the target's memory map
  (e.g. 0x08000000 for main flash).

  Multiple adapter children can coexist under a single bootloader node,
  allowing flash areas per addressable regions (main flash, option bytes,
  system memory, SRAM, ...).

compatible: "st,stm32-bootloader-flash"

include: [base.yaml]

properties:
  reg:
    required: true
    description: |
      <base-address size-in-bytes> of the target memory region exposed as
      a flash device.

  erase-block-size:
    type: int
    required: true
    description: |
      Page/sector size used for flash_erase operations. Non-uniform
      layouts are not supported by this adapter — if you need them, expose
      the adapter as read-only or split the region across multiple child
      nodes.

  write-block-size:
    type: int
    default: 4
    description: Write alignment (AN3155 requires 4-byte aligned writes).

  read-only:
    type: boolean
    description: |
      When set, flash_write / flash_erase on this adapter return -EACCES.
      Useful for exposing read-only regions (system memory, factory OTP).
```

## dts/bindings/misc/st,stm32-bootloader-uart.yaml
```yaml
# SPDX-License-Identifier: Apache-2.0
# Copyright (c) 2026 Alex Fabre

description: |
  STM32 system bootloader over UART (AN3155).

  Transport-specific bindings of a st,stm32-bootloader device.

  The host sees its usart peripheral reconfigured to match the
  AN3155-required framing (8-bit, even parity by default, 115200 baud,
  no flow control). Configuration is restored the original dts settings
  on exit.

compatible: "st,stm32-bootloader"

include: [uart-device.yaml, "st,stm32-bootloader.yaml"]

properties:
  timeout-ms:
    type: int
    default: 100
    description: Per-command response timeout in milliseconds.

  baudrate:
    type: int
    default: 115200
    description: |
      UART baudrate used during bootloader sessions. The STM32 bootloader
      auto-detects between 1200 and 115200.

  parity-none:
    type: boolean
    description: |
      Set when the target requires no parity (STM32WB0 series, STM32WL3x
      line). Most STM32 bootloaders require even parity (the default).
```

## dts/bindings/misc/st,stm32-bootloader.yaml
```yaml
# SPDX-License-Identifier: Apache-2.0
# Copyright (c) 2026 Alex Fabre

description: |
  Common properties for STM32 system bootloader host driver bindings.

  Shared by all transport-specific bindings (USART for now; I2C, CAN, SPI
  are possible future transports). The host optionally drives the target's
  BOOT0, BOOT1 and NRST pins through GPIO; any pin absent from the device
  tree is skipped, so this driver also works with targets that are already
  in bootloader mode by other means.

  To expose a region of the target's memory as a Zephyr flash device, add
  an 'st,stm32-bootloader-flash' child node.

properties:
  boot0-gpios:
    type: phandle-array
    description: GPIO connected to the target STM32 BOOT0 (or BOOT) pin.

  boot1-gpios:
    type: phandle-array
    description: GPIO connected to the target STM32 BOOT1 pin (if any).

  nrst-gpios:
    type: phandle-array
    description: GPIO connected to the target STM32 NRST (reset) pin.

  reset-pulse-ms:
    type: int
    default: 1
    description: NRST pulse duration in milliseconds.

  boot-delay-ms:
    type: int
    default: 10
    description: |
      Delay after reset before the bootloader is ready for commands
      (refer to AN2606 for per-product values).

  erase-timeout-ms:
    type: int
    default: 35000
    description: |
      Timeout for erase/mass-erase operations. Mass erase can take 30+ s.
```

## dts/bindings/misc/st,stm32-npu-cache.yaml
```yaml
# Copyright (c) 2026 STMicroelectronics
# SPDX-License-Identifier: Apache-2.0

description: STM32N6 NPU cache (aka CACHEAXI) block

compatible: "st,stm32-npu-cache"

include: [reset-device.yaml, base.yaml]

properties:
  reg:
    required: true

  clocks:
    required: true

  resets:
    required: true
```

## dts/bindings/misc/st,stm32-npu.yaml
```yaml
# Copyright (c) 2025 STMicroelectronics
# SPDX-License-Identifier: Apache-2.0

description: STM32 Neural-ART accelerator

compatible: "st,stm32-npu"

include: [reset-device.yaml, base.yaml]

properties:
  reg:
    required: true

  clocks:
    required: true

  resets:
    required: true
```

## dts/bindings/misc/st,stm32-syscfg.yaml
```yaml
# Copyright (c) 2023 Aurelien Jarno
# SPDX-License-Identifier: Apache-2.0

description: STMicroelectronics STM32 System Configuration Controller

compatible: "st,stm32-syscfg"

include: base.yaml

properties:
  reg:
    required: true

  clocks:
    required: true

child-binding:
  description: Interrupt Line
  include: [interrupt-controller.yaml]
  properties:
    interrupts:
      type: array
      required: true
      description: interrupts for device

    "#interrupt-cells":
      const: 2

  interrupt-cells:
    - irq
    - priority
```

## dts/bindings/misc/st,stm32n6-ramcfg.yaml
```yaml
# Copyright 2025 STMicroelectronics
# SPDX-License-Identifier: Apache-2.0

description: STM32 SRAM configuration controller

compatible: "st,stm32n6-ramcfg"

include: base.yaml

properties:
  reg:
    required: true

  clocks:
    required: true
    description: |
      Two clocks are required to enable the SRAM:
        * "ramcfg" for the RAMCFG controller clock
        * "axisram" for the SRAM dedicated clock
  clock-names:
    required: true
```
