## dts/bindings/misc/infineon,tcpwm-tgpio.yaml
```yaml
# Copyright (c) 2026 Linumiz.
#
# SPDX-License-Identifier: Apache-2.0

description: Infineon tgpio

compatible: "infineon,tcpwm-tgpio"

include: [base.yaml, pinctrl-device.yaml, "infineon,system-interrupts.yaml"]
```

## dts/bindings/misc/intel,adsp-communication-widget.yaml
```yaml
# Copyright (c) 2022 Intel Corporation.
# SPDX-License-Identifier: Apache-2.0

description: Intel ADSP Communication Widget

compatible: "intel,adsp-communication-widget"

include: base.yaml

properties:
  reg:
    required: true
```

## dts/bindings/misc/intel,timeaware-gpio.yaml
```yaml
# Copyright (c) 2022 Intel Corporation
# SPDX-License-Identifier: Apache-2.0

description: Intel TGPIO

compatible: "intel,timeaware-gpio"

include: [base.yaml]

properties:
  reg:
    required: true

  timer-clock:
    type: int
    required: true
    description: ART timer clock frequency

  max-pins:
    type: int
    required: true
    description: Total number of available pins

  artv-ctrl:
    type: boolean
    description: |
      Some platforms have ARTV_CTRL which is required for
      reading the ART timestamp. This property is used to
      indicate if the support of ARTV_CTRL is available
      or not.
```

## dts/bindings/misc/microchip,smartfusion2-can.yaml
```yaml
# SPDX-FileCopyrightText: Copyright Bavariamatic GmbH
# SPDX-License-Identifier: Apache-2.0

description: SmartFusion2 CAN controller block

compatible: "microchip,smartfusion2-can"

include: microchip,smartfusion2-common.yaml
```

## dts/bindings/misc/microchip,smartfusion2-comblk.yaml
```yaml
# SPDX-FileCopyrightText: Copyright Bavariamatic GmbH
# SPDX-License-Identifier: Apache-2.0

description: SmartFusion2 COM block peripheral

compatible: "microchip,smartfusion2-comblk"

include: microchip,smartfusion2-common.yaml
```

## dts/bindings/misc/microchip,smartfusion2-common.yaml
```yaml
# SPDX-FileCopyrightText: Copyright Bavariamatic GmbH
# SPDX-License-Identifier: Apache-2.0

include: base.yaml

properties:
  reg:
    required: true
```

## dts/bindings/misc/microchip,smartfusion2-corecfg.yaml
```yaml
# SPDX-FileCopyrightText: Copyright Bavariamatic GmbH
# SPDX-License-Identifier: Apache-2.0

description: SmartFusion2 CoreConfig block

compatible: "microchip,smartfusion2-corecfg"

include: microchip,smartfusion2-common.yaml
```

## dts/bindings/misc/microchip,smartfusion2-ddr.yaml
```yaml
# SPDX-FileCopyrightText: Copyright Bavariamatic GmbH
# SPDX-License-Identifier: Apache-2.0

description: SmartFusion2 MDDR configuration block

compatible: "microchip,smartfusion2-ddr"

include: microchip,smartfusion2-common.yaml
```

## dts/bindings/misc/microchip,smartfusion2-ethernet.yaml
```yaml
# SPDX-FileCopyrightText: Copyright Bavariamatic GmbH
# SPDX-License-Identifier: Apache-2.0

description: SmartFusion2 Ethernet MAC block

compatible: "microchip,smartfusion2-ethernet"

include: microchip,smartfusion2-common.yaml
```

## dts/bindings/misc/microchip,smartfusion2-fddr.yaml
```yaml
# SPDX-FileCopyrightText: Copyright Bavariamatic GmbH
# SPDX-License-Identifier: Apache-2.0

description: SmartFusion2 FDDR configuration block

compatible: "microchip,smartfusion2-fddr"

include: microchip,smartfusion2-common.yaml
```

## dts/bindings/misc/microchip,smartfusion2-hpdma.yaml
```yaml
# SPDX-FileCopyrightText: Copyright Bavariamatic GmbH
# SPDX-License-Identifier: Apache-2.0

description: SmartFusion2 high-performance DMA block

compatible: "microchip,smartfusion2-hpdma"

include: microchip,smartfusion2-common.yaml
```

## dts/bindings/misc/microchip,smartfusion2-rtc.yaml
```yaml
# SPDX-FileCopyrightText: Copyright Bavariamatic GmbH
# SPDX-License-Identifier: Apache-2.0

description: SmartFusion2 RTC block

compatible: "microchip,smartfusion2-rtc"

include: microchip,smartfusion2-common.yaml
```

## dts/bindings/misc/microchip,smartfusion2-serdes.yaml
```yaml
# SPDX-FileCopyrightText: Copyright Bavariamatic GmbH
# SPDX-License-Identifier: Apache-2.0

description: SmartFusion2 SERDES configuration block

compatible: "microchip,smartfusion2-serdes"

include: microchip,smartfusion2-common.yaml
```

## dts/bindings/misc/microchip,smartfusion2-sysreg.yaml
```yaml
# SPDX-FileCopyrightText: Copyright Bavariamatic GmbH
# SPDX-License-Identifier: Apache-2.0

description: SmartFusion2 system register block

compatible: "microchip,smartfusion2-sysreg"

include: microchip,smartfusion2-common.yaml
```

## dts/bindings/misc/microchip,smartfusion2-timers.yaml
```yaml
# SPDX-FileCopyrightText: Copyright Bavariamatic GmbH
# SPDX-License-Identifier: Apache-2.0

description: SmartFusion2 timer block

compatible: "microchip,smartfusion2-timers"

include: microchip,smartfusion2-common.yaml
```

## dts/bindings/misc/microchip,smartfusion2-usb.yaml
```yaml
# SPDX-FileCopyrightText: Copyright Bavariamatic GmbH
# SPDX-License-Identifier: Apache-2.0

description: SmartFusion2 USB controller block

compatible: "microchip,smartfusion2-usb"

include: microchip,smartfusion2-common.yaml
```

## dts/bindings/misc/microchip,smartfusion2-watchdog.yaml
```yaml
# SPDX-FileCopyrightText: Copyright Bavariamatic GmbH
# SPDX-License-Identifier: Apache-2.0

description: SmartFusion2 watchdog block

compatible: "microchip,smartfusion2-watchdog"

include: microchip,smartfusion2-common.yaml
```

## dts/bindings/misc/microchip,usb3803.yaml
```yaml
# Copyright (c) 2025 Applied Materials
# SPDX-License-Identifier: Apache-2.0

description: Microchip USB3803 High Speed Hub Controller

compatible: "microchip,usb3803"

include: i2c-device.yaml

properties:
  rst-pin-gpios:
    type: phandle-array
    description: |
      GPIO connected to reset pin of usb3803.
  bypass-pin-gpios:
    type: phandle-array
    description: |
      GPIO connected to bypass pin of usb3803.
```

## dts/bindings/misc/microchip,xec-ecs.yaml
```yaml
# Copyright (c) 2022 Microchip Technology Inc.
# SPDX-License-Identifier: Apache-2.0

description: Microchip EC Subsystem

compatible: "microchip,xec-ecs"

include: base.yaml

properties:
  reg:
    required: true
```

## dts/bindings/misc/nordic,axon.yaml
```yaml
# Copyright (c) 2026 Nordic Semiconductor ASA
# SPDX-License-Identifier: Apache-2.0

description: Nordic Axon

compatible: "nordic,axon"

include:
  - "base.yaml"

properties:
  reg:
    required: true

  interrupts:
    required: true
```

## dts/bindings/misc/nordic,ironside-ipc.yaml
```yaml
# Copyright (c) 2025 Nordic Semiconductor ASA
# SPDX-License-Identifier: Apache-2.0

description: IPC configuration for Nordic IronSide SE

compatible: "nordic,ironside-se-ipc"

include: base.yaml

properties:
  memory-regions:
    type: phandle-array
    required: true
    description: phandles to shared memory regions, two needed.

  memory-region-names:
    type: string-array
    required: true
    description: Names of the memory regions (must be called "call" and "event")

  mboxes:
    required: true
    description: MBOX channel specifiers (TX, RX and event are required)

  mbox-names:
    required: true
    description: MBOX channel names (must be called "tx", "rx" and "event")
```

## dts/bindings/misc/nordic,nrf-bicr.yaml
```yaml
# Copyright (c) 2024 Nordic Semiconductor ASA
# SPDX-License-Identifier: Apache-2.0

description: Nordic BICR (Board Information Configuration Registers)

compatible: "nordic,nrf-bicr"

include: base.yaml

properties:
  reg:
    required: true
```

## dts/bindings/misc/nordic,nrf-coresight.yaml
```yaml
# Copyright (c) 2025 Nordic Semiconductor ASA
# SPDX-License-Identifier: Apache-2.0

description: Nordic Coresight Subsystem (Trace Port Interface Unit)

compatible: "nordic,nrf-coresight"

include: [base.yaml, pinctrl-device.yaml, nordic-clockpin.yaml]

properties:
  reg:
    required: true

  mode:
    required: true
    type: string
    enum:
      - "stm-tpiu"
      - "stm-etr"
    description: >
      Specifies which mode to configure the Coresight subsystem in.
```

## dts/bindings/misc/nordic,nrf-dppic-global.yaml
```yaml
# Copyright (c) 2024 Nordic Semiconductor ASA
# SPDX-License-Identifier: Apache-2.0

description: |
  Nordic Global DPPIC
  (Distributed Programmable Peripheral Interconnect Controller)

  Updated DPPIC binding set for Nordic products that have global DPPIC instances
  with inter-bridge functionality. These instances also have split-ownership
  of its channels and channel groups.

compatible: "nordic,nrf-dppic-global"

include:
  - "nordic,nrf-dppic.yaml"
  - "nordic,nrf-dppic-links.yaml"
  - "nordic,split-channels.yaml"
  - "nordic,split-channel-groups.yaml"
```

## dts/bindings/misc/nordic,nrf-dppic-links.yaml
```yaml
# Copyright (c) 2024 Nordic Semiconductor ASA
# SPDX-License-Identifier: Apache-2.0

description: Nordic DPPIC Channel Linking

properties:
  source-channels:
    type: array
    description: |
      Channels that are linked to channels of DPPIC instances on separate
      bridges as publishing sources.

  sink-channels:
    type: array
    description: |
      Channels that are linked to channels of DPPIC instances on separate
      bridges as subscribing sinks.
```
