## dts/bindings/mmc/st,stm32-sdmmc.yaml
```yaml
description: STM32 SDMMC Disk Access

compatible: "st,stm32-sdmmc"

include: [mmc.yaml, pinctrl-device.yaml, reset-device.yaml]

properties:
  disk-name:
    type: string
    required: true
    description: |
      Disk name.

  clocks:
    required: true

  reg:
    required: true

  resets:
    required: true

  pinctrl-0:
    required: true

  pinctrl-names:
    required: true

  cd-gpios:
    type: phandle-array
    description: Card Detect pin

  pwr-gpios:
    type: phandle-array
    description: Power pin

  bus-width:
    type: int
    default: 1
    description: |
      bus width for SDMMC access, defaults to the minimum necessary
      number of bus lines
    enum:
      - 1
      - 4
      - 8

  clk-div:
    type: int
    default: 0
    description: |
      Clock division factor for SDMMC. The relationship between this value
      and the output bus frequency is FREQ_BUS = SDMMMC_CLK / [CLKDIV + 2].
      Therefore an input clock of 25MHz and a division factor of 0 would
      result in a bus frequency of 25MHz / [0 + 2] = 12.5MHz.

  clk-bypass:
    type: boolean
    description: |
      Bypass the clock divider configured in `clk-div`, which results in the
      output bus frequency matching the input SDMMC_CLK. Not supported on
      all part numbers.

  idma:
    type: boolean
    description: |
      SDMMC device has an internal DMA. Internal DMA doesn't require any additional
      configuration using "dmas" property.
      Delete this property to use interrupt driven mode.

  dmas:
    description: |
      Optional DMA channel specifier. If DMA should be used, specifier should
      hold a phandle reference to the dma controller, the channel number,
      the slot number, channel configuration and finally features.

      Only priority bits are used in the configuration. There are no feature
      flags.

      For example dmas for TX/RX on SDMMC
         dmas = <&dma2 4 6 0x30000 0x00>, <&dma2 4 3 0x30000 0x00>;
      Alternatively, for a shared TX/RX DMA channels on a STM32L4
         dmas = <&dma2 5 7 STM32_DMA_PRIORITY_HIGH>;

  dma-names:
    description: |
      DMA channel name. If DMA should be used, expected value is either "tx", "rx"
      or a single "txrx" for the shared channel configuration

      For example
         dma-names = "tx", "rx";
      or
         dma-names = "txrx";
```

## dts/bindings/mmc/st,stm32f1-sdmmc.yaml
```yaml
# Copyright (c) 2024 Benjamin Björnsson benjamin.bjornsson@gmail.com

# SPDX-License-Identifier: Apache-2.0

description: |
        ST STM32F1 family SDIO
        Remove the resets property since there's no reset register
        for AHB peripherals on F1 series.

compatible: "st,stm32f1-sdmmc"

include:
  - name: st,stm32-sdmmc.yaml
    property-blocklist:
      - resets
```

## dts/bindings/mmu_mpu/arm,armv6m-mpu.yaml
```yaml
# Copyright (c) 2020, Linaro Limited
# SPDX-License-Identifier: Apache-2.0

description: ARMv6-M Memory Protection Unit (MPU)

compatible: "arm,armv6m-mpu"

include: base.yaml

properties:
  reg:
    required: true
```

## dts/bindings/mmu_mpu/arm,armv7m-mpu.yaml
```yaml
description: ARMv7-M Memory Protection Unit (MPU)

compatible: "arm,armv7m-mpu"

include: base.yaml

properties:
  reg:
    required: true

  arm,num-mpu-regions:
    type: int
    description: number of MPU regions supported by hardware
```

## dts/bindings/mmu_mpu/arm,armv8.1m-mpu.yaml
```yaml
description: ARMv8.1-M MPU (Memory Protection Unit)

compatible: "arm,armv8.1m-mpu"

include: base.yaml

properties:
  reg:
    required: true
```

## dts/bindings/mmu_mpu/arm,armv8m-mpu.yaml
```yaml
description: ARMv8-M MPU (Memory Protection Unit)

compatible: "arm,armv8m-mpu"

include: base.yaml

properties:
  reg:
    required: true
```

## dts/bindings/mmu_mpu/nxp,sysmpu.yaml
```yaml
# Copyright 2024 NXP
# SPDX-License-Identifier: Apache-2.0

description: NXP System Memory Protection Unit (SYSMPU)

compatible: "nxp,sysmpu"

include: base.yaml

properties:
  reg:
    required: true
```

## dts/bindings/modem/gemalto,ehs6.yaml
```yaml
#
# Copyright (c) 2019, Song Qiang <songqiang1304521@gmail.com>
#
# SPDX-License-Identifier: Apache-2.0
#
---
title: Gemalto EHS6 Wireless Modem
version: 0.1

description: >
    This is a representation of the Gelmalto EHS6 wireless modem.

inherits:
    !include uart-device.yaml

properties:
    compatible:
      type: string
      category: required
      constraint: "gemalto,ehs6"
      generation: define

...
```

## dts/bindings/modem/gsm-ppp.yaml
```yaml
# Copyright (c) 2021 G-Technologies Sdn. Bhd.
# SPDX-License-Identifier: Apache-2.0

description: GSM PPP modem

compatible: "gsm,ppp"

include: uart-device.yaml

properties:
  label:
    required: true
```
