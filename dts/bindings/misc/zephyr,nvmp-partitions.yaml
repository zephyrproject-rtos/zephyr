## dts/bindings/misc/zephyr,nvmp-partitions.yaml
```yaml
description: |
  This binding is used to describe partitions on non volatile memory.

  Here is an example:

    &flash0 {
            nvmp_partitions {
                    compatible = "zephyr, nvmp-partitions";
                    #address-cells = <1>;
                    #size-cells = <1>;

                    partition0: partition@0 {
                            reg = <0x00000000 0x0000C000>;
                    };
                    partition1: partition@c000 {
                            reg = <0x0000C000 0x00076000>;
                    };
            };
    };

compatible: "zephyr,nvmp-partitions"

properties:
  "#address-cells":
    type: int
    description: |
      Number of cells required to represent a child node's
      reg property address. This must be large enough to
      represent the start offset of each partition.

  "#size-cells":
    type: int
    description: |
      Number of cells required to represent a child node's
      reg property address. This must be large enough to
      represent the size of each partition in bytes.

child-binding:
  description: |
    Each child node of the fixed-partitions node represents
    an individual flash partition. These should usually
    look like this:

      partition_nodelabel: partition@START_OFFSET {
              label = "human-readable-name";
              reg = <0xSTART_OFFSET 0xSIZE>;
      };
  properties:
    label:
      type: string
      description: |
        Human readable string describing the flash partition.
    read-only:
      type: boolean
      description: set this property if the partition is read-only
    reg:
      type: array
      description: |
        This should be in the format <OFFSET SIZE>, where OFFSET
        is the offset of the flash partition relative to the base
        address of the parent memory, and SIZE is the size of
        the partition in bytes.
      required: true
```

## dts/bindings/misc/zephyr,nvmp-retained-mem.yaml
```yaml
# Copyright (c) 2023 Laczen
# SPDX-License-Identifier: Apache-2.0

# Compatible used to describe nvmp on retained_mem

include: base.yaml
```

## dts/bindings/misc/zephyr,smpmgr-forward.yaml
```yaml
# Copyright (c) 2025 Freedom Veiculos Eletricos
# SPDX-License-Identifier: Apache-2.0

description: |
  The SMP MCUmgr Mux is a software defined muxer to route SMP requests between
  nodes in the hardware. It is composed from one upstream port and a finite
  number of downstream ports.

  The zephyr,smpmgr-forward node should be added in the zephyr,uart-mcumgr chosen
  node. The zephyr,smpmgr-forward router uses a counter in the protocol to know
  when it should stop to forward the data downstream. In this case, the data
  is sent to the local device in the zephyr,uart-mcumgr interface.

  In the below snip it is possible to see the definition of my_muxer. The
  my_muxer is composed by three node: 'the_upstream', 'down1' and 'down2'. In
  this case the 'down1' node is the 'index 0' and 'down2' is the 'index 1'.

    / {
      chosen {
        zephyr,uart-mcumgr = &my_muxer;
      };

      the_upstream: the_upstream{
        compatible = "zephyr,smpmgr-transport";
        status = "okay";

        transport = <&cdc_acm_uart0>;
        type = "serial";
      };

      down1: down1{
        compatible = "zephyr,smpmgr-transport";
        status = "okay";

        transport = <&uart1>;
        type = "serial";
      };

      down2: down2{
        compatible = "zephyr,smpmgr-transport";
        status = "okay";

        transport = <&uart0>;
        type = "ble";
      };

      my_muxer: my_muxer {
        compatible = "zephyr,smpmgr-forward";
        status = "okay";

        upstream = <&the_upstream>;
        downstream = <&down1>, <&down2>;
      };
    };

  In the above example when the protocol mux counter is 0 the content is
  pushed to zephyr,uart-mcumgr. In any other case the system will forward to
  the respective downstream port. An error is returned if the index is out of
  range.

  The content that came from the local or a downstream port is forward to the
  upstream interface.

compatible: "zephyr,smpmgr-forward"

include:
  - name: base.yaml

properties:
  upstream:
    type: phandle
    required: true
    description: |
      phandle to the upstream node. This should be a zephyr,smpmgr-transport
      node.

  downstream:
    type: phandles
    required: true
    description: |
      list of the phandle to all downstream nodes. These should be a
      zephyr,smpmgr-transport node. The order of the nodes define the interface
      number.
```

## dts/bindings/misc/zephyr,smpmgr-transport.yaml
```yaml
# Copyright (c) 2025 Freedom Veiculos Eletricos
# SPDX-License-Identifier: Apache-2.0

description: SMP MCUmgr Interface

compatible: "zephyr,smpmgr-transport"

include:
  - name: base.yaml

properties:
  transport:
    type: phandle
    required: true
    description: phandle to the transport node.

  type:
    type: string
    required: true
    enum:
      - "serial"
      - "ble"
    description: define the transport type.
```

## dts/bindings/misc/zephyr,swdp-gpio.yaml
```yaml
# Copyright (c) 2019 Phytec Messtechnik GmbH
# Copyright (c) 2023 Nordic Semiconductor ASA
# SPDX-License-Identifier: Apache-2.0

description: |
  Serial Wire Debug Port interface implementation by GPIO bit-banging.

  Schematic using dual-supply bus transceiver and separate dout and dnoe pins

         VCC_3V3                      VCC_REF
            ^                           ^
            |       +-------------+     |
            +-------|vcca     vccb|-----+
                    |             |
   clk-gpios -------|a           b|-------------- SWD CLK
                    |             |
   noe-gpios -------|dir       gnd|-----+
                    +-------------+     |
                     74LVC1T45          v
                                       GND


         VCC_3V3                      VCC_REF
            ^                           ^
            |       +-------------+     |
            +-------|vcca     vccb|-----+
                    |             |
   dio-gpios -------|a           b|------------*- SWD DIO
                    |             |            |
            +-------|dir       gnd|-----+      |
            |       +-------------+     |      |
            v        74LVC1T45          v      |
           GND                         GND     |
                                               |
                                               |
         VCC_3V3                      VCC_REF  |
            ^                           ^      |
            |       +-------------+     |      |
            +-------|vcca     vccb|-----+      |
                    |             |            |
  dout-gpios -------|a           b|------------+
                    |             |
  dnoe-gpios -------|dir       gnd|-----+
                    +-------------+     |
                     74LVC1T45          v
                                       GND

  Direct connection using only dio pin for SWD DIO.

   clk-gpios ------------------------------------ SWD CLK

   dio-gpios ------------------------------------ SWD DIO

  Of course, bidirectional bus transceiver between dio and SWD DIO can also be
  used together with noe pin to enable/disable transceivers.

compatible: "zephyr,swdp-gpio"

include: base.yaml

properties:
  clk-gpios:
    type: phandle-array
    required: true
    description: GPIO pin used for SWCLK output

  dio-gpios:
    type: phandle-array
    required: true
    description: |
      GPIO pin used for SWDIO input. This pin is also used for the SWDIO output
      if separate output pin is not defined.

  dout-gpios:
    type: phandle-array
    description: |
      Optional GPIO pin used for SWDIO output.

  dnoe-gpios:
    type: phandle-array
    description: |
      GPIO pin used to disable the SWDIO output buffer behind optional
      pin dout-gpios.

  noe-gpios:
    type: phandle-array
    description: |
      Optional pin to disable all bus transceivers if any are present.

  reset-gpios:
    type: phandle-array
    description: |
      Optional GPIO pin used for RESET output.

  port-write-cycles:
    type: int
    required: true
    description: |
      Number of processor cycles for I/O Port write operations.For example, the
      GPIO clock may be different from the CPU clock. This can usually be
      found in the SoC documentation.
```

## dts/bindings/mm/intel,adsp-imr.yaml
```yaml
# SPDX-License-Identifier: Apache-2.0
#
# Copyright (c) 2022 Intel Corporation

description: INTEL Audio DSP IMR Memory

compatible: "intel,adsp-imr"

include: [mm_drv.yaml, "zephyr,memory-region.yaml"]

properties:
  reg:
    required: true

  block-size:
    required: true
    type: int
```

## dts/bindings/mm/intel,adsp-mtl-tlb.yaml
```yaml
# Copyright (c) 2022 Kumar Gala <galak@kernel.org>
#
# SPDX-License-Identifier: Apache-2.0

description: INTEL Audio DSP TLB Meteor Lake Memory Mapper

compatible: "intel,adsp-mtl-tlb"

include: mm_drv.yaml

properties:
    reg:
        required: true

    paddr-size:
        type: int
        description: Number of significant bits in the page index.
        required: true

    exec-bit-idx:
        type: int
        description: Index of the execute permission bit.

    write-bit-idx:
        type: int
        description: Index of the write permission bit.
```

## dts/bindings/mm/intel,adsp-tlb.yaml
```yaml
# Copyright (c) 2021 Intel Corporation
#
# SPDX-License-Identifier: Apache-2.0

description: INTEL Audio DSP TLB Memory Mapper

compatible: "intel,adsp-tlb"

include: mm_drv.yaml

properties:
  reg:
    required: true

  paddr-size:
    type: int
    description: Number of significant bits in the page index.
    required: true

  exec-bit-idx:
    type: int
    description: Index of the execute permission bit.

  write-bit-idx:
    type: int
    description: Index of the write permission bit.
```

## dts/bindings/mm/mm_drv.yaml
```yaml
# Copyright (c) 2021 Intel Corporation
#
# SPDX-License-Identifier: Apache-2.0

# Common fields for Memory Management Driver

include: base.yaml
```

## dts/bindings/mmc/cdns,sdhc.yaml
```yaml
# Copyright (c) 2023 Intel Corporation
# SPDX-License-Identifier: Apache-2.0

description: Cadence SDHC Controller node

compatible: "cdns,sdhc"

include: [mmc.yaml, reset-device.yaml]

properties:
  clock-frequency:
    type: int
    required: false
  reg:
    required: true
  power_delay_ms:
    type: int
    required: true
  fifo-depth:
    type: int
    required: true
```

## dts/bindings/mmc/mmc-spi-slot.yaml
```yaml
# Copyright (c) 2018 Google LLC.
# SPDX-License-Identifier: Apache-2.0

description: MMC/SD/SDIO slot connected via SPI

compatible: "zephyr,mmc-spi-slot"

include: spi-device.yaml
```

## dts/bindings/mmc/mmc.yaml
```yaml
# Copyright (c) 2019, NXP
# SPDX-License-Identifier: Apache-2.0

# Specifies the MMC/SDHC module

include: base.yaml
```

## dts/bindings/mmc/nxp,imx-usdhc.yaml
```yaml
# Copyright (c) 2019, NXP
# SPDX-License-Identifier: Apache-2.0

description: NXP i.MXRT USDHC module

compatible: "nxp,imx-usdhc"

include: mmc.yaml

properties:
    clocks:
      required: true

    pwr-gpios:
      type: phandle-array
      required: false
      description: |
        Power pin
        This pin defaults to active high when consumed by the SD card. The
        property value should ensure the flags properly describe the signal
        that is presented to the driver.

    cd-gpios:
      type: phandle-array
      required: false
      description: |
        Detect pin
        This pin defaults to active low when produced by the SD card. The
        property value should ensure the flags properly describe the signal
        that is presented to the driver.

    no-1-8-v:
      type: boolean
      required: false
      description: |
        When the external SD card circuit does not support 1.8V, add this
        property to disable 1.8v card voltage of SD card controller.

    detect-dat3:
      type: boolean
      required: false
      description: |
        Enable the host to detect an SD card via the DAT3 line of the SD card
        connection. Requires the board to define a function to pull DAT3 low or
        high using pullup/pulldown resistors.

    label:
      required: true
```

## dts/bindings/mmc/renesas,ra-sdmmc.yaml
```yaml
# Copyright (c) 2024 Renesas Electronics Corporation
# SPDX-License-Identifier: Apache-2.0

description: Renesas RA sdmmc disk access

compatible: "renesas,ra-sdmmc"

include: [base.yaml, pinctrl-device.yaml]

properties:
  channel:
    type: int
    required: true

  bus-width:
    type: int
    enum:
      - 1
      - 4
    default: 4

  block-size:
    type: int
    default: 512

  sd-support:
    type: int
    enum:
      - 0
      - 1
    default: 1

  mmc-support:
    type: int
    enum:
      - 0
      - 1
    default: 0

  card-detect:
    type: int
    enum:
      - 0
      - 1
    default: 1

  write-protect:
    type: int
    enum:
      - 0
      - 1
    default: 0

  reg:
    required: true

  pinctrl-0:
    required: true

  pinctrl-names:
    required: true

  enable-gpios:
    type: phandle-array
    description: |
      GPIO to use to enable/disable the SDHI. This GPIO is driven active
      when the SDHI is enabled and inactive when the SDHI is disabled

  interrupts:
    required: true

  interrupt-names:
    required: true
```

## dts/bindings/mmc/renesas,rcar-emmc.yaml
```yaml
description: Renesas R-Car eMMC

compatible: "renesas,rcar-mmc"

include: [sdhc.yaml, mmc.yaml, pinctrl-device.yaml, reset-device.yaml]

properties:
  clocks:
    required: true

  reg:
    required: true

  pinctrl-0:
    required: true

  pinctrl-names:
    required: true

  max-bus-freq:
    required: true

  non-removable:
    type: boolean
    description: |
      Non-removable slots (like eMMC), which are assumed to always be present,
      will affect the `sdhc_card_present` call. This call will always return
      true if this property exists for the node.

  mmc-sdr104-support:
    type: boolean

  cd-gpios:
    type: phandle-array
    description: Card Detect pin

  pwr-gpios:
    type: phandle-array
    description: Power pin

  vmmc-supply:
    type: phandle
    description: |
      Supply for the card power

  vqmmc-supply:
    type: phandle
    description: |
      Supply for the bus IO line power, such as a level shifter.
      If the level shifter is controlled by a GPIO line, this shall
      be modeled as a "regulator-fixed" with a GPIO line for
      switching the level shifter on/off.

  bus-width:
    type: int
    default: 1
    description: |
        Bus width for SDMMC access, defaults to the minimum necessary
        number of bus lines
    enum:
      - 1
      - 4
      - 8
```

## dts/bindings/mmc/snps,designware-sdmmc.yaml
```yaml
# Copyright (c) 2021 Intel Corporation
# SPDX-License-Identifier: Apache-2.0

description: Synopsys Designware SDMMC Controller node

compatible: "snps,designware-sdmmc"

include: mmc.yaml

properties:
  clock-frequency:
    type: int
    required: false
    description: clock frequency information for DW SDMMC Controller
  reg:
    required: true

  resets:
    required: true
```
