## dts/bindings/misc/adi,adg2712.yaml
```yaml
# Copyright (c) 2026 Analog Devices Inc.
# SPDX-License-Identifier: Apache-2.0

description: |
  Analog Devices ADG2712 quad SPST analog switch, GPIO control mode.
  Pin-compatible variant of the ADG1712.

  Each of the 4 SPST switches is controlled by a dedicated GPIO pin
  (IN1 through IN4).

compatible: "adi,adg2712"

include: adi,adg17xx-base.yaml

examples:
  - |
    adg2712 {
      compatible = "adi,adg2712";
      in1-gpios = <&gpio0 0 GPIO_ACTIVE_HIGH>;
      in2-gpios = <&gpio0 1 GPIO_ACTIVE_HIGH>;
      in3-gpios = <&gpio0 2 GPIO_ACTIVE_HIGH>;
      in4-gpios = <&gpio0 3 GPIO_ACTIVE_HIGH>;
    };
```

## dts/bindings/misc/adi,adg736.yaml
```yaml
# Copyright (c) 2026 Analog Devices Inc.
# SPDX-License-Identifier: Apache-2.0

description: |
  Analog Devices ADG736 dual SPDT analog switch, GPIO control mode.

  Each of the 2 SPDT switches is controlled by a dedicated GPIO pin
  (IN1 and IN2). The ADG736 has no enable pin.

compatible: "adi,adg736"

include: adi,adg1736-base.yaml

examples:
  - |
    adg736 {
      compatible = "adi,adg736";
      in1-gpios = <&gpio0 0 GPIO_ACTIVE_HIGH>;
      in2-gpios = <&gpio0 1 GPIO_ACTIVE_HIGH>;
    };
```

## dts/bindings/misc/adi,adgm3121-gpio.yaml
```yaml
# Copyright (c) 2026 Analog Devices Inc.
# SPDX-License-Identifier: Apache-2.0

description: |
  Analog Devices ADGM3121 DPDT MEMS switch (DC-24GHz), parallel GPIO
  control mode.

  Each of the 4 MEMS switches is controlled by a dedicated GPIO pin
  (IN1 through IN4).

  Example:

    adgm3121 {
      compatible = "adi,adgm3121-gpio";
      in1-gpios = <&gpio0 0 GPIO_ACTIVE_HIGH>;
      in2-gpios = <&gpio0 1 GPIO_ACTIVE_HIGH>;
      in3-gpios = <&gpio0 2 GPIO_ACTIVE_HIGH>;
      in4-gpios = <&gpio0 3 GPIO_ACTIVE_HIGH>;
    };

compatible: "adi,adgm3121-gpio"

properties:
  in1-gpios:
    type: phandle-array
    required: true
    description: GPIO controlling switch SW1 (RF1A-RFCA)

  in2-gpios:
    type: phandle-array
    required: true
    description: GPIO controlling switch SW2 (RF2A-RFCA)

  in3-gpios:
    type: phandle-array
    required: true
    description: GPIO controlling switch SW3 (RF2B-RFCB)

  in4-gpios:
    type: phandle-array
    required: true
    description: GPIO controlling switch SW4 (RF1B-RFCB)
```

## dts/bindings/misc/adi,adgm3121.yaml
```yaml
# Copyright (c) 2026 Analog Devices Inc.
# SPDX-License-Identifier: Apache-2.0

description: |
  Analog Devices ADGM3121 DPDT MEMS switch (DC-24GHz), SPI control mode.

  The ADGM3121 contains 4 MEMS switches controlled via a single SPI register
  at address 0x20 using 16-bit SPI frames (Mode 0, MSB-first, max 10MHz).

  Example:

    &spi1 {
      adgm3121: adgm3121@0 {
        compatible = "adi,adgm3121";
        reg = <0>;
        spi-max-frequency = <10000000>;
      };
    };

compatible: "adi,adgm3121"

include: spi-device.yaml
```

## dts/bindings/misc/adi,max2221x-misc.yaml
```yaml
# Copyright (c) 2025 Analog Devices Inc.
# SPDX-License-Identifier: Apache-2.0

include: base.yaml

description: Analog Devices MAX22216/MAX22217 MISC

compatible: "adi,max2221x-misc"
```

## dts/bindings/misc/adi,tmc6460-spi.yaml
```yaml
# SPDX-FileCopyrightText: Copyright (c) 2026 Cherrence Sarip <cherrence.sarip@analog.com>
# SPDX-License-Identifier: Apache-2.0

description: |
  Analog Devices / Trinamic TMC6460 motor controller (SPI mode).

  Uses 48-bit (6-byte) SPI datagrams: 2 address bytes + 4 data bytes.
  SPI Mode 1 (CPOL=0, CPHA=1), MSB first.

compatible: "adi,tmc6460"

include:
  - name: spi-device.yaml

properties:
  spi-max-frequency:
    type: int
    required: true
    description: Maximum SPI clock frequency supported by the device.

  pole-pairs:
    type: int
    default: 4
    description: |
      Number of magnetic pole pairs of the attached BLDC/PMSM motor. This is a
      physical property of the motor and is required for correct commutation
      and electrical-angle calculation.

  hall-mapping:
    type: int
    default: 3
    description: |
      Hall UVW sensor mapping value. For a correctly wired Hall sensor the
      value is 3; other values compensate for alternative sensor wiring.

  hall-io-inversion:
    type: boolean
    description: |
      Invert the polarity of all three Hall sensor inputs. Set when the Hall
      sensor outputs are wired with inverted logic levels.

  abn-ppr:
    type: int
    default: 1024
    description: |
      ABN incremental encoder pulses-per-rotation (PPR). This is a physical
      property of the attached encoder. The counts-per-rotation used by the
      controller is four times this value (quadrature decoding).

examples:
  - |
    &spi0 {
        /* SPI bus options here, not shown */

        /* TMC6460 BLDC/PMSM motor controller on SPI */
        tmc6460: tmc6460@0 {
            compatible = "adi,tmc6460";
            reg = <0>;
            spi-max-frequency = <DT_FREQ_M(1)>; /* Maximum SPI bus frequency */

            pole-pairs = <4>;         /* Motor magnetic pole pairs */
            hall-mapping = <3>;       /* Hall UVW sensor mapping */
            hall-io-inversion;        /* Invert Hall sensor input polarity */
            abn-ppr = <1024>;         /* ABN encoder pulses-per-rotation */
        };
    };
```

## dts/bindings/misc/adi,tmc6460-uart.yaml
```yaml
# SPDX-FileCopyrightText: Copyright (c) 2026 Cherrence Sarip <cherrence.sarip@analog.com>
# SPDX-License-Identifier: Apache-2.0

description: |
  Analog Devices / Trinamic TMC6460 motor controller (UART mode).

  The TMC6460 UART protocol differs from other Trinamic chips:
  - Sync byte: 0x42 (not 0x05)
  - 16-bit register addresses encoded in two bytes
  - CRC8 polynomial: 0x100011011 (reflected), optional
  - Supports RTMI (Real-Time Motion Interface) streaming

compatible: "adi,tmc6460"

include: [uart-device.yaml]

properties:
  uart-crc:
    type: boolean
    description: |
      Enable CRC8 for UART communication.
      When set, an additional CRC byte is appended to each datagram.
      Both normal (read/write) and RTMI CRC are enabled.

  pole-pairs:
    type: int
    default: 4
    description: |
      Number of magnetic pole pairs of the attached BLDC/PMSM motor. This is a
      physical property of the motor and is required for correct commutation
      and electrical-angle calculation.

  hall-mapping:
    type: int
    default: 3
    description: |
      Hall UVW sensor mapping value. For a correctly wired Hall sensor the
      value is 3; other values compensate for alternative sensor wiring.

  hall-io-inversion:
    type: boolean
    description: |
      Invert the polarity of all three Hall sensor inputs. Set when the Hall
      sensor outputs are wired with inverted logic levels.

  abn-ppr:
    type: int
    default: 1024
    description: |
      ABN incremental encoder pulses-per-rotation (PPR). This is a physical
      property of the attached encoder. The counts-per-rotation used by the
      controller is four times this value (quadrature decoding).
```

## dts/bindings/misc/allegro,a4988.yaml
```yaml
# Copyright (c) 2023 Kindhome Sp. z o.o <kindhome.io>
# SPDX-License-Identifier: Apache-2.0

description: Allegro Microsystems a4988 Microstepping Driver

compatible: "allegromicro,a4988"

include: base.yaml

properties:
  ms1-gpios:
    type: phandle-array
    required: true
  ms2-gpios:
    type: phandle-array
    required: true
  ms3-gpios:
    type: phandle-array
    required: true
  direction-gpios:
    type: phandle-array
    required: true
  enable-gpios:
    type: phandle-array
    required: true
  reset-gpios:
    type: phandle-array
    required: true
  sleep-gpios:
    type: phandle-array
    required: true
  step-gpios:
    type: phandle-array
    required: true
```

## dts/bindings/misc/analogix,anx7327.yaml
```yaml
# Copyright (c) 2025 Applied Materials
# SPDX-License-Identifier: Apache-2.0

description: Analogix ANX7327 USB-PD v3.0 port controller

compatible: "analogix,anx7327"

include: i2c-device.yaml

properties:
  int-pin-gpios:
    type: phandle-array
    description: |
      GPIO connected to video interrupt pin of anx7533.
  i2c-addr-2:
    type: int
    description: |
      second i2c address of the device
```

## dts/bindings/misc/analogix,anx7533.yaml
```yaml
# Copyright (c) 2025 Applied Materials
# SPDX-License-Identifier: Apache-2.0

description: Analogix ANX7533 low-power 4K Ultra-HD (4096x2160p60) mobile HD receiver

compatible: "analogix,anx7533"

include: i2c-device.yaml

properties:
  vid-en-pin-gpios:
    type: phandle-array
    description: |
      GPIO connected to video enable pin of anx7533.
  vid-rst-pin-gpios:
    type: phandle-array
    description: |
      GPIO connected to video reset pin of anx7533.
  vid-int-pin-gpios:
    type: phandle-array
    description: |
      GPIO connected to video interrupt pin of anx7533.
  reg-offset:
    type: int
    description: |
      i2c address of the device offset
  reg-offset-rd:
    type: int
    description: |
      i2c address of the device offset read
```

## dts/bindings/misc/at,at32-syscfg.yaml
```yaml
# Copyright (c) 2021 Teslabs Engineering S.L.
# SPDX-License-Identifier: Apache-2.0

description: AT32 System Configuration Registers

compatible: "at,at32-syscfg"

include: base.yaml

properties:
  reg:
    required: true

  clocks:
    required: true
```

## dts/bindings/misc/dap.sw_gpio.yaml
```yaml
# Copyright (c) 2019, Phytec Messtechnik GmbH
# SPDX-License-Identifier: Apache-2.0

title: Blah blah

description: >
    This is a representation of the SW GPIO interface

compatible: "dap,sw_gpio"

include: base.yaml

properties:
    clk-gpios:
      type: phandle-array
      required: true
      description: GPIO pin used for SWCLK output

    dout-gpios:
      type: phandle-array
      required: true
      description: GPIO pin used for SWDIO output

    din-gpios:
      type: phandle-array
      required: true
      description: GPIO pin used for SWDIO input

    dnoe-gpios:
      type: phandle-array
      required: true
      description: GPIO pin used for SWDIO NOE output

    noe-gpios:
      type: phandle-array
      required: true
      description: GPIO pin used for SWD NOE output

    reset-gpios:
      type: phandle-array
      required: true
      description: GPIO pin used for RESET input

    port-write-cycles:
      type: int
      required: true
      description: Number of processor cycles for I/O Port write operations
```

## dts/bindings/misc/ene,kb106x-gcfg.yaml
```yaml
# Copyright (c) 2025 ENE Technology Inc.
# SPDX-License-Identifier: Apache-2.0

description: ENE, General Configuration

compatible: "ene,kb106x-gcfg"

include: [base.yaml]

properties:
  reg:
    required: true
```

## dts/bindings/misc/ene,kb1200-gcfg.yaml
```yaml
# Copyright (c) 2024 ENE Technology Inc.
# SPDX-License-Identifier: Apache-2.0

description: ENE, General Configuration node

compatible: "ene,kb1200-gcfg"

include: [base.yaml]

properties:
  reg:
    required: true
```

## dts/bindings/misc/ene,kb1200-pmu.yaml
```yaml
# Copyright (c) 2024 ENE Technology Inc.
# SPDX-License-Identifier: Apache-2.0

description: ENE, Power Manager node

compatible: "ene,kb1200-pmu"

include: [base.yaml]

properties:
  reg:
    required: true
```

## dts/bindings/misc/espressif,esp-tool.yaml
```yaml
# Copyright (c) 2025 Espressif Systems (Shanghai) Co., Ltd.
# SPDX-License-Identifier: Apache-2.0

description: |
  ESP tool is device that communicates with the target using either
  UART or SPI, selected via devicetree.
  ESP tool is multipurpose interface based on ESP Serial Flasher library.
  Interface needs UART or SPI peripheral, together with boot and reset pins.
  PIO pins. It is used to program and control external
  target device.

compatible: "espressif,esp-tool"

include:
  - base.yaml

properties:
  uart:
    type: phandle
    required: false
    description: UART used for communication

  spi:
    type: phandle
    required: false
    description: SPI controller used for communication

  cs-gpios:
    type: phandle-array
    required: false
    description: Chip select GPIO (required for SPI mode)

  reset-gpios:
    type: phandle-array
    required: true
    description: Target reset GPIO

  boot-gpios:
    type: phandle-array
    required: true
    description: Target boot GPIO

  initial-baudrate:
    type: int
    required: false

  higher-baudrate:
    type: int
    required: false

  num-trials:
    type: int
    required: true

  sync-timeout-ms:
    type: int
    required: true

# additionalProperties: false
#
#oneOf:
#  - required: [ uart ]
#  - required: [ spi ]
```

## dts/bindings/misc/espressif,esp32-lcd-cam.yaml
```yaml
# Copyright (c) 2025 Chen Xingyu <hi@xingrz.me>
# SPDX-License-Identifier: Apache-2.0

description: |
  ESP32 LCD-CAM controller

  The LCD-CAM controller consists of two functional modules: an LCD output block
  and a DVP camera input block. Both modules share the same clock and pinctrl
  resources.

compatible: "espressif,esp32-lcd-cam"

include: [base.yaml, pinctrl-device.yaml]
```

## dts/bindings/misc/espressif,esp32-rmt-device.yaml
```yaml
# SPDX-FileCopyrightText: Copyright The Zephyr Project Contributors
# SPDX-License-Identifier: Apache-2.0

# Common fields for Espressif RMT devices

include: [base.yaml]

on-bus: "espressif,esp32-rmt"

properties:
  reg:
    required: true
```

## dts/bindings/misc/espressif,esp32-rmt.yaml
```yaml
# SPDX-FileCopyrightText: Copyright The Zephyr Project Contributors
# SPDX-License-Identifier: Apache-2.0

description: |
    Espressif Remote Control Transceiver (RMT)

    The RMT (Remote Control Transceiver) peripheral was designed to act as an infrared transceiver.
    However, due to the flexibility of its data format, RMT can be extended to a versatile and
    general-purpose transceiver, transmitting or receiving many other types of signals.

    pinctrl is used to configure RMT channels and GPIO to be used.
    When using ESP32 or ESP32S2 series, each RMT channel should be used once (eg. RMT_OUT0_GPIOxx
    and RMT_IN0_GPIOxx can't be used at the same time, etc.). An error is displayed when trying to
    create channels whith such configuration.
    This limitation is due to the number of channels available. See
    `SOC_RMT_TX_CANDIDATES_PER_GROUP`, `SOC_RMT_RX_CANDIDATES_PER_GROUP` and
    `SOC_RMT_CHANNELS_PER_GROUP` for more details.

    DMA feature is available only on ESP32S3 and with only one "tx" and one "rx" DMA channels
    available. DMA channels are optional. Using DMA channels is activated configuring DMA channels
    in the RMT peripheral and configuring pinctrl to use DMA capable RMT channels
    (eg. RMT_OUT3_GPIOxx and RMT_OUT3_GPIOxx on ESP32S3).

    Here is an example ESP32 configuration with a RMT device:

    &pinctrl {
      rmt_default: rmt_default {
        group1 {
          pinmux = <RMT_OUT3_GPIO13>;
        };

        group2 {
          pinmux = <RMT_IN3_GPIO12>;
        };
      };
    };

    rmt: rmt@60016000 {
        compatible = "espressif,esp32-rmt";
        #address-cells = <1>;
        #size-cells = <0>;
        reg = <0x60016000 0x1000>;
        pinctrl-0 = <&rmt_default>;
        pinctrl-names = "default";
        dmas = <&dma 8>, <&dma 9>;
        dma-names = "rx", "tx";
        interrupts = <RMT_INTR_SOURCE IRQ_DEFAULT_PRIORITY 0>;
        interrupt-parent = <&intc>;
        clocks = <&clock ESP32_RMT_MODULE>;
        status = "okay";
    };

compatible: "espressif,esp32-rmt"

include: [base.yaml, pinctrl-device.yaml]

bus: "espressif,esp32-rmt"

properties:
  reg:
    required: true

  pinctrl-0:
    required: true

  pinctrl-names:
    required: true

  clocks:
    required: true

  interrupts:
    required: true

  interrupt-parent:
    required: true
```
