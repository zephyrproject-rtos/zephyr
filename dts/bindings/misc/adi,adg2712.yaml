## dts/bindings/misc/gardena,antenna.yaml
```yaml
# Copyright (c) 2023 GARDENA GmbH
#
# SPDX-License-Identifier: Apache-2.0

description: default GPIO config for GARDENA sim3u radio module

compatible: "gardena,antenna"

include: base.yaml

properties:
    diversity-mode-gpios:
        type: phandle-array
        required: true
    diversity-state-gpios:
        type: phandle-array
        required: true
    antenna-control-gpios:
        type: phandle-array
        required: true
    antenna-input-gpios:
        type: phandle-array
        required: true
    led-red-input-gpios:
        type: phandle-array
        required: true
    led-green-input-gpios:
        type: phandle-array
        required: true
    led-blue-input-gpios:
        type: phandle-array
        required: true
```

## dts/bindings/misc/gd,gd32-syscfg.yaml
```yaml
# Copyright (c) 2021 Teslabs Engineering S.L.
# SPDX-License-Identifier: Apache-2.0

description: GigaDevice GD32 System Configuration Registers

compatible: "gd,gd32-syscfg"

include: base.yaml

properties:
  reg:
    required: true

  rcu-periph-clock:
    type: int
    description: Reset Control Unit Peripheral Clock ID
    required: true
```

## dts/bindings/misc/google,openthread-spinel.yaml
```yaml
# Copyright (c) 2022, Basalte bv
# SPDX-License-Identifier: Apache-2.0

description: Virtual device to communicate with RCP using Spinel

compatible: "google,openthread-spinel"

include: spi-device.yaml

properties:
  irq-gpios:
    type: phandle-array
    required: false
    description: Interrupt pin

      Optional interript pin asserted by the RCP
      radio device on data ready.

  reset-gpios:
    type: phandle-array
    required: false
    description: RESET pin

      The RESET pin of the RCP radio device.

  reset-time:
    type: int
    required: false
    default: 1
    description: The duration (in ms) for the RCP radio reset.

  startup-time:
    type: int
    required: false
    default: 0
    description: The duration (in ms) for the RCP radio startup.

  cs-delay:
    type: int
    required: false
    default: 0
    description: The delay (in ms) for the RCP radio chip select.
```

## dts/bindings/misc/id8,buzzer.yaml
```yaml
# Copyright (c) 2026 ID8 Engineering AB
# SPDX-License-Identifier: Apache-2.0

description: ID8 buzzer driven from a PWM output

compatible: "id8,buzzer"

properties:
  pwms:
    type: phandle-array
    required: true
    description: PWM specifier used to drive the buzzer.
```

## dts/bindings/misc/infineon,gpu.yaml
```yaml
# SPDX-FileCopyrightText: <text>Copyright (c) 2026 Infineon Technologies AG,
# or an affiliate of Infineon Technologies AG.</text>
#
# SPDX-License-Identifier: Apache-2.0

description: Infineon GPU graphics accelerator

compatible: "infineon,gpu"

include: base.yaml

properties:
  reg:
    required: true

  interrupts:
    required: true
```

## dts/bindings/misc/infineon,system-interrupts.yaml
```yaml
# Copyright (c) 2023 Cypress Semiconductor Corporation (an Infineon company) or
# an affiliate of Cypress Semiconductor Corporation
#
# SPDX-License-Identifier: Apache-2.0

properties:
  system-interrupts:
    type: array
    description: |
      Information about system interrupts generated by the device (peripherals, etc), encoded
      as an array of one or more interrupt specifiers.
```
