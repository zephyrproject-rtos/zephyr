## dts/bindings/misc/ti,cc35xx-hsm.yaml
```yaml
# Copyright (c) 2025 Conclusive Engineering Sp. z o.o.
# SPDX-License-Identifier: Apache-2.0

description: TI SimpleLink CC35xx HSM (Hardware Security Module)

compatible: "ti,cc35xx-hsm"

include: base.yaml

properties:
  "#address-cells":
    const: 1
  "#size-cells":
    const: 0
```

## dts/bindings/misc/ti,unicomm.yaml
```yaml
# Copyright 2026 Texas Instruments Incorporated
# SPDX-License-Identifier: Apache-2.0

description: Texas Instruments Unified Communication Peripheral

compatible: "ti,unicomm"

include: base.yaml

properties:
  reg:
    required: true

  interrupts:
    required: true

  unicomm-fixed-mode:
    type: boolean
    description: |
      Guards against an invalid write to IPMODE on UNICOMMs that have only one mode.
```

## dts/bindings/misc/zephyr,modbus-serial.yaml
```yaml
# Copyright (c) 2020 PHYTEC Messtechnik GmbH
# SPDX-License-Identifier: Apache-2.0

description: Modbus over serial line device

compatible: "zephyr,modbus-serial"

include: uart-device.yaml

properties:
  de-gpios:
    type: phandle-array
    description: Driver enable pin.

      Driver enable pin (DE) of the RS-485 transceiver.
      If connected directly the MCU pin should be configured
      as active high.

  re-gpios:
    type: phandle-array
    description: Receiver enable pin.

      Receiver enable pin (nRE) of the RS-485 transceiver.
      If connected directly the MCU pin should be configured
      as active low.

  use-rtu-timeout-override:
    type: boolean
    description: Use rtu-timeout-override instead of the calculated RTU timeout.

      By default, the RTU timeout (inter-frame delay t3.5) is calculated from the
      baud rate and limited to the value at 38400 baud (about 1 ms) for higher
      baud rates. Set this property to use rtu-timeout-override instead, e.g. for
      protocols with response times below 1 ms at high baud rates.

  rtu-timeout-override:
    type: int
    description: RTU timeout in microseconds, used if use-rtu-timeout-override is set.

      0 is only supported with CONFIG_MODBUS_SERIAL_ASYNC_API. The end of a frame
      is then detected by the UART driver, e.g. by an idle line interrupt, without
      an additional delay.
```

## dts/bindings/misc/zephyr,security-partition.yaml
```yaml
# SPDX-FileCopyrightText: Copyright (c) 2026 Infineon Technologies AG,
# SPDX-FileCopyrightText: or an affiliate of Infineon Technologies AG. All rights reserved.
#
# SPDX-License-Identifier: Apache-2.0

title: CPU security-attribution region table

description: |
  Region table for the arch security-partition API (ARMv8-M SAU, and
  equivalents on other architectures).  Each child node describes one
  address region and the security attribution to apply to it; Secure-world
  code reads the children and passes them to
  arch_security_partition_configure().

  Example:

    security_partition {
        compatible = "zephyr,security-partition";
        #address-cells = <1>;
        #size-cells = <1>;

        region@0 {
            reg = <0x00000000 0x10000000>;
            zephyr,attr = "non-secure";
        };
        region@18110000 {
            reg = <0x18110000 0x2000>;
            zephyr,attr = "non-secure-callable";
        };
    };

compatible: "zephyr,security-partition"

child-binding:
  description: One security-attributed address region.

  properties:
    reg:
      type: array
      required: true
      description: "<base size> of the region, in bytes."

    zephyr,attr:
      type: string
      required: true
      enum:
        - "secure"
        - "non-secure"
        - "non-secure-callable"
      description: |
        Security attribution for the region.  The enum order matches
        enum arch_security_attr (secure, non-secure, non-secure-callable),
        so DT_ENUM_IDX() maps directly onto it.
```

## dts/bindings/modem/fibocom,le250.yaml
```yaml
# SPDX-FileCopyrightText: Copyright (c) 2026 Julien Vermillard <julien@clunkymachines.com>
# SPDX-License-Identifier: Apache-2.0

description: Fibocom LE250 cellular modem

compatible: "fibocom,le250"

include: zephyr,cellular-modem-device.yaml

properties:
  mdm-power-gpios:
    type: phandle-array
    description: |
      Active-low, open-drain connection to the LE250 PWRKEY input. The host
      must release this signal when inactive because PWRKEY is internally
      pulled up by the modem.
```

## dts/bindings/modem/modem-sims.yaml
```yaml
# Copyright (c) 2026 Pedro Ramos
# SPDX-License-Identifier: Apache-2.0

description: |
  SIM slots of a cellular modem.

  A node with this compatible, named "sim-slots", is a child of the modem node.
  Each of its children is one SIM slot: a SIM holder, or a SIM interface of the
  modem. A slot is selected by applying the MUX state in its mux-states
  property, for example a gpio-mux driving a switch that routes the SIM lines
  of the modem to one of several SIM holders.

  A modem node without a sim-slots child has a single SIM.

  Example of a modem with one SIM interface, switched between two SIM holders
  by one GPIO:

    sim_mux: sim-mux {
            compatible = "gpio-mux";
            #mux-control-cells = <0>;
            #mux-state-cells = <1>;
            mux-gpios = <&gpio0 5 GPIO_ACTIVE_HIGH>;
    };

    &uart1 {
            modem {
                    compatible = "quectel,bg95";

                    sim-slots {
                            compatible = "modem-sims";
                            #address-cells = <1>;
                            #size-cells = <0>;

                            sim0: sim-slot@0 {
                                    reg = <0>;
                                    mux-states = <&sim_mux 0>;
                                    default-sim;
                            };

                            sim1: sim-slot@1 {
                                    reg = <1>;
                                    mux-states = <&sim_mux 1>;
                            };
                    };
            };
    };

compatible: "modem-sims"

properties:
  "#address-cells":
    type: int
    required: true
    const: 1

  "#size-cells":
    type: int
    required: true
    const: 0

child-binding:
  description: |
    One SIM slot.

  include:
    - name: mux-consumer.yaml
      property-allowlist:
        - mux-states

  properties:
    reg:
      type: array
      required: true
      description: |
        Index of the SIM slot, from 0 to 255. This is the slot index of the
        cellular API.

    mux-states:
      required: true
      description: |
        MUX state that routes the modem to this SIM slot.

    default-sim:
      type: boolean
      description: |
        Select this SIM slot when the device starts. At most one slot can have
        this property. Without it, the first slot is selected.
```

## dts/bindings/modem/nordic,nrf91-sm-v2.yaml
```yaml
# Copyright (c) 2026 Nordic Semiconductor ASA
# SPDX-License-Identifier: Apache-2.0

title: Nordic nRF91 Serial Modem

description: |
  Nordic nRF91 series running the Serial Modem application v2.0.0 or later.
  This includes the nRF91M1 module.

compatible: "nordic,nrf91-sm-v2"

include: zephyr,cellular-modem-device.yaml

properties:
  zephyr,use-default-pdp-ctx:
    default: 1

  zephyr,mdm-reset-behavior:
    default: ["toggle_on_recovery"]
```

## dts/bindings/modem/quectel,bg770.yaml
```yaml
# Copyright (c) 2026 Mark Geiger
# SPDX-License-Identifier: Apache-2.0

description: Quectel BG770 modem

compatible: "quectel,bg770"

include: zephyr,cellular-modem-device.yaml

properties:
  mdm-power-gpios:
    type: phandle-array

  mdm-reset-gpios:
    type: phandle-array
    required: true

  zephyr,mdm-reset-behavior:
    default: ["hold_on_suspend", "toggle_on_resume", "toggle_on_recovery"]
```

## dts/bindings/modem/quectel,eg21-g.yaml
```yaml
# Copyright (c) 2026 Guilherme Costa
# SPDX-License-Identifier: Apache-2.0

description: Quectel EG21-G modem

compatible: "quectel,eg21-g"

include: zephyr,cellular-modem-device.yaml

properties:
  mdm-reset-gpios:
    type: phandle-array

  mdm-dtr-gpios:
    type: phandle-array

  mdm-wdisable-gpios:
    type: phandle-array

  target-baudrate:
    enum: [9600, 19200, 38400, 57600, 115200, 230400, 460800, 921600]

  zephyr,mdm-reset-behavior:
    default: ["toggle_on_recovery"]
```

## dts/bindings/modem/quectel,eg25-g.yaml
```yaml
description: Quectel EG25-G modem

compatible: "quectel,eg25-g"

include: zephyr,cellular-modem-device.yaml

properties:
  mdm-reset-gpios:
    type: phandle-array

  mdm-dtr-gpios:
    type: phandle-array

  mdm-wdisable-gpios:
    type: phandle-array

  target-baudrate:
    enum: [9600, 19200, 38400, 57600, 115200, 230400, 460800, 921600]

  zephyr,mdm-reset-behavior:
    default: ["toggle_on_recovery"]
```

## dts/bindings/modem/telit,le910c1tx.yaml
```yaml
# Copyright(c) 2026 Telit Cinterion S.p.A. All rights reserved.
# SPDX-License-Identifier: Apache-2.0

description: Telit LE910C1tx Modem

compatible: "telit,le910c1tx"

include: zephyr,cellular-modem-device.yaml

properties:
  zephyr,mdm-reset-behavior:
    default: ["toggle_on_resume", "toggle_on_recovery"]

  mdm-power-gpios:
    type: phandle-array
    required: true

  mdm-reset-gpios:
    type: phandle-array
    required: true
```

## dts/bindings/modem/trasna,lexi-r7.yaml
```yaml
# Copyright (c) 2026, Trasna.io
# SPDX-License-Identifier: Apache-2.0

description: Trasna LEXI-R7 modem

compatible: "trasna,lexi-r7"

include: zephyr,cellular-modem-device.yaml

properties:
  zephyr,mdm-reset-behavior:
    default: ["toggle_on_recovery"]
```

## dts/bindings/mspi/microchip,qspi-g1-mspi.yaml
```yaml
# Copyright (c) 2026 Microchip Technology Inc.
# SPDX-License-Identifier: Apache-2.0
title: Microchip MSPI G1 QSPI driver

description: |
    Microchip MSPI driver bindings.

    Group g1 MSPI driver supports following hardware peripherals:
    - name="QSPI" id="U2008" version="1.6.3"

compatible: "microchip,qspi-g1-mspi"

include:
  - base.yaml
  - pinctrl-device.yaml
  - mspi-controller.yaml

properties:
  reg:
    required: true

  interrupts:
    required: true

  clocks:
    required: true
    description: APB, AHB, and AHB2X.

  clock-names:
    required: true
    enum: ["apb", "ahb", "ahb2x"]

  scramble-key:
    type: int
    description: |
      32-bit user key for QSPI scrambling. Required if scrambling is used.
      WARNING: This key is stored in plain text in the devicetree. For
      production use, consider secure key provisioning mechanisms.

  scramble-random-disable:
    type: boolean
    description: |
      When set, the scrambling algorithm uses only the user key (portable
      between devices). When not set (default), a chip-specific random value
      is included (more secure but data cannot be unscrambled by other chips).
```

## dts/bindings/mspi/microchip,xec-gpspi-v2-controller.yaml
```yaml
# Copyright (c) 2026 Microchip Technology Inc. and its subsidiaries.
# SPDX-License-Identifier: Apache-2.0

description: Microchip XEC General Purpose SPI(GPSPI-V2) MSPI controller

compatible: "microchip,xec-gpspi-v2-controller"

include: [base.yaml, mspi-controller.yaml, pinctrl-device.yaml]

properties:
  reg:
    required: true

  interrupts:
    required: true

  pinctrl-0:
    required: true

  pinctrl-names:
    required: true

  clock-frequency:
    type: int
    required: true
    description: |
      QMSPI input clock frequency in Hz. For MEC175x this is 96000000.

  pcr-scr:
    type: int
    required: true
    description: |
      PCR sleep control register encoding for power gating this peripheral.

  girqs:
    type: array
    required: true
    description: |
      GIRQ and bit-position encoding for this peripheral interrupt source.

  dmas:
    description: |
      Optional DMA channel specifier, required for DMA transactions.
      For example dmas = <phandle-to-central-dma chan-number dma-slot-num>
      The dma-slot-number is Device Number from the DMA Host Device Selection
      table in the chip data sheet. GP-SPI controller uses two DMA channel one
      for transmit and the second for receive. For example in MEC175x GP-SPI
      controller 0 DMA Device Number 12 is transmit and Device Number 13 is
      receive. We choose DMA channel 5 for TX and channel 6 for RX:
         dmas = <&dmac 5 12>, <&dmac 6 13>;

  dma-names:
    description: |
      DMA channel name. If DMA should be used, expected value is "tx" or "rx".

      For example
         dma-names = "tx", "rx";
    enum:
      - "tx"
      - "rx"
```

## dts/bindings/mspi/nordic,nrf-mspi.yaml
```yaml
# Copyright (c) 2025 Nordic Semiconductor ASA
# SPDX-License-Identifier: Apache-2.0

description: Nordic MSPI Interface using SSI IP

compatible: "nordic,nrf-mspi"

include: snps,designware-ssi.yaml

properties:
  nordic,hspadctrl:
    type: phandle
    description: |
      GPIO port whose base address is shared with the GPIOHSPADCTRL peripheral
      that provides the elastic buffer for this MSPI instance. The referenced
      node must have the hspadctrl-supported property.

  nordic,hspadctrl-index:
    type: int
    min: 0
    max: 1
    description: |
      Index of the GPIOHSPADCTRL.CTRL register that provides the elastic buffer
      for this MSPI instance.

  nordic,enable-elastic-buffer:
    type: boolean
    description: |
      Enable the elastic buffer in GPIOHSPADCTRL for this MSPI instance. The
      buffer samples incoming data with a feedback clock that has passed
      through a replica pad, which cancels the pad delay variation over
      process, voltage and temperature. Requires nordic,hspadctrl, and the
      nordic,eb-rx-delay and rx-sample-delay (snps,designware-ssi.yaml)
      properties to be set.

      The driver programs the buffer with the same clock polarity and phase
      as the MSPI core, which covers a board round trip delay of up to one
      SCK period with CPHA=0, but only up to half an SCK period with CPHA=1.
      Covering up to a full period with CPHA=1 takes the buffer programmed
      with CPOL and CPHA swapped plus a wait cycle inserted into the
      transfer, which is not supported yet.

  nordic,eb-rx-delay:
    type: int
    min: 0
    max: 7
    description: |
      Value for GPIOHSPADCTRL.CTRL[n].RXDELAY, in clock cycles of the MSPI
      core clock. Determines how long the elastic buffer waits before handing
      captured data over to the core clock domain. Only has an effect if
      nordic,enable-elastic-buffer is set. Chosen together with rx-sample-delay
      (snps,designware-ssi.yaml): the core has to sample after the buffer has
      released the data but before the next SCK cycle overwrites it, so
      rx-sample-delay belongs in [nordic,eb-rx-delay + 3, nordic,eb-rx-delay
      + 2 + the SCK period in core clock cycles]. Recommended to be set to 7.
```

## dts/bindings/mspi/nxp,lpc-spifi.yaml
```yaml
# SPDX-FileCopyrightText: Copyright The Zephyr Project Contributors
# SPDX-License-Identifier: Apache-2.0

title: NXP LPC SPIFI controller

description: |
  The SPIFI block on the LPC546xx family drives one serial
  flash device with single, dual or quad data lines.

  reg lists two regions selected by reg-names:
    - "control": the SPIFI register block
    - "memory": the memory-mapped flash window

compatible: "nxp,lpc-spifi"

include: [base.yaml, pinctrl-device.yaml, reset-device.yaml, mspi-controller.yaml]

properties:
  reg:
    required: true

  reg-names:
    required: true

  clocks:
    required: true

  clock-frequency:
    required: true

  pinctrl-0:
    required: true

  pinctrl-names:
    required: true
```
