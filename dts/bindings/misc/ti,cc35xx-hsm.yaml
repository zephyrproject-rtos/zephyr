## dts/bindings/mspi/raspberrypi,pico-mspi-pio.yaml
```yaml
# Copyright (c) 2026 WIZnet Co., Ltd.
# SPDX-License-Identifier: Apache-2.0

description: |
  Raspberry Pi Pico (RP2040/RP2350) PIO-based MSPI controller.

  Implements MSPI_IO_MODE_QUAD_1_4_4: a 1-wire serial instruction byte
  followed by 4-wire quad address, dummy, and data phases.

  The node must be a child of a PIO device node (&pio0 or &pio1).

  The state machine spends four cycles on every SCLK period, so a device's
  mspi-max-frequency has to stay at or below clk_sys / 4: 37.5 MHz on the
  RP2350 and 31.25 MHz on the RP2040.  The controller rejects a device
  configuration it cannot clock.

  Example:

    &pio0 {
      mspi0: mspi0 {
        compatible = "raspberrypi,pico-mspi-pio";
        clocks = <&clocks RPI_PICO_CLKID_CLK_SYS>;
        #address-cells = <1>;
        #size-cells = <0>;
        pinctrl-0 = <&pio0_qspi_default>;
        pinctrl-names = "default";
        clk-gpios = <&gpio0 17 GPIO_ACTIVE_HIGH>;
        io0-gpios = <&gpio0 18 GPIO_ACTIVE_HIGH>;
        io1-gpios = <&gpio0 19 GPIO_ACTIVE_HIGH>;
        io2-gpios = <&gpio0 20 GPIO_ACTIVE_HIGH>;
        io3-gpios = <&gpio0 21 GPIO_ACTIVE_HIGH>;
        ce-gpios = <&gpio0 16 GPIO_ACTIVE_LOW>;
        status = "okay";

        w6300: w6300@0 {
          compatible = "wiznet,w6300";
          reg = <0>;
          mspi-max-frequency = <33000000>;
          mspi-io-mode = "MSPI_IO_MODE_QUAD_1_4_4";
          ...
        };
      };
    };

compatible: "raspberrypi,pico-mspi-pio"

include: [mspi-controller.yaml, pinctrl-device.yaml]

properties:
  clk-gpios:
    type: phandle-array
    required: true
    description: SPI clock (SCLK) GPIO.

  io0-gpios:
    type: phandle-array
    required: true
    description: Data line IO0 (MOSI in single-wire mode).

  io1-gpios:
    type: phandle-array
    required: true
    description: Data line IO1 (MISO in single-wire mode).

  io2-gpios:
    type: phandle-array
    required: true
    description: Data line IO2.  Must be io0 pin + 2.

  io3-gpios:
    type: phandle-array
    required: true
    description: Data line IO3.  Must be io0 pin + 3.

  clocks:
    required: true
    description: Clock source for computing the PIO clock divider.

  dmas:
    required: true
    description: |
      TX and RX DMA channels used to feed and drain the PIO FIFOs.
      Only the channel cell is used; the data request line is derived at
      runtime from the PIO state machine the driver is given, so the slot
      cell is ignored.

  dma-names:
    required: true
    description: Must be "tx" and "rx".
```

## dts/bindings/mspi/st,nor-mspi.yaml
```yaml
# Copyright (c) 2026 EXALT Technologies.
# SPDX-License-Identifier: Apache-2.0

description: STM32 memory device on mspi bus

compatible: "st,nor-mspi"

include: jedec,nor-mspi.yaml

properties:
  st,mem-type:
    type: string
    enum:
      - "micron"
      - "macronix"
      - "apmem"
      - "macronix_ram"
      - "hyperbus"
      - "apmem_16bits"
    required: true
    description: |
        Selects the memory type programmed into the controller MTYP field.

        - "micron": Micron memories.
        - "macronix": Macronix memories.
```

## dts/bindings/mspi/st,stm32-qspi-controller.yaml
```yaml
# Copyright (c) 2025 EXALT Technologies.
# SPDX-License-Identifier: Apache-2.0

description: STM32 QSPI controller

compatible: "st,stm32-qspi-controller"

include: [base.yaml, pinctrl-device.yaml, mspi-controller.yaml]

properties:
  reg:
    required: true

  interrupts:
    required: true

  pinctrl-0:
    required: true

  pinctrl-names:
    required: true

  clock-names:
    required: true

  clocks:
    required: true

  dmas:
    description: |
      Optional DMA channel specifier, required for DMA transactions.
      For example dmas for TX/RX on QSPI
         dmas = <&dma1 5 41 0x10000>;

  dma-names:
    description: |
      DMA channel name. If DMA should be used, expected value is "tx_rx".

      For example
         dma-names = "tx_rx";
    enum:
      - "tx_rx"

  st,ssht-enable:
    type: boolean
    description: |
      Enables Sample Shifting half-cycle.

      It is recommended to be enabled in STR mode and disabled in DTR mode.

  clock-frequency:
    required: true

  st,cs-high-time:
    type: int
    default: 8
    min: 1
    max: 8
    description: |
      Minimum number of QSPI clock cycles the chip select signal must remain
      high between commands issued to the flash memory.

      The minimum acceptable value depends on the flash memory model and the
      QSPI clock frequency. Using a value higher than the minimum required by
      the flash memory does not lead to communication errors, but is
      suboptimal as it reduces the throughput.

      Defaults to 8 clock cycles, which is the maximum supported value.
```

## dts/bindings/mspi/st,stm32-xspi-controller.yaml
```yaml
# Copyright (c) 2025 EXALT Technologies.
# SPDX-License-Identifier: Apache-2.0

description: |
    STM32 XSPI controller.

compatible: "st,stm32-xspi-controller"

include: [base.yaml, pinctrl-device.yaml, mspi-controller.yaml]

properties:
  reg:
    required: true

  interrupts:
    required: true

  pinctrl-0:
    required: true

  pinctrl-names:
    required: true

  clocks:
    required: true

  clock-names:
    required: true

  dma-names:
    description: DMA channel name.
    enum:
      - tx
      - rx

  st,ssht-enable:
    type: boolean
    description: |
      Enables Sample Shifting half-cycle.

      It is recommended to be enabled in STR mode and disabled in DTR mode.

  clock-frequency:
    required: true

  st,csbound:
    type: int
    default: 3
    description: |
      Limit a transaction to a boundary of aligned addresses. The size of the
      alignment is given by the value: 2^(csbound) bits.
      A csbound value of 0 means the feature is disabled.
      The default is the minimum recommended value in the Reference Manual. It
      is recommended to set this value according to the length of the burst wrap
      of the PSRAM device for the linear burst command.
    min: 0
    max: 31

  st,refresh:
    type: int
    default: 0
    description: |
      Refresh rate in number of memory clock cycles. The chip select is
      released every refresh + 1 clock cycles for writes and refresh + 4
      clock cycles for reads, also while the memory-mapped prefetch holds
      it low. Required by PSRAM devices with a maximum chip select low time
      (tCEM). Set it below tCEM expressed in memory clock cycles.
      A value of 0 means the feature is disabled.
```

## dts/bindings/mspi/zephyr,mspi-bitbang-controller.yaml
```yaml
# SPDX-FileCopyrightText: Copyright The Zephyr Project Contributors
# SPDX-License-Identifier: Apache-2.0

title: Bitbang MSPI controller

description: |
  MSPI controller implemented in software on GPIO pins.

  The controller supports synchronous programmed I/O transfers in controller
  mode, half duplex, with all I/O modes up to the number of io-gpios entries,
  all data rates and all clock polarity and phase modes. Transfers run as fast
  as the GPIO accesses allow, at most at the frequency a device requests.

  Limitations:

  - Asynchronous transfers are rejected with -ENOTSUP.

  - The MSPI_DMA and MSPI_MEMMAP transfer modes are rejected with -ENOTSUP.

  - Full duplex and DQS are rejected with -ENOTSUP.

  - Callbacks, memory mapping (XIP), scrambling and timing configuration are
    not implemented.

  - The priority of a transfer and the callback mask of a packet are ignored.

  - The maximum CE active time of a device (time_to_break) is not enforced. CE
    stays asserted for a whole packet; a packet is never interrupted to
    release and reassert CE, however long it takes.

  - The memory boundary of a device (mem_boundary) is not enforced. A packet
    that crosses the boundary is not split, so the device driver has to issue
    one packet per boundary-aligned block itself.

  - With hold_ce set, CE stays asserted between the packets of a transfer and
    after it, and a following transfer on the same CE line continues with CE
    asserted. CE is released by a transfer without hold_ce, by a transfer on
    another CE line, by a transfer that times out, by
    mspi_get_channel_status() and by mspi_config(). While CE is held,
    mspi_dev_config() for the same device from the thread that holds the
    controller is allowed and leaves CE asserted. mspi_dev_config() for
    another device returns -EBUSY as long as the controller has not been
    released.

compatible: "zephyr,mspi-bitbang-controller"

include: mspi-controller.yaml

properties:
  sck-gpios:
    type: phandle-array
    required: true
    description: Serial clock output.

  io-gpios:
    type: phandle-array
    required: true
    description: |
      Data lines, up to sixteen, indexed like the IO0 .. IO15 pins of a
      multi-bit SPI device. In single I/O mode IO0 is the data output and IO1
      the data input; a multi-line phase uses IO0 .. IOn in both directions.

examples:
  - |
    mspi0: mspi-bitbang-controller {
        compatible = "zephyr,mspi-bitbang-controller";
        #address-cells = <1>;
        #size-cells = <0>;
        sck-gpios = <&gpio3 7 GPIO_ACTIVE_HIGH>;
        io-gpios = <&gpio3 8 GPIO_ACTIVE_HIGH>,
                   <&gpio3 9 GPIO_ACTIVE_HIGH>,
                   <&gpio3 10 (GPIO_ACTIVE_HIGH | GPIO_PULL_UP)>,
                   <&gpio3 11 (GPIO_ACTIVE_HIGH | GPIO_PULL_UP)>;
        ce-gpios = <&gpio3 0 GPIO_ACTIVE_LOW>;
        clock-frequency = <1000000>;

        flash@0 {
            compatible = "jedec,nor";
            reg = <0>;
            size = <DT_SIZE_M(64)>;
            jedec-id = [ef 40 17];
            mspi-max-frequency = <1000000>;
            mspi-io-mode = "MSPI_IO_MODE_QUAD_1_1_4";
            mspi-data-rate = "MSPI_DATA_RATE_SINGLE";
            mspi-cpp-mode = "MSPI_CPP_MODE_0";
            mspi-endian = "MSPI_BIG_ENDIAN";
            mspi-ce-polarity = "MSPI_CE_ACTIVE_LOW";
        };
    };
```

## dts/bindings/mtd/avalanche,as301g208.yaml
```yaml
# Copyright (c) 2026 Space Cubics Inc.
# SPDX-License-Identifier: Apache-2.0

description: |
  Avalanche Technology AS301G208 1 Gbit MRAM-based persistent SRAM.

  The device exposes two separately selected QSPI interfaces, each with
  512 Mbit of storage. A node describes one interface and exposes 64 MiB.
  Combining both interfaces in dual-parallel mode is not supported.

compatible: "avalanche,as301g208"

include: avalanche,serial-mram-common.yaml
```

## dts/bindings/mtd/avalanche,as302g208.yaml
```yaml
# Copyright (c) 2026 Space Cubics Inc.
# SPDX-License-Identifier: Apache-2.0

description: |
  Avalanche Technology AS302G208 2 Gbit MRAM-based persistent SRAM.

  The device exposes two separately selected QSPI interfaces, each with
  1 Gbit of storage. A node describes one interface and exposes 128 MiB.
  Combining both interfaces in dual-parallel mode is not supported.

compatible: "avalanche,as302g208"

include: avalanche,serial-mram-common.yaml
```
