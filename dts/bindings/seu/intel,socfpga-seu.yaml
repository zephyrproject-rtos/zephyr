## dts/bindings/seu/intel,socfpga-seu.yaml
```yaml
# Copyright (c) 2023 Intel Corporation
#
# SPDX-License-Identifier: Apache-2.0

description: SEU driver instance on Intel Agilex SOC

compatible: "intel,socfpga-seu"

include: base.yaml
```

## dts/bindings/shi/ite,it8xxx2-shi.yaml
```yaml
# Copyright (c) 2022 Google LLC
# SPDX-License-Identifier: Apache-2.0

description: ITE IT8XXX2 Serial Host Interface (SHI)

compatible: "ite,it8xxx2-shi"

include: [pinctrl-device.yaml, shi-device.yaml]

properties:
  pinctrl-0:
    required: true

  pinctrl-names:
    required: true

  cs-gpios:
    type: phandle-array
    required: true
    description: |
      Pin used as chip-select for the SHI interface. Change in level will
      trigger the interrupt for the handler of host commands.
```

## dts/bindings/shi/nuvoton,npcx-shi-enhanced.yaml
```yaml
# Copyright (c) 2022 Google LLC
# SPDX-License-Identifier: Apache-2.0

description: Nuvoton, NPCX Serial Host Interface (SHI) node

compatible: "nuvoton,npcx-shi-enhanced"

include: [pinctrl-device.yaml, shi-device.yaml, "nuvoton,npcx-shi.yaml"]
```

## dts/bindings/shi/nuvoton,npcx-shi.yaml
```yaml
# Copyright (c) 2022 Google LLC
# SPDX-License-Identifier: Apache-2.0

description: Nuvoton, NPCX Serial Host Interface (SHI) node

compatible: "nuvoton,npcx-shi"

include: [pinctrl-device.yaml, shi-device.yaml]

properties:
  pinctrl-0:
    required: true

  pinctrl-names:
    required: true

  clocks:
    required: true
    description: configurations of device source clock controller

  shi-cs-wui:
    type: phandle
    required: true
    description: |
      Mapping table between Wake-Up Input (WUI) and SHI_CS signal.

      For example the WUI mapping on NPCX7 would be
        shi-cs-wui = <&wui_io53>;
```

## dts/bindings/shi/shi-device.yaml
```yaml
# Copyright (c) 2022 Google LLC
# SPDX-License-Identifier: Apache-2.0

include: [base.yaml]

properties:
  reg:
    required: true

  buffer-rx-size:
    type: int
    required: true
    description: |
      Size of the internal buffer used for receiving data on the bus.

  buffer-tx-size:
    type: int
    required: true
    description: |
      Size of the internal buffer used for transmitting data over the bus.
```

## dts/bindings/sip_svc/arm,sip-svc.yaml
```yaml
# Copyright (c) 2021, Intel Corporation. All rights reserved.
# SPDX-License-Identifier: Apache-2.0

description: Arm SiP Services

compatible: "arm,sip-svc"

include: base.yaml

properties:
  label:
    required: true

  method:
    type: string
    required: true
    description: The method of calling the secure firmware.
    enum:
      - smc
      - hvc
```

## dts/bindings/sip_svc/intel,agilex-socfpga-sip-smc.yaml
```yaml
# Copyright (c) 2023 Intel Corporation
#
# SPDX-License-Identifier: Apache-2.0

description: SiP SVC driver instance on Intel Agilex SOC FPGA for SMC call

compatible: "intel,agilex-socfpga-sip-smc"

include: base.yaml

properties:
  method:
    type: string
    const: smc
    required: true
    description: |
      The method of calling the EL3 firmware.The current driver only supports
      communication with EL3 firmware.
  zephyr,num-clients:
    type: int
    required: true
    description: |
      Number of allowed clients that can communicate with lower layer.
      Maximum allowed is 16.
```

## dts/bindings/slave/i2c,eeprom.yaml
```yaml
#
# Copyright (c) 2018, Nordic Semiconductor
#
# SPDX-License-Identifier: Apache-2.0
#
---
title: Virtual I2C slave eeprom
id: i2c,eeprom
version: 0.1

description: >
    This binding gives a base representation of I2C slave eeprom

inherits:
    !include i2c-device.yaml

properties:
    compatible:
      constraint: "i2c,eeprom"
    size:
      type: int
      category: required
      description: I2C Slave EEPROM Size in KiB
      generation: define

...
```

## dts/bindings/slave/spi,flash.yaml
```yaml
#
# Copyright (c) 2018, Intel Corporation
#
# SPDX-License-Identifier: Apache-2.0
#
---
title: SPI NOR FLASH
version: 0.1

description: >
    This binding gives a base representation of SPI slave NOR FLASH

inherits:
    !include spi-device.yaml

properties:
    compatible:
      constraint: "spi,flash"
    size:
      type: int
      category: required
      description: SPI Slave NOR FLASH Size in KiB
      generation: define

...
```

## dts/bindings/slcd/nxp,slcd.yaml
```yaml
# Copyright 2026 NXP
# SPDX-License-Identifier: Apache-2.0

description: NXP SLCD (Segmented Liquid Crystal Display) controller

compatible: "nxp,slcd"

include: [base.yaml, slcd-controller.yaml, pinctrl-device.yaml]

properties:
  reg:
    required: true

  front-plane-pins:
    required: true
    type: array
    description: |
      Array of front-plane pin indices used for LCD segment display.
      Each index represents an LCD pin number (0-63) that is configured
      as a front-plane segment driver. These pins drive the individual
      segments of the LCD display.
      Example: <16 17 18 19 20 21 22 23 24 25 26 27>

  back-plane-pins:
    required: true
    type: array
    description: |
      Array of back-plane pin indices used as LCD common lines.
      Each index represents an LCD pin number (0-63) that is configured
      as a back-plane common driver. These pins provide the timing/common
      signals for multiplexing the LCD display (COM0, COM1, COM2, etc.).
      Example: <28 29 30 31>

  blink-rate:
    type: int
    default: 1
    enum: [0, 1, 2, 3, 4, 5, 6, 7]
    description: |
      SLCD blink rate selection (0-7). Maps to slcd_blink_rate_t values.
      - 0: kSLCD_BlinkRate00 - LCD clock/((2^11)) or LCD clock/((2^12))
      - 1: kSLCD_BlinkRate01 - LCD clock/((2^12)) or LCD clock/((2^13))
      - 2: kSLCD_BlinkRate02 - LCD clock/((2^13)) or LCD clock/((2^14))
      - 3: kSLCD_BlinkRate03 - LCD clock/((2^14)) or LCD clock/((2^15))
      - 4: kSLCD_BlinkRate04 - LCD clock/((2^15)) or LCD clock/((2^16))
      - 5: kSLCD_BlinkRate05 - LCD clock/((2^16)) or LCD clock/((2^17))
      - 6: kSLCD_BlinkRate06 - LCD clock/((2^17)) or LCD clock/((2^18))
      - 7: kSLCD_BlinkRate07 - LCD clock/((2^18)) or LCD clock/((2^19))
      Default is 1 (kSLCD_BlinkRate01).
```

## dts/bindings/slcd/slcd-controller.yaml
```yaml
# Copyright 2026 NXP
# SPDX-License-Identifier: Apache-2.0

description: |
  Segmented LCD (SLCD) Controller.

  Generic SLCD controller driver that supports controlling an SLCD device.
  This driver can be implemented by either a dedicated SLCD IP or a general
  GPIO IP, depending on what the SoC provides.

include: base.yaml

bus: slcd

properties:
  num-front-pins:
    type: int
    required: true
    description: Number of front plane pins the controller has

  num-back-coms:
    type: int
    required: true
    description: Number of back plane(com) pins the controller has
```

## dts/bindings/slcd/slcd-panel.yaml
```yaml
# Copyright 2026 NXP
# SPDX-License-Identifier: Apache-2.0

description: |
  SLCD Panel Device

  Represents a segmented LCD panel connected to an SLCD controller.
  The SLCD panel defines the characteristics of the display including
  segment type, how many positions of numbers, letters and icons, the
  front plane pins and back plane COMs used by this panel, and the
  multiplexing configuration.

include: base.yaml

on-bus: slcd

properties:
  segment-type:
    type: string
    enum:
      - "3-segment"
      - "7-segment"
      - "8-segment"
      - "9-segment"
      - "10-segment"
      - "11-segment"
      - "12-segment"
      - "14-segment"
      - "16-segment"
    description: |
      Type of segment display. Defines the number of segments per position.
      Common values:
      - "7-segment": Standard 7-segment alphanumeric display (segments A-G)
      - "14-segment" or "16-segment": Extended alphanumeric displays
      - "3-segment": Minimal segment display
      
  num-positions:
    type: int
    description: |
      Number of character positions or digit positions on the display.
      For example, a 6-digit display would have num-positions = 6.

  num-icons:
    type: int
    description: |
      Number of special icons or indicators on the display.
      Icons are individual segments that are not part of standard character positions.
      For example, a colon, decimal point, or status indicator would count as one icon.

  com-list:
    type: array
    description: |
      The number list of each back plane COMs used for multiplexing the display. Each
      number cannot exceed the slcd controller's num-back-coms value minus 1.
      For example, if the controller has 8 back plane COMs, the list can be <4,5,6,7>.
      This is used to map the COM indices in the segment-mux/icon-mux array, and to support
      SLCD controller controlling multiple panels.

  pin-list:
    type: array
    description: |
      The number list of each front plane pins used for multiplexing the display. Each
      number cannot exceed the slcd controller's num-front-pins value minus 1.
      For example, if the controller has 32 back plane COMs, the list can be
      <16,17,18,19,20,21,22,23,24,25,26,27>.
      This is used to map the pin indices in the segment-mux/icon-mux array, and to support
      SLCD controller controlling multiple panels.

  segment-mux:
    type: array
    description: |
      2D multiplexing array for segment mapping.
      Maps each segment of each position to a specific pin and COM line.

      Array dimensions: num-positions x num-segments
      For a 7-segment(segment A to G) display with 6 positions, array size
      is 6 x 7 = 42 elements

      Encoding: Each uint32 value encodes pin number and COM bit as 0xPPCC
      - PP: Pin number (cannot exceed the array size of pin-list)
      - CC: COM bit (cannot exceed the array size of com-list)

      Example: For segment A of position 2 controlled by pin 8, COM 3:
      segment-mux value = 0x88 (pin=8, com=0b1000)

  icon-mux:
    type: array
    description: |
      1D multiplexing array for icon mapping.
      Maps each special icon to a specific pin and COM line.

      Array size: num-icons elements

      Encoding: Same format as segment-mux (0xPPCC)
      - PP: Pin number (cannot exceed the array size of pin-list)
      - CC: COM bit (cannot exceed the array size of com-list)

      Example: For icon 0 controlled by pin 15, COM 2:
      icon-mux value = 0xF4 (pin=15, com=0b100)
```

## dts/bindings/slcd/zephyr,segment7.yaml
```yaml
# Copyright 2026 NXP
# SPDX-License-Identifier: Apache-2.0

description: 7-segment LCD panel device

compatible: "zephyr,segment7"

include: slcd-panel.yaml
```

## dts/bindings/smbus/intel,pch-smbus.yaml
```yaml
# Copyright (c) 2022 Intel Corporation
# SPDX-License-Identifier: Apache-2.0

description: Intel Platform Controller Hub SMBus node

compatible: "intel,pch-smbus"

include: [smbus-controller.yaml, pcie-device.yaml]

properties:
  interrupts:
    required: true
```

## dts/bindings/smbus/smbus-controller.yaml
```yaml
# Copyright (c) 2022 Intel Corporation
# SPDX-License-Identifier: Apache-2.0

# Common fields for SMBus controllers

include: base.yaml

bus: smbus

properties:
  "#address-cells":
    required: true
    const: 1
  "#size-cells":
    required: true
    const: 0
  clock-frequency:
    type: int
    description: Initial clock frequency in Hz
```

## dts/bindings/smbus/smbus-device.yaml
```yaml
# Copyright (c) 2022 Intel Corporation
# SPDX-License-Identifier: Apache-2.0

# Common fields for SMBus devices

include: [base.yaml, power.yaml]

on-bus: smbus

properties:
  reg:
    required: true
    description: device address on SMBus bus
```

## dts/bindings/smbus/st,stm32-smbus.yaml
```yaml
# Copyright (c) 2023 SILA Embedded Solutions GmbH
# SPDX-License-Identifier: Apache-2.0

description: STM32 SMBus controller

compatible: "st,stm32-smbus"

include: [smbus-controller.yaml, pinctrl-device.yaml]

properties:
  i2c:
    type: phandle
    required: true
    description: I2C device which maps to the same address
```

## dts/bindings/smmu/arm,smmu-v3.yaml
```yaml
# Copyright (c) 2023 Arm Limited (or its affiliates). All rights reserved.
# SPDX-License-Identifier: Apache-2.0

description: |+
  The SMMUv3 architecture is a significant departure from previous
  revisions, replacing the MMIO register interface with in-memory command
  and event queues and adding support for the ATS and PRI components of
  the PCIe specification.


compatible: "arm,smmu-v3"

include: base.yaml

properties:
  reg:
    required: true

  "#iommu-map-cells":
    const: 3
    type: int
    required: true
    description: |
      - Request ID base
      - IOMMU base
      - length

iommu-map-cells:
  - rid-base
  - iommu-base
  - length
```

## dts/bindings/soc/soc,silabs.yaml
```yaml
#
# Copyright (c) 2018, Piotr Mienkowski
#
# SPDX-License-Identifier: Apache-2.0
#
---
title: SiLabs SoC
version: 0.1

description: >
    This binding gives a base representation of the SiLabs SoC

inherits:
    !include soc.yaml

properties:
    compatible:
      constraint: "soc,silabs"
...
```

## dts/bindings/soc/soc.yaml
```yaml
---
title: Common MMIO SOC properties
version: 0.1

description: >
    This binding gives a base representation of a SoC Device

properties:
    reg:
      type: array
      description: mmio register space
      generation: define
      category: required

    soc-label:
      type: string
      category: optional
      description: >
              Label as defined by SoC Vendor documentation (ie "0", "1",
              or "A", "B") meant for code generation specifically
      generation: define
```

## dts/bindings/spi/adi,max32-spi.yaml
```yaml
# Copyright (c) 2024 Analog Devices, Inc.
# SPDX-License-Identifier: Apache-2.0

description: ADI MAX32 SPI

include:
  - name: spi-controller.yaml
  - name: pinctrl-device.yaml

compatible: "adi,max32-spi"

properties:
  reg:
    required: true

  interrupts:
    required: true

  pinctrl-0:
    type: phandles
    required: true
```

## dts/bindings/spi/ambiq,mspi.yaml
```yaml
# Copyright (c) 2023 Antmicro <www.antmicro.com>
# SPDX-License-Identifier: Apache-2.0

description: Ambiq MSPI

compatible: "ambiq,mspi"

include: [spi-controller.yaml, pinctrl-device.yaml]

properties:
  reg:
    required: true

  interrupts:
    required: true
```

## dts/bindings/spi/ambiq,spi-bleif.yaml
```yaml
# Copyright (c) 2024 Ambiq Micro Inc.
# SPDX-License-Identifier: Apache-2.0

description: |
    This binding gives a representation of SPI controller in some Ambiq
    Apollox Blue SOC (e.g. Apollo3 Blue) which uses BLEIF module for SPI
    transceiver.

compatible: "ambiq,spi-bleif"

include: [spi-controller.yaml, pinctrl-device.yaml, ambiq-pwrcfg.yaml]

properties:
  reg:
    required: true

  ambiq,pwrcfg:
    required: true
```
