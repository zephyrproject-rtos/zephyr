## dts/bindings/kscan/nuvoton,npcx-kscan.yaml
```yaml
# Copyright (c) 2022 Nuvoton Technology Corporation.
# SPDX-License-Identifier: Apache-2.0

description: Nuvoton, NPCX keyboard scan controller

compatible: "nuvoton,npcx-kscan"

include: [kscan.yaml, pinctrl-device.yaml]

properties:
  reg:
    required: true

  clocks:
    required: true

  pinctrl-0:
    required: true

  pinctrl-names:
    required: true

  wui-maps:
    type: phandles
    required: true
    description: |
        Mapping table between Wake-Up Input (WUI) and KSIs.

        For example the WUI mapping on 8 KSI pads would be
           wui-maps = <&wui_io30 &wui_io31 &wui_io27 &wui_io26
                       &wui_io25 &wui_io24 &wui_io23 &wui_io22>;

  row-size:
    type: int
    default: 8
    required: true
    description: |
        The row size is used in the keyboard matrix.
        valid range: 1 - 8

  col-size:
    type: int
    default: 18
    required: true
    description: |
        The column size is used in the keyboard matrix.
        valid range: 1 - 18

  debounce-down-ms:
    type: int
    default: 10
    description: Determines the time in msecs for debouncing a key press.

  debounce-up-ms:
    type: int
    default: 20
    description: Determines the time in msecs for debouncing a key release.

  no-ghostkey-check:
    type: boolean
    description: |
        Ignore the ghost key checking in the driver if the diodes are used
        in the matrix hardware.
```

## dts/bindings/kscan/nuvoton,npcx-kscan_matrix.yaml
```yaml
# Copyright (c) 2022 Nuvoton Technology Corporation.
# SPDX-License-Identifier: Apache-2.0

description: Nuvoton, NPCX keyboard scan matrix controller

compatible: "nuvoton,npcx-kscan-matrix"

include: [kscan.yaml, pinctrl-device.yaml]

properties:
    reg:
        required: true

    clocks:
        required: true

    pinctrl-0:
        required: true
    pinctrl-names:
        required: true

    wui-maps:
        type: phandles
        required: true
        description: |
            Mapping table between Wake-Up Input (WUI) and 8 IOs belong to this device.
            Please notice not all IOs connect to WUIs.

            In this case, it will be presented by wui_none.
            For example the WUI mapping on NPCX7 KSI pads would be
               wui-maps = <&wui_io30 &wui_io31 &wui_io27 &wui_io26
                           &wui_io25 &wui_io24 &wui_io23 &wui_io22>;
```

## dts/bindings/kscan/st,stmpe811.yaml
```yaml
# Copyright Konstantinos Papadopoulos <kostas.papadopulos@gmail.com>
# SPDX-License-Identifier: Apache-2.0

description: STMPE811 resistive touch panels

compatible: "st,stmpe811"

include: [kscan.yaml, i2c-device.yaml]

properties:
    int-gpios:
      type: phandle-array
      required: false
```

## dts/bindings/kscan/touchscreen.yaml
```yaml
# SPDX-License-Identifier: Apache-2.0

properties:
    touchscreen-min-x:
      type: int
      required: false
      description: minimum x coordinate reported

    touchscreen-min-y:
      type: int
      required: false
      description: minimum y coordinate reported
      
    touchscreen-size-x:
      type: int
      required: false
      description: horizontal resolution of touchscreen(in pixels)

    touchscreen-size-y:
      type: int
      required: false
      description: vertical resolution of touchscreen(in pixels)

    touchscreen-max-pressure:
      type: int
      required: false
      description: maximum reported pressure (arbitrary range
                  dependent on the controller)

    touchscreen-min-pressure:
      type: int
      required: false
      description: minimum pressure on the touchscreen to be achieved
                  in order for the touchscreen driver to report a touch event.
      
    touchscreen-fuzz-x:
      type: int
      required: false
      description: horizontal noise value of the absolute input device (in pixels)

    touchscreen-fuzz-y:
      type: int
      required: false
      description: vertical noise value of the absolute input device (in pixels)

    touchscreen-fuzz-pressure:
      type: int
      required: false
      description: pressure noise value of the absolute input device (arbitrary
        range dependent on the controller)

    touchscreen-average-samples:
      type: int
      required: false
      description: Number of data samples which are averaged
                  for each read (valid values dependent on the
                  controller)

    touchscreen-inverted-x:
      type: boolean
      required: false
      description: X axis is inverted

    touchscreen-inverted-y:
      type: boolean
      required: false
      description: Y axis is inverted

    touchscreen-swapped-x-y:
      type: boolean
      required: false
      description: X and Y axis are swapped Swapping is 
                  done after inverting the axis
```

## dts/bindings/kscan/xpt,xpt2046.yaml
```yaml
# Copyright (c) 2022 SenCai(1065402494@qq.com)
# SPDX-License-Identifier: Apache-2.0

description: XPT2046 touch screen controller

compatible: "xpt,xpt2046"

include: [kscan.yaml, spi-device.yaml, touchscreen.yaml]

properties:
    pendown-gpios:
      type: phandle-array
      required: true
      description: GPIO handle describing the pin the !PENIRQ
                  line is connected to. act

    touchscreen-size-x:
      required: true
      description: horizontal resolution of touchscreen(in pixels, u16)

    touchscreen-size-y:
      required: true
      description: vertical resolution of touchscreen(in pixels, u16)

    x-min:
      type: int
      required: true
      description: Minimum value on the X axis (u16).

    x-max:
      type: int
      required: true
      description: maximum value on the X axis (u16).

    y-min:
      type: int
      required: true
      description: Minimum value on the Y axis (u16).

    y-max:
      type: int
      required: true
      description: maximum value on the Y axis (u16).
```

## dts/bindings/kscan/zephyr,kscan-adapter.yaml
```yaml
description: Input to kscan adapter

compatible: "zephyr,kscan-adapter"

include: kscan.yaml

properties:
  input:
    type: phandle
    required: true
```

## dts/bindings/kscan/zephyr,kscan-input.yaml
```yaml
# Copyright 2023 Google LLC
# SPDX-License-Identifier: Apache-2.0

description: |
  Input to kscan adapter.

  Allows using an input device with the kscan API. Define as a child node of
  the input device, for example

  chosen {
    zephyr,keyboard-scan = &kscan_input;
  };

  ft5336@38 {
    ...
    kscan_input: kscan-input {
      compatible = "zephyr,kscan-input";
    };
  };

compatible: "zephyr,kscan-input"

include: kscan.yaml
```

## dts/bindings/kscan/zephyr,sdl-kscan.yaml
```yaml
# Copyright (c) 2022 Kumar Gala <galak@kernel.org>
# SPDX-License-Identifier: Apache-2.0

description: SDL based emulated keyboard matrix devices

compatible: "zephyr,sdl-kscan"

include: kscan.yaml
```

## dts/bindings/led/arduino,modulino-buttons-leds.yaml
```yaml
# Copyright (c) 2025 Google, LLC
# SPDX-License-Identifier: Apache-2.0

description: Arduino Modulino buttons LEDs

compatible: "arduino,modulino-buttons-leds"
```

## dts/bindings/led/arduino,uno-q-ledmatrix.yaml
```yaml
# Copyright 2026 Shankar Sridhar
# SPDX-License-Identifier: Apache-2.0

description: |
  Arduino UNO Q LED Matrix Driver
  
  8x13 LED matrix (104 LEDs total) controlled through a packed binary format.
  The matrix is managed by dedicated hardware on the STM32U585 MCU.
  
  Example:
    led_matrix: led-matrix {
        compatible = "arduino,uno-q-ledmatrix";
        rows = <8>;
        columns = <13>;
        status = "okay";
    };

compatible: "arduino,uno-q-ledmatrix"

properties:
  gpios:
    type: phandle-array
    required: true
    description: |
      Array of 11 GPIO pins used for charlieplexing the LED matrix.
      These must be PF0-PF10 on the STM32U585.
      Order: LED_MATRIX_0 to LED_MATRIX_10
      
  rows:
    type: int
    required: true
    description: Number of rows in the LED matrix
    const: 8

  columns:
    type: int
    required: true  
    description: Number of columns in the LED matrix
    const: 13

  led-pairs:
    type: array
    required: true
    description: |
      Flat array of anode/cathode GPIO index pairs, one pair per LED.
      Each LED occupies two consecutive cells:
        cell 0: anode pin index   (0-10, driven HIGH to source current)
        cell 1: cathode pin index (0-10, driven LOW to sink current)
 
      Pairs are ordered by LED index: row-major, left to right, top to
      bottom. Total cell count must equal rows * columns * 2 = 208.
 
      Pin indices refer to the position in the gpios phandle-array,
      not the GPIO number on the SoC.
      
  brightness:
    type: int
    default: 255
    description: |
      Default brightness level (0-255).
      Note: The UNO Q matrix supports 8-bit grayscale.
```

## dts/bindings/led/arm,fvp-leds.yaml
```yaml
# Copyright (c) 2026 Arm Limited (or its affiliates)
# SPDX-License-Identifier: Apache-2.0

description: |
  Driver for controlling Arm FVP LEDs using the LED driver API.

  Arm Fixed Virtual Platforms include visual outputs (labeled S6LEDs) in the FVP GUI.
  These "LEDs" are memory-mapped to an address location in the address map.

compatible: "arm,fvp-leds"

child-binding:
  description: FVP LED child node

  include:
    - name: led-node.yaml
      property-allowlist:
        - label
```

## dts/bindings/led/awinic,aw20216s.yaml
```yaml
description: Awinic AW20216S LED Driver

compatible: "awinic,aw20216s"

include: ["spi-device.yaml", "led-controller.yaml"]

on-bus: spi

properties:
  en-gpios:
    type: phandle-array
    description: Enable pin
  sync-gpios:
    type: phandle-array
    description: Sync pin
  current-limit:
    type: int
    default: 150
    description: Global current limit
  sl-current-limit:
    type: int
    default: 150
    description: Switch level current limit

child-binding:
  properties:
    index:
      required: true
```

## dts/bindings/led/dac-leds-common.yaml
```yaml
# Copyright (c) 2025, Prevas A/S
# SPDX-License-Identifier: Apache-2.0

description: |
  Common fields for DAC LEDs

child-binding:
  description: Common DAC LED child node
  properties:
    dac:
      type: phandle
      required: true
      description: |
        Property containing phandle to DAC e.g. &dac.
    channel:
      type: int
      required: true
      description: |
        The DAC channel.
    resolution:
      type: int
      required: true
      description: |
        The DAC resolution to use.
```

## dts/bindings/led/dac-leds-vccs.yaml
```yaml
# Copyright (c) 2018, Linaro Limited
# Copyright (c) 2025, Prevas A/S
# SPDX-License-Identifier: Apache-2.0

description: |
  Group of DAC-controlled LEDs using voltage control current source (vccs) circuit.

  Each LED is defined in a child node of the dac-leds node.

  Here is an example which defines an LED in the node /leds:

  / {
          leds {
                  compatible = "dac-leds-vccs";
                  led_0 {
                          dac = <&dac1>;
                          channel = <0>;
                          resolution = <12>;
                  };
          };
  };

  Above:

  - led_0 uses dac1 channel 0 with 12 bit resolution.

compatible: "dac-leds-vccs"

include: ["dac-leds-common.yaml"]
```

## dts/bindings/led/dac-leds.yaml
```yaml
# Copyright (c) 2018, Linaro Limited
# Copyright (c) 2025, Prevas A/S
# SPDX-License-Identifier: Apache-2.0

title: Group of DAC-controlled LEDs.

description: |
  Each LED is defined in a child node of the dac-leds node.

  Here is an example which defines an LED in the node /leds:

  / {
          leds {
                  compatible = "dac-leds";
                  led_0 {
                          dac-dev = <&dac1>;
                          channel = <0>;
                          resolution = <12>;
                  };
                  led_1 {
                          dac-dev = <&dac1>;
                          channel = <1>;
                          resolution = <12>;
                          voltage-min-brightness-mv = <1400>;
                          voltage-max-brightness-mv = <2700>;
                          voltage-max-dac-mv = <3300>;
                          output-buffer;
                  };
          };
  };

  Above:

  - led_0 uses dac1 channel 0 with 12 bit resolution.
  - led_1 uses dac1 channel 1 with 12 bit resolution and setup to supply an LED directly.

compatible: "dac-leds"

child-binding:
  description: DAC LED child node
  properties:
    dac-dev:
      type: phandle
      required: true
      description: |
        Property containing phandle to DAC e.g. &dac.

    channel:
      type: int
      required: true
      description: |
        The DAC channel.

    resolution:
      type: int
      required: true
      description: |
        The DAC resolution to use.

    voltage-min-brightness-mv:
      type: int
      description: |
        Voltage at brightness 0%.
        If not specified the minimum DAC output voltage is used.

    voltage-max-brightness-mv:
      type: int
      description: |
        Voltage at brightness 100%.
        If not specified the maximum DAC output voltage is used.

    voltage-max-dac-mv:
      type: int
      description: |
        The DAC maximum output voltage.
        Required if voltage-min-brightness-mv or voltage-max-brightness-mv is set.

    output-buffer:
      type: boolean
      description: |
        Enable the output buffer of the DAC.
        This is required if it is used to drive an LED directly.
```
