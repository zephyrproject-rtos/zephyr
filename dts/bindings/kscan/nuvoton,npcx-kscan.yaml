## dts/bindings/led/gpio-leds.yaml
```yaml
# Copyright (c) 2018, Linaro Limited
# SPDX-License-Identifier: Apache-2.0

description: |
  This allows you to define a group of LEDs. Each LED in the group is
  controlled by one (single-color) or more (multi-color) GPIOs. Each LED is
  defined in a child node of the gpio-leds node.

  Here is an example which defines three LEDs in the node /leds:

  / {
  	leds {
  		compatible = "gpio-leds";
  		led_0 {
  			gpios = <&gpio0 1 GPIO_ACTIVE_LOW>;
  		};
  		led_1 {
  			gpios = <&gpio0 2 GPIO_ACTIVE_HIGH>;
  		};
  		led_2 {
  			gpios = <&gpio1 15 (GPIO_PULL_UP | GPIO_ACTIVE_LOW)>;
  		};
      led_3 {
        gpios = <&gpio2 0 GPIO_ACTIVE_LOW>,
                <&gpio2 1 GPIO_ACTIVE_LOW>,
                <&gpio2 2 GPIO_ACTIVE_LOW>;
        color-mapping = <LED_COLOR_ID_RED
                         LED_COLOR_ID_GREEN
                         LED_COLOR_ID_BLUE>;
      };
  	};
  };

  Above:

  - led_0 is pin 1 on gpio0. The LED is on when the pin is low,
    and off when the pin is high.
  - led_1 is pin 2 on gpio0. The LED is on when the pin is high,
    and off when it is low.
  - led_2 is pin 15 on gpio1. The LED is on when the pin is low,
    and the pin's internal pull-up resistor should be enabled.
  - led_3 is controlled by three pins on gpio2. The LED is a common-anode
    RGB LED, with the red, green, and blue channels connected to pins 0, 1,
    and 2, respectively. Each channel is on when the corresponding pin is
    low, and off when the pin is high.

compatible: "gpio-leds"

child-binding:
  description: GPIO LED child node
  properties:
    gpios:
      type: phandle-array
      required: true
    color-mapping:
      type: array
      description: |
        Channel to color mapping (or pixel order). The number of elements
        in the array must match the number of gpios.

        This property is only required for multi-color LEDs. For single-color
        LEDs, this property should be omitted.

        For example a GRB channel to color mapping would be

           color-mapping = <LED_COLOR_ID_GREEN
                            LED_COLOR_ID_RED
                            LED_COLOR_ID_BLUE>;
    label:
      type: string
      description: |
        Human readable string describing the LED. It can be used by an
        application to identify this LED or to retrieve its number/index
        (i.e. child node number) on the parent device.
```

## dts/bindings/led/holtek,ht16k33.yaml
```yaml
description: Holtek HT16K33 LEDs

compatible: "holtek,ht16k33"

include: i2c-device.yaml

bus: ht16k33

properties:
  irq-gpios:
    type: phandle-array
    description: IRQ pin
```

## dts/bindings/led/infineon,airoc-leds.yaml
```yaml
# Copyright (c) 2025 Beechwoods Software Inc.
#
# SPDX-License-Identifier: Apache-2.0

description: |
  Infineon AIROC Wirless Controller
  LED Port

compatible: "infineon,airoc-leds"

child-binding:
  description: AIROC LED child node
  properties:
    gpios:
      type: phandle-array
      required: true
```

## dts/bindings/led/issi,is31fl3193.yaml
```yaml
# Copyright (c) 2026 Kickmaker
# SPDX-License-Identifier: Apache-2.0

description: |
  IS31FL3193 3-channel LED driver with programmable pattern sequencing

  Supports single-channel and RGB LEDs. For single channel LEDs,
  the led_set_brightness() API can be used to set the brightness of each LED.

compatible: "issi,is31fl3193"

include: ["i2c-device.yaml", "led-controller.yaml"]

child-binding:
  properties:
    label:
      required: true

    color-mapping:
      required: true

    current-limit:
      type: int
      enum:
        - 42
        - 10
        - 5
        - 30
        - 17  # Actually 17.5mA, but rounded down to fit in an integer
      required: true
      description: |
        The current limit for the LED in mA.

examples:
  - |
    /* Single RGB LED */
    is31fl3193@68 {
      compatible = "issi,is31fl3193";
      reg = <0x68>;

      led_0 {
        label = "RGB LED";
        color-mapping =
          <LED_COLOR_ID_RED>,
          <LED_COLOR_ID_GREEN>,
          <LED_COLOR_ID_BLUE>;
      };
    };
  - |
    /* Three single-channel LEDs */
    is31fl3193@68 {
      compatible = "issi,is31fl3193";
      reg = <0x68>;

      led_0 {
        label = "RED LED";
        color-mapping = <LED_COLOR_ID_RED>;
      };

      led_1 {
        label = "GREEN LED";
        color-mapping = <LED_COLOR_ID_GREEN>;
      };

      led_2 {
        label = "BLUE LED";
        color-mapping = <LED_COLOR_ID_BLUE>;
      };
    };
```

## dts/bindings/led/issi,is31fl3194.yaml
```yaml
# Copyright (c) 2024 Arduino SA
# SPDX-License-Identifier: Apache-2.0

description: |
  IS31FL3194 3-channel LED driver with programmable pattern sequencing

  This driver supports single-channel and RGB LEDs. For single channel LEDs,
  the led_set_brightness() API can be used to set the brightness of each LED.
  For RGB LEDs, the led_set_color() API can be used to set the red, green and
  blue components; the driver takes care of routing to the outputs described
  by the color-mapping property.

  The LED_SHELL application can be used for testing.

  The following defines a single RGB LED in the is31fl3194 DT node:

    is31fl3194@53 {
      compatible = "issi,is31fl3194";
      reg = <0x53>;

      led_0 {
        label = "RGB LED";
        color-mapping =
          <LED_COLOR_ID_RED>,
          <LED_COLOR_ID_GREEN>,
          <LED_COLOR_ID_BLUE>;
      };
    };

  The following example defines three single-channel LEDs in the is31fl3194 DT node:

    is31fl3194@53 {
      compatible = "issi,is31fl3194";
      reg = <0x53>;

      led_0 {
        label = "RED LED";
        color-mapping = <LED_COLOR_ID_RED>;
      };

      led_1 {
        label = "GREEN LED";
        color-mapping = <LED_COLOR_ID_GREEN>;
      };

      led_2 {
        label = "BLUE LED";
        color-mapping = <LED_COLOR_ID_BLUE>;
      };
    };


compatible: "issi,is31fl3194"

include: ["i2c-device.yaml", "led-controller.yaml"]

child-binding:
  properties:
    label:
      required: true

    color-mapping:
      required: true

    current-limit:
      type: int
      enum:
        - 10
        - 20
        - 30
        - 40
      required: true
      description: |
        The current limit for the LED in mA.
```

## dts/bindings/led/issi,is31fl3197.yaml
```yaml
# Copyright (c) 2024 Arduino SA
# SPDX-License-Identifier: Apache-2.0

description: |
  IS31FL3197 4-channel LED controller with programmable pattern sequencing

  Supports single-channel and RGB and maybe RGBW LEDs. For single
  channel LEDs.

  The following shows configuration for Arduino Giga Display shield

  The following defines a single RGB LED in the is31fl3197 DT node:

    is31fl3197@50 {
      compatible = "issi,is31fl3197";
      reg = <0x50>;

      led_0 {
        label = "RGB LED";
        color-mapping =
          <LED_COLOR_ID_RED>,
          <LED_COLOR_ID_GREEN>,
          <LED_COLOR_ID_BLUE>;
      };
    };

  The following example defines three single-channel LEDs in the is31fl3197 DT node:

    is31fl3197@50 {
      compatible = "issi,is31fl3197";
      reg = <0x50>;

      led_0 {
        label = "RED LED";
        color-mapping = <LED_COLOR_ID_RED>;
      };

      led_1 {
        label = "GREEN LED";
        color-mapping = <LED_COLOR_ID_GREEN>;
      };

      led_2 {
        label = "BLUE LED";
        color-mapping = <LED_COLOR_ID_BLUE>;
      };
    };

compatible: "issi,is31fl3197"

include: ["i2c-device.yaml", "led-controller.yaml"]

child-binding:
  properties:
    label:
      required: true

    color-mapping:
      required: true

    current-limit:
      type: int
      default: 10
      enum:
        - 10
      description: |
        The current limit for the LED in mA.
```

## dts/bindings/led/issi,is31fl3216a.yaml
```yaml
# Copyright (c) 2023 Endor AG
# SPDX-License-Identifier: Apache-2.0

description: |
  is31fl3216a LED driver for Lumissil Microsystems (a division of ISSI)

compatible: "issi,is31fl3216a"

include: i2c-device.yaml
```

## dts/bindings/led/issi,is31fl3238.yaml
```yaml
# Copyright (c) 2026 Moritz Gericke
# SPDX-License-Identifier: Apache-2.0

description: |
  is31fl3238 LED driver for Lumissil Microsystems (a division of ISSI) for up to 18 LEDs

compatible: "issi,is31fl3238"

include: ["i2c-device.yaml", "led-controller.yaml"]

properties:
  sdb-gpios:
    type: phandle-array
    description: |
      Hardware shutdown pin. If routed on the board, this property must be
      present. Set to a logical 1 at boot to exit the device from hardware
      shutdown.

  current-limit:
    type: int
    required: true
    description: |
      Global current limit. Sets the global current control register of LED
      driver (see table 8). Limits global current based on the following
      formula: I_OUT(MAX) * (current-limit/256) * (SLA + SLB)/(256*2).
      (see also table 6 regarding SLA and SLB)
      Valid range: 0 - 255

  pwm-frequency-hz:
    type: int
    default: 62000
    description: |
      The PWM frequency. Sets the PWM frequency of the LED driver
      indirectly via the oscillator clock frequency selection part of the
      control register (see table 4). Adjust to avoid audible hum.
      Defaults to POR value of 62 kHz.
    enum:
      - 62000
      - 32000
      - 4000
      - 2000
      - 1000
      - 500
      - 244
      - 122

  spread-spectrum-enable:
    type: boolean
    description: |
      Enable spread spectrum function to optimize EMI performance in
      combination with cycle time and range (see table 13).

  spread-spectrum-cycle-time-us:
    type: int
    default: 1980
    description: |
      The spread spectrum cycle time in uS (also see table 13).
      Defaults to POR value of 1980 uS.
    enum:
      - 1980
      - 1200
      - 820
      - 660

  spread-spectrum-range-percent:
    type: int
    default: 5
    description: |
      The spread spectrum range in +-x% (also see table 13).
    enum:
      - 5
      - 15
      - 24
      - 34

child-binding:
  properties:
    label:
      type: string
      required: true
      description: |
        The child LED's label.

    color-mapping:
      type: array
      required: true
      description: |
        The child LED's color mapping.

    current-limit-mapping:
      type: array
      required: true
      description: |
        The current limit mapping for the LED (see table 7). Limits
        individual current based on the following formula:
        I_OUT(MAX) * (current-limit/256) * (SLA + SLB)/(256*2).
        Note: SLA + SLB are set together via single 9-bit value.
        Must be of same cardinality as color mapping!
        Valid range: 0 - 511

    start-channel:
      type: int
      required: true
      description: |
        The child LED's start channel.
        Valid range: 0 - 17
```

## dts/bindings/led/issi,is31fl3733.yaml
```yaml
# Copyright 2023 Daniel DeGrasse <daniel@degrasse.com>
# SPDX-License-Identifier: Apache-2.0
description: ISSI IS31FL3733 LED Matrix Driver

compatible: "issi,is31fl3733"

include: "i2c-device.yaml"

properties:
  sdb-gpios:
    type: phandle-array
    description: |
      Hardware shutdown pin. If routed on the board, this property must be
      present. Set to a logical 1 at boot to exit the device from hardware
      shutdown.

  current-limit:
    type: int
    default: 0xFF
    description: |
      Global current limit. Sets the global current control register of LED
      driver (set table 14). Limits global current based on the following
      formula: (840/R_ISET) * (current-limit/256). Defaults to max value
      of 0xFF, so led output will still be enabled if property is
      not provided.

  sync-mode:
    type: string
    default: "none"
    enum:
      - "none"
      - "master"
      - "slave"
    description: |
      This property configures the LED controller as a master or slave
      clock device. This can be used to synchronize the output of multiple
      LED controllers. See SYNC bits in led configuration register for more
      information.
```

## dts/bindings/led/issi,is31fl3743.yaml
```yaml
# Copyright 2023 Daniel DeGrasse <daniel@degrasse.com>
# Copyright 2025-2026 Framework Computer Inc
# SPDX-License-Identifier: Apache-2.0
description: ISSI IS31FL3743 LED Matrix Driver

compatible: "issi,is31fl3743"

include: "i2c-device.yaml"

properties:
  sdb-gpios:
    type: phandle-array
    description: |
      Hardware shutdown pin. If routed on the board, this property must be
      present. Set to a logical 1 at boot to exit the device from hardware
      shutdown.

  current-limit:
    type: int
    default: 0xFF
    description: |
      Global current limit. Sets the global current control register of LED
      driver (set table 14). Limits global current based on the following
      formula: (343/R_ISET) * (current-limit/256). Defaults to max value
      of 0xFF, so LED output will still be enabled if property is
      not provided.

  current-sources:
    type: int
    default: 11
    description: |
      How many SW pins to source current from. Starting from SW1, enable n number of SW pins to
      source current for driving the LEDs. The default value works fine even if not all SW pins are
      connected to LEDs, however driving unconnected pins can result in audible electrical noise.
      So it is advised to disable all unused pins.
      Example: Setting this to 5, enables SW1-SW5 and disables SW6-SW11
    enum:
      - 11
      - 10
      - 9
      - 8
      - 7
      - 6
      - 5
      - 4
      - 3
      - 2
      - 0

  sync-mode:
    type: string
    default: "none"
    enum:
      - "none"
      - "slave"
      - "master"
    description: |
      This property configures the LED controller as a master or slave
      clock device. This can be used to synchronize the output of multiple
      LED controllers. See SYNC bits in LED configuration register for more
      information.
```
