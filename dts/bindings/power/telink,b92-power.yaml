## dts/bindings/power/telink,b92-power.yaml
```yaml
# Copyright (c) 2023-2024 Telink Semiconductor
# SPDX-License-Identifier: Apache-2.0

description: Telink B92 power control node

compatible: "telink,b92-power"

include: base.yaml

properties:
  reg:
    required: true

  power-mode:
    type: string
    required: true
    enum:
      - "LDO_1P4_LDO_2P0"
      - "DCDC_1P4_LDO_2P0"
      - "DCDC_1P4_DCDC_2P0"

  vbat-type:
    type: string
    required: true
    enum:
      - "VBAT_MAX_VALUE_LESS_THAN_3V6"
      - "VBAT_MAX_VALUE_GREATER_THAN_3V6"
```

## dts/bindings/power/telink,tl321x-power.yaml
```yaml
# Copyright (c) 2023 Telink Semiconductor
# SPDX-License-Identifier: Apache-2.0

description: Telink TL321X power control node

compatible: "telink,tl321x-power"

include: base.yaml

properties:
  reg:
    required: true

  power-mode:
    type: string
    required: true
    enum:
      - "LDO_1P25_LDO_1P8"

  vbat-type:
    type: string
    required: true
    enum:
      - "VBAT_MAX_VALUE_LESS_THAN_3V6"
      - "VBAT_MAX_VALUE_GREATER_THAN_3V6"
```

## dts/bindings/power/telink,tl721x-power.yaml
```yaml
# Copyright (c) 2024 Telink Semiconductor
# SPDX-License-Identifier: Apache-2.0

description: Telink TL721X power control node

compatible: "telink,tl721x-power"

include: base.yaml

properties:
  reg:
    required: true

  power-mode:
    type: string
    required: true
    enum:
      - "LDO_0P94_LDO_1P8"
      - "DCDC_0P94_LDO_1P8"
      - "DCDC_0P94_DCDC_1P8"

  vbat-type:
    type: string
    required: true
    enum:
      - "VBAT_MAX_VALUE_LESS_THAN_3V6"
      - "VBAT_MAX_VALUE_GREATER_THAN_3V6"
```

## dts/bindings/power/zephyr,power-state.yaml
```yaml
# Copyright (c) 2020, Intel Corporation
# Copyright 2025 NXP
# SPDX-License-Identifier: Apache-2.0

description: |
  Properties for power management idle states.

compatible: "zephyr,power-state"

properties:
  power-state-name:
    type: string
    required: true
    description: indicates a power state
    enum:
      - "active"
      - "runtime-idle"
      - "suspend-to-idle"
      - "standby"
      - "suspend-to-ram"
      - "suspend-to-disk"
      - "soft-off"
  substate-id:
    type: int
    description: Platform specific identification.
  min-residency-us:
    type: int
    description: |
      Minimum residency duration in microseconds.

      How much time the residency in a given idle state must last for state entry
      to be worthwhile energywise. It includes the time to enter into this state
      and represents the "break-even" time to justify the time and power spent
      on the work needed for entering and exiting the state based on how much actual energy
      is saved once in the state, compared to choosing the next shallowest state.
  exit-latency-us:
    type: int
    description: |
        Worst case latency in microseconds required to exit the idle state.
  zephyr,pm-device-disabled:
    type: boolean
    description: |
       Disable system managed device power management for this state. When set,
       the power management subsystem will not suspend devices before entering
       this state.
```

## dts/bindings/ppc/nuvoton,numaker-ppc.yaml
```yaml
# Copyright (c) 2024 Nuvoton Technology Corporation
# SPDX-License-Identifier: Apache-2.0

description: Nuvoton NuMaker USB Type-C power path controller

compatible: "nuvoton,numaker-ppc"

include: [base.yaml]
```

## dts/bindings/ppc/nxp,nx20p3483.yaml
```yaml
# Copyright 2023 Google LLC
# SPDX-License-Identifier: Apache-2.0

description: NXP NX20P3483 Power path controller chip

compatible: "nxp,nx20p3483"

include: [base.yaml, i2c-device.yaml]

properties:
  irq-gpios:
    type: phandle-array
    description: Interrupt pin

  snk-ovp:
    type: int
    default: 1
    description:
      Sink high-voltage overvoltage protection threshold in millivolts.
      This value must be set using one of the NX20P348X_U_THRESHOLD_* defines.

  src-hv:
    type: boolean
    description:
      If set, source role will use high-voltage path instead of 5V.

  src-hv-ocp:
    type: int
    default: 6
    description:
      Source high-voltage overcurrent protection threshold in milliamperes.
      This value must be set using one of the NX20P348X_I_THRESHOLD_* defines.

  src-5v-ocp:
    type: int
    default: 6
    description:
      Source 5V overcurrent protection threshold in milliamperes.
      This value must be set using one of the NX20P348X_I_THRESHOLD_* defines.
```

## dts/bindings/ps2/ite,it51xxx-ps2.yaml
```yaml
# Copyright (c) 2026 ITE Corporation. All Rights Reserved.
# SPDX-License-Identifier: Apache-2.0

description: IT51XXX PS2 controller

compatible: "ite,it51xxx-ps2"

include: [ps2.yaml, pinctrl-device.yaml]

properties:
  reg:
    required: true

  interrupts-extended:
    required: true

  bus-busy-timeout-ms:
    type: int
    description: |
      Timeout, in milliseconds, to wait for ps2 bus to become idle before
      transmitting. This value must be 500 (msec) or less. Default: 10 (msec).

  clk-gpios:
    type: phandle-array
    description: |
      GPIO pin used for the PS/2 clock signal, configured as wake source.
      This property is required if (device) power management is enabled.

  data-gpios:
    type: phandle-array
    description: |
      GPIO pin used for the PS/2 data signal, configured as wake source.
      This property is required if (device) power management is enabled.
```

## dts/bindings/ps2/nuvoton,npcx-ps2-channel.yaml
```yaml
# Copyright (c) 2021 Nuvoton Technology Corporation.
# SPDX-License-Identifier: Apache-2.0

description: Nuvoton, NPCX-PS/2 channel pads node

compatible: "nuvoton,npcx-ps2-channel"

include: [base.yaml, pinctrl-device.yaml]

properties:
  channel:
    type: int
    required: true
    description: index of i2c channel

  pinctrl-0:
    required: true

  pinctrl-names:
    required: true
```

## dts/bindings/ps2/nuvoton,npcx-ps2-ctrl.yaml
```yaml
# Copyright (c) 2021 Nuvoton Technology Corporation.
# SPDX-License-Identifier: Apache-2.0

description: Nuvoton, NPCX-PS/2 controller node

compatible: "nuvoton,npcx-ps2-ctrl"

include: base.yaml

bus: ps2

properties:
    reg:
      required: true

    clocks:
        required: true

    interrupts:
      required: true
```

## dts/bindings/ps2/ps2.yaml
```yaml
# Copyright (c) 2019, Intel Corporation
# SPDX-License-Identifier: Apache-2.0

# Common properties for PS/2 devices

include: base.yaml

bus: ps2

properties:
    "#address-cells":
      type: int
      required: true
      const: 1
    "#size-cells":
      type: int
      required: true
      const: 0
```

## dts/bindings/pse/pse-device.yaml
```yaml
# SPDX-License-Identifier: Apache-2.0

description: Properties for PSE devices

include: base.yaml

properties:
  friendly-name:
    type: string
    description: |
      Human readable string describing the PSE device. It can be used to
      distinguish multiple instances of the same model to a host operating 
      system.
```

## dts/bindings/pse/skyworks.si3474.yaml
```yaml
# SPDX-License-Identifier: Apache-2.0

description: Si3474 PoE Power Source Equipment

# Si3474 is on I2C.
compatible: "skyworks,si3474"

include: [pse-device.yaml, i2c-device.yaml]

properties:
  int-gpios:
    type: phandle-array
    required: true
    description: |
      The INT signal default configuration is active-high. The
      property value should ensure the flags properly describe the
      signal that is presented to the driver.
  rst-gpios:
    type: phandle-array
    required: true
    description: |
      The reset signal default configuration is active-high. The
      property value should ensure the flags properly describe the
      signal that is presented to the driver.
  oss-gpios:
    type: phandle-array
    required: true
    description: |
      The Over Supply Signal default configuration is active-high. The
      property value should ensure the flags properly describe the
      signal that is presented to the driver.
```

## dts/bindings/psi5/nxp,s32-psi5-channel.yaml
```yaml
# Copyright 2024 NXP
#
# SPDX-License-Identifier: Apache-2.0

description: Properties for Peripheral Sensor Interface (PSI5) channel

compatible: "nxp,s32-psi5-channel"

include: base.yaml

properties:
  async-mode:
    type: boolean
    description: |
      This setting enables the channel operation asynchronous mode with only RX active.
      Otherwise enables the channel operation synchronous mode with both TX and RX active.

  # Channel TX configuration
  target-pulse-us:
    type: int
    required: true
    description: |
       The duration of the internally generated synchronization pulses,
       measured in microseconds (us).

  decoder-offset-us:
    type: int
    required: true
    description: |
        The duration for which the Manchester decoder remains inactive after the falling edge
        of a sync pulse, measured in microseconds (us).

  low-pulse-width-us:
    required: true
    type: int
    description: |
      The duration of the pulse width for a data value of '0', measured in microseconds (us).

  high-pulse-width-us:
    required: true
    type: int
    description: |
      The duration of the pulse width for a data value of '1', measured in microseconds (us).

  tx-mode:
    type: string
    required: true
    enum:
      - short-frame-31
      - short-frame-5
      - long-frame-31
      - long-frame-5
      - x-long-frame-31
      - x-long-frame-5
      - xx-long-frame
      - non-standard-frame
    description: |
      Transmitter mode:
        - short-frame-31: Short Frame (V1.3) with 31 "1s" as the start condition
        - short-frame-5: Short Frame (V1.3) with 5 "0s" as the start condition
        - long-frame-31: Long Frame (V1.3) with 31 "1s" as the start condition
        - long-frame-5: Long Frame (V1.3) with 5 "0s" as the start condition
        - x-long-fram-31: X-Long Frame (V1.3) with 31 "1s" as the start condition
        - x-long-frame-5: X-Long Frame (V1.3) with 5 "0s" as the start condition
        - xx-long-frame: XX-Long (V2.0)
        - non-standard-frame: Non Standard Length

  # Channel RX configuration
  rx-buf-size:
    type: int
    required: true
    description: |
      The maximum number of RX buffers used for storing PSI5 messages, range from 1 to 32.

  bitrate-kbps:
    type: int
    required: true
    enum:
      - 125
      - 189
    description: |
      Selects the receive message bitrate in kbps

  array-slot-duration-us:
    type: array
    required: true
    description: |
      The array contains the slot duration in microseconds (us), beginning from the rising edge
      of the timing sync pulse and ending at the final slot.

  array-slot-start-offset-us:
    type: array
    required: true
    description: |
      The array contains the start offset of the slot should start in microseconds (us),
      at which the rising edge of the timing sync pulse occurs.

  array-slot-data-length:
    type: array
    required: true
    description: |
      The array contains the number of slot bits data length (ranges from 8 to 28)
```

## dts/bindings/psi5/nxp,s32-psi5-controller.yaml
```yaml
# Copyright 2024 NXP
#
# SPDX-License-Identifier: Apache-2.0

description: Properties for Peripheral Sensor Interface (PSI5)

compatible: "nxp,s32-psi5-controller"

include: [base.yaml, pinctrl-device.yaml]
```

## dts/bindings/psi5/nxp,s32-psi5.yaml
```yaml
# Copyright 2025 NXP
#
# SPDX-License-Identifier: Apache-2.0

description: NXP S32 PSI5 (Peripheral Sensor Interface) Controller

compatible: "nxp,s32-psi5"

include: [psi5-controller.yaml, pinctrl-device.yaml]

properties:
  pinctrl-0:
    required: true

  pinctrl-names:
    required: true

child-binding:

  properties:
    interrupts:
      type: array
      required: true
      description: Information about the channel interrupts.

    num-rx-buf:
      type: int
      required: true
      description: |
        Specifies the maximum number of receive buffers used for storing PSI5 messages.
        The value can range from 1 to 32, determining how many messages can be stored in
        the buffer at any given time.
```

## dts/bindings/psi5/nxp,s32-psi5_s.yaml
```yaml
# Copyright 2024 NXP
#
# SPDX-License-Identifier: Apache-2.0

description: Properties for Peripheral Sensor Interface with Serial PHY (PSI5_S)

compatible: "nxp,s32-psi5_s"

include: [base.yaml, pinctrl-device.yaml]

properties:
  uart-baud-rate:
    type: int
    required: true
    enum:
      - 1200
      - 2400
      - 4800
      - 7200
      - 9600
      - 14400
      - 19200
      - 28800
      - 38400
      - 57600
      - 115200
      - 230400
      - 460800
      - 921600
      - 1843200
    description: |
      uart-baud-rate

  uart-preset-timeout:
    type: int
    required: true
    description: |
      Preset timeout defines the preset value of timeout counter.
      A zero-value is forbidden

  uart-tx-idle-delay-time:
    type: int
    required: true
    description: |
      This register is used to add a programmable idle time between the data that is transmitted
      on the UART Tx line. The duration of this delay is programmable between 1 to 16 bit times.
      The programmable delay is such that when the normal ECU to Sensor communication(no direct command)
      is happening, then it comes into play between each byte of transmitted data, When the ECU
      to Sensor direct command is used then this delay comes into play between each direct command.
      The direct commands can be programmed as 1,2 and 4 bytes depending on the GLCR[DIRCMD_LEN] register

  uart-reduced-over-sampling:
    type: int
    required: true
    description: |
      uart-reduced-over-sampling

  uart-sampling-point:
    type: int
    required: true
    description: |
      uart-sampling-point

child-binding:
  description: Properties for Peripheral Sensor Interface with Serial PHY (PSI5_S) channel

  compatible: "nxp,s32-psi5_s-channel"

  include: base.yaml

  properties:
    async-mode:
      type: boolean
      description: |
        This setting enables the channel operation asynchronous mode for Rx only.
        Otherwise enables the channel operation synchronous mode for both Rx and Tx.

    # Channel TX configuration
    init-cmd:
      required: true
      type: int
      description: |
        Initial reset reload value for the integrated "CMD" format

    init-acmd:
      required: true
      type: int
      description: |
        Initial reset reload value for the integrated "ACMD" format

    target-period:
      required: true
      type: int
      description: |
        Subsequent reload values for the integrated period generator

    counter-delay:
      required: true
      type: int
      description: |
        Time in us for which the manchester decoder is disabled after the falling
        edge of a sync pulse

    tx-mode:
      type: string
      required: true
      enum:
        - short-frame-31
        - short-frame-5
        - long-frame-31
        - long-frame-5
        - x-long-frame-31
        - x-long-frame-5
        - xx-long-frame
        - non-standard-frame
      description: |
        Transmitter mode:
          - short-frame-31: Short Frame (V1.3) with 31 "1s" as the start condition
          - short-frame-5: Short Frame (V1.3) with 5 "0s" as the start condition
          - long-frame-31: Long Frame (V1.3) with 31 "1s" as the start condition
          - long-frame-5: Long Frame (V1.3) with 5 "0s" as the start condition
          - x-long-fram-31: X-Long Frame (V1.3) with 31 "1s" as the start condition
          - x-long-frame-5: X-Long Frame (V1.3) with 5 "0s" as the start condition
          - xx-long-frame: XX-Long (V2.0)
          - non-standard-frame: Non Standard Length

    slots-pay-load-size:
      type: array
      required: true
      description: |
        Payload region length
```
