## dts/bindings/psi5/psi5-controller.yaml
```yaml
# Copyright 2025 NXP
#
# SPDX-License-Identifier: Apache-2.0

description: PSI5 (Peripheral Sensor Interface) Controller

include: base.yaml

properties:
  reg:
    required: true

child-binding:
  description: |
    Each child node defines the configuration of a PSI5 channel

  properties:
    reg:
      type: int
      required: true
      description: Channel identifier.

    async-mode:
      type: boolean
      description: |
        Determines the channel operation mode. When set to true, the channel operates in
        asynchronous mode with only the receive function active. When set to false,
        the channel operates in synchronous mode with both transmit and receive functions active.

    period-sync-pulse-us:
      type: int
      description: |
        Specifies the period of the internally generated synchronization pulses, measured in
        microseconds (us). This value determines the length of each synchronization pulse used
        in the system.

    pulse-width-0-us:
      type: int
      description: |
        Specifies the duration of the pulse width for a data bit value '0', measured in
        microseconds (us).

    pulse-width-1-us:
      type: int
      description: |
        Specifies the duration of the pulse width for a data bit value '1', measured in
        microseconds (us).

    decoder-start-offset-us:
      type: int
      description: |
        Specifies the duration for which the Manchester decoder remains inactive after the
        falling edge of a synchronization pulse, measured in microseconds (us). This value
        determines the delay before the decoder starts processing incoming signals again.

    tx-frame:
      type: string
      enum:
        - "short-31-1s"
        - "short-5-0s"
        - "long-31-1s"
        - "long-5-0s"
        - "x-long-31-1s"
        - "x-long-frame-5-0s"
        - "xx-long-frame"
        - "non-standard-frame"
      description: |
        Specifies the transmitter mode. Each mode defines the frame length and
        the start condition for data transmission:
          - short-31-1s: Short Frame (V1.3) with at least 31 consecutive '1' bits
            as the start condition
          - short-5-0s: Short Frame (V1.3) with at least 5 consecutive '0' bits
            as the start condition
          - long-31-1s: Long Frame (V1.3) with at least 31 consecutive '1' bits
            as the start condition
          - long-5-0s: Long Frame (V1.3) with at least 5 consecutive '0' bits
            as the start condition
          - x-long-31-1s: X-Long Frame (V1.3) with at least 31 consecutive '1' bits
            as the start condition
          - x-long-5-0s: X-Long Frame (V1.3) with at least 5 consecutive '0' bits
            as the start condition
          - xx-long: XX-Long (V2.0)
          - non-standard: Non Standard Length

    rx-bitrate-kbps:
      type: int
      required: true
      enum:
        - 125
        - 189
      description: |
        Selects the receive message bitrate in kbps. This setting determines the speed at
        which data is received.

  child-binding:
    description: |
      Each child node defines the configuration of a channel RX slot

    properties:
      reg:
        type: int
        required: true
        description: Channel RX slot identifier.

      duration-us:
        type: int
        required: true
        description: |
          Specifies the duration of a slot, starting from the rising edge of the
          timing synchronization pulse and ending at the final slot.

      start-offset-us:
        type: int
        required: true
        description: |
          Specifies the time offset at which the slot should start, measured from the
          rising edge of the timing synchronization pulse.

      data-length:
        type: int
        required: true
        description: |
          Specifies the number of bits in a slot, with valid lengths ranging from 8 to 28 bits.

      data-msb-first:
        type: boolean
        description: |
          Specifies the endianness type for data slot. Set to 1 when data is interpreted with the
          Most Significant Bit (MSB) first.

      has-smc:
        type: boolean
        description: |
          Specifies whether data slot has Serial Messaging Channel (SMC) field. Set to 1 when
          the bit (M0, M1) SMC is present in the Rx Message.

      has-parity:
        type: boolean
        description: |
          Specifies whether data slot has parity field. Set to 1 when the Parity field is
          present in the Rx Message; otherwise, the CRC field is present.
```

## dts/bindings/pulse-io/pulse-io-controller.yaml
```yaml
# Copyright (c) 2026 Espressif Systems (Shanghai) Co., Ltd.
# SPDX-License-Identifier: Apache-2.0

description: |
  Abstract Pulse IO controller.

  Vendor-specific compatibles include this binding. Children that consume
  one channel reference the controller via a "pulse-ios" phandle-array
  and a single cell that selects the channel index.

properties:
  "#pulse-io-cells":
    type: int
    required: true
    const: 1
    description: |
      Number of cells in a pulse-ios specifier. Must be 1; the single
      cell selects the channel index on the controller.

pulse-io-cells:
  - channel
```

## dts/bindings/pulse-io/zephyr,pulse-io-loopback.yaml
```yaml
# Copyright (c) 2026 Espressif Systems (Shanghai) Co., Ltd.
# SPDX-License-Identifier: Apache-2.0

description: |
  Software loopback Pulse IO controller. A functional backend that loops
  transmitted symbols back on receive, for testing the subsystem API
  without hardware.

compatible: "zephyr,pulse-io-loopback"

include: [pulse-io-controller.yaml]

properties:
  num-channels:
    type: int
    default: 4
    description: Number of channels the controller exposes.
```

## dts/bindings/pwm/adi,max2221x-pwm.yaml
```yaml
# Copyright (c) 2025 Analog Devices Inc.
# SPDX-License-Identifier: Apache-2.0

description: Analog Devices MAX22216/MAX22217 PWM

compatible: "adi,max2221x-pwm"

include: [pwm-controller.yaml, base.yaml]

properties:
  "#pwm-cells":
    const: 3

pwm-cells:
  - channel
  - period
  - flags
```

## dts/bindings/pwm/adi,max32-pwm.yaml
```yaml
# Copyright (c) 2023-2024 Analog Devices, Inc.
# SPDX-License-Identifier: Apache-2.0

description: ADI MAX32 PWM

compatible: "adi,max32-pwm"

include: [base.yaml, pwm-controller.yaml, pinctrl-device.yaml]

properties:
  pinctrl-0:
    required: true

  pinctrl-names:
    required: true

  "#pwm-cells":
    const: 3

pwm-cells:
  - channel
  - period
  - flags
```

## dts/bindings/pwm/ambiq,ctimer-pwm.yaml
```yaml
# Copyright (c) 2025, Ambiq
# SPDX-License-Identifier: Apache-2.0

description: Ambiq CTIMER PWM

compatible: "ambiq,ctimer-pwm"

include: [pwm-controller.yaml, pinctrl-device.yaml, base.yaml]

properties:
  pinctrl-0:
    required: true

  pinctrl-names:
    required: true

  timer-segment:
    type: string
    required: true
    enum:
      - "SEGMENT_A"
      - "SEGMENT_B"
    description: timer segment to use

  pwm-type:
    type: string
    required: true
    enum:
      - "PWM_ONCE"
      - "PWM_REPEAT"
    description: |
      Mode selection
      - AM_HAL_CTIMER_FN_PWM_ONCE
      - AM_HAL_CTIMER_FN_PWM_REPEAT

  "#pwm-cells":
    const: 3

pwm-cells:
  - channel
  - period
  - flags
```

## dts/bindings/pwm/ambiq,timer-pwm.yaml
```yaml
# Copyright (c) 2025, Ambiq
# SPDX-License-Identifier: Apache-2.0

description: Ambiq TIMER PWM

compatible: "ambiq,timer-pwm"

include: [pwm-controller.yaml, pinctrl-device.yaml, base.yaml]

properties:
  pinctrl-0:
    required: true

  pinctrl-names:
    required: true

  "#pwm-cells":
    const: 3

pwm-cells:
  - channel
  - period
  - flags
```

## dts/bindings/pwm/arduino-header-pwm.yaml
```yaml
# Copyright (C) 2025 TOKITA Hiroshi
# SPDX-License-Identifier: Apache-2.0

description: |
  PWM channels exposed on Arduino headers.

  Arduino's PWM pin names shares the same definition as Digital pins one.
  That is, the mapping of PWM output on pin D3 on Arduino UNO R3 header is

    pwm-map = <9 0 0 &pwm0 1 0 0>;

compatible: "arduino-header-pwm"

include: [base.yaml, pwm-nexus.yaml]
```

## dts/bindings/pwm/atmel,sam-pwm.yaml
```yaml
# Copyright (c) 2019, Aurelien Jarno
# SPDX-License-Identifier: Apache-2.0

description: Atmel SAM PWM

compatible: "atmel,sam-pwm"

include:
    - name: base.yaml
    - name: pwm-controller.yaml
    - name: pinctrl-device.yaml

properties:
    reg:
      required: true

    interrupts:
      required: true

    peripheral-id:
      type: int
      description: peripheral ID
      required: true

    prescaler:
      type: int
      required: true
      description: Clock prescaler at the input of the PWM (0 to 10)

    divider:
      type: int
      required: true
      description: Clock divider at the input of the PWM (1 to 255)

    "#pwm-cells":
      const: 2

pwm-cells:
  - channel
# period in terms of nanoseconds
  - period
```
