## dts/bindings/power/bflb,power-controller.yaml
```yaml
# Copyright (c) 2026 MASSDRIVER EI (massdriver.space)
# SPDX-License-Identifier: Apache-2.0

title: Bouffalolab Power Controller

description: |
  Power Controller for Bouffalolab MCUs

  Controls various power elements spread over multiple hardware ensembles, such as HBN and AON

  example for bl61x:
  / {
    soc {
      powerctrl: power-controller@2000e000 {
          compatible = "bflb,power";
          reg = <0x2000f000 0x1000>, <0x2000f000 0x1000>;
          reg-names = "hbn", "aon";
          status = "okay";

          interrupt-parent = <&clic>;
          interrupts = <67 1>, <68 1>, <69 1>;
          interrupt-names = "hbn0", "hbn1", "bor";
      };
    };
  };

compatible: "bflb,power-controller"

include: base.yaml

properties:
  reg:
    required: true

  reg-names:
    required: true

  brown-out-threshold-microvolt:
    type: int
    default: 2400000
    enum:
      - 2000000 # BL60x, BL70x/L Only
      - 2050000 # BL61x and BL808 only values up to 2400000
      - 2100000
      - 2150000
      - 2200000
      - 2250000
      - 2300000
      - 2350000
      - 2400000 # Also available on BL60x and BL70x/L
      - 2330000 # Range of possible values for BL616CL starting here
      - 2370000
      - 2420000
      - 2460000
      - 2510000
      - 2560000
      - 2610000
      - 2670000
    description: |
      Defines Brown Out voltage.

  brown-out-reset-disable:
    type: boolean
    description: |
      Do not reset on Brown Out.
```

## dts/bindings/power/gd,gd32-pmu.yaml
```yaml
# Copyright (c) 2022 Teslabs Engineering S.L.
# SPDX-License-Identifier: Apache-2.0

description: GD32 Power Management Unit (PMU)

compatible: "gd,gd32-pmu"

include: base.yaml

properties:
  clocks:
    required: true

  high-driver-enable:
    type: boolean
    required: false
    description: |
      This option will enable the high-driver mode. It is required when
      operating at high frequencies.
```

## dts/bindings/power/infineon,cat1b-power.yaml
```yaml
# Copyright (c) 2025 Cypress Semiconductor Corporation (an Infineon company) or
# an affiliate of Cypress Semiconductor Corporation
#
# SPDX-License-Identifier: Apache-2.0

description: Infineon CAT1B power control

compatible: "infineon,cat1b-power"

include: base.yaml

properties:

  power-profile:
    type: string
    description: |
      Selects the System Active power profile:
        - POWER_PROFILE_0 (LP MCU + Radio ON): All peripheral and CPU power modes are
        available with a maximum configurable CPU clock at 96 MHz with a regulated
        voltage of 1.1 V. Bluetooth® functionality is available because the radio
        module is powered ON.

        - POWER_PROFILE_1 (ULP MCU + Radio ON): All CPU peripherals and power modes are
        available with the maximum frequency of 48 MHz and operating at 1.0 V voltage
        regulation (see Regulator operations). Bluetooth® functionality is available because
        the radio module is powered ON.

        - POWER_PROFILE_2A (LP MCU Only): All peripheral and CPU power modes are available at
        full speed (96 MHz) with a regulated voltage of 1.1 V, but Bluetooth® functionality is not
        available because the radio module is in OFF state. The core buck voltage and mode are set
        to high power 1.16 V and SDR0 is set to regulated 1.1 V.

        - POWER_PROFILE_2B (LP MCU Only): All peripheral and CPU power modes are available at
        full speed (96 MHz) with a regulated voltage of 1.1 V, but the Bluetooth® functionality is
        not available because the radio module is in OFF state. The core buck voltage and mode are
        set to low-power 1.1 V and SDR0 is set to bypassed 1.1 V.

        - POWER_PROFILE_3 (ULP MCU Only): All CPU peripherals and power modes are available
        with the maximum frequency of 48 MHz and operating with a regulated voltage of 1.0 V.
        Bluetooth® radio module is turned OFF.
    enum:
      - "POWER_PROFILE_0"
      - "POWER_PROFILE_1"
      - "POWER_PROFILE_2A"
      - "POWER_PROFILE_2B"
      - "POWER_PROFILE_3"
```

## dts/bindings/power/ite,it8xxx2-power-elpm.yaml
```yaml
# Copyright (c) 2025 ITE Corporation. All Rights Reserved.
# SPDX-License-Identifier: Apache-2.0

description: IT8XXX2 Extreme Low Power Controller

compatible: "ite,it8xxx2-power-elpm"

include: [base.yaml, pinctrl-device.yaml]

properties:
  reg:
    required: true

  pinctrl-0:
    required: true

  pinctrl-names:
    required: true

child-binding:
  description: XLPIN configuration

  properties:
    reg:
      type: int
      description: the index of XLPIN

    latch-enable:
      type: boolean
      description: Enable latching of XLPIN if present

    polarity:
      type: string
      required: true
      enum: ["default", "low-falling", "high-rising"]
      description: |
        Polarity setting for this XLPIN:
          - "default" disables it
          - "low-falling" triggers on low/falling edge
          - "high-rising" triggers on high/rising edge
```

## dts/bindings/power/lowrisc,opentitan-pwrmgr.yaml
```yaml
# Copyright (c) 2023 Rivos
# SPDX-License-Identifier: Apache-2.0

description: OpenTitan power management

compatible: "lowrisc,opentitan-pwrmgr"

include: base.yaml

properties:
  reg:
    required: true
```

## dts/bindings/power/max170xx.yaml
```yaml
#
# Copyright (c) 2018, Foundries.io
#
# SPDX-License-Identifier: Apache-2.0
#
---
title: MAX170XX fuel gauge family
version: 0.1

description: >
    This is a representation of the MAX170XX fuel gauge family.

inherits:
  !include i2c-device.yaml

properties:
    compatible:
      type: string
      category: required
      constraint: "maxim,max170xx"
      generation: define
    alert-gpios:
      type: compound
      category: optional
      description: ALERT pin
      generation: define, use-prop-name
...
```

## dts/bindings/power/nordic,nrf-gpd.yaml
```yaml
# Copyright 2024 Nordic Semiconductor ASA
# SPDX-License-Identifier: Apache-2.0

description: Nordic nRF Global Power Domain

compatible: "nordic,nrf-gpd"

include: base.yaml

power-domain-cells:
  - id
```

## dts/bindings/power/nordic,nrf-power.yaml
```yaml
# Copyright (c) 2018 Nordic Semiconductor ASA
# SPDX-License-Identifier: Apache-2.0

description: Nordic nRF power control node

compatible: "nordic,nrf-power"

include: base.yaml

properties:
  reg:
    required: true

  interrupts:
    required: true
```

## dts/bindings/power/nordic,nrf-regulators.yaml
```yaml
# Copyright (c) 2019 Nordic Semiconductor ASA
# SPDX-License-Identifier: Apache-2.0

description: Nordic REGULATORS (voltage regulators control module)

compatible: "nordic,nrf-regulators"

include: base.yaml

properties:
  reg:
    required: true
```

## dts/bindings/power/nordic,nrf-usbreg.yaml
```yaml
# Copyright (c) 2022 Nordic Semiconductor ASA
# SPDX-License-Identifier: Apache-2.0

description: Nordic nRF family USBREG (USB Regulator Control)

compatible: "nordic,nrf-usbreg"

interrupt-source: true

include: base.yaml

properties:
  reg:
    required: true
```

## dts/bindings/power/nordic,nrf-vmc.yaml
```yaml
# Copyright (c) 2019 Nordic Semiconductor ASA
# SPDX-License-Identifier: Apache-2.0

description: Nordic VMC (Volatile Memory Controller)

compatible: "nordic,nrf-vmc"

include: base.yaml

properties:
    reg:
      required: true
```

## dts/bindings/power/nrf-power.yaml
```yaml
#
# Copyright (c) 2018 Nordic Semiconductor ASA
#
# SPDX-License-Identifier: Apache-2.0
#
---
title: Nordic nRF power control
version: 0.1

description: >
    This is a representation of the Nordic nRF power control node

properties:
    compatible:
      type: string
      category: required
      description: compatible strings
      constraint: "nordic,nrf-power"

    reg:
      type: array
      category: required
      description: mmio register space
      generation: define

    interrupts:
      type: array
      category: required
      description: required interrupts
      generation: define
...
```

## dts/bindings/power/nuvoton,npcx-power-psl.yaml
```yaml
# Copyright (c) 2022 Nuvoton Technology Corporation.
# SPDX-License-Identifier: Apache-2.0

description: Nuvoton, NPCX Power Switch Logic (PSL) control node

compatible: "nuvoton,npcx-power-psl"

include: [base.yaml, pinctrl-device.yaml]

properties:
  enable-gpios:
    type: phandle-array
    required: true
    description: |
      GPIO to used to turn on/off the Core Domain power supply (VCC1) of NPCX
      embedded controller (EC)
  pinctrl-0:
    required: true
  pinctrl-names:
    required: true
```

## dts/bindings/power/nxp,aon-wakeup-pin.yaml
```yaml
# Copyright 2024, NXP
# SPDX-License-Identifier: Apache-2.0

description: Some NXP SoC's have pins dedicated to generate a wakeup interrupt.

compatible: "nxp,aon-wakeup-pin"

include: base.yaml

properties:
  interrupts:
    type: array
    required: true
    description: Interrupt to wakeup the SoC from low power modes.

  wakeup-level:
    type: string
    enum:
      - "low"
      - "high"
    default: "high"
    description: |
        Wakeup level on the pin, default is wakeup on high level
        which is the reset value.
```

## dts/bindings/power/nxp,pdcfg-power.yaml
```yaml
# Copyright 2022, NXP
# SPDX-License-Identifier: Apache-2.0

description: Properties for NXP power management through the PDCFG register

compatible: "nxp,pdcfg-power"

include: zephyr,power-state.yaml

properties:
    deep-sleep-config:
        type: array
        description: |
          An array of values written to the PDSLEEPCFG registers that controls the power to various blocks
          while the CPU is in deep sleep mode. These values are programmed to the sleep configuration registers
          before entering deep sleep mode.
```

## dts/bindings/power/nxp,pmc-power-rail-controller.yaml
```yaml
# SPDX-FileCopyrightText: Copyright 2026 NXP
# SPDX-License-Identifier: Apache-2.0

description: |
  NXP PMC (Power Management Controller) power-rail controller.

compatible: "nxp,pmc-power-rail-controller"

include: base.yaml

examples: |
    pmc0: pmc@20f000 {
      compatible = "nxp,pmc-power-rail-controller";
      reg = <0x20f000 0x1000>;
      #power-rail-cells = <1>;
    };

    &lcdif {
      nxp,power-rails = <&pmc0 NXP_RT7XX_PMC_APD_LCDIF>,
                        <&pmc0 NXP_RT7XX_PMC_PPD_LCDIF>;
    };

properties:
  reg:
    required: true

  "#power-rail-cells":
    type: int
    const: 1

power-rail-cells:
  - id
```

## dts/bindings/power/nxp,rw-pmu.yaml
```yaml
# Copyright 2024 NXP
# SPDX-License-Identifier: Apache-2.0

description: NXP RW PMU

compatible: "nxp,rw-pmu"

include: base.yaml

properties:
  reset-causes-en:
    type: array
    description: |
      List reset causes to enable, using bitmasks of SYS_RESET registers.
```

## dts/bindings/power/nxp,s32-mc-me.yaml
```yaml
# Copyright 2024,2025 NXP
# SPDX-License-Identifier: Apache-2.0

description: NXP S32 Module Entry (MC_ME)

compatible: "nxp,s32-mc-me"

include: base.yaml

properties:
  reg:
    required: true

  software-reset-supported:
    type: boolean
    description: The module implements a software-based mechanism for initiate the reset sequence.
```

## dts/bindings/power/nxp,s32-mc-rgm.yaml
```yaml
# Copyright 2024 NXP
# SPDX-License-Identifier: Apache-2.0

description: NXP S32 Module Reset Generation (MC_RGM)

compatible: "nxp,s32-mc-rgm"

include: base.yaml

properties:
  reg:
    required: true

  func-reset-threshold:
    type: int
    enum: [0, 1, 2, 3, 4, 5, 6, 7, 8, 9, 10, 11, 12, 13, 14, 15]
    default: 15
    description: |
      Functional Reset Escalation threshold.
      If the value of this property is 0, the Functional reset escalation
      function is disabled. Any other value is the number of Functional
      resets that causes a Destructive reset, if the FRET register isn't
      written to beforehand.
      Default to maximum threshold (hardware reset value).

  dest-reset-threshold:
    type: int
    enum: [0, 1, 2, 3, 4, 5, 6, 7, 8, 9, 10, 11, 12, 13, 14, 15]
    default: 0
    description: |
      Destructive Reset Escalation threshold.
      If the value of this property is 0, the Destructive reset escalation
      function is disabled. Any other value is the number of Destructive
      resets which keeps the chip in the reset state until the next power-on
      reset triggers a new reset sequence, if the DRET register isn't
      written to beforehand.
      Default to disabled (hardware reset value).
```

## dts/bindings/power/nxp,s32k3-pmc.yaml
```yaml
# Copyright 2024 NXP
# SPDX-License-Identifier: Apache-2.0

description: NXP S32K3xx Power Management Controller (PMC)

compatible: "nxp,s32k3-pmc"

include: base.yaml

properties:
  reg:
    required: true

  lm-reg:
    type: boolean
    description: |
      Enables the Last Mile regulator, which regulates an external 1.5V
      voltage on V15 down to the core and logic supply (V11 power domain),
      which is typically 1.1V.
      When enabling PLL as system clock, the PMC Last Mile regulator should
      be enabled.

  lm-reg-auto:
    type: boolean
    description: |
      Enables to turn over automatically from Boot Regulator Mode to Last Mile
      regulator mode and vice versa, depending on the V15 voltage status.
      When configuring system clocks higher than FIRC clock frequency,
      lm-reg should be also enabled.

  lm-reg-base-control:
    type: boolean
    description: |
      Enable this if an external BJT between VDD_HV_A and V15 is used on the
      PCB. The base of this BJT must be connected to the VRC_CTRL pin and is
      controlled by the PMC to regulate a voltage of 1.5V on V15 pin.
```

## dts/bindings/power/nxp,smc.yaml
```yaml
# Copyright 2026 NXP
# SPDX-License-Identifier: Apache-2.0

description: NXP System Mode Controller (SMC)

compatible: "nxp,smc"

include: base.yaml

properties:
  reg:
    required: true
```

## dts/bindings/power/nxp,vbat.yaml
```yaml
# Copyright 2025 NXP
# SPDX-License-Identifier: Apache-2.0

description: NXP Smart Power Switch (VBAT)

compatible: "nxp,vbat"

include: base.yaml

properties:
  reg:
    required: true
```

## dts/bindings/power/realtek,rts5912-ulpm.yaml
```yaml
# Copyright (c) 2025 Realtek Semiconductor Corporation, SIBG-SD7
# SPDX-License-Identifier: Apache-2.0

description: RTS5912 ULPM power controller

compatible: "realtek,rts5912-ulpm"

include: base.yaml

properties:
  wkup-pins-max:
    type: int
    description: |
      Max nbr of system wake-up pins.
      For example wkup-pins-nb = <5>; on the rts5912

child-binding:
  description: |
    RTS5912 wake-up pin node.

    All nodes using this binding must be named "wkup-pin@[index]"
    index starts from 0

  properties:
    reg:
      type: array
      required: true
      description: Wake-up pin identifier, same as "index" in node name

    wkup-pin-pol:
      type: string
      default: rising
      description: indicates a wakeup polarity
      enum:
        - rising
        - falling

    wkup-pin-mode:
      type: string
      default: vin
      required: true
      description: indicates a wakeup pin mode selection
      enum:
        - vin
        - gpio
```
