## dts/bindings/regulator/adi,max20362-regulator.yaml
```yaml
# Copyright (c) 2025 Analog Devices Inc.
# SPDX-License-Identifier: Apache-2.0

description: |
  Analog Devices MAX20362 PMIC

  The PMIC has a bidirectional buck-boost converter, a CAP output and an LDO.
  Each rail that is used must be defined as a child node, strictly following the
  bboost, cap and ldo node names.

compatible: "adi,max20362-regulator"

include: [i2c-device.yaml, base.yaml]

properties:
  reg:
    required: true

  bat-bbin-vdrop:
    type: int
    required: true
    enum:
      - 0
      - 1
      - 2
      - 3
    description: |
      Voltage drop from BAT to BBIN in millivolts. Refer to the macros from
      <zephyr/dt-bindings/regulator/max20362.h>:
      - 0: 55 mV  (MAX20362_BAT_BBIN_VDROP_55MV)
      - 1: 100 mV (MAX20362_BAT_BBIN_VDROP_100MV)
      - 2: 150 mV (MAX20362_BAT_BBIN_VDROP_150MV)
      - 3: 200 mV (MAX20362_BAT_BBIN_VDROP_200MV)

  dvs-src:
    type: int
    required: true
    enum:
      - 0
      - 1
      - 2
    description: |
      Interface for DVS. Refer to the macros from
      <zephyr/dt-bindings/regulator/max20362.h>:
      - 0: I2C         (MAX20362_DVS_SRC_I2C)
      - 1: Pseudo-SPI  (MAX20362_DVS_SRC_PSEUDO_SPI)
      - 2: Round-Robin (MAX20362_DVS_SRC_ROUND_ROBIN)

  ldo-src:
    type: int
    required: true
    enum:
      - 0
      - 1
      - 2
    description: |
      LDO input source. If the source is buck-boost, the LDO control
      can wait for the buck to be on before turning on the LDO.
      Refer to the macros from <zephyr/dt-bindings/regulator/max20362.h>:
      - 0: BBOUT (MAX20362_LDO_SRC_BBOUT)
      - 1: CAP   (MAX20362_LDO_SRC_CAP)
      - 2: BATT  (MAX20362_LDO_SRC_BATT)

  rr-wrap:
    type: boolean
    description: |
      Round-Robin wraps back to the first VSET after the last step instead of
      stopping at the last value. Maps to DVS_CFG.RRWrap. Only used when
      dvs-src = <MAX20362_DVS_SRC_ROUND_ROBIN>.

  rr-clk-rising:
    type: boolean
    description: |
      Round-Robin clock is active-high: the voltage updates on the rising edge.
      When absent, the clock is active-low (falling edge). Maps to
      RR_CFG1.RRClkPolarity. Only used when dvs-src is Round-Robin.

  rr-timeout-reset:
    type: boolean
    description: |
      Reset the Round-Robin pointer after a timeout. Maps to RR_CFG1.RRTimeoutRes.
      Only used when dvs-src is Round-Robin.

  rr-timeout:
    type: int
    default: 0
    enum:
      - 0
      - 1
      - 2
      - 3
      - 4
      - 5
      - 6
    description: |
      Round-Robin timeout duration. Refer to the macros from
      <zephyr/dt-bindings/regulator/max20362.h>:
      - 0: disabled (MAX20362_RR_TIMEOUT_DISABLED)
      - 1: 500 us   (MAX20362_RR_TIMEOUT_500US)
      - 2: 1 ms     (MAX20362_RR_TIMEOUT_1MS)
      - 3: 2 ms     (MAX20362_RR_TIMEOUT_2MS)
      - 4: 4 ms     (MAX20362_RR_TIMEOUT_4MS)
      - 5: 8 ms     (MAX20362_RR_TIMEOUT_8MS)
      - 6: 16 ms    (MAX20362_RR_TIMEOUT_16MS)

  rr-microvolt:
    type: array
    description: |
      Round-Robin VSET table, in microvolts, in step order. Each value must fall
      on the buck-boost output range. Provide between 1 and 20 entries; the
      number of entries programs RR_CFG1.RRSize (steps = count - 1). Only used
      when dvs-src = <MAX20362_DVS_SRC_ROUND_ROBIN>.

child-binding:
  description: |
    Each rail that is used must be defined as a child node, strictly following
    these node names, otherwise it will not be recognized:
    - bboost
    - cap
    - ldo
  include:
    - name: regulator.yaml
      property-allowlist:
        - regulator-init-microvolt
        - regulator-min-microvolt
        - regulator-max-microvolt
        - regulator-init-microamp
        - regulator-max-microamp
        - regulator-always-on
        - regulator-boot-on
        - regulator-initial-mode
        - regulator-allowed-modes

examples:
  - |
    max20362_regulators: max20362@68 {
      compatible = "adi,max20362-regulator";
      reg = <0x68>;
      bat-bbin-vdrop = <0>;
      dvs-src = <0>;
      ldo-src = <1>;

      bboost {
        /* all properties for BBOOST */
      };
      cap {
        /* all properties for CAP */
      };
      ldo {
        /* all properties for LDO */
      };
    };
```

## dts/bindings/regulator/infineon,tle927x-vcc2.yaml
```yaml
# SPDX-FileCopyrightText: Copyright (c) 2026 Deere & Company
# SPDX-FileCopyrightText: Copyright (c) 2026 Linumiz
# SPDX-License-Identifier: Apache-2.0

description: |
  Infineon TLE927x VCC2 regulator.

  VCC2 is a fixed 5 V LDO, there is no voltage setting in silicon.

  regulator-initial-mode and regulator-allowed-modes take the
  TLE927X_VCC2_MODE_* values from <zephyr/dt-bindings/regulator/tle927x.h> and
  select which SBC modes the rail stays on in.

  Note: on boards where VCC2 supplies the VCAN pin, VCC2 must be on before the
  CAN transceiver is switched to Normal mode (datasheet 8.2.4), so such boards
  should set regulator-boot-on.

compatible: "infineon,tle927x-vcc2"

include:
  - name: base.yaml
  - name: regulator.yaml
    property-allowlist:
      - regulator-name
      - regulator-boot-on
      - regulator-boot-off
      - regulator-always-on
      - regulator-initial-mode
      - regulator-allowed-modes
      - startup-delay-us
      - off-on-delay-us

on-bus: tle927x
```

## dts/bindings/regulator/nordic,npm10xx-regulator.yaml
```yaml
# Copyright (c) 2026 Nordic Semiconductor
# SPDX-License-Identifier: Apache-2.0

description: Nordic nPM10xx PMIC regulator

include: base.yaml

compatible: "nordic,npm10xx-regulator"

properties:
  dvs-gpios:
    type: phandle-array
    description: |
      List of SoC GPIOs connected to PMIC as regulator control GPIOs.
      regulator_parent_dvs_state_set will drive these pins according to the bits set in the state
      identifier, that is:
        0 (0b000) - deactivate all pins
        1 (0b001) - activate only the first pin
        2 (0b010) - activate only the second pin
        3 (0b011) - activate both the first and the second pin
        etc.
      The effect of the state change is defined by the *-gpio-config properties for each of the
      regulator blocks. Provide up to three pins (nPM10xx has 3 GPIOs).

child-binding:
  include:
    - name: regulator.yaml
      property-allowlist:
        - regulator-name
        - regulator-init-microvolt
        - regulator-min-microvolt
        - regulator-max-microvolt
        - regulator-init-microamp
        - regulator-min-microamp
        - regulator-max-microamp
        - regulator-always-on
        - regulator-boot-on
        - regulator-boot-off
        - regulator-allow-bypass
        - regulator-initial-mode
        - regulator-allowed-modes
        - regulator-over-current-protection
        - regulator-active-discharge

  properties:
    regulator-init-microvolt:
      description: Valid range is 1V to 3V3 with 50mV steps. BUCK and LDO.

    regulator-min-microvolt:
      description: Valid range is 1V to 3V3 with 50mV steps. BUCK and LDO.

    regulator-max-microvolt:
      description: Valid range is 1V to 3V3 with 50mV steps. BUCK and LDO.

    regulator-alternate-microvolt:
      type: int
      description: Alternate output voltage. Valid range is 1V to 3V3 with 50mV steps. BUCK only.

    regulator-init-microamp:
      enum:
        - 66000
        - 91000
        - 117000
        - 142000
        - 167000
        - 192000
        - 217000
        - 291000
      description: Peak current limit to set during initialization. BUCK only.

    regulator-min-microamp:
      enum:
        - 66000
        - 91000
        - 117000
        - 142000
        - 167000
        - 192000
        - 217000
        - 291000
      description: Minimum allowed peak current limit. BUCK only.

    regulator-max-microamp:
      enum:
        - 66000
        - 91000
        - 117000
        - 142000
        - 167000
        - 192000
        - 217000
        - 291000
      description: Maximum allowed peak current limit. BUCK only.

    regulator-allow-bypass:
      description: |
        Enable automatic pass-through mode when BUCK output does not reach the target due to low
        supply voltage. BUCK only.

    regulator-soft-start-current-idx:
      type: int
      min: 0
      max: 7
      description: |
        Peak current limit for startup. The values are:
          LDO (in LDO mode) - 0: 20mA; 1: 30mA; 2: 50mA; 3: 80mA
          LDO (in Load Switch mode) - 0: 25mA; 1: 40mA; 2: 60mA; 3: 100mA
          LDSW - 0: 10mA; 1: 15mA; 2: 30mA; 3: 45mA
          BUCK - 0: 66mA; 1: 91mA; 2: 117mA; 3: 142mA; 4: 167mA; 5: 192mA; 6: 217mA; 7: 291mA

    regulator-soft-start-us:
      type: int
      enum:
        - 0
        - 4500
        - 7500
        - 10500
      description: |
        Soft start time. LDO and LDSW. Value 0 maps to hardware's default which is 20.5ms for LDO
        and 1.5ms for LDSW.

    regulator-pull-down-ohms:
      type: int
      enum:
        - 250
        - 500
        - 1000
        - 2000
      description: Pull-down resistance in Ohms. BUCK only.

    regulator-ripple:
      type: string
      enum:
        - "default"
        - "low"
        - "high"
      description: Output voltage ripple. BUCK only.

    enable-gpio-config:
      type: array
      description: Regulator enable controlled by specified GPIO pin <idx flags>.

    pwr-mode-gpio-config:
      type: array
      description: Regulator power mode controlled by specified GPIO pin <idx flags>. BUCK only.

    alternate-vout-gpio-config:
      type: array
      description: |
        Regulator alternate output voltage controlled by specified GPIO pin <idx flags>. BUCK only.

examples:
  - |
    npm1012: pmic@6a {
      reg = <0x6a>;
      compatible = "nordic,npm10xx";
      /* ... */

      regulators {
        compatible = "nordic,npm10xx-regulator";
        dvs-gpios = <&gpio0 0 GPIO_ACTIVE_HIGH>, <&gpio0 1 GPIO_ACTIVE_HIGH>;

        BUCK {
          regulator-init-microvolt = <2500000>;
          pwr-mode-gpio-config = <0 GPIO_ACTIVE_HIGH>;
          /* ... */
        };

        LDO {
          regulator-init-microvolt = <1800000>;
          enable-gpio-config = <1 GPIO_ACTIVE_HIGH>;
          /* ... */
        };

        LDSW {
          regulator-boot-off;
          regulator-soft-start-current-idx = <1>;  /* 15mA */
          /* ... */
        };
      };

      /* ... */
    };
```
