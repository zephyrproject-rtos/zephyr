## dts/bindings/pulse-io/nordic,nrf-pwm-pulse-io.yaml
```yaml
# SPDX-FileCopyrightText: Copyright The Zephyr Project Contributors
# Copyright (c) 2026 Dev It Wise
# SPDX-License-Identifier: Apache-2.0

title: nRF PWM pulse_io controller

description: |
  The nRF PWM peripheral exposed through the pulse_io API. Select it by
  overwriting the compatible of an nRF PWM node.

compatible: "nordic,nrf-pwm-pulse-io"

include: [base.yaml, pinctrl-device.yaml, memory-region.yaml, pulse-io-controller.yaml]

properties:
  reg:
    required: true

  interrupts:
    required: true

  pinctrl-0:
    required: true

  pinctrl-names:
    required: true

  idleout-supported:
    type: boolean
    description: |
      Indicates if the PWM instance has the IDLEOUT register. Set by the
      SoC devicetree on nRF PWM nodes.

examples:
  - |
    &pinctrl {
            pwm1_default: pwm1_default {
                    group1 {
                            psels = <NRF_PSEL(PWM_OUT0, 1, 3)>;
                    };
            };

            pwm1_sleep: pwm1_sleep {
                    group1 {
                            psels = <NRF_PSEL(PWM_OUT0, 1, 3)>;
                            low-power-enable;
                    };
            };
    };

    &pwm1 {
            compatible = "nordic,nrf-pwm-pulse-io";
            status = "okay";
            #pulse-io-cells = <1>;
            pinctrl-0 = <&pwm1_default>;
            pinctrl-1 = <&pwm1_sleep>;
            pinctrl-names = "default", "sleep";
    };

    / {
            led_strip: ws2812 {
                    compatible = "worldsemi,ws2812-pulse-io";
                    pulse-ios = <&pwm1 0>;
                    chain-length = <8>;
                    color-mapping = <LED_COLOR_ID_GREEN
                                     LED_COLOR_ID_RED
                                     LED_COLOR_ID_BLUE>;
            };
    };
```

## dts/bindings/pulse-io/st,stm32-pulse-io.yaml
```yaml
# SPDX-FileCopyrightText: Copyright The Zephyr Project Contributors
# SPDX-License-Identifier: Apache-2.0

title: STM32 timer Pulse IO controller

description: |
  Pulse IO controller on the channels of an STM32 timer, for fixed-period
  cells (CELL mode) in transmission only. The channel runs in PWM mode and
  each timer update event triggers a DMA transfer that loads the duty cycle
  of the next period. The channels share the timer prescaler and period and
  transmit one at a time.

  The node is a child of an st,stm32-timers node, whose other functions
  cannot be used at the same time. The pulse-ios cell is the timer channel
  index, 0 for CH1 to 3 for CH4.

compatible: "st,stm32-pulse-io"

include: [pulse-io-controller.yaml, base.yaml, pinctrl-device.yaml]

properties:
  pinctrl-0:
    required: true

  pinctrl-names:
    required: true

  dmas:
    required: true
    description: |
      DMA channel driven by the update request of the timer (TIMx_UP).

  dma-names:
    required: true
    enum:
      - tx

  "#pulse-io-cells":
    const: 1

  st,max-cells:
    type: int
    default: 256
    description: |
      Maximum number of cells of a transmission, plus one for the idle cell
      that ends it. It sets the size of the DMA buffer, of 4 bytes per cell.

examples:
  - |
    #include <zephyr/dt-bindings/dma/stm32_dma.h>

    timers3: timers@40000400 {
      compatible = "st,stm32-timers";
      /* ... */

      pio3: pulse-io {
        compatible = "st,stm32-pulse-io";
        pinctrl-0 = <&tim3_ch4_pb1>;
        pinctrl-names = "default";
        dmas = <&dmamux1 0 27 STM32_DMA_PRIORITY_HIGH>;
        dma-names = "tx";
        #pulse-io-cells = <1>;
      };
    };
```

## dts/bindings/pulse-io/st,stm32-timer-pulse-io.yaml
```yaml
# Copyright (c) 2026 Dent IoT
#
# SPDX-License-Identifier: Apache-2.0

description: |
  STM32 Pulse IO channel (timer + DMA-to-GPIO).

  A vendor Pulse IO backend that generates jitter-free timed edges on an
  arbitrary GPIO pin using a timer's update event to trigger a DMA transfer
  of set/reset words to the GPIO port's BSRR register.

  One node describes a single channel: one timer instance, one DMA stream,
  and one target GPIO pin. The node is a Pulse IO controller exposing a
  single channel (index 0); a consumer such as worldsemi,ws2812-pulse-io
  references it with `pulse-ios = <&node 0>`. To drive multiple strips on
  multiple pins, instantiate several such nodes, each with its own timer
  and DMA stream so the transfers can run concurrently.

  The pin needs no alternate function: the wire is driven by writing the
  GPIO port's set/reset register (BSRR) via DMA, which works on any pin.
  The timer instance, DMA stream/request, and target GPIO port and pin are
  all configured in the device tree, so the binding is not tied to a
  particular timer instance or pin.

  Note that on STM32F405/407 only DMA2 can reach GPIO (DMA1 has no AHB1
  tap); timer instances routed to DMA1 (TIM6/TIM7) therefore cannot be
  used with this backend on those parts. TIM1 (DMA2 stream5/channel6 =
  TIM1_UP) or TIM8 (DMA2 stream1/channel7 = TIM8_UP) are the usual choices.

compatible: "st,stm32-timer-pulse-io"

include: [base.yaml, pulse-io-controller.yaml]

properties:
  timer:
    type: phandle
    required: true
    description: |
      Phandle to the st,stm32-timers node whose update event triggers the
      DMA transfer. The backend derives the TIM_TypeDef register base and
      its clock/reset from this node.

  dmas:
    type: phandle-array
    required: true
    description: |
      DMA channel/stream specifier for the timer's update-DMA request, in
      the SoC's dma-controller cell format. For st,stm32-dma-v1 this is
      four cells: channel, slot (the TIMx_UP DMA request id),
      channel-config (STM32_DMA_* flags: memory-to-peripheral, memory
      increment, 32-bit width), and features.

  dma-names:
    type: string-array
    required: true
    description: Must contain "tx".

  gpios:
    type: phandle-array
    required: true
    description: |
      The GPIO port and pin driven by this channel, as a standard GPIO
      specifier (`<&gpioX pin flags>`). The backend resolves the port's
      BSRR register address and the set/reset bit from this specifier; no
      alternate function is required on the pin.

  st,prescaler:
    type: int
    default: 0
    description: |
      Timer prescaler value loaded into TIMx_PSC. The backend configures
      the auto-reload register from the requested resolution; the
      prescaler is left to the integrator so the timer clock can be divided
      to a sane range (e.g. keep ARR > 1 for the desired tick).

  buffer-size:
    type: int
    default: 0
    description: |
      Maximum number of DMA words (uint32_t) the channel can transmit in a
      single submission. 0 selects a build-time default sized for a single
      WS2812 pixel chain of chain-length LEDs.
```

## dts/bindings/pwm/adi,axi-pwmgen.yaml
```yaml
# Copyright (c) 2026 Analog Devices, Inc.
# SPDX-License-Identifier: Apache-2.0

description: Analog Devices AXI PWM Generator core

compatible: "adi,axi-pwmgen"

include: [base.yaml, pwm-controller.yaml]

properties:
  reg:
    required: true
  adi,ref-clock-hz:
    type: int
    required: true
    description: Reference clock frequency in Hz
  "#pwm-cells":
    const: 3

pwm-cells:
  - channel
  - period
  - flags
```

## dts/bindings/pwm/ite,it51xxx-pwm.yaml
```yaml
# Copyright (c) 2025 ITE Corporation. All Rights Reserved.
# SPDX-License-Identifier: Apache-2.0

description: ITE, it51xxx Pulse Width Modulator (PWM) node

compatible: "ite,it51xxx-pwm"

include: [pwm-controller.yaml, base.yaml, pinctrl-device.yaml]

properties:
  reg:
    required: true

  channel:
    type: int
    required: true
    enum: [0, 1, 2, 3, 4, 5, 6, 7]
    description: pwm output channel

  prescaler-cx:
    type: int
    required: true
    enum: [1, 2, 3]
    description: 1 = PWM_PRESCALER_C4, 2 = PWM_PRESCALER_C6, 3 = PWM_PRESCALER_C7

  max-dimming-duty:
    type: int
    enum: [0, 1, 2, 3]
    description: |
     Setting pwm max duty cycle of dimming mode (only pwm0/1/7 support),
     0 = PWM_DIMMING_DC_40H, 1 = PWM_DIMMING_DC_80H, 2 = PWM_DIMMING_DC_C0H,
     3 = PWM_DIMMING_DC_FFH

  dimming-duty-increase:
    type: int
    enum: [0, 1, 2, 3]
    description: |
     Setting pwm duty cycle increase step of dimming mode (only pwm0/1/7 support),
     0 = PWM_DIMMING_DC_STEP_1H, 1 = PWM_DIMMING_DC_STEP_2H, 2 = PWM_DIMMING_DC_STEP_4H,
     3 = PWM_DIMMING_DC_STEP_8H

  dimming-duty-decrease:
    type: int
    enum: [0, 1, 2, 3]
    description: |
     Setting pwm duty cycle decrease step of dimming mode (only pwm0/1/7 support),
     0 = PWM_DIMMING_DC_STEP_1H, 1 = PWM_DIMMING_DC_STEP_2H, 2 = PWM_DIMMING_DC_STEP_4H,
     3 = PWM_DIMMING_DC_STEP_8H

  pinctrl-0:
    required: true

  pinctrl-names:
    required: true

pwm-cells:
  - channel
  - period
  - flags
```

## dts/bindings/pwm/nxp,ipwm.yaml
```yaml
# Copyright (c) 2026 Toradex
# SPDX-License-Identifier: Apache-2.0

description: |
  NXP i.MX PWM controller.

  This is the simple PWM timer block found across the i.MX application
  processor family (i.MX27 onwards, including the i.MX8M series), referred to as
  PWMv2 in the reference manuals and exposed as the "ipwm" driver by the MCUX
  SDK. Each instance drives a single output from a 16-bit counter: the period is
  taken from PWMPR and the duty cycle is fed to PWMSAR through a four-entry
  sample FIFO.

  It is unrelated to the FlexPWM block described by "nxp,imx-pwm", which is
  organised into submodules with paired complementary outputs, deadtime
  insertion and fault inputs, and which appears on the i.MX RT, MCX and LPC
  families instead.

  Linux describes the same hardware as "fsl,imx27-pwm". A distinct compatible is
  used here because Zephyr's existing "fsl,imx27-pwm" driver is built on the
  legacy device_imx HAL, which covers only i.MX6SX and i.MX7D, and because that
  binding predates the three-cell PWM specifier that pwm_dt_spec requires.

compatible: "nxp,ipwm"

include: [pwm-controller.yaml, pinctrl-device.yaml, base.yaml, "nxp,rdc-policy.yaml"]

properties:
  reg:
    required: true
  interrupts:
    required: true
  clocks:
    required: true
  nxp,prescaler:
    type: int
    default: 1
    description: |
      Divider applied to the PWM root clock before it reaches the counter,
      expressed as the actual division factor: 1 passes the clock through
      unchanged. Valid range is 1 to 4096; the driver programs PWMCR.PRESCALER
      with this value minus one.

      The divider is static, so it fixes the counter rate reported by
      pwm_get_cycles_per_sec() and therefore the longest period a consumer can
      request. Leave it at the default unless a low PWM frequency needs a
      counter slower than the root clock.
  run-in-wait:
    type: boolean
    description: |
      Keep the counter running in WAIT mode. Without this the counter is gated
      as soon as the CPU executes WFI, which the idle thread does whenever no
      thread is runnable, stopping the output.
  "#pwm-cells":
    const: 3

pwm-cells:
  - channel
  - period
  - flags
```

## dts/bindings/pwm/ti,am3352-ecap.yaml
```yaml
# SPDX-FileCopyrightText: Copyright (c) 2026 Texas Instruments
# SPDX-License-Identifier: Apache-2.0

description: |
  TI SOC ECAP based PWM controller

  On SoCs where the eCAP's pins are reachable only through a crossbar
  (e.g. AM13E), reference the crossbar via "mux-states" instead of adding
  SoC-specific pinmux logic to this driver:

    &ecap0 {
            pinctrl-0 = <&my_apwm_pin>;
            pinctrl-names = "default";

            mux-states = <&xbar_out AM13E2_XBAR_OUT_CTRL(idx, group, bit) 1>;
            mux-state-names = "output";
    };

    &ecap1 {
            pinctrl-0 = <&my_capture_pin>;
            pinctrl-names = "default";

            mux-states = <&xbar_in CHANNEL AM13E2_XBAR_IN_STATE(GPIO_NUMBER, 1)>;
            mux-state-names = "input";
    };

  A "mux-states" entry named "input" additionally feeds this eCAP's own
  ECCTL0.INPUTSEL field (AM13E-only) with that entry's crossbar channel,
  since ECCTL0 is a mux internal to the eCAP, separate from the crossbar
  itself.

include: [pwm-controller.yaml, base.yaml, pinctrl-device.yaml, mux-consumer.yaml]

compatible: "ti,am3352-ecap"

properties:
  reg:
    required: true

  interrupts:
    required: true

  clock-frequency:
    type: int
    description: Optional peripheral frequency to use if the clock is absent

  "#pwm-cells":
    const: 3

  ti,pwren:
    type: phandle-array
    specifier-space: pwren
    description: |
      Power-enable this peripheral via SYSCTL.PWREN_*.
      Format: <&sysctl offset bit>.

pwm-cells:
  - channel
  - period
  - flags
```

## dts/bindings/pwm/ti,cc27xx-lgpt-pwm.yaml
```yaml
# Copyright (c) 2025 Texas Instruments Incorporated
# SPDX-License-Identifier: Apache-2.0

description: |
  TI CC27XX LGPT PWM Controller Node

    &lgpt0 {
      status = "okay";
    };

    &pwm0 {
      status = "okay";
      pinctrl-0 = <&pwm0_default>;
      pinctrl-names = "default";
    };

  Note: PWM0-PWM8 are 16bit without prescale, max timeout is 682550 ns (at 96MHz)
        PWM9-PWM11 are 24bit without prescale, max timeout is 174759875 ns (at 96MHz)

compatible: "ti,cc27xx-lgpt-pwm"

include: [base.yaml, pwm-controller.yaml, pinctrl-device.yaml]

properties:
  pinctrl-0:
    required: true

  pinctrl-names:
    required: true

  ti,output-index:
    type: int
    description: |
      The timer output index (0, 1, or 2) that this PWM controls.
      Must match the timer channel connected via pinctrl (T*_C0/C0N=0, T*_C1/C1N=1, T*_C2/C2N=2).

pwm-cells:
  - channel
  - period
  - flags
```

## dts/bindings/pwm/ti,cc35xx-lgpt-pwm.yaml
```yaml
# SPDX-License-Identifier: Apache-2.0

description: |
  TI CC35XX LGPT PWM Controller Node

compatible: "ti,cc35xx-lgpt-pwm"

include: [base.yaml, pwm-controller.yaml, pinctrl-device.yaml]

properties:
  pinctrl-0:
    required: true

  pinctrl-names:
    required: true

pwm-cells:
  - channel
  - period
  - flags
```

## dts/bindings/pwm/waveshare,ch32v003-pwm.yaml
```yaml
# Copyright 2026, Kim Bøndergaard <kim@fam-boendergaard.dk>
# SPDX-License-Identifier: Apache-2.0

description: Waveshare CH32V003 PWM output controller

compatible: "waveshare,ch32v003-pwm"

include: pwm-controller.yaml

properties:
  "#pwm-cells":
    const: 3

pwm-cells:
  - channel
  - period
  - flags
```

## dts/bindings/rc/gpio-ir-receiver.yaml
```yaml
# SPDX-FileCopyrightText: Copyright (c) 2026 Linumiz
# SPDX-License-Identifier: Apache-2.0

description: |
  Demodulating infrared receiver module, such as a TSOP or VS1838B, whose
  output is connected to a GPIO.

compatible: "gpio-ir-receiver"

include:
  - name: rc-device.yaml
    property-blocklist:
      - carrier-hz
      - duty-cycle-percent

properties:
  gpios:
    type: phandle-array
    required: true
    description: |
      Receiver output, one GPIO. The flags give the active level, for
      example GPIO_ACTIVE_LOW for modules that pull the output low while
      they receive the carrier.
```

## dts/bindings/rc/rc-device.yaml
```yaml
# SPDX-FileCopyrightText: Copyright (c) 2026 Linumiz
# SPDX-License-Identifier: Apache-2.0

description: Common properties of remote control devices.

include: base.yaml

properties:
  protocols:
    type: array
    description: |
      Protocols enabled at init, as RC_PROTO_* values from
      <zephyr/dt-bindings/rc/rc-proto.h>. Each value enables the decoder
      that handles it, with all protocols of that decoder's group. Values
      without a built decoder are ignored. If the property is absent, all
      built decoders are enabled.
```
