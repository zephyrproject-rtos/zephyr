## dts/bindings/power/nxp,spc.yaml
```yaml
# Copyright 2025 NXP
# SPDX-License-Identifier: Apache-2.0

description: NXP System Power Control (SPC)

compatible: "nxp,spc"

include: base.yaml

properties:
  reg:
    required: true

  wakeup-delay:
    type: int
    description: |
      Number of SPC timer clock cycles written to the 16-bit LPWKUP_DELAY
      field. When LP_CFG and ACTIVE_CFG select different VDD_CORE levels,
      this value must meet the chip-specific minimum for the regulator and
      voltage transition described in the reference manual. Board power
      policies must increase this value if needed for a different transition
      or an external PMIC/switch controlled by SPC_LPREQ; use the larger of
      the regulator and external-device delays.

  active-dcdc-output-microvolt:
    type: int
    description: |
      Active-mode DCDC regulator output voltage, in microvolts.
      Legal values are SoC-specific; the SoC power init validates the
      configured value against the levels the DCDC can actually produce.
      When this property is absent, the SoC leaves the active-mode DCDC
      output voltage untouched.
```

## dts/bindings/power/st,stm32h7-pwr.yaml
```yaml
# Copyright (c) 2025 STMicroelectronics
# SPDX-License-Identifier: Apache-2.0

description: STM32H7 power controller

compatible: "st,stm32h7-pwr"

include: "st,stm32-pwr.yaml"

properties:
  power-supply:
    type: string
    required: true
    description: |
      Power supply configuration

      This property specifies the voltage regulators configuration
      and indicates how the core domain voltage (Vcore) is generated.
      Refer to your product's Datasheet and Reference Manual for details.

      WARNING: If this property's value does not match the target board's
      hardware configuration, the product will deadlock during boot which
      prevents debugging or re-programming. If such a situation occurs,
      configure the product to start execution in System memory instead
      then erase the firmware with incorrect configuration.

      ldo: LDO supply
        The LDO is enabled and generates Vcore; the SMPS is disabled.

      external-source: Bypass
        An external supply provides Vcore; SMPS and LDO are disabled.

      smps-direct: Direct SMPS supply
        The SMPS is enabled and generates Vcore; the LDO is disabled.

      smps-ldo: SMPS supplies LDO (no external supply)
        The SMPS is enabled; the LDO generates Vcore from the SMPS output.

      smps-ext-ldo: External SMPS supply, supplies LDO
        The SMPS is enabled and generates a fixed supply for the LDO and
        external devices. The LDO generates Vcore from the SMPS output.

      smps-ext-bypass: External SMPS supply and bypass
        The SMPS is enabled and its output powers external devices.
        Vcore is provided directly by an external supply; LDO is disabled.
    enum:
      - "ldo"
      - "external-source"
      - "smps-direct"
      - "smps-ldo"
      - "smps-ext-ldo"
      - "smps-ext-bypass"

  smps-output-voltage:
    type: string
    description: |
      SMPS output voltage level selection

      This property is required when the "power-supply" property
      is either "smps-ldo", "smps-ext-ldo" or "smps-ext-bypass".

      1V8: SMPS output is at 1.8 Volts
      2V5: SMPS output is at 2.5 Volts
    enum:
      - "1V8"
      - "2V5"

  voltage-scale:
    type: int
    description: |
      Voltage regulator scale selection

      If present, this property can be used to indicate the desired
      voltage regulator scale to use. This choice affects several
      aspects of the system:
        * power consumption
        * memory and flash wait states
        * maximal system clock frequency
        * availability of certain peripherals
        * ...

      The following values can be selected [1]:
      +---------+----------------+---------------------------------+
      | Scale # | Max. frequency | Notes                           |
      +---------+----------------+---------------------------------+
      |    0    |     480 MHz    | Highest power consumption [2]   |
      +---------+----------------+---------------------------------+
      |    1    |     400 MHz    |                                 |
      +---------+----------------+---------------------------------+
      |    2    |     300  MHz   |                                 |
      +--------+----------------+---------------------------------+
      |    3    |     200  MHz   | Lowest power consumption        |
      +---------+----------------+---------------------------------+

      [1] Source: RM0433, Table 60. Kernel clock distribution overview
      [2] On STM32H74x/H75x lines, VOS0 is the overdrive scale entered by
      setting SYSCFG_PWRCR.ODEN, and is only valid when Vcore is generated
      by the LDO (H7 Data Sheets; stm32h7xx_hal_pwr.h). Other supply modes
      (e.g. SMPS-direct, LDO off) are limited to VOS1.

      When this property is not present, the lowest voltage scale compatible
      with the system's clock configuration is selected automatically: for
      example, voltage scale 3 would be used if the system was configured
      to operate with a system clock frequency of 64 MHz.

      Note that the same behavior is observed if the property is provided but
      the selected voltage scale is not compatible with the system's clock
      configuration; in this case, clock configuration takes precedence and
      the value of this property is ignored.
    min: 0
    max: 3
```

## dts/bindings/power/st,stm32h7p-pwr.yaml
```yaml
# SPDX-FileCopyrightText: Copyright (c) 2026 STMicroelectronics
# SPDX-License-Identifier: Apache-2.0

title: STM32H7P Power Controller

description: |
  The STM32H7P Power Controller (PWR) is responsible for system supply
  voltage regulation, power supply supervision and power management.

compatible: "st,stm32h7p-pwr"

include: "st,stm32-pwr.yaml"

properties:
  st,power-supply:
    type: string
    required: true
    description: |
      Power supply configuration

      This property specifies the voltage regulators configuration
      and indicates how the core domain voltage (Vcore) is generated.
      Refer to your product's Datasheet and Reference Manual for details.

      WARNING: If this property's value does not match the target board's
      hardware configuration, the product will deadlock during boot which
      prevents debugging or re-programming. If such a situation occurs,
      configure the product to start execution in System memory instead
      then erase the firmware with incorrect configuration.

      internal-regulator: Internal regulator (LDO/SMPS)
        The internal regulator is enabled and generates Vcore.
        (Depending on product number, the internal regulator is LDO or SMPS)

      external-source: Bypass
        An external supply provides Vcore; the internal regulator is disabled.
    enum:
      - "internal-regulator"
      - "external-source"
```

## dts/bindings/power/st,stm32n6-pwr.yaml
```yaml
# Copyright (c) 2026 STMicroelectronics
# SPDX-License-Identifier: Apache-2.0

description: STM32N6 power controller

compatible: "st,stm32n6-pwr"

include: "st,stm32-pwr.yaml"

properties:
  power-supply:
    type: string
    required: true
    description: |
      Power supply configuration

      This property specifies the voltage regulators configuration
      and indicates how the core domain voltage (Vcore) is generated.
      Refer to your product's Datasheet and Reference Manual for details.

      WARNING: If this property's value does not match the target board's
      hardware configuration, the product will deadlock during boot which
      prevents debugging or re-programming. If such a situation occurs,
      configure the product to start execution in System memory instead
      then erase the firmware with incorrect configuration.

      smps: Internal SMPS supply
        Internal SMPS is enabled and generates Vcore.

      external-source: External regulator supply
        An external supply provides Vcore; internal SMPS is disabled.
    enum:
      - "smps"
      - "external-source"

  st,external-control-gpios:
    type: phandle-array
    max-len: 1
    description: |
      This property describes the pin that controls the external voltage.
      Used only when the "power-supply" property is set to "external-source".
      This property describes a pin connected to the external source which,
      when set to high logic level, makes that source's output voltage change
      from VOS low level to VOS high. This pin will be asserted by software
      during boot if VOS high is required. Whether this property is necessary
      or not depends on the target board's hardware implementation as well as
      on the clock configuration.

      This property is ignored if the "power-supply" property is set to "smps".
      This property only supports internal GPIO (e.g. gpioa).

examples:
  - |
    /* Example: STM32N6 internal SMPS  */
    pwr: power@56024800 {
      compatible = "st,stm32n6-pwr";
      reg = <0x56024800 0x400>;
      power-supply = "smps";
    };

    /* Overlay example: external SMPS controlled by PB12 */
    &pwr {
      power-supply = "external-source";
      st,external-control-gpios = <&gpiob 12 GPIO_ACTIVE_HIGH>;
    };
```

## dts/bindings/ppc/infineon,ppc.yaml
```yaml
# SPDX-FileCopyrightText: Copyright (c) 2026 Infineon Technologies AG,
# SPDX-FileCopyrightText: or an affiliate of Infineon Technologies AG. All rights reserved.
#
# SPDX-License-Identifier: Apache-2.0

title: Infineon Peripheral Protection Controller (PPC)

description: |
  Infineon PPC hardware block. Configures access rights for
  peripheral bus slots governed by a single PPC instance (PERI0 or PERI1).

  nonsecure-regions lists the specific cy_en_prot_region_t enum values (as
  integers) that are opened for non-secure access. The driver calls
  Cy_Ppc_ConfigAttrib() (secAttribute=NON_SECURE, privAttribute=NONPRIV) and
  Cy_Ppc_SetPcMask() for each listed region. Only the curated set of regions
  the non-secure world actually needs (e.g. the console SCB) should be listed;
  sweeping every region bus-faults on self-protection / SROM-locked slots.
  This mirrors the Infineon BSP "M33_M55" non-secure PPC domain used by TF-M.

  Example (PPC0, opening the PERI0 console SCB path to NS):

    ppc0: ppc@52020000 {
        compatible = "infineon,ppc";
        reg = <0x52020000 0x2000>;
        /* MAIN, GR1..GR5 groups, PCLK0_MAIN, SCB2 (console) */
        nonsecure-regions = <0x00 0x02 0x03 0x04 0x05 0x06 0x10 0x130>;
        pc-mask = <0xE6>;
        status = "okay";
    };

compatible: "infineon,ppc"

include: base.yaml

properties:
  reg:
    required: true

  nonsecure-regions:
    type: array
    required: true
    description: |
      List of cy_en_prot_region_t integer values describing the peripheral
      protection regions to configure for non-secure access.

  pc-mask:
    type: int
    default: 0xE6
    description: |
      Bitmask of protection contexts (PCs 0-7) that are granted access.
      Default 0xE6 matches the Infineon BSP / TF-M non-secure domain
      (PC1, PC2, PC5, PC6, PC7; the non-secure CM33 runs as PC5).
```

## dts/bindings/ps2/microchip,xec-ps2.yaml
```yaml
# Copyright (c) 2019, Intel Corporation
# SPDX-License-Identifier: Apache-2.0

description: Microchip XEC PS/2 controller

compatible: "microchip,xec-ps2"

include: [ps2.yaml, pinctrl-device.yaml]

properties:
  reg:
    required: true

  interrupts:
    required: true

  girqs:
    type: array
    required: true
    description: |
      Array of encoded GIRQ and bit position for each interrupt
      signal the block generates.

  pcr-scr:
    type: int
    required: true
    description: Encoded PS2 PCR register index and bit position

  wakerx-gpios:
    type: phandle-array
    description: GPIO configured as PS2 DAT wake source
```

## dts/bindings/pse/pse-controller.yaml
```yaml
# Copyright (c) 2026 Analog Devices, Inc.
# SPDX-License-Identifier: Apache-2.0

description: |
  Common fields for Power Sourcing Equipment (PSE) controllers, as defined
  in IEEE 802.3 Clause 30/33/104/145.

include: base.yaml

properties:
  "#address-cells":
    const: 1

  "#size-cells":
    const: 0

child-binding:
  description: PSE Power Interface (PI)

  properties:
    reg:
      type: int
      required: true
      description: PI index.

    "#pse-cells":
      const: 0
      description: Number of cells for the PI phandle specifier.

    pairset-names:
      type: string-array
      description: |
        Names of the pairsets, corresponding to the phandles in
        'pairsets'. IEEE 802.3-2022 145.2.4.
      enum:
        - "alternative-a"
        - "alternative-b"

    pairsets:
      type: phandle-array
      description: |
        Phandles to the power supply for each pairset named in
        'pairset-names'. IEEE 802.3-2022 33.2.3 / 145.2.4.

    polarity-supported:
      type: string-array
      description: |
        Polarity configuration(s) supported by this PI's pairsets.
      enum:
        - "MDI-X"
        - "MDI"
        - "X"
        - "S"

    vpwr-supply:
      type: phandle
      description: Regulator power supply for the PI.
```

## dts/bindings/pulse-io/espressif,esp32-rmt.yaml
```yaml
# SPDX-FileCopyrightText: Copyright The Zephyr Project Contributors
# SPDX-License-Identifier: Apache-2.0

title: Espressif Remote Control Transceiver (RMT) pulse_io controller

description: |
  The RMT peripheral generates and captures timed digital edges on GPIO
  lines. It is exposed through the vendor-neutral pulse_io API.

  Channel model: pulse_io channel indexes map directly to hardware RMT
  channels. On SoCs with dedicated channels (ESP32-S3, ESP32-C3,
  ESP32-C5, ESP32-C6, ESP32-H2, ESP32-P4), transmit channels come
  first, followed by receive channels (for example on ESP32-S3 channels
  0-3 are transmit and 4-7 are receive). On ESP32 and ESP32-S2 every
  channel supports both directions, but each channel can only be used
  in one direction at a time. The capability masks reported by
  pulse_io_get_capabilities() describe the split.

  pinctrl routes a channel to a GPIO: RMT_OUTn selects the n-th
  transmit channel and RMT_INn selects the n-th receive channel. On
  SoCs with dedicated channels the receive index is relative, so
  RMT_IN0 on ESP32-S3 is pulse_io channel 4. A channel without a pin
  in the selected pinctrl state cannot be opened for that direction.

  DMA is available only on ESP32-S3 and only on the last transmit and
  last receive channel. It is optional and enabled by adding the "tx"
  and "rx" dmas entries.

  The first example below routes transmit channel 0 to GPIO13 and the
  first receive channel (pulse_io channel 4 on ESP32-S3) to GPIO12.
  The second example enables DMA on the ESP32-S3.

compatible: "espressif,esp32-rmt"

include: [base.yaml, pinctrl-device.yaml, pulse-io-controller.yaml]

properties:
  reg:
    required: true

  pinctrl-0:
    required: true

  pinctrl-names:
    required: true

  clocks:
    required: true

  interrupts:
    required: true

  interrupt-parent:
    required: true

examples:
  - |
      &pinctrl {
        rmt_default: rmt_default {
          group1 {
            pinmux = <RMT_OUT0_GPIO13>;
          };

          group2 {
            pinmux = <RMT_IN0_GPIO12>;
          };
        };
      };

      &rmt {
        pinctrl-0 = <&rmt_default>;
        pinctrl-names = "default";
        status = "okay";
      };
  - |
      &rmt {
        dmas = <&dma 8>, <&dma 9>;
        dma-names = "rx", "tx";
      };
```
