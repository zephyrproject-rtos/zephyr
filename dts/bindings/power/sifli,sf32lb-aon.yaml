## dts/bindings/power/sifli,sf32lb-aon.yaml
```yaml
# Copyright (c) 2025 Core Devices LLC
# SPDX-License-Identifier: Apache-2.0

description: SiFli SF32LB AON

compatible: "sifli,sf32lb-aon"

include: base.yaml

properties:
  reg:
    required: true
```

## dts/bindings/power/sifli,sf32lb-pmuc.yaml
```yaml
# Copyright (c) 2025 Core Devices LLC
# SPDX-License-Identifier: Apache-2.0

description: SiFli SF32LB PMUC

compatible: "sifli,sf32lb-pmuc"

include: base.yaml

properties:
  reg:
    required: true
```

## dts/bindings/power/sifli,sf32lb52x-pmuc.yaml
```yaml
# Copyright (c) 2025 Core Devices LLC
# SPDX-License-Identifier: Apache-2.0

description: SiFli SF32LB52x PMUC

compatible: "sifli,sf32lb52x-pmuc"

include: base.yaml

properties:
  reg:
    required: true
```

## dts/bindings/power/sifli-sf32lb-aon.yaml
```yaml
# Copyright (c) 2025 Core Devices LLC
# SPDX-License-Identifier: Apache-2.0

properties:
  sifli,aon:
    type: phandle
    description: SiFli SF32LB AON node
```

## dts/bindings/power/sifli-sf32lb-pmuc.yaml
```yaml
# Copyright (c) 2025 Core Devices LLC
# SPDX-License-Identifier: Apache-2.0

properties:
  sifli,pmuc:
    type: phandle
    description: SiFli SF32LB PMUC node
```

## dts/bindings/power/st,power-management.yaml
```yaml
# Copyright (c) 2023 Kenneth J. Miller <ken@miller.ec>
# SPDX-License-Identifier: Apache-2.0

properties:
  st,reinit-power-states:
    type: phandles
    description: |
      Specifies special power states where a peripheral requires
      reinitialization due to configuration loss.

      While states at or beyond S2RAM are naturally assumed to need
      reinitialization, this property highlights the exceptions to that rule.
```

## dts/bindings/power/st,stm32-dualreg-pwr.yaml
```yaml
# Copyright (c) 2025 STMicroelectronics
# SPDX-License-Identifier: Apache-2.0

description: |
  STM32 power controller with dual regulator (LDO + SMPS)

compatible: "st,stm32-dualreg-pwr"

include: "st,stm32-pwr.yaml"

properties:
  power-supply:
    type: string
    required: true
    description: |
      Power supply configuration

      This property specifies the voltage regulators configuration
      and indicates how the core domain voltage (Vcore) is generated.
      Refer to your product's Datasheet and Reference Manual for details.

      ldo: LDO supply
        The LDO is enabled and generates Vcore; the SMPS is disabled.

      smps: SMPS supply
        The SMPS is enabled and generates Vcore; the LDO is disabled.
    enum:
      - "ldo"
      - "smps"
```

## dts/bindings/power/st,stm32-iocell.yaml
```yaml
# Copyright (c) 2026 STMicroelectronics
# SPDX-License-Identifier: Apache-2.0

description: STM32 I/O cell controller

compatible: "st,stm32-iocell"

include:
  - name: base.yaml
  - name: nvmem-consumer.yaml

properties:
  "#address-cells":
    const: 0

  "#size-cells":
    const: 0

  nvmem-cells:
    description: |
      Single nvmem-cells entry named "safeguard" can be provided to access
      OTP/option byte value where HSLV enable bit is stored.
      This is optional depending on the SoC series.

child-binding:
  description: |
    IO power domains

  properties:
    domain:
      type: int
      description: |
        I/O domain managed by the cell.
        This must be one of the SoC-specific values defined in header
        `include/zephyr/dt-bindings/power/stm32XXX_iocell.h`.

    hslv-mode:
      type: string
      default: "off"
      enum:
        - "off"
        - "on"
        - "auto"
      description: |
        Allows to turn on HSLV (high-speed low voltage) option.
        This option will work only if the corresponding bit is set in
        option bytes / OTP fuse.
        Enabling this option on domain that is powered from 3.3V
        can permanently damage the device! Please consult datasheet for
        precise threshold value.
        Selecting "auto" will follow the setting in option bytes / OTP.
        This can be useful for board allowing both 1.8V and 3.3V operation.

    compensation-enabled:
      type: boolean
      description: |
        Enables the I/O compensation cell
```

## dts/bindings/power/st,stm32-pwr-wkupctrl.yaml
```yaml
# SPDX-FileCopyrightText: Copyright (c) 2026 STMicroelectronics
# SPDX-License-Identifier: Apache-2.0

title: STM32 wake-up lines controller

description: |
  Control logic for wake-up lines in STM32 SoCs. This control logic is located
  inside the Power Controller (PWR) and configured using PWR MMIO registers.

  In STM32 SoCs, several "wake-up lines" (also known as "wake-up pins") are
  connected to the Power Controller. An event on these lines can wake up SoCs
  from low-power modes in which the main power domain is turned off, such as
  Standby or Shutdown modes on STM32U5.

compatible: "st,stm32-pwr-wkupctrl"

properties:
  st,max-wkup-line-idx:
    type: int
    required: true
    description: |
      Index of the highest wake-up line `WKUPn` supported by the SoC.

      NOTE: only wake-up lines connected to a GPIO pin, which are usually
      named `WKUPn`, should be taken into account for this property, and
      lines connected only to internal sources should be ignored.

      For example, this property should be set equal to 8 on a series where
      WKUP8 is the highest wake-up line connected to a GPIO pin.

  st,has-multi-source-lines:
    type: boolean
    description: |
      If present, indicates that the event source for each wake-up line
      can be configured by software and selected among multiple sources
      (which can be internal sources or a GPIO pin).

      If not present, the event source for each wake-up line is hardwired
      to a specific source (GPIO pin) and cannot be changed by software.

  st,has-pwr-full-pupd:
    type: boolean
    description: |
      If present, indicates that the Power Controller is capable of managing
      the internal pull-up/pull-down resistors of all GPIO pins in the SoC.

      This feature can be identified by the presence of a pair of registers
      (`PWR_PUCRx`/`PWR_PDCRx`, `x` = A/B/C/...) in the PWR register map for
      each GPIO port in the SoC. Note that there are some series where some
      of these registers exist, but not for all GPIO ports: in this case,
      the property must NOT be present.

child-binding:
  description: |
    STM32 wake-up line node.

    Nodes using this binding should be named `wkup@[n]`, where `n` is
    the wake-up line index as found in its name `WKUPn` (starting from 1).

  include:
    - name: base.yaml
      property-allowlist:
        - reg

  properties:
    reg:
      required: true
      description: Wake-up line index

    wkup-gpios:
      type: phandle-array
      description: |
        Specifies which GPIO pin(s) can trigger this wake-up line.

        The `flags` cell of each entry in this property has a particular meaning:
        - if the property `st,has-multi-source-lines` is present in the parent node,
          it indicates which of the line's wake-up sources corresponds to the
          specific GPIO pin (`STM32_PWR_WKUP_EVT_SRC_n`)
        - otherwise, it must be set to `STM32_PWR_WKUP_PIN_NOT_MUXED` to indicate
          that the wake-up source selection is hardwired.

        Refer to `include/zephyr/dt-bindings/power/stm32_pwr.h` for more details
        and see the examples below for an overview of the different use cases.

examples:
  - |
    /* Example: STM32WBA series */
    power@46020800 {
      /* ...PWR properties omitted for brevity... */

      wakeup-controller {
        compatible = "st,stm32-pwr-wkupctrl";
        #address-cells = <1>;
        #size-cells = <0>;

        st,max-wkup-line-idx = <8>;
        st,has-multi-source-lines;

        wkup@1 {
          /*
           * Wake-up line 1, triggerable by two different GPIOs:
           *  - source 0: PA0
           *  - source 1: PB2
           */
          reg = <0x1>;
          wkup-gpios = <&gpioa 0 STM32_PWR_WKUP_EVT_SRC_0>,
                       <&gpiob 2 STM32_PWR_WKUP_EVT_SRC_1>;
        };

        wkup@2 {
          /*
           * Wake-up line 2, triggerable by only one GPIO: PC13.
           * Regardless, the appropriate `STM32_PWR_WKUP_EVT_SRC_n`
           * value must still be set in the `flags` cell.
           */
          reg = <0x2>;
          wkup-gpios = <&gpioc 13 STM32_PWR_WKUP_EVT_SRC_1>;
        };

        /* ...other lines omitted for brevity... */
      };
    };

  - |
    /* Example: STM32F1 series */
    pwr: power@40007000 {
      /* ...PWR properties omitted for brevity... */

      wakeup-controller {
        compatible = "st,stm32f1-pwr-wkupctrl", "st,stm32-pwr-wkupctrl";
        #address-cells = <1>;
        #size-cells = <0>;

        st,max-wkup-line-idx = <1>;
        /* Note the absence of `st,has-multi-source-lines` property... */

        wkup@1 {
          /* ...and use of the `STM32_PWR_WKUP_PIN_NOT_MUXED` value. */
          reg = <0x1>;
          wkup-gpios = <&gpioa 0 STM32_PWR_WKUP_PIN_NOT_MUXED>;
        };
    };
```

## dts/bindings/power/st,stm32-pwr.yaml
```yaml
# Copyright (c) 2023 STMicroelectronics
# SPDX-License-Identifier: Apache-2.0

description: STM32 power controller

compatible: "st,stm32-pwr"

include: base.yaml

properties:
  reg:
    required: true
```

## dts/bindings/power/st,stm32-wkup-pin-sel.yaml
```yaml
# Copyright (c) 2023 STMicroelectronics
# SPDX-License-Identifier: Apache-2.0


description: |
  STM32 system wakeup Node for stm32U5
  where each pin is multiplexed and
  when polarity and pull-up/down are configurable for each pin.

compatible: "st,stm32-wkup-pin-sel"

properties:
  syswakeup-pin:
    type: int
    description: |
      nb (index) of the sys wakeup pin associated with the GPIO
      For example PC13 is associated with wakeup pin nb <2> on the stm32u5

  syswakeup-sel:
    type: int
    enum:
      - 0
      - 1
      - 2
    description: |
      signal selection [0,1,2] of the sys wakeup pin associated with the GPIO
      For example PC13 is associated with wakeup signal 1

  "#wkpin-cells":
    type: int
    const: 1
    description: |
      reference to the system wakeup pin
      with its polarity config to trig the wakeup event.

# Parameter syntax of stm32 follows the st,stm32-pwr dts syntax

wkpin-cells:
  - polarity
```

## dts/bindings/power/st,stm32-wkup-pin0.yaml
```yaml
# Copyright (c) 2023 STMicroelectronics
# SPDX-License-Identifier: Apache-2.0

description: |
  STM32 system wakeup Node w/o polarity configuration

compatible: "st,stm32-wkup-pin0"

properties:
  syswakeup-pin:
    type: int
    description: |
      nb (index) of the sys wakeup pin associated with the GPIO
      Ex. pin PC13 is associated with wakeup pin nb <2> on the stm32f0x

  "#wkpin-cells":
    type: int
    const: 0
    description: |
      reference to the system wakeup pin and its polarity to trig the wakeup event.
```

## dts/bindings/power/st,stm32-wkup-pin1.yaml
```yaml
# Copyright (c) 2023 STMicroelectronics
# SPDX-License-Identifier: Apache-2.0

description: |
  STM32 system wakeup Node with polarity configuration

compatible: "st,stm32-wkup-pin1"

properties:
  syswakeup-pin:
    type: int
    description: |
      nb (index) of the sys wakeup pin associated with the GPIO
      For example PC13 is associated with wakeup pin nb <2> on the stm32g474

  "#wkpin-cells":
    type: int
    const: 1
    description: |
      reference to the system wakeup pin and its polarity to trig the wakeup event.

# Parameter syntax of stm32 follows the st,stm32-pwr dts syntax

wkpin-cells:
  - polarity
```

## dts/bindings/power/st,stm32-wkup-pin2.yaml
```yaml
# Copyright (c) 2023 STMicroelectronics
# SPDX-License-Identifier: Apache-2.0


description: |
  STM32 system wakeup Node for stm32H5, stm32H7 and stm32MP1
  when polarity and pull-up/down are configurable for each pin.

compatible: "st,stm32-wkup-pin2"

properties:
  syswakeup-pin:
    type: int
    description: |
      nb (index) of the sys wakeup pin associated with the GPIO
      For example PC13 is associated with wakeup pin nb <2> on the stm32h575

  "#wkpin-cells":
    type: int
    const: 2
    description: |
      reference to the system wakeup pin and its polarity
      plus its pull-up/down config to trig the wakeup event.

# Parameter syntax of stm32 follows the st,stm32-pwr dts syntax

wkpin-cells:
  - polarity
  - pupd
```

## dts/bindings/power/st,stm32f1-pwr-wkupctrl.yaml
```yaml
# SPDX-FileCopyrightText: Copyright (c) 2026 STMicroelectronics
# SPDX-License-Identifier: Apache-2.0

title: STM32F1-like wake-up pins controller

description: |
  Control logic for wake-up pins found in STM32F1 and other series.

  On series such as STM32F1, enabling a pin as wake-up pin forces it
  into "input pull-down" mode and the polarity of wake-up pins is
  fixed to "rising edge detection", unlike the implementation found
  in other series where these parameters (PU/PD and polarity) can be
  configured arbitrarily by software.

  Note that the term "wake-up pin" is used instead of "wake-up line" in
  this binding because each wake-up line in these series is hardwired
  to a specific GPIO pin (no source selection is possible).

compatible: "st,stm32f1-pwr-wkupctrl"

include:
  - name: "st,stm32-pwr-wkupctrl.yaml"
    property-blocklist:
      - st,has-multi-source-lines
```

## dts/bindings/power/st,stm32f7-pwr-wkupctrl.yaml
```yaml
# SPDX-FileCopyrightText: Copyright (c) 2026 STMicroelectronics
# SPDX-License-Identifier: Apache-2.0

title: STM32F7 wake-up pins controller

description: |
  Specific control logic for wake-up pins found in STM32F7 series.

  On STM32F7 series, the polarity of wake-up pins can be configured
  by software. However, it is not possible to enable the internal
  pull-up or pull-down while in Standby mode (unlike in other series).

  Note that the term "wake-up pin" is used instead of "wake-up line" in
  this binding because each wake-up line in STM32F7 series is hardwired
  to a specific GPIO pin (no source selection is possible).

compatible: "st,stm32f7-pwr-wkupctrl"

include:
  - name: "st,stm32-pwr-wkupctrl.yaml"
    property-blocklist:
      - st,has-multi-source-lines
```

## dts/bindings/power/st,stm32h5-iocell.yaml
```yaml
# Copyright (c) 2026 CodeWrights GmbH
# SPDX-License-Identifier: Apache-2.0

title: STM32H5 I/O cell controller

description: |
  I/O cell controller similar to the one found in STM32H7R/S and STM32N6
  series, except that the HSLV configuration is done on a per-pin basis
  at GPIO level instead of a domain basis.

compatible: "st,stm32h5-iocell"

include:
  - name: st,stm32-iocell.yaml
    property-blocklist:
      - hslv-mode
```

## dts/bindings/power/st,stm32h5-wkup-pin.yaml
```yaml
# Copyright (c) 2023 STMicroelectronics
# SPDX-License-Identifier: Apache-2.0

description: |
  STM32 system wakeup Node for stm32H5, stm32H7 and stm32MP1

compatible: "st,stm32h5-wkup-pin"

properties:
  syswakeup-pin:
    type: int
    description: |
      nb (index) of the sys wakeup pin associated with the GPIO
      For example PC13 is associated with wakeup pin nb <2> on the stm32g474

  "#wkpin-cells":
    type: int
    const: 2
    description: |
      reference to the system wakeup pin and its polarity
      plus its pull-up/down config to trig the wakeup event.

# Parameter syntax of stm32 follows the dma client dts syntax

wkpin-cells:
  - polarity
  - pupd
```
