## dts/bindings/power/st,stm32h7rs-pwr.yaml
```yaml
# Copyright (c) 2025 STMicroelectronics
# SPDX-License-Identifier: Apache-2.0

description: STM32H7R/S power controller

compatible: "st,stm32h7rs-pwr"

include: "st,stm32-pwr.yaml"

properties:
  power-supply:
    type: string
    required: true
    description: |
      Power supply configuration

      This property specifies the voltage regulators configuration
      and indicates how the core domain voltage (Vcore) is generated.
      Refer to your product's Datasheet and Reference Manual for details.

      WARNING: If this property's value does not match the target board's
      hardware configuration, the product will deadlock during boot which
      prevents debugging or re-programming. If such a situation occurs,
      configure the product to start execution in System memory instead
      then erase the firmware with incorrect configuration.

      WARNING: The so-called "cascade" mode where SMPS powers the LDO
      is NOT supported on STM32H7R/S series, unlike STM32H7 series!


      ldo: LDO supply
        The LDO is enabled and generates Vcore; the SMPS is disabled.

      external-source: Bypass
        An external supply provides Vcore; SMPS and LDO are disabled.

      smps-direct: Direct SMPS supply
        The SMPS is enabled and generates Vcore; the LDO is disabled.

      smps-ext-ldo: External SMPS supply, LDO supply
        The LDO is enabled and generates Vcore from VddLDO.
        Independentely, the SMPS is also enabled and generates
        a 1.8V supply for external devices.

      smps-ext-bypass: External SMPS supply and bypass
        The SMPS is enabled and generates a 1.8V supply for external devices.
        Vcore is provided directly by an external supply; LDO is disabled.
    enum:
      - "ldo"
      - "external-source"
      - "smps-direct"
      - "smps-ext-ldo"
      - "smps-ext-bypass"
```

## dts/bindings/power/st,stm32u5-pwr.yaml
```yaml
# Copyright (c) 2025 STMicroelectronics
# SPDX-License-Identifier: Apache-2.0

title: STM32U5 power controller

description: |
  Power controller of STM32U5 series

  Controls two voltage regulators which can output one voltage
  among four different voltage scales, depending on use case.

compatible: "st,stm32u5-pwr"

include: "st,stm32-dualreg-pwr.yaml"

properties:
  voltage-scale:
    type: int
    description: |
      Voltage regulator scale selection

      If present, this property can be used to indicate the desired
      voltage regulator scale to use. This choice affects several
      aspects of the system:
        * power consumption
        * memory and flash wait states
        * maximal system clock frequency
        * availability of certain peripherals
        * ...

      The following values can be selected:
      +---------+----------------+---------------------------------+
      | Scale # | Max. frequency | Notes                           |
      +---------+----------------+---------------------------------+
      |    1    |     160 MHz    | Highest power consumption       |
      +---------+----------------+---------------------------------+
      |    2    |     110 MHz    |                                 |
      +---------+----------------+---------------------------------+
      |    3    |     55  MHz    | [1]                             |
      +---------+----------------+---------------------------------+
      |    4    |     25  MHz    | Lowest power consumption [1][2] |
      +---------+----------------+---------------------------------+

      [1] OTG_HS cannot be used when this voltage scale is selected.
      [2] OTG_FS / USB cannot be used when this voltage scale is selected.

      When this property is not present, the lowest voltage scale compatible
      with the system's clock configuration is selected automatically: for
      example, voltage scale 3 would be used if the system was configured
      to operate with a system clock frequency of 40 MHz.

      Note that the same behavior is observed if the property is provided but
      the selected voltage scale is not compatible with the system's clock
      configuration; in this case, clock configuration takes precedence and
      the value of this property is ignored.
    enum:
      - 1
      - 2
      - 3
      - 4
```

## dts/bindings/power/st,stm32wb0-pwr.yaml
```yaml
# Copyright (c) 2024 STMicroelectronics
# SPDX-License-Identifier: Apache-2.0

description: STM32WB0 power controller

compatible: "st,stm32wb0-pwr"

include: "st,stm32-pwr.yaml"

properties:
  smps-mode:
    type: string
    required: true
    description: |
      SMPS mode selection

      OFF:
        - SMPS converter disabled
        - LDOs supply voltage: VDD

      WARNING: The SMPS must not be disabled on board using the
      'SMPS supply configuration', so this mode should NEVER be
      selected on these boards. Only use this mode if your board
      is using the 'NOSMPS supply configuration'.

      Refer to RM0505 §5.5 "SMPS step down regulator" for details.

      PRECHARGE: (also called BYPASS)
        - SMPS converter enabled - clock disabled
        - LDOs supply voltage: VDD (though SMPS)
          - Current supplied to LDOs can be limited
            (feature only supported on STM32WB05 / STM32WB09)

      RUN: (also called ON)
        - SMPS converter enabled - clock enabled
        - LDOs supply voltage: regulated SMPS output
          - Target output voltage can be programmed
    enum:
      - "OFF"
      - "PRECHARGE"
      - "RUN"

  smps-bom:
    type: int
    description: |
      SMPS L/C BOM selection

      Indicates which L/C BOM is present on the board:
        1: 1.5µH inductance, 2.2µF output capacitance
        2: 2.2µH inductance, 4.7µF output capacitance
        3: 10µH inductance, 4.7µF output capacitance
      Refer to RM0505 §5.5 for more details about L/C BOM.

      This property is required if `smps-mode` is not "OFF".
    enum:
      - 1
      - 2
      - 3

  smps-clock-prescaler:
    type: int
    default: 4
    description: |
      SMPS clock prescaler factor

      The SMPS clock, CLK_SMPS, comes from a 16 MHz source that
      goes through one of two prescalers, with a respective
      division factor of 2 and 4. This property selects which
      prescaler should be used.

      Setting this property to 2 results in CLK_SMPS = 8 MHz.
      Setting this property to 4 results in CLK_SMPS = 4 MHz.

      All features of the SMPS can be used regardless of which
      prescaler has been chosen. Since a slower clock results
      in less power consumption, this property defaults to 4.

      This property is only used if `smps-mode` is not "OFF".
    enum:
      - 2
      - 4

  smps-lp-floating:
    type: boolean
    description: |
      Floating SMPS output in low-power state

      If this property is set, the SMPS output pin (VFBSD)
      is left floating when the SoC is in low-power state.

      If this property is not set, the SMPS is placed in
      PRECHARGE mode when the SoC is in low-power state.
      (i.e., VFBSD voltage is equal to VDD)

  smps-current-limit:
    type: string
    default: "20"
    description: |
      SMPS output current limit (in mA)

      The default value of 20 mA corresponds to the maximal
      output current allowed for the SMPS, and is also equal
      to the hardware reset configuration.

      On STM32WB06 and STM32WB07, this property is ignored as
      the output current limitation feature is not available.

      This property is only used if `smps-mode` is "PRECHARGE".
    enum:
      - "2_5"
      - "5"
      - "10"
      - "20"

  smps-output-voltage:
    type: string
    default: "1V40"
    description: |
      SMPS regulated output voltage

      The default value corresponds to the hardware reset
      configuration of 1.40V regulated output.

      This property is only used if `smps-mode` is "RUN".
    enum:
      - "1V20"
      - "1V25"
      - "1V30"
      - "1V35"
      - "1V40"
      - "1V45"
      - "1V50"
      - "1V55"
      - "1V60"
      - "1V65"
      - "1V70"
      - "1V75"
      - "1V80"
      - "1V85"
      - "1V90"
      - "1V95"
```

## dts/bindings/power/st,stm32wba-pwr.yaml
```yaml
# Copyright (c) 2026 STMicroelectronics
# SPDX-License-Identifier: Apache-2.0

title: STM32WBA power controller

description: |
  Power controller of STM32WBA series

  Controls the memory retained in s2ram power state.

compatible: "st,stm32wba-pwr"

include: "st,stm32-dualreg-pwr.yaml"

properties:
  retain-sram2:
    type: boolean
    description: |
      Enables retention of SRAM2 while in Standby low-power mode.
      (Standby mode is a suspend-to-RAM power state)

      If this property is present, the entire SRAM2 memory region
      will be retained in Standby mode (all contents preserved).

      If this property is not present, the SRAM2 memory region will
      will not be retained in Standby mode (all contents are lost),
      except if the Zephyr RAM region `/chosen/zephyr,sram` overlaps
      with SRAM2 (in this case, retention is always enabled).

examples:
  - |
    /*
     * Not used RAM retained (and so powered) is simply a
     * pointless waste of energy.
     * `/chosen/zephyr,sram` (Zephyr system memory) is mapped on
     * sram0 memory controller.
     * According the required ram, sram0 memory controller will use
     * SRAM1 (up to 448KB) and SRAM2 (up to 64KB) physical banks.
     *
     * Let's imagine a build report shows an application needs
     * 120 KB of RAM and Standby low-power feature is required.
     * In this case only the first 2 pages of SRAM1 will be retained.
     * And SRAM2 is not retained by default.
     * The overlay file can be modified like this:
     */
    sram0: memory@20000000 {
            reg = <0x20000000 DT_SIZE_K(120)>;
    };
  - |
    /*
     * If for any specific reason application needs to retain SRAM2:
     */
    &pwr {
            power-supply = "smps";
            retain-sram2;
            status = "okay";
    };
  - |
    /*
     * If full memory is required, SRAM1 and SRAM2 will be
     * fully retained and the sram0 memory node will appear
     * like this:
     */
    sram0: memory@20000000 {
            reg = <0x20000000 DT_SIZE_K(512)>;
    };
```

## dts/bindings/power/state.yaml
```yaml
# Copyright (c) 2020, Intel Corporation
# SPDX-License-Identifier: Apache-2.0

description: Properties for power management state

compatible: "zephyr,power-state"

properties:
    power-state-name:
        type: string
        required: true
        description: indicates a power state
        enum:
            - "active"
            - "runtime-idle"
            - "suspend-to-idle"
            - "standby"
            - "suspend-to-ram"
            - "suspend-to-disk"
            - "soft-off"
    substate-id:
        type: int
        required: false
        description: Platform specific identification.
    min-residency-us:
        type: int
        required: false
        description: |
            Minimum residency duration in microseconds. It is the minimum time for a
            given idle state to be worthwhile energywise. It includes the time to enter
            in this state.
    exit-latency-us:
        type: int
        required: false
        description: |
            Worst case latency in microseconds required to exit the idle state.
```

## dts/bindings/power/stm32,stm32l4-power.yaml
```yaml
compatible: "stm32,stm32l4-power"

include: zephyr,power-state.yaml

properties:
  sram-retention:
    type: boolean
    description: |
      SRAM retention during low power mode if true
      SRAM content is lost during low power mode if false
```

## dts/bindings/power/telink,b91-power.yaml
```yaml
# Copyright (c) 2021 Telink Semiconductor
# SPDX-License-Identifier: Apache-2.0

description: Telink B91 power control node

compatible: "telink,b91-power"

include: base.yaml

properties:
  reg:
    required: true

  power-mode:
    type: string
    required: true
    enum:
      - "LDO_1P4_LDO_1P8"
      - "DCDC_1P4_LDO_1P8"
      - "DCDC_1P4_DCDC_1P8"

  vbat-type:
    type: string
    required: true
    enum:
      - "VBAT_MAX_VALUE_LESS_THAN_3V6"
      - "VBAT_MAX_VALUE_GREATER_THAN_3V6"
```
