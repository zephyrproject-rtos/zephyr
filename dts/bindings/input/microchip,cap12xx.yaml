## dts/bindings/input/realtek,bee-keyscan.yaml
```yaml
# Copyright (c) 2026, Realtek Semiconductor Corporation
# SPDX-License-Identifier: Apache-2.0

description: |
  Bee Keyscan.

  The Bee Keyscan should be used with an external keyscan matrix.
  There is a total of 12 rows and 20 columns.
  You can assign any available pins to row or colunm by pinctrl.
  The rows and columns need to be indexed starting from 0.

compatible: "realtek,bee-keyscan"

include: [kbd-matrix-common.yaml, pinctrl-device.yaml]

properties:
  reg:
    required: true

  clocks:
    required: true

  interrupts:
    required: true

  pinctrl-0:
    required: true

  pinctrl-names:
    required: true

  row-size:
    required: true
    default: 2
    description: |
      Actual row size of the external keyscan matrix.
      Hardware supports up to 12 rows.

  col-size:
    required: true
    default: 2
    description: |
      Actual column size of the external keyscan matrix.
      Hardware supports up to 20 columns.

  scan-div:
    type: int
    default: 1
    description: |
      Clock divider for the Keyscan scanning clock.
      Formula: scan_clock = source_clock / (scan-div + 1).
      Assuming the source_clock is 5MHz, the default value 1 results in a 2.5MHz scan_clock.
      Maximum value: 65535.

  delay-div:
    type: int
    default: 49
    description: |
      Clock divider for the Keyscan delay clock (used for debounce, poll interval and release).
      Formula: delay_clock = scan_clock / (delay-div + 1).
      With the default 2.5MHz scan_clock, the default value 49 results in a 50kHz delay_clock.
      Maximum value: 255.
      poll-period-us and release-time-us each depend on the delay_clock period
      (T_delay = 1 / delay_clock), and each has its own maximum of 512 ticks.
      With the default 50kHz delay_clock (20us period), all three properties have:
        - Resolution: 20us
        - Range: 0 to 10240us

  poll-period-us:
    description: |
      Keyscan interval during scans, in microseconds.

      In manual mode, there is no hardware limit on this value because key
      scanning is driven by a software timer.

      In auto mode, the allowed range depends on the delay clock period
      (T_delay = 1 / delay_clock) and the maximum delay counter value
      (512 ticks).

  release-time-us:
    type: int
    default: 5000
    description: |
      Time to detect all keys released in auto-scan mode.

examples:
  - |
    &keyscan {
          pinctrl-0 = <&keyscan_default>;
          pinctrl-names = "default";
          row-size = <2>;
          col-size = <2>;
          debounce-down-ms = <10>;
          debounce-up-ms = <10>;
          poll-period-us = <10000>;
          release-time-us = <10000>;
          status = "okay";
      };

    &pinctrl {
        keyscan_default: keyscan_default {
            group1 {
              psels = <BEE_PSEL(KEY_COL_0, P0_6)>,
                      <BEE_PSEL(KEY_COL_1, P0_7)>;
              output-enable;
              output-low;
              bias-disable;
            };

            group2 {
              psels = <BEE_PSEL(KEY_ROW_0, P2_4)>,
                      <BEE_PSEL(KEY_ROW_1, P2_5)>;
              output-disable;
              bias-pull-up;
              bias-pull-strong;
            };
        };
    };
```

## dts/bindings/input/realtek,rts5912-kbd.yaml
```yaml
# Copyright (c) 2025 Realtek Corporation.
# SPDX-License-Identifier: Apache-2.0

description: Realtek RTS5912 keyboard matrix controller

compatible: "realtek,rts5912-kbd"

include: [kbd-matrix-common.yaml, pinctrl-device.yaml]

properties:
  reg:
    required: true

  interrupts:
    required: true

  pinctrl-0:
    required: true

  pinctrl-names:
    required: true

  row-size:
    required: true
    min: 1
    max: 9

  col-size:
    required: true
    min: 1
    max: 19

  kso-ignore-mask:
    type: int
    default: 0
```

## dts/bindings/input/renesas,ra-ctsu-button.yaml
```yaml
# Copyright (c) 2025 Renesas Electronics Corporation
# SPDX-License-Identifier: Apache-2.0

description: |
  Renesas RA Capacitive Touch Button instance.

  This node is a renesas,ra-ctsu grandchild node and applies filters and calculations
  to detect an input event on a group which is the child of renesas,ra-ctsu.
  For more information see input/renesas,ra-ctsu.yaml

  Example:

  #include <dt-bindings/input/input-event-codes.h>

  &ctsu {
    compatible = "renesas,ra-ctsu";

    group1 {
      ...
      button1 {
        compatible = "renesas,ra-ctsu-button";
        elements = <0>;
        threshold = <769>;
        hysteresis = <38>;
        event-code = <INPUT_KEY_0>;
      };

      button2 {
        compatible = "renesas,ra-ctsu-button";
        elements = <1>;
        threshold = <769>;
        hysteresis = <38>;
        event-code = <INPUT_KEY_1>;
      };
    };
  };

  Notes: The order of the CTSU button nodes in the same group must follow these elements index.

compatible: "renesas,ra-ctsu-button"

include: [base.yaml]

properties:
  event-code:
    type: int
    required: true
    description: |
      The key code for the device. This is used to identify the device in the
      input subsystem. It should be one of the values defined in
      include/input-event-codes.h.

  elements:
    type: int
    default: 0
    description: |
      Element number from CTSU group that this button located on.

  threshold:
    type: int
    default: 0
    description: |
      Touch/non-touch judgement threshold for automatic judgement.

  hysteresis:
    type: int
    default: 0
    description: |
      Threshold hysteresis for chattering prevention for automatic judgement.
```

## dts/bindings/input/renesas,ra-ctsu-wheel.yaml
```yaml
# Copyright (c) 2025 Renesas Electronics Corporation
# SPDX-License-Identifier: Apache-2.0

description: |
  Renesas RA Capacitive Touch Wheel

  This node is a renesas,ra-ctsu grandchild node and applies filters and calculations
  to detect an input event on a group which is the child of renesas,ra-ctsu.
  For more information see input/renesas,ra-ctsu.yaml

  Example:

  #include <dt-bindings/input/input-event-codes.h>

  &ctsu {
    compatible = "renesas,ra-ctsu";

    group1 {
      ...
      wheel {
        compatible = "renesas,ra-ctsu-wheel";
        elements = <0>, <3>, <2>, <1>;
        threshold = <711>;
        event-code = <INPUT_ABS_WHEEL>;
      };
    };
  };

compatible: "renesas,ra-ctsu-wheel"

include: [base.yaml]

properties:
  event-code:
    type: int
    required: true
    description: |
      The key code for the device. This is used to identify the device in the
      input subsystem. It should be one of the values defined in
      include/input-event-codes.h.

  elements:
    type: array
    description: |
      Element number array from CTSU group that used by this node. It should have the same
      order with electrode located on the Capacitive Pad.

  threshold:
    type: int
    default: 0
    description: |
      Touch/non-touch judgement threshold for automatic judgement.
```

## dts/bindings/input/renesas,ra-ctsu.yaml
```yaml
# Copyright (c) 2025 Renesas Electronics Corporation
# SPDX-License-Identifier: Apache-2.0

description: Renesas RA Capacitive Sensing Unit

compatible: "renesas,ra-ctsu"

include: [base.yaml, pinctrl-device.yaml]

properties:
  pinctrl-0:
    required: true

  clocks:
    required: true

  interrupts:
    required: true
    description: IRQ number and priority to use for CTSU.

  interrupt-names:
    required: true
    description: |
      Interrupts must be given corresponding names so that the shim driver can recognize them.
      - "ctsuwr": write interrupt
      - "ctsurd": read interrupt
      - "ctsufn": end interrupt

  variant:
    required: true
    type: string
    enum: ["ctsua", "ctsu2"]
    description: Determine which ctsu device is in use

  clock-div:
    type: int
    enum: [1, 2, 4, 8]
    default: 1
    description: Select divider value for operating input clock. Default as div by 1.

  pwr-supply-sel:
    type: string
    enum: ["vcc", "internal-power"]
    default: "internal-power"
    description: CTSU Transmission Power Supply Select (for both CTSUa and CTSU2).

  pwr-supply-sel2:
    type: string
    enum: ["pwr-supply-sel", "vcc-private"]
    default: "pwr-supply-sel"
    description: CTSU Transmission Power Supply Select 2 (CTSU2 Only)

  atune1:
    type: string
    enum: ["normal", "high"]
    default: "normal"
    description: |
      CTSU Power Supply Capacity Adjustment (CTSUa Only):
      - "normal": 40uA
      - "high": 80uA

  atune12:
    type: int
    enum: [80, 40, 20, 160]
    default: 40
    description: |
      CTSU Power Supply Capacity Adjustment in uA (CTSU2 Only)

  measure-mode:
    type: string
    enum:
      - "self-multi-scan"
      - "mutual-full-scan"
      - "mutual-cfc-scan"
      - "current-scan"
      - "correction-scan"
      - "diagnosis-scan"
    default: "self-multi-scan"
    description: CTSU Measurement Mode Select

  po-sel:
    type: string
    enum:
      - "low-gpio"
      - "hi-z"
      - "low"
      - "same-pulse"
    default: "same-pulse"
    description: CTSU Non-Measured Channel Output Select (CTSU2 Only)

  tscap-gpios:
    type: phandle-array
    required: true
    description: |
      CTSU TSCAP Pin. This pin is used to discharge the capacitior by
      control to output low, before switching to CTSU function.

child-binding:
  description: Renesas RA CTSU touch configuration
  properties:
    ctsuchac:
      type: array
      default: [0, 0, 0, 0, 0]
      description: |
        TSCAP pin enable mask. Expected fields, in order, are:
        - ctsuchac0: TS00-TS07 enable mask
        - ctsuchac1: TS08-TS15 enable mask
        - ctsuchac2: TS16-TS23 enable mask
        - ctsuchac3: TS24-TS31 enable mask
        - ctsuchac4: TS32-TS39 enable mask

    ctsuchtrc:
      type: array
      default: [0, 0, 0, 0, 0]
      description: |
        TSCAP pin mutual-tx mask. Expected fields, in order, are:
        - ctsuchtrc0: TS00-TS07 mutual-tx mask
        - ctsuchtrc1: TS08-TS15 mutual-tx mask
        - ctsuchtrc2: TS16-TS23 mutual-tx mask
        - ctsuchtrc3: TS24-TS31 mutual-tx mask
        - ctsuchtrc4: TS32-TS39 mutual-tx mask

    rx-count:
      type: int
      default: 0
      description: |
        The number of RX channels to be used. This should be set to the number of
        channels that are enabled in the ctsuchac0-4 properties.

    tx-count:
      type: int
      default: 0
      description: |
        The number of TX channels to be used. This should be set to the number of
        channels that are enabled in the ctsuchtrc0-4 properties.

    ssdiv:
      type: string-array
      default: ["4.00"]
      enum:
        - "4.00"
        - "2.00"
        - "1.33"
        - "1.00"
        - "0.80"
        - "0.67"
        - "0.57"
        - "0.50"
        - "0.44"
        - "0.40"
        - "0.36"
        - "0.33"
        - "0.31"
        - "0.29"
        - "0.27"
        - "0.00"
      description: CTSU Spectrum Diffusion Frequency Division Setting (CTSUa Only)

    so:
      type: array
      default: [0]
      description: CTSU Sensor Offset Adjustment

    snum:
      type: array
      default: [0]
      description: CTSU Measurement Count Setting

    sdpa:
      type: array
      default: [0]
      description: CTSU Base Clock Setting

    on-freq:
      type: int
      default: 0
      description: The cumulative number of determinations of ON.

    off-freq:
      type: int
      default: 0
      description: The cumulative number of determinations of OFF.

    drift-freq:
      type: int
      default: 0
      description: Base value drift frequency (0 mean no use).

    cancel-freq:
      type: int
      default: 0
      description: Maximum continuous ON (0 mean no use).

    num-moving-avg:
      type: int
      default: 0
      description: |
        The number of samples to use for moving average. If set to 0, no moving average is applied.
        This is useful for smoothing the sensor readings.
```

## dts/bindings/input/renesas,rx-ctsu-button.yaml
```yaml
# Copyright (c) 2025 Renesas Electronics Corporation
# SPDX-License-Identifier: Apache-2.0

description: RX Renesas Capatitive Touch Button Component

compatible: "renesas,rx-ctsu-button"
```

## dts/bindings/input/renesas,rx-ctsu-slider.yaml
```yaml
# Copyright (c) 2025 Renesas Electronics Corporation
# SPDX-License-Identifier: Apache-2.0

description: RX Renesas Capatitive Touch Slider Component

compatible: "renesas,rx-ctsu-slider"
```

## dts/bindings/input/renesas,rx-ctsu-wheel.yaml
```yaml
# Copyright (c) 2025 Renesas Electronics Corporation
# SPDX-License-Identifier: Apache-2.0

description: RX Renesas Capatitive Touch Wheel Component

compatible: "renesas,rx-ctsu-wheel"
```

## dts/bindings/input/renesas,rx-ctsu.yaml
```yaml
# Copyright (c) 2025 Renesas Electronics Corporation
# SPDX-License-Identifier: Apache-2.0

description: RX Renesas Capatitive Touch Sensing Unit

compatible: "renesas,rx-ctsu"

include: [base.yaml, pinctrl-device.yaml]

properties:
  max-num-sensors:
    type: int
    required: true
    description: Maximum number of sensors available in the CTSU

  low-voltage-mode:
    type: boolean
    description: |
      Enable low voltage mode
      In this mode, the CTSU will work with lower voltage
      This mode is useful when the system is working with low voltage

  tscap-gpios:
    type: phandle-array
    required: true
    description: |
      CTSU TSCAP Pin

  pinctrl-0:
    required: true

  pinctrl-names:
    required: true

child-binding:
  description: CTSU Sensor Component

  properties:
    component-type:
      type: string
      required: true
      enum:
        - "button"
        - "slider"
        - "wheel"
      description: |
        Type of component

    ssdiv:
      type: int
      default: 1
      description: |
        Spectrum Diffusion Frequency Division Setting
        - 0:      4.00 <= Base Clock Frequency fb (MHz)
        - 1..14:  4.00/(ssdiv+1) <= fb < 4.00/(ssdiv)
        - 15:     fb < 0.27

    so:
      type: int
      default: 0x074
      description: |
        Sensor Offset Adjustment (10 bits):
        Current offset amount

    snum:
      type: int
      default: 3
      description: |
        Set the number of measurements = snum + 1

    sdpa:
      type: int
      default: 7
      description: |
        Base Clock Setting (5 bits)(0 - 31):
        Operating clock divided by 2*(sdpa+1)

    resolution:
      type: int
      default: 100
      description: Resolution of wheel or slider

    channels-num:
      type: array
      required: true
      description: |
        Channels number that are used by the component
        In case of "slider" or "wheel", channels should be placed in order
          as they are on the slider or wheel. (from the lowest value to the highest value)
        In case of "button", there must be only 1 element in array.
        Otherwise, CTSU will not working.

    touch-count-threshold:
      type: int
      default: 1500
      description: |
        Count threshold to determine touching or not
        In case of "slider" or "wheel",
          this is the threshold to start the position calculation

    threshold-range:
      type: int
      default: 500
      description: |
        Range of threshold: if count > threshold + range => touching
                            if count < threshold => untouch

    zephyr,code:
      type: int
      required: true
      description: Key code to emit.
```

## dts/bindings/input/sitronix,cf1133.yaml
```yaml
#
# Copyright (c) 2024, Kickmaker
#
# SPDX-License-Identifier: Apache-2.0


description: CF1133 capacitive touch panels

compatible: "sitronix,cf1133"

include: i2c-device.yaml

properties:
  int-gpios:
    type: phandle-array
    description: |
      Interrupt GPIO. Used by the controller to signal touch data is
      available. Active low.
```
