## dts/bindings/input/microchip,cap12xx.yaml
```yaml
# Copyright (c) 2022 Keiya Nobuta
# SPDX-License-Identifier: Apache-2.0

description: Microchip CAP12xx family of 3, 6 and 8-channel capacitive touch sensors.

compatible: "microchip,cap12xx"

include: i2c-device.yaml

properties:
  int-gpios:
    type: phandle-array
    description: |
      Interrupt GPIO when not using polling mode.

  repeat:
    type: boolean
    description: |
      Property to enable the interrupt repeat mode for prolonged touch events.

  poll-interval-ms:
    type: int
    default: 10
    description: |
      Polling interval in ms when not using interrupt mode.

  input-codes:
    type: array
    required: true
    description: |
      Array of input event key codes (INPUT_KEY_* or INPUT_BTN_*).

  sensor-gain:
    type: int
    enum:
      - 1
      - 2
      - 4
      - 8
    default: 1
    description: |
      Defines the gain of the sensor circuitry. This
      effectively controls the sensitivity, as a
      smaller delta capacitance is required to
      generate the same delta count values.

  sensitivity-delta-sense:
    type: int
    enum: [1, 2, 4, 8, 16, 32, 64, 128]
    default: 32
    description:
      Controls the sensitivity multiplier of a touch detection.
      Higher value means more sensitive settings.
      At the more sensitive settings, touches are detected for a smaller delta
      capacitance corresponding to a "lighter" touch.

  signal-guard:
    type: array
    enum: [0, 1]
    default: [0, 0, 0]
    description: |
      0 - off
      1 - on
      The signal guard isolates the signal from virtual grounds.
      If enabled then the behavior of the channel is changed to signal guard.
      The number of entries must correspond to the number of channels.

  calib-sensitivity:
    type: array
    enum: [1, 2, 4]
    default: [1, 1, 1]
    description: |
      Specifies an array of numeric values that controls the gain
      used by the calibration routine to enable sensor inputs
      to be more sensitive for proximity detection.
      Gain is based on touch pad capacitance range
      1 - 5-50pF
      2 - 0-25pF
      4 - 0-12.5pF
      The number of entries must correspond to the number of channels.
```

## dts/bindings/input/microchip,xec-kbd.yaml
```yaml
# Copyright (c) 2019, Intel Corporation
# Copyright (c) 2021, Microchip Technology Inc.
# SPDX-License-Identifier: Apache-2.0

description: Microchip XEC keyboard matrix controller

compatible: "microchip,xec-kbd"

include:
  - name: kbd-matrix-common.yaml
  - name: pinctrl-device.yaml
  - name: microchip,dmec-ecia-girq.yaml

properties:
  "#address-cells":
    required: true
    const: 1

  "#size-cells":
    type: int
    const: 0

  reg:
    required: true

  interrupts:
    required: true

  pcrs:
    type: int
    required: true
    description: KBD PCR register index and bit position

  row-size:
    required: true

  col-size:
    required: true
```

## dts/bindings/input/nintendo,nunchuk.yaml
```yaml
# Copyright (c) 2024 Bootlin
# SPDX-License-Identifier: Apache-2.0

description: Nintendo Nunchuk joystick through I2C

compatible: "nintendo,nunchuk"

include: i2c-device.yaml

properties:
  polling-interval-ms:
    type: int
    default: 50
    description: |
      Interval between two reads, in ms. The interval must be greater than 20 ms or equal to 0 ms
      to disable the periodical polling and use the nunchuk_read() function to trigger a readout.
      Defaults to 50 ms.
```

## dts/bindings/input/nuvoton,npcx-kbd.yaml
```yaml
# Copyright (c) 2022 Nuvoton Technology Corporation.
# SPDX-License-Identifier: Apache-2.0

description: Nuvoton NPCX keyboard scan controller

compatible: "nuvoton,npcx-kbd"

include: [kbd-matrix-common.yaml, pinctrl-device.yaml]

properties:
  reg:
    required: true

  clocks:
    required: true

  pinctrl-0:
    required: true

  pinctrl-names:
    required: true

  wui-maps:
    type: phandles
    required: true
    description: |
        Mapping table between Wake-Up Input (WUI) and KSIs.

        For example the WUI mapping on 8 KSI pads would be
           wui-maps = <&wui_io30 &wui_io31 &wui_io27 &wui_io26
                       &wui_io25 &wui_io24 &wui_io23 &wui_io22>;

  row-size:
    required: true

  col-size:
    required: true
```

## dts/bindings/input/nxp,gpt-ppm-input.yaml
```yaml
# Copyright (c) 2023 NXP Semiconductors
# SPDX-License-Identifier: Apache-2.0

description: |
  PPM input driver using NXP MCUX General-Purpose Timer (GPT)
  This driver implements the PPM protocol used in RC radio
  to send out analogue joystick and switches output.
  The driver binds this to the Zephyr input system using INPUT_EV_CODES

  The following examples defines a a binding of 2 joysticks using 4 PPM channels

  &gpt5 {
    compatible = "nxp,gpt-ppm-input";
    pinctrl-0 = <&pinmux_gpt_ppm>;
    pinctrl-names = "default";
    capture-channel = <1>;
    right_stick_x {
      channel = <1>;
      label = "Right stick x";
      type = <INPUT_EV_ABS>;
      zephyr,code = <INPUT_ABS_RX>;
    };
    right_stick_y {
      channel = <2>;
      label = "Right stick y";
      type = <INPUT_EV_ABS>;
      zephyr,code = <INPUT_ABS_RY>;
    };
    left_stick_x {
      channel = <3>;
      label = "Left stick x";
      type = <INPUT_EV_ABS>;
      zephyr,code = <INPUT_ABS_X>;
    };
    left_stick_y {
      channel = <4>;
      label = "Left stick y";
      type = <INPUT_EV_ABS>;
      zephyr,code = <INPUT_ABS_Y>;
    };
  };

compatible: "nxp,gpt-ppm-input"

include: [base.yaml, pinctrl-device.yaml]

properties:
  reg:
    required: true

  interrupts:
    required: true

  pinctrl-0:
    required: true

  pinctrl-names:
    required: true

  gptfreq:
    type: int
    required: true
    description: gpt frequences

  capture-channel:
    type: int
    required: true

child-binding:
  description: PPM Channel to input-event-code binding
  properties:
    channel:
      type: int
      required: true
      description: PPM input channel
    label:
      type: string
      description: Descriptive name of the key
    type:
      type: int
      required: true
      description: Input event types see INPUT_EV_CODES
    zephyr,code:
      type: int
      required: true
      description: Code to emit.
```

## dts/bindings/input/nxp,mcux-kpp.yaml
```yaml
# Copyright 2025 NXP
# SPDX-License-Identifier: Apache-2.0

description: NXP KPP controller

compatible: "nxp,mcux-kpp"

include: [base.yaml, pinctrl-device.yaml]

properties:
  reg:
    required: true

  interrupts:
    required: true

  clocks:
    required: true
```

## dts/bindings/input/nxp,tsi-input.yaml
```yaml
# Copyright 2026 NXP
# SPDX-License-Identifier: Apache-2.0

description: NXP TSI V6 Touch Sensing Input Device

compatible: "nxp,tsi-input"

include: [base.yaml, pinctrl-device.yaml]

properties:
  reg:
    required: true

  interrupts:
    required: true

  clocks:
    required: true

  channel-mask:
    type: int
    description: Bitmask of enabled TSI channels (bit N = channel N)

  input-codes:
    type: array
    description: |
      Array of input codes corresponding to each enabled channels.
      Use INPUT_KEY_* or INPUT_BTN_* codes from dt-bindings/input/input-event-codes.h

  touch-threshold:
    type: int
    default: 100
    description: |
      Touch detection threshold (delta counts from baseline).
      Can be positive or negative value depending on the baseline calculation.

  release-threshold:
    type: int
    description: |
      Release detection threshold (delta counts from baseline).
      If not specified, defaults to touch-threshold / 2.
      Should be less than touch-threshold to provide hysteresis.
      Can be positive or negative value depending on the baseline calculation.

  scan-period-ms:
    type: int
    default: 50
    description: Scan period in milliseconds

  pinctrl-0:
    required: true

  pinctrl-names:
    required: true
```

## dts/bindings/input/parade,tma525b.yaml
```yaml
# Copyright (c) 2025 NXP
# SPDX-License-Identifier: Apache-2.0

description: TMA525b capacitive touch controller

compatible: "parade,tma525b"

include: [i2c-device.yaml, touchscreen-common.yaml]

properties:
  int-gpios:
    type: phandle-array
    description: |
      Interrupt GPIO. Used by the controller to signal touch data is
      available. Active low.
  reset-gpios:
    type: phandle-array
    description: |
      Reset GPIO. Used to reset the controller during initialization, and
      to wake it from hibernation mode. Active low.
  power-gpios:
    type: phandle-array
    description: |
      Power on GPIO. Used to enable the controller during initialization.
```

## dts/bindings/input/pixart,pat912x.yaml
```yaml
# Copyright 2024 Google LLC
# SPDX-License-Identifier: Apache-2.0

description: PAT9125EL Miniature Optical Navigation Chip

compatible: "pixart,pat912x"

include: i2c-device.yaml

properties:
  motion-gpios:
    type: phandle-array
    required: true
    description:
      GPIO connected to the motion pin, active low.

  zephyr,axis-x:
    type: int
    description: |
      The input code for the X axis to report for the device, typically any of
      INPUT_REL_*. No report produced for the device X axis if unspecified.

  zephyr,axis-y:
    type: int
    description: |
      The input code for the Y axis to report for the device, typically any of
      INPUT_REL_*. No report produced for the device Y axis if unspecified.

  res-x-cpi:
    type: int
    description: |
      CPI resolution for the X axis, range 0 to 1275, rounded down to the
      closest supported value in increments of 5.

  res-y-cpi:
    type: int
    description: |
      CPI resolution for the Y axis, range 0 to 1275, rounded down to the
      closest supported value in increments of 5.

  invert-x:
    type: boolean
    description: |
      Invert X axis values.

  invert-y:
    type: boolean
    description: |
      Invert Y axis values.

  sleep1-enable:
    type: boolean
    description: |
      Enable sleep1 mode.

  sleep2-enable:
    type: boolean
    description: |
      Enable sleep2 mode, only valid if sleep1 is also enabled.
```

## dts/bindings/input/pixart,paw32xx.yaml
```yaml
# Copyright 2024 Google LLC
# SPDX-License-Identifier: Apache-2.0

description: PAW32xx ultra low power wireless mouse chip

compatible: "pixart,paw32xx"

include: spi-device.yaml

properties:
  motion-gpios:
    type: phandle-array
    required: true
    description:
      GPIO connected to the motion pin, active low.

  zephyr,axis-x:
    type: int
    required: true
    description: |
      The input code for the X axis to report for the device, typically any of
      INPUT_REL_*. No report produced for the device X axis if unspecified.

  zephyr,axis-y:
    type: int
    required: true
    description: |
      The input code for the Y axis to report for the device, typically any of
      INPUT_REL_*. No report produced for the device Y axis if unspecified.

  res-cpi:
    type: int
    description: |
      CPI resolution for the sensor. This can also be changed in runtime using
      the paw32xx_set_resolution() API.

  invert-x:
    type: boolean
    description: |
      Invert X axis values.

  invert-y:
    type: boolean
    description: |
      Invert Y axis values.

  force-awake:
    type: boolean
    description: |
      Initialize the sensor in "force awake" mode. This can also be enabled or
      disabled in runtime by the application using the paw32xx_force_awake()
      API.
```

## dts/bindings/input/pixart,pmw3610.yaml
```yaml
# Copyright 2024 Google LLC
# SPDX-License-Identifier: Apache-2.0

description: PMW3610 Low Power Laser Mouse Sensor

compatible: "pixart,pmw3610"

include: spi-device.yaml

properties:
  motion-gpios:
    type: phandle-array
    required: true
    description:
      GPIO connected to the motion pin, active low.

  reset-gpios:
    type: phandle-array
    description:
      GPIO connected to the reset pin, active low.

  zephyr,axis-x:
    type: int
    required: true
    description: |
      The input code for the X axis to report for the device, typically any of
      INPUT_REL_*. No report produced for the device X axis if unspecified.

  zephyr,axis-y:
    type: int
    required: true
    description: |
      The input code for the Y axis to report for the device, typically any of
      INPUT_REL_*. No report produced for the device Y axis if unspecified.

  res-cpi:
    type: int
    description: |
      CPI resolution for the sensor, range from 200 to 3200, rounded down to
      the closest supported value in increments of 200. This can also be
      changed in runtime using the pmw3610_set_resolution() API.

  invert-x:
    type: boolean
    description: |
      Invert X axis values.

  invert-y:
    type: boolean
    description: |
      Invert Y axis values.

  force-awake:
    type: boolean
    description: |
      Initialize the sensor in "force awake" mode. This can also be enabled or
      disabled in runtime by the application using the pmw3610_force_awake()
      API.

  smart-mode:
    type: boolean
    description: |
      Enable the "smart mode" algorithm as described in the device datasheet.
      This should improve sensor tracking across a wider range of surfaces.
```
