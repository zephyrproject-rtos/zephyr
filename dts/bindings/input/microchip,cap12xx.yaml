## dts/bindings/input/st,stmpe811.yaml
```yaml
# Copyright (c) 2023 Antmicro <www.antmicro.com>
# SPDX-License-Identifier: Apache-2.0

description: STMPE811 I2C touchscreen controller

compatible: "st,stmpe811"

include: i2c-device.yaml

properties:
  int-gpios:
    type: phandle-array
    description: |
      Interrupt GPIO. Used by the controller to signal touch data is
      available. Active low.

  screen-width:
    type: int
    default: 0
    description: |
      Screen width for scaling the reported coordinates.
      Default: raw touchscreen resolution.

  screen-height:
    type: int
    default: 0
    description: |
      Screen height for scaling the reported coordinates.
      Default: raw touchscreen resolution.

  raw-x-min:
    type: int
    description: |
      Signed raw X axis start for scaling the reported coordinates.
      No effect if screen size is not set.

  raw-y-min:
    type: int
    description: |
      Signed raw Y axis start for scaling the reported coordinates.
      No effect if screen size is not set.

  raw-x-max:
    type: int
    description: |
      Raw X axis end for scaling the reported coordinates.
      No effect if screen size is not set.

  raw-y-max:
    type: int
    description: |
      Raw Y axis end for scaling the reported coordinates.
      No effect if screen size is not set.

  panel-driver-settling-time-us:
    type: int
    enum:
      - 10
      - 100
      - 500
      - 1000
      - 5000
      - 10000
      - 50000
      - 100000
    required: true
    description: |
      Panel driver settling time (microseconds). For large panels (> 6"), a capacitor of 10 nF
      is recommended at the touchscreen terminals for noise filtering.
      As a general rule, 1-5 nF capacitors require around 500 us settling time, and 5-10 nF need
      around 1 ms. When a larger capacitor is used, this value should be changed, as it can
      lead to inaccuracy of the measurement.

  touch-detect-delay-us:
    type: int
    enum:
      - 10
      - 50
      - 100
      - 500
      - 1000
      - 5000
      - 10000
      - 50000
    required: true
    description: |
      Touch detect delay (microseconds) is the delay from the activation of the pull-up resistor
      in the X+ line to the time the device performs touch detection.
      If no capacitor, or a smaller capacitor is used, this value can be lowered to
      minimize detection latency, but it could lower the position stability.

  touch-average-control:
    type: int
    enum:
      - 1
      - 2
      - 4
      - 8
    required: true
    description: |
      Average control (number of samples).
      This parameter can be set to any of the possible values.
      Higher values result in more filtering of noise, but also introduce
      more latency in the touch detection process.

      Use cases that require low touch detection latency
      may benefit from using a lower value for this parameter,
      at the cost of less noise filtering.

  tracking-index:
    type: int
    enum:
      - 0
      - 4
      - 8
      - 16
      - 32
      - 64
      - 92
      - 127
    required: true
    description: |
      Tracking index determines the minimal distance between
      the current touch position and the previous touch position.
      If the distance is shorter than the tracking index, it is discarded.
      Lowering the tracking index increases the frequency of touch events,
      but also increases the load on the system.
```

## dts/bindings/input/tbs,crsf.yaml
```yaml
# Copyright (c) 2026 NXP Semiconductors
# SPDX-License-Identifier: Apache-2.0

title: TBS CRSF

description: |
  CRSF (Crossfire), originally developed by Team BlackSheep (TBS) and used by
  ExpressLRS (ELRS) and others, is a bidirectional UART-based serial protocol
  that can be used to receive analog joystick and switch inputs from RC
  transmitters.

  CRSF uses a non-inverted signal and therefore does not require an external
  inverter or RX pin inversion support. It operates over a standard UART
  interface (RX/TX) at 420000 baud, 8N1.

  The binding allows mapping of up to 16 CRSF channels to Zephyr input events.
  Each channel can be configured to generate either absolute position events
  (for joysticks and sliders) or key events (for switches).

  The following example shows how to configure 2 joysticks and a button using 5 channels:

  &lpuart6 {
    status = "okay";

    crsf {
        compatible = "tbs,crsf";
        right_stick_x {
            channel = <1>;
            type = <INPUT_EV_ABS>;
            zephyr,code = <INPUT_ABS_RX>;
        };
        right_stick_y {
            channel = <2>;
            type = <INPUT_EV_ABS>;
            zephyr,code = <INPUT_ABS_RY>;
        };
        left_stick_x {
            channel = <3>;
            type = <INPUT_EV_ABS>;
            zephyr,code = <INPUT_ABS_X>;
        };
        left_stick_y {
            channel = <4>;
            type = <INPUT_EV_ABS>;
            zephyr,code = <INPUT_ABS_Y>;
        };
        kill_switch {
            channel = <5>;
            type = <INPUT_EV_KEY>;
            zephyr,code = <INPUT_KEY_0>;
        };
    };
  };

compatible: "tbs,crsf"

include: [base.yaml, uart-device.yaml]

child-binding:
  description: |
    CRSF Channel to input-event-code binding
    INPUT_EV_ABS & INPUT_EV_MSC gives raw input value
    INPUT_EV_KEY emulates a key
  properties:
    channel:
      type: int
      required: true
      description: |
        CRSF input channel
        Valid range: 1 - 16
    type:
      type: int
      required: true
      description: Input event types see INPUT_EV_CODES
    zephyr,code:
      type: int
      required: true
      description: Code to emit.
```

## dts/bindings/input/ti,tsc2007.yaml
```yaml
# Copyright (c) 2026, Institute of Embedded Systems ZHAW
# SPDX-License-Identifier: Apache-2.0

description: TSC2007 touch panel controller

compatible: "ti,tsc2007"

include: [i2c-device.yaml, touchscreen-common.yaml, touchscreen-common-calibration.yaml]

properties:
  int-gpios:
    type: phandle-array
    description: |
      Interrupt GPIO. Used by the controller to signal touch data is
      available. Active low.

  x-plate-ohms:
    type: int
    description: |
      The resistance of the touchscreen X-plate in ohms specifies
      the physical resistance of the X-direction plate on the touchscreen.
```

## dts/bindings/input/touchscreen-common-calibration.yaml
```yaml
# Copyright (c) 2026, Institute of Embedded Systems ZHAW
# SPDX-License-Identifier: Apache-2.0

description: Common touchscreen calibration properties

properties:
  raw-x-min:
    type: int
    description: |
      Signed raw X axis start for scaling the reported coordinates.
      No effect if screen size is not set.

  raw-x-max:
    type: int
    description: |
      Raw X axis end for scaling the reported coordinates.
      No effect if screen size is not set.

  raw-y-min:
    type: int
    description: |
      Signed raw Y axis start for scaling the reported coordinates.
      No effect if screen size is not set.

  raw-y-max:
    type: int
    description: |
      Raw Y axis end for scaling the reported coordinates.
      No effect if screen size is not set.
```
