## dts/bindings/input/gpio-kbd-matrix.yaml
```yaml
# Copyright 2023 Google LLC
# SPDX-License-Identifier: Apache-2.0

description: |
  GPIO based keyboard matrix input device

  Implement an input device for a GPIO based keyboard matrix.

  Example configuration:

  kbd-matrix {
          compatible = "gpio-kbd-matrix";
          row-gpios = <&gpio0 0 (GPIO_PULL_UP | GPIO_ACTIVE_LOW)>,
                      <&gpio0 1 (GPIO_PULL_UP | GPIO_ACTIVE_LOW)>;
          col-gpios = <&gpio0 2 GPIO_ACTIVE_LOW>,
                      <&gpio0 3 GPIO_ACTIVE_LOW>,
                      <&gpio0 4 GPIO_ACTIVE_LOW>;
          no-ghostkey-check;
  };

compatible: "gpio-kbd-matrix"

include:
  - name: kbd-matrix-common.yaml
    property-blocklist:
      - row-size
      - col-size

properties:
  row-gpios:
    type: phandle-array
    required: true
    description: |
      GPIO for the keyboard matrix rows, up to 8 different GPIOs. All row GPIO
      pins must have interrupt support if idle-mode is set to "interrupt"
      (default).

  col-gpios:
    type: phandle-array
    required: true
    description: |
      GPIO for the keyboard matrix columns, supports up to 32 different GPIOs.
      When unselected, this pin will be either driven to inactive state or
      configured to high impedance (input) depending on the col-drive-inactive
      property.

  col-drive-inactive:
    type: boolean
    description: |
      If enabled, unselected column GPIOs will be driven to inactive state.
      Default to configure unselected column GPIOs to high impedance.

  idle-mode:
    type: string
    default: "interrupt"
    enum:
      - "interrupt"
      - "poll"
      - "scan"
    description: |
      Controls the driver behavior on idle, "interrupt" waits for a new key
      press using GPIO interrupts on the row lines, "poll"  periodically polls
      the row lines with all the columns selected, "scan" just keep scanning
      the matrix continuously, requires "poll-timeout-ms" to be set to 0.
```

## dts/bindings/input/gpio-keys.yaml
```yaml
# Copyright (c) 2018, Linaro Limited
# SPDX-License-Identifier: Apache-2.0

description: |
  Group of GPIO-bound input keys.

  This defines a group of buttons that can generate input events. Each button
  is defined in a child node of the gpio-keys node and defines a specific key
  code.

compatible: "gpio-keys"

include: base.yaml

properties:
  debounce-interval-ms:
    type: int
    default: 30
    description: |
       Debouncing interval time in milliseconds.
       If not specified defaults to 30.

  polling-mode:
    type: boolean
    description: |
      Do not use interrupts for the key GPIOs, poll the pin periodically at the
      specified debounce-interval-ms instead.

  zephyr,suspend-action:
    type: string
    default: "disconnect-with-pupd"
    description: |
      Action taken by driver on key GPIOs when device is suspended.

      none:
        No action - GPIO pins are not reconfigured.
        Useful when the GPIO controller does not support GPIO_DISCONNECTED.

      disconnect-with-pupd:
        This option is provided mainly for backwards compatibility.
        You probably want to use `full-disconnect` instead.

        GPIO pins are reconfigured in GPIO_DISCONNECTED state using a call
        to gpio_pin_configure_dt() which is identical to `full-disconnect`
        if Devicetree does not contain flag GPIO_PULL_DOWN or GPIO_PULL_UP.
        Otherwise, the behavior is implementation-defined:
        - the requested pull-down/pull-up resistor may or may not be enabled
        - the GPIO controller driver may reject the request (-ENOTSUP)

      full-disconnect:
        Fully disconnect GPIO pins (reconfigure without PU/PD flags)

        GPIO pins are reconfigured in GPIO_DISCONNECTED state using a call
        to gpio_pin_configure() with all flags from Devicetree unchanged,
        except GPIO_PULL_DOWN and GPIO_PULL_UP which are masked out.

        This should place GPIO pins in an high-impedance/"floating" state.

      The default value is `disconnect-with-pupd` for backwards compatibility.
    enum:
      - "none"
      - "disconnect-with-pupd"
      - "full-disconnect"

child-binding:
  description: GPIO KEYS child node
  properties:
    gpios:
      type: phandle-array
      required: true

    label:
      type: string
      description: Descriptive name of the key

    zephyr,code:
      type: int
      description: Key code to emit.

examples:
  - |
    #include <zephyr/dt-bindings/input/input-event-codes.h>

    / {
           buttons {
                   compatible = "gpio-keys";
                   button_0 {
                           gpios = <&gpio0 13 (GPIO_PULL_UP | GPIO_ACTIVE_LOW)>;
                           zephyr,code = <INPUT_KEY_0>;
                   };
           };
    };
```

## dts/bindings/input/gpio-qdec.yaml
```yaml
# Copyright 2023 Google LLC
# SPDX-License-Identifier: Apache-2.0

description: |
  GPIO based QDEC input device

  Implement an input device generating relative axis event reports for a rotary
  encoder connected to two GPIOs.

  By default (ISR mode) the driver registers an edge interrupt on gpios[0] (A
  signal) only. On every edge it reads both A and B immediately and determines
  direction from whether they match, with no polling delay. gpios[1] (B) is a
  plain input read inside the callback, so only one GPIO interrupt line is
  claimed. This avoids shared-line conflicts on platforms such as STM32.

  When the polling-mode property is set the driver reverts to the original
  behaviour: it idles until it sees a transition on any encoder signal line,
  then switches to polling both signal lines periodically at sample-time-us,
  and goes back to idling after idle-timeout-ms. sample-time-us and
  idle-timeout-ms are required when polling-mode is set.

compatible: "gpio-qdec"

include: base.yaml

properties:
  gpios:
    type: phandle-array
    required: true
    description: |
      GPIO for the A and B encoder signals. In ISR mode (default) only
      gpios[0] (A) receives a GPIO interrupt; gpios[1] (B) is a plain input
      read inside the ISR callback.

  led-gpios:
    type: phandle-array
    description: |
      GPIOs for LED or other components needed for sensing the AB signals.
      Only used in polling-mode.

  led-pre-us:
    type: int
    description: |
      Time between enabling the led-gpios output pins and reading the encoder
      state on the input pins, meant to give the state detector (such a
      phototransistor) time to settle to right state. Required if led-gpios and
      idle-poll-time-us are specified, can be explicitly set to 0 for no delay.

  steps-per-period:
    type: int
    required: true
    description: |
      How many steps to count before reporting an input event. In ISR mode
      each qualifying A-signal edge counts as one step; use 1 for one report
      per detent on a standard encoder. In polling mode each sampled quadrature
      state transition counts as one step; use 4 for one report per detent.

  zephyr,axis:
    type: int
    required: true
    description: |
      The input code for the axis to report for the device, typically any of
      INPUT_REL_*.

  sample-time-us:
    type: int
    description: |
      How often to sample the A and B signal lines when tracking the encoder
      movement. Required when polling-mode is set.

  idle-poll-time-us:
    type: int
    description: |
      How often to sample the A and B signal while idling. If unset then the
      driver will use the GPIO interrupt to exit idle state, and any GPIO
      specified in led-gpios will be enabled all the time. If non zero, then
      the driver will poll every idle-poll-time-us microseconds while idle, and
      only activate led-gpios before sampling the encoder state.
      Only used in polling-mode.

  idle-timeout-ms:
    type: int
    description: |
      Timeout for the last detected transition before stopping the sampling
      timer and going back to idle state. Required when polling-mode is set.

  polling-mode:
    type: boolean
    description: |
      Use the original polling-based decoder instead of ISR mode. When set,
      sample-time-us and idle-timeout-ms must also be specified.

examples:
  - |
    #include <zephyr/dt-bindings/input/input-event-codes.h>

    /* ISR mode (default): one interrupt line, immediate direction decode. */
    qdec_isr {
            compatible = "gpio-qdec";
            gpios = <&gpio0 14 (GPIO_PULL_UP | GPIO_ACTIVE_HIGH)>,
                    <&gpio0 13 (GPIO_PULL_UP | GPIO_ACTIVE_HIGH)>;
            steps-per-period = <1>;
            zephyr,axis = <INPUT_REL_WHEEL>;
    };

    /* Polling mode (original behaviour). */
    qdec_poll {
            compatible = "gpio-qdec";
            gpios = <&gpio0 14 (GPIO_PULL_UP | GPIO_ACTIVE_HIGH)>,
                    <&gpio0 13 (GPIO_PULL_UP | GPIO_ACTIVE_HIGH)>;
            steps-per-period = <4>;
            zephyr,axis = <INPUT_REL_WHEEL>;
            polling-mode;
            sample-time-us = <2000>;
            idle-timeout-ms = <200>;
    };
```

## dts/bindings/input/hynitron,cst816s.yaml
```yaml
# Copyright (c) 2021 Qingsong Gou <gouqs@hotmail.com>
# SPDX-License-Identifier: Apache-2.0

description: Hynitron CST816S touchscreen sensor

compatible: "hynitron,cst816s"

include: i2c-device.yaml

properties:
  irq-gpios:
    type: phandle-array
    description: |
      The irq signal defaults to active low as produced by the
      sensor. The property value should ensure the flags properly
      describe the signal that is presented to the driver.

  rst-gpios:
    type: phandle-array
    description: |
      The reset signal defaults to active low to the
      sensor. The property value should ensure the flags properly
      describe the signal that is presented to the driver.

  auto-wake-time:
    type: int
    default: 5
    enum:
      - 1
      - 2
      - 3
      - 4
      - 5
    description:
      Auto-recalibration period during low-power mode in minutes. Range 1–5.
      The default value is specified in the data sheet.

  scan-th:
    type: int
    default: 48
    description:
      Low-power scan wake-up threshold. Smaller = more sensitive. Range 1–255.
      The default value is specified in the data sheet.

  scan-win:
    type: int
    default: 3
    description:
      Measurement range for low-power scan. Larger = more sensitive but higher consumption.
      The datasheet is mentiones values from 0 to 3 as valid options with 3 as default.
      But you can go higher as it is an 8-bit register and higher values than 3 seem to
      work fine. They improve the sensitivity further at the cost of power consumption.

  scan-freq:
    type: int
    default: 7
    description:
      Frequency for low-power scan. Smaller = more sensitive. Range 1–255.
      The default value is specified in the data sheet.

  scan-i-dac:
    type: int
    default: 200
    description:
      Current for low-power scan. Smaller = more sensitive. Range 1–255.
      The default value is not specified in the data sheet. Instead, 200 is
      chosen as a reasonable default based on typical usage.

  auto-sleep-time:
    type: int
    default: 2
    description:
      Time (in seconds) of inactivity after which the controller automatically
      enters standby / low-power mode. The default value is specified in the data sheet.
```

## dts/bindings/input/ilitek,ili2132a.yaml
```yaml
# Copyright (c) 2024 Joel Jaldemark
# SPDX-License-Identifier: Apache-2.0

description: ILI2132A capacitive touch controller

compatible: "ilitek,ili2132a"

include: i2c-device.yaml

properties:
  irq-gpios:
    type: phandle-array
    required: true
    description: |
      Interrupt pin

  rst-gpios:
    type: phandle-array
    required: true
    description: |
      Reset pin
```

## dts/bindings/input/input-keymap.yaml
```yaml
# Copyright 2024 Google LLC
# SPDX-License-Identifier: Apache-2.0

description: |
  Row-column to key mapper

  Listens for row-column events from the parent device and reports key events.

  Example configuration:

  #include <zephyr/dt-bindings/input/input-event-codes.h>
  #include <zephyr/dt-bindings/input/keymap.h>

  kbd {
      ...
      keymap {
          compatible = "input-keymap";
          keymap = <
              MATRIX_KEY(0, 0, INPUT_KEY_1)
              MATRIX_KEY(0, 1, INPUT_KEY_2)
              MATRIX_KEY(0, 2, INPUT_KEY_3)
              MATRIX_KEY(1, 0, INPUT_KEY_4)
              MATRIX_KEY(1, 1, INPUT_KEY_5)
              MATRIX_KEY(1, 2, INPUT_KEY_6)
              MATRIX_KEY(2, 0, INPUT_KEY_7)
              MATRIX_KEY(2, 1, INPUT_KEY_8)
              MATRIX_KEY(2, 2, INPUT_KEY_9)
          >;
          row-size = <3>;
          col-size = <3>;
      };
  };

compatible: "input-keymap"

properties:
  keymap:
    type: array
    required: true
    description: |
      List of codes, using the MATRIX_KEY() macro.

  row-size:
    type: int
    required: true
    description: |
      The number of rows in the keymap.

  col-size:
    type: int
    required: true
    description: |
      The number of columns in the keymap.
```

## dts/bindings/input/ite,it51xxx-kbd.yaml
```yaml
# Copyright (c) 2025 ITE Corporation. All Rights Reserved.
# SPDX-License-Identifier: Apache-2.0

description: ITE it51xxx keyboard matrix controller

compatible: "ite,it51xxx-kbd"

include: [kbd-matrix-common.yaml, pinctrl-device.yaml]

properties:
  reg:
    required: true

  interrupts:
    required: true

  wucctrl:
    type: phandles
    description: |
      Configure wakeup controller, this controller is used to set that
      when the interrupt is triggered in EC low power mode, it can wakeup
      EC or not. Via this controller, we set the wakeup trigger edge,
      enable, disable, and clear wakeup status for the specific pin which
      may be gpio pins or alternate pins.

  kso16-gpios:
    type: phandle-array
    required: true
    description: |
      The KSO16 pin for the selected port.

  kso17-gpios:
    type: phandle-array
    required: true
    description: |
      The KSO17 pin for the selected port.

  kso-ignore-mask:
    type: int
    default: 0
    description: |
      Bitmask of KSO signals to ignore, this can be used to instruct the driver
      to skip KSO signals between 0 and (col-size - 1) that are used as GPIOs.
      Default to 0 (no signals masked).

  pinctrl-0:
    required: true

  pinctrl-names:
    required: true

  row-size:
    required: true

  col-size:
    required: true
```

## dts/bindings/input/ite,it8801-kbd.yaml
```yaml
# Copyright (c) 2024 ITE Corporation. All Rights Reserved.
# SPDX-License-Identifier: Apache-2.0

description: ITE IT8801 I2C-based keyboard matrix scan controller

compatible: "ite,it8801-kbd"

include: [kbd-matrix-common.yaml, pinctrl-device.yaml]

properties:
  reg:
    required: true

  mfdctrl:
    type: phandles
    description: |
      Switching the pin to KSO alternate function.

  kso-mapping:
    type: array

  row-size:
    required: true

  col-size:
    required: true
```
