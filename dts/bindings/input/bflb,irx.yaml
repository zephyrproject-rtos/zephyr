## dts/bindings/input/kbd-matrix-common.yaml
```yaml
# Copyright 2023 Google LLC
# SPDX-License-Identifier: Apache-2.0

description: Keyboard matrix device

include: base.yaml

properties:
  row-size:
    type: int
    description: |
      The number of rows in the keyboard matrix.

  col-size:
    type: int
    description: |
      The number of column in the keyboard matrix.

  poll-period-ms:
    type: int
    default: 5
    description: |
      Defines the poll period in msecs between between matrix scans, set to 0
      to never exit poll mode. Defaults to 5ms if unspecified.

  stable-poll-period-ms:
    type: int
    description: |
      Defines the poll period in msecs between matrix scans when the matrix is
      stable, defaults to poll-period-ms value if unspecified.

  poll-timeout-ms:
    type: int
    default: 100
    description: |
      How long to wait before going from polling back to idle state. Defaults
      to 100ms if unspecified.

  debounce-down-ms:
    type: int
    default: 10
    description: |
      Debouncing time for a key press event. Defaults to 10ms if unspecified.

  debounce-up-ms:
    type: int
    default: 20
    description: |
      Debouncing time for a key release event. Defaults to 20ms if unspecified.

  settle-time-us:
    type: int
    default: 50
    description: |
      Delay between setting column output and reading the row values. Defaults
      to 50us if unspecified.

  actual-key-mask:
    type: array
    description:
      Keyboard scanning mask. For each keyboard column, specify which
      keyboard rows actually exist. Can be used to avoid triggering the ghost
      detection on non existing keys. No masking by default, any combination is
      valid.

  no-ghostkey-check:
    type: boolean
    description: |
        Ignore the ghost key checking in the driver if the diodes are used
        in the matrix hardware.
```

## dts/bindings/input/keyboard-gpio.yaml
```yaml
# Copyright (c) 2022, tangchunhui@coros.com
# SPDX-License-Identifier: Apache-2.0

description: Keyboard GPIO parent node

compatible: "keyboard-gpio"

include: base.yaml

child-binding:
    description: Keyboard GPIO child node
    properties:
       gpios:
          type: phandle-array
          required: true
       label:
          type: string
          description: Descriptive name of the key
       code:
          type: int
          required: true
          description: User-defined key code
       debounce-ms:
          type: int
          required: false
          description: Key debounce delay time in milliseconds
       longpress-ms:
          type: int
          required: false
          description: Key long press delay time in milliseconds
       holdpress-ms:
          type: int
          required: false
          description: Key hold press delay time in milliseconds
```

## dts/bindings/input/microchip,cap1203.yaml
```yaml
# Copyright (c) 2022 Keiya Nobuta
# SPDX-License-Identifier: Apache-2.0

description: CAP1203 3-channel capacitive touch sensor

compatible: "microchip,cap1203"

include: i2c-device.yaml

properties:
  int-gpios:
    type: phandle-array

  input-codes:
    type: array
    required: true
    description: |
      Array of input event key codes (INPUT_KEY_* or INPUT_BTN_*).
```
