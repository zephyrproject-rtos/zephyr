## dts/bindings/input/bflb,irx.yaml
```yaml
# Copyright (c) 2025 MASSDRIVER EI (massdriver.space)
# SPDX-License-Identifier: Apache-2.0

description: |
  Bouffalolab Infrared Receiver Peripheral
  Wire the output of a diode like VS1838B to the specified GPIO pin.

compatible: "bflb,irx"

include:
  - name: base.yaml

properties:
  reg:
    required: true

  ir-gpios:
    required: true
    type: phandle-array
    description: |
      Single GPIO used as input pin, must be first port (gpio0).
      Flags do not apply as it is a special usage.

  protocol:
    required: true
    type: string
    description: |
      What IR protocol is used:
        - NEC: NEC Protocol
        - RC5: RC5 Protocol
        - PW: Pulse width: count the length of each on/off pulse in us.
          PW will easily overflow FIFO on BL60x and BL70x.
          On BL61x, increase CONFIG_INPUT_QUEUE_MAX_MSGS to handle the large amount of data.
    enum:
      - "NEC"
      - "RC5"
      - "PW"

  pw-end-pulse-width:
    type: int
    description: |
      Length of time for a pulse / lack of pulse in microseconds to trigger the end of transmission
      interrupt in pulse width mode.

  invert:
    type: boolean
    description: |
      Invert input. With VS1838B wired directly, you want this enabled.

  deglitch-cnt:
    type: int
    default: 0
    description: |
      Deglitch count, 4-bits value. It is unnecessary most of the time, 0 disables it.
```

## dts/bindings/input/chipsemi,chsc5x.yaml
```yaml
description: CHSC5X touchscreen sensor

compatible: "chipsemi,chsc5x"

include: [i2c-device.yaml, touchscreen-common.yaml]

properties:
  int-gpios:
    type: phandle-array
    required: true
    description: |
      Interrupt GPIO. Used by the controller to signal touch data is available. Active low.

  reset-gpios:
    type: phandle-array
    description: Reset GPIO used to reset the touch controller.
```

## dts/bindings/input/chipsemi,chsc6540.yaml
```yaml
description: CHSC6540 touch controller

compatible: "chipsemi,chsc6540"

include: chipsemi,chsc6x-common.yaml
```

## dts/bindings/input/chipsemi,chsc6x-common.yaml
```yaml
description: CHSC6X touchscreen sensor

include: [i2c-device.yaml, touchscreen-common.yaml]

properties:
  irq-gpios:
    type: phandle-array
    required: true
    description: |
      Interrupt GPIO. Used by the controller to signal touch data is
      available. Active low.
```

## dts/bindings/input/chipsemi,chsc6x.yaml
```yaml
description: CHSC6X touchscreen sensor

compatible: "chipsemi,chsc6x"

include: chipsemi,chsc6x-common.yaml
```

## dts/bindings/input/cirque,pinnacle-common.yaml
```yaml
# Copyright (c) 2024 Ilia Kharin
# SPDX-License-Identifier: Apache-2.0

description: Cirque Pinnacle 1CA027 ASIC trackpad

properties:
  data-ready-gpios:
    type: phandle-array
    description: |
      Data Ready (DR) GPIO pin. The DR pin is connected to Pinnacle HW_DR
      which is active high when SW_DR or SW_CC are asserted. If connected
      directly, the MCU pin should be configured as active low.

  sensitivity:
    type: string
    default: "4x"
    description: |
      ADC attenuation, 1x is the most sensitive and 4x is the least sensitive.
    enum:
      - "1x"
      - "2x"
      - "3x"
      - "4x"

  data-mode:
    type: string
    default: "relative"
    description: |
      Data output mode in which position is reported. In the relative mode
      each position is reported as relative to the last position. In the
      absolute mode absolute coordinates are reported.
    enum:
      - "absolute"
      - "relative"

  idle-packets-count:
    type: int
    default: 0
    description: |
      The number of empty packets where both X and Y are set to 0. They are
      started to be sent when a finger presence is detected missing (no touch
      detected) every 10 ms. They are stopped to be sent when a finger presence
      it detected. An application can count these packets in order to detect
      taps. When set to 0, no empty packets are sent. Supported values from 0
      to 255.

  clipping-enable:
    type: boolean
    description: |
      In the absolute mode enable clipping of reported coordinates which are
      outside of the active range.

  active-range-x-min:
    type: int
    default: 128
    description: |
      The minimum X value which can be reported.

  active-range-x-max:
    type: int
    default: 1920
    description: |
      The maximum X value which can be reported.

  active-range-y-min:
    type: int
    default: 64
    description: |
      The minimum Y value which can be reported.

  active-range-y-max:
    type: int
    default: 1472
    description: |
      The maximum Y value which can be reported.

  scaling-enable:
    type: boolean
    description: |
      In the absolute mode enable scaling of coordinates according to
      the specified resolution for X and Y axises. The scaling is applied only
      when the clipping is enabled.

  scaling-x-resolution:
    type: int
    default: 1024
    description: Resolution for the X axis.

  scaling-y-resolution:
    type: int
    default: 1024
    description: Resolution for the Y axis.

  invert-x:
    type: boolean
    description: |
      In the absolute mode invert X coordinate.

  invert-y:
    type: boolean
    description: |
      In the absolute mode invert Y coordinate.

  primary-tap-enable:
    type: boolean
    description: |
      In the relative mode enable the primary tap.

  swap-xy:
    type: boolean
    description: |
      In the relative mode swap X and Y coordinates. This is equivalent for
      rotating coordinates by 90 degrees.
```

## dts/bindings/input/cirque,pinnacle-i2c.yaml
```yaml
# Copyright (c) 2024 Ilia Kharin
# SPDX-License-Identifier: Apache-2.0

description: Cirque Pinnacle 1CA027 ASIC trackpad connected through I2C

compatible: "cirque,pinnacle"

include: ["i2c-device.yaml", "cirque,pinnacle-common.yaml"]
```

## dts/bindings/input/cirque,pinnacle-spi.yaml
```yaml
# Copyright (c) 2024 Ilia Kharin
# SPDX-License-Identifier: Apache-2.0

description: Cirque Pinnacle 1CA027 ASIC trackpad connected through SPI

compatible: "cirque,pinnacle"

include: ["spi-device.yaml", "cirque,pinnacle-common.yaml"]
```

## dts/bindings/input/cypress,cy8cmbr3xxx.yaml
```yaml
# Copyright (c) 2025 Basalte bv
# SPDX-License-Identifier: Apache-2.0

description: |
  Cypress CY8CMBR3002/3102/3106S/3108/3110/3116 capacitive touch sensor

compatible: "cypress,cy8cmbr3xxx"

include: i2c-device.yaml

properties:
  int-gpios:
    type: phandle-array
    required: true
    description: |
      The interrupt pin generates an active low pulse signal on
      any change in the CapSense sensor's status.

  rst-gpios:
    type: phandle-array
    required: true
    description: |
      The reset pin resets the capsense controller with an active
      low reset pulse.

  input-codes:
    type: array
    required: true
    description: |
      Array of input event key codes (INPUT_KEY_* or INPUT_BTN_*).

  proximity-codes:
    type: array
    description: |
      Array of input event key codes (INPUT_KEY_* or INPUT_BTN_*).
```

## dts/bindings/input/ene,kb106x-kbd.yaml
```yaml
# Copyright (c) 2025 ENE Technology Inc.
# SPDX-License-Identifier: Apache-2.0

description: ENE KB106x keyboard matrix controller

compatible: "ene,kb106x-kbd"

include: [kbd-matrix-common.yaml, pinctrl-device.yaml]

properties:
  gpio-dev:
    type: phandle
    required: true

  row-pins:
    type: array
    required: true
    description: GPIOs for the keyboard rows.

  col-pins:
    type: array
    required: true
    description: GPIOs for the keyboard columns.

  pinctrl-0:
    required: true

  pinctrl-names:
    required: true

  row-size:
    required: true

  col-size:
    required: true
```

## dts/bindings/input/espressif,esp32-touch-sensor.yaml
```yaml
# Copyright (c) 2023 Espressif Systems (Shanghai) Co., Ltd.
# SPDX-License-Identifier: Apache-2.0

description: |
  Zephyr input touch sensor parent node

  This defines a group of touch sensors that can generate input events. Each touch
  sensor is defined in a child node of the touch-sensor node and defines a specific key
  code.

  For example:

  #include <zephyr/dt-bindings/input/input-event-codes.h>
  #include <zephyr/dt-bindings/input/esp32-touch-sensor-input.h>

  &touch {
         compatible = "espressif,esp32-touch";
         status = "okay";

         debounce-interval-ms = <30>;
         href-microvolt = <27000000>;
         lref-microvolt = <500000>;
         href-atten-microvolt = <1000000>;
         filter-mode = <ESP32_TOUCH_FILTER_MODE_IIR_16>;
         filter-debounce-cnt = <1>;
         filter-noise-thr = <ESP32_TOUCH_FILTER_NOISE_THR_4_8TH>;
         filter-jitter-step = <4>;
         filter-smooth-level = <ESP32_TOUCH_FILTER_SMOOTH_MODE_IIR_2>;

         touch_sensor_0 {
                 channel-num = <1>;
                 channel-sens = <20>;
                 zephyr,code = <INPUT_KEY_0>;
         };
  };


compatible: "espressif,esp32-touch"

include: base.yaml

properties:
  debounce-interval-ms:
    type: int
    default: 30
    description: Debouncing interval time in milliseconds.

  href-microvolt:
    type: int
    enum:
      - 2400000
      - 2500000
      - 2500000
      - 2700000
    default: 2700000
    description: Touch sensor high reference voltage.

  lref-microvolt:
    type: int
    enum:
      - 500000
      - 600000
      - 700000
      - 800000
    default: 500000
    description: Touch sensor low reference voltage.

  href-atten-microvolt:
    type: int
    enum:
      - 1500000
      - 1000000
      - 500000
      - 0
    default: 1000000
    description: Touch sensor high reference attenuation voltage.

  filter-mode:
    type: int
    default: 2
    description: |
       Touch sensor IIR filter coefficient.
       If not specified defaults to ESP32_TOUCH_FILTER_MODE_IIR_16.

  filter-debounce-cnt:
    type: int
    default: 1
    description: |
       Touch sensor debounce count.
       If not specified defaults to 1.

  filter-noise-thr:
    type: int
    default: 0
    description: |
       Touch sensor noise threshold coefficient.
       If not specified defaults to ESP32_TOUCH_FILTER_NOISE_THR_4_8TH.

  filter-jitter-step:
    type: int
    default: 4
    description: |
       Touch sensor jitter filter step size.
       If not specified defaults to 4.

  filter-smooth-level:
    type: int
    default: 1
    description: |
       Touch sensor level of filter applied on the original data against large noise interference.
       If not specified defaults to ESP32_TOUCH_FILTER_SMOOTH_MODE_IIR_2.

child-binding:
  description: Touch sensor child node
  properties:
    channel-num:
      type: int
      required: true
      description: Touch sensor channel number

    channel-sens:
      type: int
      default: 20
      description: |
         Touch sensor channel sensibility in 100th.
         If not specified defaults to 20.

    zephyr,code:
      type: int
      required: true
      description: Key code to emit.
```

## dts/bindings/input/focaltech,ft5336.yaml
```yaml
# Copyright (c) 2020,2023 NXP
# SPDX-License-Identifier: Apache-2.0

description: FT3267/FT5XX6/FT6XX6 capacitive touch panels

compatible: "focaltech,ft5336"

include: i2c-device.yaml

properties:
  int-gpios:
    type: phandle-array
    description: |
      Interrupt GPIO. Used by the controller to signal touch data is
      available. Active low.
  reset-gpios:
    type: phandle-array
    description: |
      Reset GPIO. Used to reset the controller during initialization, and
      to wake it from hibernation mode. Active low.
```

## dts/bindings/input/focaltech,ft6146.yaml
```yaml
# Copyright (c) 2025 Qingsong Gou <gouqs@hotmail.com>
# SPDX-License-Identifier: Apache-2.0

description: FocalTech FT6146 capacitive touch controller

compatible: "focaltech,ft6146"

include: [i2c-device.yaml, touchscreen-common.yaml]

properties:
  int-gpios:
    type: phandle-array
    description: Interrupt GPIO specification, active low

  reset-gpios:
    type: phandle-array
    description: Reset GPIO specification, active low
```

## dts/bindings/input/futaba,sbus.yaml
```yaml
# Copyright (c) 2024 NXP Semiconductors
# SPDX-License-Identifier: Apache-2.0

title: Futaba SBUS

description: |
  SBUS is a single-wire inverted serial protocol that can be used to receive
  analog joystick and switch inputs from RC transmitters. Since the signal is
  inverted, you need to use an external signal inverter or set the rx-invert
  flag on the serial controller node (if it supports pin inversion).

  The binding allows mapping of up to 16 SBUS channels to Zephyr input events.
  Each channel can be configured to generate either absolute position events
  (for joysticks) or key events (for switches).

  The following example shows how to configure 2 joysticks and a button using 5 channels:

  &lpuart6 {
    status = "okay";

    sbus {
        compatible = "futaba,sbus";
        right_stick_x {
            channel = <1>;
            type = <INPUT_EV_ABS>;
            zephyr,code = <INPUT_ABS_RX>;
        };
        right_stick_y {
            channel = <2>;
            type = <INPUT_EV_ABS>;
            zephyr,code = <INPUT_ABS_RY>;
        };
        left_stick_x {
            channel = <3>;
            type = <INPUT_EV_ABS>;
            zephyr,code = <INPUT_ABS_X>;
        };
        left_stick_y {
            channel = <4>;
            type = <INPUT_EV_ABS>;
            zephyr,code = <INPUT_ABS_Y>;
        };
        kill_switch {
            channel = <5>;
            type = <INPUT_EV_KEY>;
            zephyr,code = <INPUT_KEY_0>;
        };
    };
  };

compatible: "futaba,sbus"

include: [base.yaml, uart-device.yaml]

child-binding:
  description: |
    SBUS Channel to input-event-code binding
    INPUT_EV_ABS & INPUT_EV_MSC gives raw input value
    INPUT_EV_KEY emulates a key
  properties:
    channel:
      type: int
      required: true
      description: |
        SBUS input channel
        Valid range: 1 - 16
    type:
      type: int
      required: true
      description: Input event types see INPUT_EV_CODES
    zephyr,code:
      type: int
      required: true
      description: Code to emit.
```
