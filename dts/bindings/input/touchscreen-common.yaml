## dts/bindings/input/touchscreen-common.yaml
```yaml
# Copyright (c) 2024 Antmicro <www.antmicro.com>
# SPDX-License-Identifier: Apache-2.0

# Common fields for touch controllers

include: base.yaml

properties:
  screen-width:
    type: int
    default: 0
    description: |
      Horizontal resolution of touchscreen (maximum x coordinate reported + 1). The default
      corresponds to a valid value for non-inverted axis, required for a display with an inverted x
      axis.

  screen-height:
    type: int
    default: 0
    description: |
      Vertical resolution of touchscreen (maximum y coordinate reported + 1). The default
      corresponds to a valid value for non-inverted axis, required for a display with an inverted y
      axis.

  inverted-x:
    type: boolean
    description: X axis is inverted.

  inverted-y:
    type: boolean
    description: Y axis is inverted.

  swapped-x-y:
    type: boolean
    description: X and Y axis are swapped. Swapping is done after inverting the axis.

  display:
    type: phandle
    description: |
      Optional handle to the display controller this touchscreen feeds. When set, output-width /
      output-height are taken from the referenced node's width / height instead of the properties
      below, so the panel resolution is not duplicated. Falls back to output-width / output-height
      when this is not set.

  output-width:
    type: int
    description: |
      Horizontal resolution of the display the touchscreen is bonded to. The two pairs name two
      different spaces: screen-width / screen-height describe what the touch controller reports,
      output-width / output-height describe the panel those reports should land on. When this
      and output-height are both set, reported coordinates are scaled from the former into
      the latter. Omitting them disables scaling, so coordinates are reported exactly as the
      controller produced them. Ignored when display is set, which supplies these
      dimensions instead.

      Scaling is applied after inverting and swapping, and is what makes swapped-x-y usable on a
      rotated panel whose two dimensions differ: the swapped axes carry each other's range, which
      a bare swap would leave mismatched against the display.

  output-height:
    type: int
    description: |
      Vertical resolution of the display the touchscreen is bonded to. See output-width.
```

## dts/bindings/input/virtio,input.yaml
```yaml
# Copyright (c) 2026 Carlo Caione <ccaione@baylibre.com>
# SPDX-License-Identifier: Apache-2.0

description: VIRTIO Input device

compatible: "virtio,input"

include: base.yaml

properties:
  display:
    type: phandle
    description: |
      Display used to scale absolute axes. When set, ABS_X and ABS_Y
      coordinates are scaled from the range advertised by the device to
      the display resolution, as expected by consumers operating in
      screen coordinates.
```

## dts/bindings/input/vishay,vs1838b.yaml
```yaml
# Copyright (c) 2025 Bastien Jauny <bastien.jauny@smile.fr>
# SPDX-License-Identifier: Apache-2.0

description: Vishay VS1838B infrared receiver

compatible: "vishay,vs1838b"

properties:
  data-gpios:
    required: true
    type: phandle-array
    description: |
      GPIO used to transmit the received data.
```

## dts/bindings/input/wch,ch9350l.yaml
```yaml
# Copyright (c) 2026 MASSDRIVER EI (massdriver.space)
# SPDX-License-Identifier: Apache-2.0

description: |
  WinChipHead CH9350L USB HID to UART control chip.
  This supports State 0.


  &uart0 {
    status = "okay";

      usb_kb {
        compatible = "wch,ch9350l";
        status = "okay";

        kb-codemap = <
          4 INPUT_KEY_Q
          5 INPUT_KEY_B
          6 INPUT_KEY_C
        >;
        mouse-codemap = <
          1 INPUT_BTN_LEFT
          2 INPUT_BTN_RIGHT
          4 INPUT_BTN_MIDDLE
        >;
      };
  };

compatible: "wch,ch9350l"

include: [base.yaml, uart-device.yaml]

properties:
  kb-codemap:
    type: array
    description: |
      Maps a keyboard key code to a input code by pair of 2 when needed.

  mouse-codemap:
    type: array
    description: |
      Maps a mouse button code to a input code by pair of 2 when needed.
```

## dts/bindings/input/xptek,xpt2046.yaml
```yaml
# Copyright (c) 2023 Seppo Takalo
# SPDX-License-Identifier: Apache-2.0

description: Driver for XPT2046 touch IC
compatible: "xptek,xpt2046"

include: spi-device.yaml

properties:
  int-gpios:
    type: phandle-array
    required: true
    description: Interrupt GPIO.

  touchscreen-size-x:
    type: int
    required: true
    description: horizontal resolution of screen

  touchscreen-size-y:
    type: int
    required: true
    description: vertical resolution of screen

  min-x:
    type: int
    required: true
    description: minimum raw X value reported.

  min-y:
    type: int
    required: true
    description: minimum raw Y value reported.

  max-x:
    type: int
    required: true
    description: maximum raw X value reported.

  max-y:
    type: int
    required: true
    description: maximum raw Y value reported.

  z-threshold:
    type: int
    description: Z value threshold to trigger a touch
    default: 100

  reads:
    type: int
    description: How many reads per touch to average the value
    default: 1
```

## dts/bindings/input/zephyr,gpio-keys.yaml
```yaml
# Copyright (c) 2022 Google LLC
# SPDX-License-Identifier: Apache-2.0

compatible: "zephyr,gpio-keys"

include: [gpio-keys.yaml]
```

## dts/bindings/input/zephyr,input-abs-to-rel.yaml
```yaml
description: Input absolute to relative

compatible: "zephyr,input-abs-to-rel"

properties:
  input:
    type: phandle
    required: true
```

## dts/bindings/input/zephyr,input-longpress.yaml
```yaml
# Copyright 2023 Google LLC
# SPDX-License-Identifier: Apache-2.0

description: |
  Input longpress pseudo-device

  Listens for key events as an input and produces key events as output
  corresponding to short and long press.

  Can be optionally be associated to a specific device to listen for events
  only from that device. Example configuration:

  #include <zephyr/dt-bindings/input/input-event-codes.h>

  longpress {
          input = <&buttons>;
          compatible = "zephyr,input-longpress";
          input-codes = <INPUT_KEY_0>, <INPUT_KEY_1>;
          short-codes = <INPUT_KEY_A>, <INPUT_KEY_B>;
          long-codes = <INPUT_KEY_X>, <INPUT_KEY_Y>;
          long-delay-ms = <1000>;
  };

  Example output:

  input event: dev=buttons          SYN type= 1 code= 11 value=1 # INPUT_KEY_0 press
  # release before one second
  input event: dev=buttons          SYN type= 1 code= 11 value=0 # INPUT_KEY_0 release
  input event: dev=longpress        SYN type= 1 code= 30 value=1 # INPUT_KEY_A press
  input event: dev=longpress        SYN type= 1 code= 30 value=0 # INPUT_KEY_A release

  input event: dev=buttons          SYN type= 1 code= 11 value=1 # INPUT_KEY_0 press
  # hold for more than one second
  input event: dev=longpress        SYN type= 1 code= 45 value=1 # INPUT_KEY_X press
  # wait for release
  input event: dev=buttons          SYN type= 1 code= 11 value=0 # INPUT_KEY_0 release
  input event: dev=longpress        SYN type= 1 code= 45 value=0 # INPUT_KEY_X release

compatible: "zephyr,input-longpress"

properties:
  input:
    type: phandle
    description: |
      Input device phandle, if not specified listen for input from all devices.

  input-codes:
    type: array
    required: true
    description: |
      Array of input event key codes (INPUT_KEY_* or INPUT_BTN_*).

  short-codes:
    type: array
    required: true
    description: |
      Array of key codes to be generated for short press (INPUT_KEY_* or
      INPUT_BTN_*).

  long-codes:
    type: array
    required: true
    description: |
      Array of key codes to be generated for long press (INPUT_KEY_* or
      INPUT_BTN_*).

  long-delay-ms:
    type: int
    required: true
    description: Time delay to register a long press in milliseconds.
```

## dts/bindings/input/zephyr,input-sdl-touch.yaml
```yaml
# Copyright (c) 2022 Kumar Gala <galak@kernel.org>
# SPDX-License-Identifier: Apache-2.0

description: SDL based emulated touch panel

compatible: "zephyr,input-sdl-touch"

properties:
  display:
    type: phandle
    description: Handle to the display that the input events are raised for
```

## dts/bindings/input/zephyr,lvgl-button-input.yaml
```yaml
# Copyright 2023 Fabian Blatz <fabianblatz@gmail.com>
# SPDX-License-Identifier: Apache-2.0

description: |
  LVGL button indev pseudo-device

  Listens for button input events and routes the
  lv_indev_data_t to the underlying button lv_indev_t managed by LVGL.

  Example configuration:

  pointer {
          compatible = "zephyr,lvgl-button-input";
          input = <&buttons>;
          input-codes = <INPUT_KEY_0 INPUT_KEY_1>;
          coordinates = <120 220>, <150 250>;
  };

  When the device receives an input_event with code INPUT_KEY_0
  a click event will be performed at (120,220).

compatible: "zephyr,lvgl-button-input"

include: zephyr,lvgl-common-input.yaml

properties:
  input-codes:
    type: array
    required: true
    description: |
      Array of input event key codes (INPUT_KEY_* or INPUT_BTN_*).

  coordinates:
    type: array
    description: |
      Array of points (x,y) the associated input-code is mapped to.
```

## dts/bindings/input/zephyr,lvgl-common-input.yaml
```yaml
# Copyright 2023 Fabian Blatz <fabianblatz@gmail.com>
# Copyright 2025 Abderrahmane JARMOUNI
# SPDX-License-Identifier: Apache-2.0

# Common fields for input lvgl pseudo devices

properties:
  input:
    type: phandle
    description: |
      Input device phandle.
  display:
    type: phandle
    description: |
      Phandle of the display device to pass input commands to.
      Used in multi-display setup.
```

## dts/bindings/input/zephyr,lvgl-encoder-input.yaml
```yaml
# Copyright 2023 Fabian Blatz <fabianblatz@gmail.com>
# SPDX-License-Identifier: Apache-2.0

description: |
  LVGL encoder indev pseudo-device

  Listens for button/encoder input events and routes the
  lv_indev_data_t to the underlying encoder lv_indev_t managed by LVGL.

  Example configuration:

  encoder {
          compatible = "zephyr,lvgl-encoder-input";
          rotation-input-code = <INPUT_REL_Y>;
          button-input-code = <INPUT_KEY_0>;
  };

compatible: "zephyr,lvgl-encoder-input"

include: zephyr,lvgl-common-input.yaml

properties:
  rotation-input-code:
    type: int
    required: true
    description: |
      Input event code associated with rotation (INPUT_REL_*).

  button-input-code:
    type: int
    description: |
      Input event key code for encoder button (INPUT_KEY_* or INPUT_BTN_*).
```

## dts/bindings/input/zephyr,lvgl-keypad-input.yaml
```yaml
# Copyright 2023 Fabian Blatz <fabianblatz@gmail.com>
# SPDX-License-Identifier: Apache-2.0

description: |
  LVGL keypad indev pseudo-device

  Listens for input events and routes the
  lv_indev_data_t to the underlying keypad lv_indev_t managed by LVGL.

  The property input-codes can be used to setup a mapping of input codes
  to the lvgl keys. There are lvgl keys that have a special function:
  https://docs.lvgl.io/master/overview/indev.html#keys.

  The pseudo device can be associated to a specific device to listen only
  for events from that device. Example configuration:

  #include <zephyr/dt-bindings/lvgl/lvgl.h>

  keypad {
          compatible = "zephyr,lvgl-keypad-input";
          input = <&buttons>;
          input-codes = <INPUT_KEY_1 INPUT_KEY_2>;
          lvgl-codes = <LV_KEY_NEXT LV_KEY_PREV>;
  };

compatible: "zephyr,lvgl-keypad-input"

include: zephyr,lvgl-common-input.yaml

properties:
  input-codes:
    type: array
    required: true
    description: |
      Array of input event key codes (INPUT_KEY_* or INPUT_BTN_*).

  lvgl-codes:
    type: array
    required: true
    description: |
      Array of mapped lvgl keys.
```

## dts/bindings/input/zephyr,lvgl-pointer-input.yaml
```yaml
# Copyright 2023 Fabian Blatz <fabianblatz@gmail.com>
# SPDX-License-Identifier: Apache-2.0

description: |
  LVGL pointer indev pseudo-device

  Listens for touch input events and routes the
  lv_indev_data_t to the underlying pointer lv_indev_t managed by LVGL.

  Needs to be associated to a specific device to listen for events
  from that device.

compatible: "zephyr,lvgl-pointer-input"

include: zephyr,lvgl-common-input.yaml

properties:
  swap-xy:
    type: boolean
    deprecated: true
    description: |
      Swap x-y axes to align input with the display.
      Deprecated: Use the swap-xy property of the underlying input device instead.

  invert-x:
    type: boolean
    deprecated: true
    description: |
      Invert x axes to align input with the display.
      Deprecated: Use the invert-x property of the underlying input device instead.

  invert-y:
    type: boolean
    deprecated: true
    description: |
      Invert y axes to align input with the display.
      Deprecated: Use the invert-y property of the underlying input device instead.

examples:
  - |
    pointer {
            compatible = "zephyr,lvgl-pointer-input";
            input = <&input_sdl_touch>;
    };
```

## dts/bindings/input/zephyr,native-linux-evdev.yaml
```yaml
# Copyright 2023 Google LLC
# SPDX-License-Identifier: Apache-2.0

description: |
  Linux evdev based input device

  Allows using a Linux evdev device to read input events and report them back
  as Zephyr input events.

  Example configuration:

  evdev {
          compatible = "zephyr,native-linux-evdev";
  };

  Then run the binary specifying the evdev device with the --evdev flag, for
  example:

  ./build/zephyr/zephyr.exe --evdev=/dev/input/event0

compatible: "zephyr,native-linux-evdev"

include: base.yaml
```

## dts/bindings/interrupt-controller/adi,max32-rv32-intc.yaml
```yaml
description: MAX32 RV32 Core Interrupt Controller

compatible: "adi,max32-rv32-intc"

include: [base.yaml, interrupt-controller.yaml]

properties:
  reg:
    required: true

  "#interrupt-cells":
    const: 2

interrupt-cells:
  - irq
  - priority
```

## dts/bindings/interrupt-controller/amd,acp-intc.yaml
```yaml
# SPDX-FileCopyrightText: Copyright The Zephyr Project Contributors
# Copyright (c) 2026 AMD
# SPDX-License-Identifier: Apache-2.0

description: AMD ACP interrupt controller

compatible: "amd,acp-intc"

include: [interrupt-controller.yaml, base.yaml]

interrupt-cells:
  - irq
```

## dts/bindings/interrupt-controller/andestech,nceplic100.yaml
```yaml
#
# Copyright (c) 2024 Meta Platforms
#
# SPDX-License-Identifier: Apache-2.0
#

description: Andes Platform-Level Interrupt Controller (NCEPLIC100)

compatible: "andestech,nceplic100"

include: sifive,plic-1.0.0.yaml
```

## dts/bindings/interrupt-controller/arm,gic-v1.yaml
```yaml
# SPDX-License-Identifier: Apache-2.0

description: ARM Generic Interrupt Controller v1

compatible: arm,gic-v1

include: arm,gic.yaml
```

## dts/bindings/interrupt-controller/arm,gic-v2.yaml
```yaml
# SPDX-License-Identifier: Apache-2.0

description: ARM Generic Interrupt Controller v2

compatible: arm,gic-v2

include: arm,gic.yaml
```
