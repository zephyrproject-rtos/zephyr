## dts/bindings/cpu/renesas,rxv3.yaml
```yaml
# Copyright (c) 2025 Renesas Electronics Corporation
# SPDX-License-Identifier: Apache-2.0

description: Renesas RXv3 CPU

compatible: "renesas,rxv3"

include: renesas,rx.yaml
```

## dts/bindings/cpu/riscv,cpus.yaml
```yaml
# Copyright (c) 2021 Gerson Fernando Budke <nandojve@gmail.com>
# SPDX-License-Identifier: Apache-2.0

description: RISC-V CPU

compatible: "riscv"

include: cpu.yaml

properties:
  mmu-type:
    description: Memory Management Unit (MMU)
    type: string
    enum:
      - riscv,sv32
      - riscv,sv39
      - riscv,sv48
      - riscv,none

  riscv,isa:
    description: RISC-V instruction set architecture
    type: string
    deprecated: true

  riscv,isa-base:
    description: The base ISA implemented by the hart.
    type: string
    required: true
    enum:
      - rv32i
      - rv32e
      - rv64i
      - rv128i

  riscv,isa-extensions:
    description: |
      Extensions supported by the hart. Take a look at
      https://www.kernel.org/doc/Documentation/devicetree/bindings/riscv/extensions.yaml
      and https://gcc.gnu.org/onlinedocs/gcc/RISC-V-Options.html
      for a list of possible extensions. Not all options listed there are
      necessarily supported by Zephyr.
    type: string-array
    required: true
```

## dts/bindings/cpu/riscv,it8xxx2.yaml
```yaml
# Copyright (c) 2020 ITE Corporation. All Rights Reserved.
# SPDX-License-Identifier: Apache-2.0

description: ITE IT8XXX2 RISC-V CPU

compatible: "riscv-ite"

include: cpu.yaml
```

## dts/bindings/cpu/riscv-common.yaml
```yaml
# Copyright (c) 2021 Gerson Fernando Budke <nandojve@gmail.com>
# SPDX-License-Identifier: Apache-2.0

# Common include file for RISC-V CPUs.

include: cpu.yaml

properties:
  mmu-type:
    description: Memory Management Unit (MMU)
    type: string
    enum:
      - riscv,sv32
      - riscv,sv39
      - riscv,sv48
      - riscv,none

  riscv,isa:
    description: RISC-V instruction set architecture
    type: string
    deprecated: true

  riscv,isa-base:
    description: The base ISA implemented by the hart.
    type: string
    required: true
    enum:
      - rv32i
      - rv32e
      - rv64i
      - rv128i

  riscv,isa-extensions:
    description: |
      Extensions supported by the hart. Take a look at
      https://www.kernel.org/doc/Documentation/devicetree/bindings/riscv/extensions.yaml
      and https://gcc.gnu.org/onlinedocs/gcc/RISC-V-Options.html
      for a list of possible extensions. Not all options listed there are
      necessarily supported by Zephyr.
    type: string-array
    required: true

  riscv,privilege-modes:
    description: |
      Privilege modes supported by the hart. Each element is one of "m"
      (Machine), "s" (Supervisor), or "u" (User). Used to prevent enabling
      CONFIG_RISCV_S_MODE on harts that do not implement Supervisor mode.
    type: string-array
    default: ["m"]

  riscv,isa-omissions:
    description: |
      Elements of the base ISA expected but not supported by the hart. Currently, the
      only value respected by Zephyr is "fence", to disable use of builtin barrier
      operations.
    type: string-array
```

## dts/bindings/cpu/riscv.yaml
```yaml
# Copyright (c) Qualcomm Technologies, Inc. and/or its subsidiaries.
# SPDX-License-Identifier: Apache-2.0

description: Generic RISC-V CPU

compatible: "riscv"

include: riscv-common.yaml
```

## dts/bindings/cpu/sample_controller.yaml
```yaml
# Copyright (c) 2018 Nordic Semiconductor ASA
# SPDX-License-Identifier: Apache-2.0

description: Sample controller CPU

compatible: "sample_controller"

include: cpu.yaml
```

## dts/bindings/cpu/sensry,ganymed-sy1xx.yaml
```yaml
# Copyright (c) 2024 sensry.io
# SPDX-License-Identifier: Apache-2.0

include: riscv,cpus.yaml

description: Sensry Ganymed SY1xx Core CPU

compatible: "sensry,sy1xx"
```

## dts/bindings/cpu/sifive,e31.yaml
```yaml
# Copyright (c) 2022 Shawn Nematbakhsh <shawn@rivosinc.com>
# SPDX-License-Identifier: Apache-2.0

description: SiFive E31 Standard Core CPU

compatible: "sifive,e31"

include: sifive-common.yaml
```

## dts/bindings/cpu/sifive,e51.yaml
```yaml
# Copyright (c) 2022 Shawn Nematbakhsh <shawn@rivosinc.com>
# SPDX-License-Identifier: Apache-2.0

description: SiFive E51 Standard Core CPU

compatible: "sifive,e51"

include: sifive-common.yaml
```

## dts/bindings/cpu/sifive,s7.yaml
```yaml
# Copyright (c) 2022 Shawn Nematbakhsh <shawn@rivosinc.com>
# SPDX-License-Identifier: Apache-2.0

description: SiFive S7 Standard Core CPU

compatible: "sifive,s7"

include: sifive-common.yaml
```

## dts/bindings/cpu/sifive,u54.yaml
```yaml
# Copyright (c) 2024 Antmicro <www.antmicro.com>
#
# SPDX-License-Identifier: Apache-2.0

description: SiFive U54 Standard Core CPU

compatible: "sifive,u54"

include: sifive-common.yaml
```

## dts/bindings/cpu/sifive-common.yaml
```yaml
# Copyright (c) 2021 Gerson Fernando Budke <nandojve@gmail.com>
# SPDX-License-Identifier: Apache-2.0

# Common fields for SiFive RISC-V CPUs

include: riscv,cpus.yaml

properties:
  hardware-exec-breakpoint-count:
    type: int
    description: Number of hardware break points
```

## dts/bindings/cpu/snps,arcem.yaml
```yaml
# Copyright (c) 2018 Nordic Semiconductor ASA
# SPDX-License-Identifier: Apache-2.0

description: Synopsys ARC EM CPU

compatible: "snps,arcem"

include: cpu.yaml
```

## dts/bindings/cpu/snps,av5rhx.yaml
```yaml
# Copyright (c) 2024 Synopsys, Inc.
# SPDX-License-Identifier: Apache-2.0

description: Synopsys ARC-V RHX RISC-V CPU

compatible: "snps,av5rhx"

include: riscv,cpus.yaml
```

## dts/bindings/cpu/snps,av5rmx.yaml
```yaml
# Copyright (c) 2024 Synopsys, Inc.
# SPDX-License-Identifier: Apache-2.0

description: Synopsys ARC-V RMX RISC-V CPU

compatible: "snps,av5rmx"

include: riscv,cpus.yaml
```

## dts/bindings/cpu/spinalhdl,vexiiriscv.yaml
```yaml
# SPDX-FileCopyrightText: Copyright The Zephyr Project Contributors
# SPDX-License-Identifier: Apache-2.0

description: VexiiRiscv RISC-V CPU

compatible: "spinalhdl,vexiiriscv"

include: riscv-common.yaml
```

## dts/bindings/cpu/spinalhdl,vexriscv.yaml
```yaml
# SPDX-FileCopyrightText: Copyright The Zephyr Project Contributors
# SPDX-License-Identifier: Apache-2.0

description: VexRiscv core

compatible: "spinalhdl,vexriscv"

include: riscv,cpus.yaml
```

## dts/bindings/cpu/telink,b91.yaml
```yaml
# Copyright (c) 2021 Telink Semiconductor
# SPDX-License-Identifier: Apache-2.0

description: Telink RISC-V CPU

compatible: "telink,b91"

include: riscv,cpus.yaml
```

## dts/bindings/cpu/telink,b9x.yaml
```yaml
# Copyright (c) 2021-2024 Telink Semiconductor
# SPDX-License-Identifier: Apache-2.0

description: Telink RISC-V CPU

compatible: "telink,b9x"

include: riscv,cpus.yaml
```

## dts/bindings/cpu/telink,tlx.yaml
```yaml
# Copyright (c) 2024 Telink Semiconductor
# SPDX-License-Identifier: Apache-2.0

description: Telink RISC-V CPU

compatible: "telink,tlx"

include: riscv,cpus.yaml
```

## dts/bindings/cpu/telink,w91.yaml
```yaml
# Copyright (c) 2023 Telink Semiconductor
# SPDX-License-Identifier: Apache-2.0

description: Telink RISC-V CPU

compatible: "telink,w91"

include: riscv,cpus.yaml
```

## dts/bindings/cpu/thead,c906.yaml
```yaml
# Copyright (c) 2023-2024 Chen Xingyu <hi@xingrz.me>
# SPDX-License-Identifier: Apache-2.0

description: T-Head C906 RISC-V CPU

compatible: "thead,c906"

include: riscv,cpus.yaml
```

## dts/bindings/cpu/thead,c908.yaml
```yaml
# Copyright (c) 2024 Junhui Liu <liujh2818@outlook.com>
# SPDX-License-Identifier: Apache-2.0

description: T-Head C908 RISC-V CPU

compatible: "thead,c908"

include: riscv,cpus.yaml
```

## dts/bindings/cpu/wch,qingke-v2.yaml
```yaml
# Copyright (c) 2024 Dhiru Kholia <dhiru.kholia@gmail.com>
# SPDX-License-Identifier: Apache-2.0

description: WCH QingKe V2 RISC-V MCU

compatible: "wch,qingke-v2"

include: cpu.yaml
```

## dts/bindings/cpu/wch,qingke-v3.yaml
```yaml
# Copyright (c) 2023-2024 Chen Xingyu <hi@xingrz.me>
# SPDX-License-Identifier: Apache-2.0

description: WCH QingKe V3 RISC-V CPU

compatible: "wch,qingke-v3"

include: cpu.yaml
```
