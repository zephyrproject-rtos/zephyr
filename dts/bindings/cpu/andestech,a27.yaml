## dts/bindings/cpu/andestech,a27.yaml
```yaml
# Copyright (c) 2026 Andes Technology Corporation
# SPDX-License-Identifier: Apache-2.0

description: Andes Technology AndesCore A27 RISC-V core

compatible: "andestech,a27"

include: riscv-common.yaml
```

## dts/bindings/cpu/andestech,a45.yaml
```yaml
# Copyright (c) 2026 Andes Technology Corporation
# SPDX-License-Identifier: Apache-2.0

description: Andes Technology AndesCore A45 RISC-V core

compatible: "andestech,a45"

include: riscv-common.yaml
```

## dts/bindings/cpu/andestech,a46.yaml
```yaml
# Copyright (c) 2026 Andes Technology Corporation
# SPDX-License-Identifier: Apache-2.0

description: Andes Technology AndesCore A46 RISC-V core

compatible: "andestech,a46"

include: riscv-common.yaml
```

## dts/bindings/cpu/andestech,ax25.yaml
```yaml
# Copyright (c) 2026 Andes Technology Corporation
# SPDX-License-Identifier: Apache-2.0

description: Andes Technology AndesCore AX25 RISC-V core

compatible: "andestech,ax25"

include: riscv-common.yaml
```

## dts/bindings/cpu/andestech,ax27.yaml
```yaml
# Copyright (c) 2026 Andes Technology Corporation
# SPDX-License-Identifier: Apache-2.0

description: Andes Technology AndesCore AX27 RISC-V core

compatible: "andestech,ax27"

include: riscv-common.yaml
```

## dts/bindings/cpu/andestech,ax45.yaml
```yaml
# Copyright (c) 2026 Andes Technology Corporation
# SPDX-License-Identifier: Apache-2.0

description: Andes Technology AndesCore AX45 RISC-V core

compatible: "andestech,ax45"

include: riscv-common.yaml
```

## dts/bindings/cpu/andestech,ax46.yaml
```yaml
# Copyright (c) 2026 Andes Technology Corporation
# SPDX-License-Identifier: Apache-2.0

description: Andes Technology AndesCore AX46 RISC-V core

compatible: "andestech,ax46"

include: riscv-common.yaml
```

## dts/bindings/cpu/andestech,ax65.yaml
```yaml
# Copyright (c) 2026 Andes Technology Corporation
# SPDX-License-Identifier: Apache-2.0

description: Andes Technology AndesCore AX65 RISC-V core

compatible: "andestech,ax65"

include: riscv-common.yaml
```

## dts/bindings/cpu/andestech,d23.yaml
```yaml
# Copyright (c) 2026 Andes Technology Corporation
# SPDX-License-Identifier: Apache-2.0

description: Andes Technology AndesCore D23 RISC-V core

compatible: "andestech,d23"

include: riscv-common.yaml
```

## dts/bindings/cpu/andestech,d25f.yaml
```yaml
# Copyright (c) 2026 Andes Technology Corporation
# SPDX-License-Identifier: Apache-2.0

description: Andes Technology AndesCore D25F RISC-V core

compatible: "andestech,d25f"

include: riscv-common.yaml
```

## dts/bindings/cpu/andestech,d45.yaml
```yaml
# Copyright (c) 2026 Andes Technology Corporation
# SPDX-License-Identifier: Apache-2.0

description: Andes Technology AndesCore D45 RISC-V core

compatible: "andestech,d45"

include: riscv-common.yaml
```

## dts/bindings/cpu/andestech,n22.yaml
```yaml
# Copyright (c) 2026 Andes Technology Corporation
# SPDX-License-Identifier: Apache-2.0

description: Andes Technology AndesCore N22 RISC-V core

compatible: "andestech,n22"

include: riscv-common.yaml
```

## dts/bindings/cpu/andestech,n225.yaml
```yaml
# Copyright (c) 2026 Andes Technology Corporation
# SPDX-License-Identifier: Apache-2.0

description: Andes Technology AndesCore N225 RISC-V core

compatible: "andestech,n225"

include: riscv-common.yaml
```

## dts/bindings/cpu/andestech,n25f.yaml
```yaml
# Copyright (c) 2026 Andes Technology Corporation
# SPDX-License-Identifier: Apache-2.0

description: Andes Technology AndesCore N25F RISC-V core

compatible: "andestech,n25f"

include: riscv-common.yaml
```

## dts/bindings/cpu/andestech,n45.yaml
```yaml
# Copyright (c) 2026 Andes Technology Corporation
# SPDX-License-Identifier: Apache-2.0

description: Andes Technology AndesCore N45 RISC-V core

compatible: "andestech,n45"

include: riscv-common.yaml
```

## dts/bindings/cpu/andestech,nx25f.yaml
```yaml
# Copyright (c) 2026 Andes Technology Corporation
# SPDX-License-Identifier: Apache-2.0

description: Andes Technology AndesCore NX25F RISC-V core

compatible: "andestech,nx25f"

include: riscv-common.yaml
```

## dts/bindings/cpu/andestech,nx45.yaml
```yaml
# Copyright (c) 2026 Andes Technology Corporation
# SPDX-License-Identifier: Apache-2.0

description: Andes Technology AndesCore NX45 RISC-V core

compatible: "andestech,nx45"

include: riscv-common.yaml
```

## dts/bindings/cpu/arm,arm926ej-s.yaml
```yaml
# Copyright (c) 2026 Takayuki Goto
# SPDX-License-Identifier: Apache-2.0

description: ARM926EJ-S CPU

compatible: "arm,arm926ej-s"

include: cpu.yaml
```

## dts/bindings/cpu/arm,cortex-a520.yaml
```yaml
# Copyright The Zephyr Project Contributors
# SPDX-License-Identifier: Apache-2.0

description: Arm Cortex-A520 CPU

compatible: "arm,cortex-a520"

include: cpu.yaml
```

## dts/bindings/cpu/cpu.yaml
```yaml
# Copyright (c) 2019 Nordic Semiconductor ASA
# SPDX-License-Identifier: Apache-2.0

# Common fields for CPUs

include: base.yaml

properties:
  device_type:
    type: string
    default: "cpu"
    description: |
      Standard device_type identifying this node as a cpu. Required to maintain compatibility
      with the IEEE 1275 standard as well as for DT_FOREACH_CPU family of devicetree macros to
      identify cpu nodes within the "/cpus" parent node

  zephyr,deferred-start:
    type: boolean
    description: |
      Do not start this CPU during kernel boot. By default, with CONFIG_SMP
      the kernel starts every available CPU during start up. When this flag
      is set the CPU is left un-started until architecture, SoC, board or
      application code brings it up at run time with k_smp_cpu_start() (or
      k_smp_cpu_resume()). The flag has no effect on the boot CPU.
  clock-frequency:
    type: int
    description: Clock frequency in Hz
  cpu-power-states:
    type: phandles
    description: List of power management states supported by this cpu
  i-cache-line-size:
    type: int
    description: i-cache line size
  d-cache-line-size:
    type: int
    description: d-cache line size
  enable-method:
    type: string
    enum:
      - "psci"
      - "spin-table"
    description: Enable method for cpu, either it is "psci" or "spin-table"
  cpu-release-addr:
    type: array
    description: Address of the release mailbox used by the spin-table enable-method.
```

## dts/bindings/cpu/intel,x86_64.yaml
```yaml
# Copyright (c) 2026 Intel Corporation
# SPDX-License-Identifier: Apache-2.0

description: Generic x86-64 qemu CPU

compatible: "intel,x86_64"

include: cpu.yaml
```

## dts/bindings/cpu/motorola,m68000.yaml
```yaml
# SPDX-License-Identifier: Apache-2.0

description: Motorola M68000 processor

compatible: "motorola,m68000"

include: cpu.yaml
```

## dts/bindings/cpu/motorola,m68010.yaml
```yaml
# SPDX-License-Identifier: Apache-2.0

description: Motorola M68010 processor

compatible: "motorola,m68010"

include: cpu.yaml
```

## dts/bindings/cpu/mti,mips24KEc.yaml
```yaml
# SPDX-FileCopyrightText: 2026 Muhammad Waleed Badar
# SPDX-License-Identifier: Apache-2.0

description: MIPS 24KEc

compatible: "mti,mips24KEc"

include: cpu.yaml
```

## dts/bindings/cpu/openhwgroup,cva6.yaml
```yaml
# Copyright (c) 2025 CISPA Helmholtz Center for Information Security gGmbH
# SPDX-License-Identifier: Apache-2.0

description: OpenHW Group CVA6 CPU

compatible: "openhwgroup,cva6"

include: riscv-common.yaml

properties:
  timebase-frequency:
    required: true
    description: Clock speed at which the core-local machine timer operates.
```
