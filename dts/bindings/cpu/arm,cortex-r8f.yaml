## dts/bindings/cpu/arm,cortex-r8f.yaml
```yaml
# SPDX-FileCopyrightText: Copyright The Zephyr Project Contributors
# SPDX-License-Identifier: Apache-2.0

description: ARM Cortex-R8F CPU

compatible: "arm,cortex-r8f"

include: cpu.yaml
```

## dts/bindings/cpu/cadence,tensilica-xtensa-lx4.yaml
```yaml
# Copyright (c) 2018 Nordic Semiconductor ASA
# SPDX-License-Identifier: Apache-2.0

description: Cadence Tensilica Xtensa LX4 CPU

compatible: "cadence,tensilica-xtensa-lx4"

include: cpu.yaml
```

## dts/bindings/cpu/cadence,tensilica-xtensa-lx6.yaml
```yaml
# Copyright (c) 2018 Nordic Semiconductor ASA
# SPDX-License-Identifier: Apache-2.0

title: Cadence Tensilica Xtensa LX6 CPU

description: |
    This binding gives a base representation for Cadence Tensilica Xtensa LX6 CPU.

compatible: "cadence,tensilica-xtensa-lx6"

include: cpu.yaml
```

## dts/bindings/cpu/cdns,swerv,s400.yaml
```yaml
# Copyright (c) 2026 Intel Corporation
#
# SPDX-License-Identifier: Apache-2.0

description: Cadence SweRV S400 CPU

compatible: "cdns,swerv,s400"

include: riscv,cpus.yaml
```

## dts/bindings/cpu/cdns,swerv,s420.yaml
```yaml
# Copyright (c) 2026 Intel Corporation
#
# SPDX-License-Identifier: Apache-2.0

description: Cadence SweRV S420 CPU

compatible: "cdns,swerv,s420"

include: riscv,cpus.yaml
```

## dts/bindings/cpu/cdns,tensilica-xtensa-lx3.yaml
```yaml
# Copyright (c) 2018 Nordic Semiconductor ASA
# SPDX-License-Identifier: Apache-2.0

description: Cadence Tensilica Xtensa LX3 CPU

compatible: "cdns,tensilica-xtensa-lx3"

include: cpu.yaml
```

## dts/bindings/cpu/cdns,tensilica-xtensa-lx6.yaml
```yaml
# Copyright (c) 2018 Nordic Semiconductor ASA
# SPDX-License-Identifier: Apache-2.0

description: Cadence Tensilica Xtensa LX6 CPU

compatible: "cdns,tensilica-xtensa-lx6"

include: cpu.yaml

properties:
    clock-source:
      type: int
      description: cpu clock source
      required: false
```

## dts/bindings/cpu/cdns,tensilica-xtensa-lx7.yaml
```yaml
# Copyright (c) 2021 Espressif Systems (Shanghai) Co., Ltd.
# SPDX-License-Identifier: Apache-2.0

description: Cadence Tensilica Xtensa LX7 CPU

compatible: "cdns,tensilica-xtensa-lx7"

include: cpu.yaml

properties:
  clock-source:
    type: int
    description: cpu clock source
```

## dts/bindings/cpu/efinix,vexriscv-sapphire.yaml
```yaml
# Copyright (c) 2024 Antmicro <www.antmicro.com>
#
# SPDX-License-Identifier: Apache-2.0

description: VexRiscv core with the configuration as used in the Efinix Sapphire SoC

compatible: "efinix,vexriscv-sapphire"

include: riscv,cpus.yaml
```

## dts/bindings/cpu/espressif,riscv.yaml
```yaml
# Copyright (c) 2021 Espressif Systems (Shanghai) Co., Ltd.
# SPDX-License-Identifier: Apache-2.0

description: Espressif RISC-V CPU

compatible: "espressif,riscv"

include: riscv,cpus.yaml

properties:
  clock-source:
    required: true
    type: int
    description: |
      Defines the CPU clock source, each corresponding to different frequencies:
      - 0: ESP32_CPU_CLK_SRC_XTAL - Uses the external crystal clock typically at 40 MHz.
      - 1: ESP32_CPU_CLK_SRC_PLL - Utilizes an internal PLL which operates at either
      320 MHz or 480 MHz.
      - 2: ESP32_CPU_CLK_SRC_RC_FAST - Employs an internal fast RC oscillator with
      frequency of 17.5 MHz.
    enum:
      - 0
      - 1
      - 2

  xtal-freq:
    required: true
    type: int
    description: Value of the external XTAL connected to ESP32. This is typically 40 MHz.
    enum:
      - 26000000
      - 32000000
      - 40000000
```

## dts/bindings/cpu/espressif,xtensa-lx7.yaml
```yaml
# Copyright (c) 2024 Espressif Systems (Shanghai) Co., Ltd.
# SPDX-License-Identifier: Apache-2.0

description: Espressif Xtensa LX7 CPU

compatible: "espressif,xtensa-lx7"

include: cdns,tensilica-xtensa-lx7.yaml

properties:
  clock-source:
    type: int
    required: true
    description: |
      Defines the CPU clock source, each corresponding to different frequencies:
      - 0: ESP32_CPU_CLK_SRC_XTAL - Uses the external crystal clock typically at 40 MHz.
      - 1: ESP32_CPU_CLK_SRC_PLL - Utilizes an internal PLL which operates at either
      320 MHz or 480 MHz.
      - 2: ESP32_CPU_CLK_SRC_RC_FAST - Employs an internal fast RC oscillator with
      frequency of 17.5 MHz. 8 MHz for ESP32S2.
      - 3: APLL_CLK - 16 Mhz ~ 128 MHz (ESP32S2 Only)
    enum:
      - 0
      - 1
      - 2
      - 3

  xtal-freq:
    type: int
    required: true
    description: Value of the external XTAL connected to ESP32.
    enum:
      - 40000000
```

## dts/bindings/cpu/gaisler,leon3.yaml
```yaml
# Copyright (c) 2021 Nordic Semiconductor ASA
# SPDX-License-Identifier: Apache-2.0

description: Gaisler LEON3 CPU

compatible: "gaisler,leon3"

include: cpu.yaml
```

## dts/bindings/cpu/hisilicon,riscv.yaml
```yaml
# Copyright (c) 2023 Chen Xingyu <hi@xingrz.me>
# SPDX-License-Identifier: Apache-2.0

description: HiSilicon RISC-V CPU

compatible: "hisilicon,riscv"

include: cpu.yaml
```

## dts/bindings/cpu/infineon,tricore.yaml
```yaml
# Copyright (c) 2026 Infineon Technologies AG
# SPDX-License-Identifier: Apache-2.0

description: Infineon TriCore CPU

compatible: "infineon,tricore"

include: cpu.yaml
```

## dts/bindings/cpu/intel,alder-lake.yaml
```yaml
# Copyright (c) 2023 Intel Corp.
# SPDX-License-Identifier: Apache-2.0

description: Intel Alder Lake CPU

compatible: "intel,alder-lake"

include: cpu.yaml
```

## dts/bindings/cpu/intel,apollo_lake.yaml
```yaml
# Copyright (c) 2021 Intel Corp.
# SPDX-License-Identifier: Apache-2.0

description: Intel Apollo lake CPU

compatible: "intel,apollo_lake"

include: cpu.yaml
```

## dts/bindings/cpu/intel,atom.yaml
```yaml
# Copyright (c) 2021 Intel Corp.
# SPDX-License-Identifier: Apache-2.0

description: Intel Atom CPU

compatible: "intel,atom"

include: cpu.yaml
```

## dts/bindings/cpu/intel,bartlett-lake.yaml
```yaml
# Copyright (c) 2025 Intel Corp.
# SPDX-License-Identifier: Apache-2.0

description: Intel Bartlett Lake CPU

compatible: "intel,bartlett-lake"

include: cpu.yaml
```

## dts/bindings/cpu/intel,elkhart-lake.yaml
```yaml
# Copyright (c) 2021 Intel Corp.
# SPDX-License-Identifier: Apache-2.0

description: Intel Elkhart Lake CPU

compatible: "intel,elkhart-lake"

include: cpu.yaml
```

## dts/bindings/cpu/intel,elkhart_lake.yaml
```yaml
# Copyright (c) 2021 Intel Corp.
# SPDX-License-Identifier: Apache-2.0

description: Intel Elkhart Lake CPU

compatible: "intel,elkhart_lake"

include: cpu.yaml
```

## dts/bindings/cpu/intel,ish.yaml
```yaml
# Copyright (c) 2023 Intel Corporation
#
# SPDX-License-Identifier: Apache-2.0

description: INTEL ISH CPU

compatible: "intel,ish"

include: cpu.yaml
```

## dts/bindings/cpu/intel,lakemont.yaml
```yaml
# Copyright (c) 2021 Intel Corp.
# SPDX-License-Identifier: Apache-2.0

description: Intel Lakemont CPU

compatible: "intel,lakemont"

include: cpu.yaml
```

## dts/bindings/cpu/intel,niosv.yaml
```yaml
# Copyright (C) 2023, Intel Corporation
# SPDX-License-Identifier: Apache-2.0

description: INTEL FPGA NIOSV Softcore Processor

compatible: "intel,niosv"

include: cpu.yaml
```

## dts/bindings/cpu/intel,nova-lake.yaml
```yaml
# Copyright (c) 2026 Intel Corp.
# SPDX-License-Identifier: Apache-2.0

description: Intel Nova Lake CPU

compatible: "intel,nova-lake"

include: cpu.yaml
```

## dts/bindings/cpu/intel,panther-lake.yaml
```yaml
# Copyright (c) 2025 Intel Corp.
# SPDX-License-Identifier: Apache-2.0

description: Intel Panther Lake CPU

compatible: "intel,panther-lake"

include: cpu.yaml
```
