## dts/bindings/cpu/intel,raptor-lake.yaml
```yaml
# Copyright (c) 2022 Intel Corp.
# SPDX-License-Identifier: Apache-2.0

description: Intel Raptor Lake CPU

compatible: "intel,raptor-lake"

include: cpu.yaml
```

## dts/bindings/cpu/intel,wildcat-lake.yaml
```yaml
# Copyright (c) 2025 Intel Corp.
# SPDX-License-Identifier: Apache-2.0

description: Intel Wildcat Lake CPU

compatible: "intel,wildcat-lake"

include: cpu.yaml
```

## dts/bindings/cpu/intel,x86.yaml
```yaml
# Copyright (c) 2021 Intel Corp.
# SPDX-License-Identifier: Apache-2.0

description: Generic x86 qemu CPU

compatible: "intel,x86"

include: cpu.yaml
```

## dts/bindings/cpu/litex,vexiiriscv-standard.yaml
```yaml
# SPDX-FileCopyrightText: Copyright The Zephyr Project Contributors
#
# SPDX-License-Identifier: Apache-2.0

description: VexiiRiscv core with the standard configuration as used by LiteX

compatible: "litex,vexiiriscv-standard"

include: riscv,cpus.yaml
```

## dts/bindings/cpu/litex,vexriscv-standard.yaml
```yaml
# Copyright (c) 2024 Antmicro <www.antmicro.com>
#
# SPDX-License-Identifier: Apache-2.0

description: VexRiscv core with the standard configuration as used by LiteX

compatible: "litex,vexriscv-standard"

include: spinalhdl,vexriscv.yaml

properties:
  i-cache-line-size:
    default: 32
  d-cache-line-size:
    default: 32
```

## dts/bindings/cpu/lowrisc,ibex.yaml
```yaml
# Copyright (c) 2024 Antmicro <www.antmicro.com>
#
# SPDX-License-Identifier: Apache-2.0

description: LowRISC Ibex RISC-V core

compatible: "lowrisc,ibex"

include: riscv,cpus.yaml
```

## dts/bindings/cpu/microchip,dsPIC33A.yaml
```yaml
# Copyright (c) 2025, Microchip Technology Inc.
# SPDX-License-Identifier: Apache-2.0

description: Microchip dsPIC33A CPU

compatible: "microchip,dsPIC33A"

include: cpu.yaml
```

## dts/bindings/cpu/neorv32,cpu.yaml
```yaml
# Copyright (c) 2021 Henrik Brix Andersen <henrik@brixandersen.dk>
# SPDX-License-Identifier: Apache-2.0

description: NEORV32 RISC-V CPU

compatible: "neorv32,cpu"

include: riscv,cpus.yaml
```

## dts/bindings/cpu/nordic,vpr.yaml
```yaml
# Copyright (c) 2024 Nordic Semiconductor ASA
# SPDX-License-Identifier: Apache-2.0

description: Nordic Semiconductor RISC-V VPR CPU

compatible: "nordic,vpr"

include: riscv-common.yaml

properties:
  nordic,bus-width:
    type: int
    enum:
      - 32
      - 64
    required: true
    description:
      Bus width of the CPU.

  nordic,vpr-ready-event:
    type: int
    description:
      Event which is set by the VPR core (cpuppr) to indicate that it is running.
```

## dts/bindings/cpu/nuclei,bumblebee.yaml
```yaml
# Copyright (c) 2021 TOKITA Hiroshi <tokita.hiroshi@gmail.com>
# SPDX-License-Identifier: Apache-2.0

description: Nuclei Bumblebee RISC-V Core

compatible: "nuclei,bumblebee"

include: riscv,cpus.yaml
```

## dts/bindings/cpu/nuclei,hummingbird.yaml
```yaml
# Copyright (c) 2021 TOKITA Hiroshi
# SPDX-License-Identifier: Apache-2.0

description: Nuclei HummingBird RISC-V Core

compatible: "nuclei,hummingbird"

include: cpu.yaml
```

## dts/bindings/cpu/nuclei,n308.yaml
```yaml
# Copyright (c) 2025 Junhui Liu <junhui.liu@pigmoral.tech>
# SPDX-License-Identifier: Apache-2.0

description: Nuclei N308 RISC-V Core

compatible: "nuclei,n308"

include: riscv,cpus.yaml
```

## dts/bindings/cpu/openhwgroup,cv32a6.yaml
```yaml
# Copyright (c) 2024 CISPA Helmholtz Center for Information Security gGmbH
#
# SPDX-License-Identifier: Apache-2.0

description: OpenHW Group CVA6 core in 32 bit configurations

compatible: "openhwgroup,cva32a6"

include: riscv,cpus.yaml
```

## dts/bindings/cpu/openhwgroup,cv64a6.yaml
```yaml
# Copyright (c) 2024 CISPA Helmholtz Center for Information Security gGmbH
#
# SPDX-License-Identifier: Apache-2.0

description: OpenHW Group CVA6 core in 64 bit configuration

compatible: "openhwgroup,cva64a6"

include: riscv,cpus.yaml
```

## dts/bindings/cpu/openisa,ri5cy.yaml
```yaml
# Copyright (c) 2024 Antmicro <www.antmicro.com>
#
# SPDX-License-Identifier: Apache-2.0

description: OpenISA RI5CY core

compatible: "openisa,ri5cy"

include: riscv,cpus.yaml
```

## dts/bindings/cpu/openisa,zero-ri5cy.yaml
```yaml
# Copyright (c) 2024 Antmicro <www.antmicro.com>
#
# SPDX-License-Identifier: Apache-2.0

description: OpenISA Zero-RI5CY core

compatible: "openisa,zero-ri5cy"

include: riscv,cpus.yaml
```

## dts/bindings/cpu/qemu,nios2-zephyr.yaml
```yaml
# Copyright (c) 2020 Nordic Semiconductor ASA
# SPDX-License-Identifier: Apache-2.0

description: QEMU NIOS2 Zephyr CPU

compatible: "qemu,nios2-zephyr"

include: [interrupt-controller.yaml, base.yaml]

properties:
  "#interrupt-cells":
    const: 1

interrupt-cells:
  - irq
```

## dts/bindings/cpu/qemu,riscv-virt.yaml
```yaml
# Copyright (c) 2024 Antmicro <www.antmicro.com>
#
# SPDX-License-Identifier: Apache-2.0

description: QEMU RISC-V virt machine CPU

compatible: "qemu,riscv-virt"

include: riscv,cpus.yaml
```

## dts/bindings/cpu/qemu,rv32.yaml
```yaml
# Copyright (c) 2020 Katsuhiro Suzuki
# SPDX-License-Identifier: Apache-2.0

description: >
    This is a representation of QEMU rv32 CPU.

compatible: "qemu,rv32"

include: cpu.yaml
```

## dts/bindings/cpu/qemu,rv64.yaml
```yaml
# Copyright (c) 2020 Katsuhiro Suzuki
# SPDX-License-Identifier: Apache-2.0

description: >
    This is a representation of QEMU rv64 CPU.

compatible: "qemu,rv64"

include: cpu.yaml
```

## dts/bindings/cpu/renesas,g4mh.yaml
```yaml
# Copyright (c) 2026 Renesas Electronics Corporation
# SPDX-License-Identifier: Apache-2.0

description: Renesas G4MH CPU

compatible: "renesas,g4mh"

include: renesas,rh850.yaml
```

## dts/bindings/cpu/renesas,rh850.yaml
```yaml
# Copyright (c) 2026 Renesas Electronics Corporation
# SPDX-License-Identifier: Apache-2.0

description: Renesas RH850 CPU

compatible: "renesas,rh850"

include: cpu.yaml
```

## dts/bindings/cpu/renesas,rx.yaml
```yaml
# Copyright (c) 2021 KT-Elektronik Klaucke und Partner GmbH
# SPDX-License-Identifier: Apache-2.0

description: Renesas RX CPU

compatible: "renesas,rx"

include: cpu.yaml
```

## dts/bindings/cpu/renesas,rxv1.yaml
```yaml
# Copyright (c) 2025 Renesas Electronics Corporation
# SPDX-License-Identifier: Apache-2.0

description: Renesas RXv1 CPU

compatible: "renesas,rxv1"

include: renesas,rx.yaml
```

## dts/bindings/cpu/renesas,rxv2.yaml
```yaml
# Copyright (c) 2025 Renesas Electronics Corporation
# SPDX-License-Identifier: Apache-2.0

description: Renesas RXv2 CPU

compatible: "renesas,rxv2"

include: renesas,rx.yaml
```
