## dts/bindings/cpu/renesas,g4kh.yaml
```yaml
# Copyright (c) 2026 Renesas Electronics Corporation
# SPDX-License-Identifier: Apache-2.0

description: Renesas G4KH CPU

compatible: "renesas,g4kh"

include: renesas,rh850.yaml
```

## dts/bindings/cpu/renesas,rh850-g4kh.yaml
```yaml
# SPDX-FileCopyrightText: Copyright (c) 2026 Linumiz
#
# SPDX-License-Identifier: Apache-2.0

description: Renesas RH850 G4KH CPU core

compatible: "renesas,rh850-g4kh"

include: renesas,rh850.yaml
```

## dts/bindings/cpu/renesas,rh850-g4mh.yaml
```yaml
# SPDX-FileCopyrightText: Copyright (c) 2026 Linumiz
#
# SPDX-License-Identifier: Apache-2.0

description: Renesas RH850 G4MH CPU core

compatible: "renesas,rh850-g4mh"

include: renesas,rh850.yaml
```

## dts/bindings/cpu/renesas,rxv3e.yaml
```yaml
# Copyright (c) 2026 Renesas Electronics Corporation
# SPDX-License-Identifier: Apache-2.0

description: Renesas RX CPU

compatible: "renesas,rxv3e"

include: renesas,rx.yaml
```

## dts/bindings/cpu/xuantie,c906.yaml
```yaml
# Copyright (c) 2026 MASSDRIVER EI
# SPDX-License-Identifier: Apache-2.0

title: Xuantie C906 Core CPU

description: |
  C906 is an 'ultra high-performance' 64-bit CPU built on the RISC-V instruction set architecture.

compatible: "xuantie,c906"

include: riscv-common.yaml

properties:
  hardware-exec-breakpoint-count:
    type: int
    description: Number of hardware break points
```

## dts/bindings/cpu/xuantie,e902.yaml
```yaml
# Copyright (c) 2026 MASSDRIVER EI
# SPDX-License-Identifier: Apache-2.0

title: Xuantie E902 Core CPU

description: |
  E902 is an embedded CPU core with ultra-low power consumption.

compatible: "xuantie,e902"

include: riscv-common.yaml
```

## dts/bindings/crc/st,stm32-crc-v1.yaml
```yaml
# Copyright (c) 2026 STMicroelectronics
# SPDX-License-Identifier: Apache-2.0

title: STM32 CRC calculation unit

description: |
  Cyclic Redundancy Check (CRC) calculation unit with
  fix parameters, capable of CRC32-IEEE and CRC32-MPEG2

compatible: "st,stm32-crc-v1"

include: [base.yaml, reset-device.yaml]

properties:
  reg:
    required: true

  clocks:
    required: true
```

## dts/bindings/crc/st,stm32f1-crc.yaml
```yaml
# Copyright (c) 2026 STMicroelectronics
# SPDX-License-Identifier: Apache-2.0

title: STM32F1-like CRC calculation unit

description: |
  STM32F1-like Cyclic Redundancy Check (CRC) calculation unit with
  fix word-size (32 bits), polynomial (0x04C11DB7) and initial value
  (0xFFFFFFFF).

compatible: "st,stm32f1-crc"

include: [base.yaml]

properties:
  reg:
    required: true

  clocks:
    required: true
```

## dts/bindings/crc/ti,msp-crc.yaml
```yaml
# Copyright (c) 2026, Texas Instruments Inc.
# SPDX-License-Identifier: Apache-2.0

title: Texas Instruments MSP CRC Accelerator

description: |
  Texas Instruments MSP Cyclic Redundancy Check (CRC) Engine.
  This accelerator generates signature or a given data sequence
  based on the CRC16-CCITT polynomial or the CRC32-ISO3309
  polynomial.

compatible: "ti,msp-crc"

include: base.yaml

properties:
  reg:
    required: true
```

## dts/bindings/crc/ti,mspm0-crc.yaml
```yaml
# Copyright (c) 2026, Texas Instruments Inc.
# SPDX-License-Identifier: Apache-2.0

title: Texas Instruments MSPM0 CRC Accelerator

description: |
  Texas Instruments MSPM0 Cyclic Redundancy Check (CRC) Engine.
  This accelerator generates signature for a given data sequence
  based on the CRC16-CCITT polynomial or the CRC32-ISO3309
  polynomial.

compatible: "ti,mspm0-crc"

include: base.yaml

properties:
  reg:
    required: true
```

## dts/bindings/crc/ti,mspm0-crcp.yaml
```yaml
# Copyright (c) 2026, Texas Instruments Inc.
# SPDX-License-Identifier: Apache-2.0

title: Texas Instruments MSPM0 CRCP Accelerator

description: |
  Texas Instruments MSPM0 Cyclic Redundancy Check (CRCP) Engine
  with polynomial selection. This accelerator generates signature for
  a given data sequence based on the custom polynomial configurable
  by the user.

compatible: "ti,mspm0-crcp"

include: base.yaml

properties:
  reg:
    required: true
```

## dts/bindings/crypto/lowrisc,opentitan-hmac.yaml
```yaml
# SPDX-FileCopyrightText: 2026 Yousef Kitaneh
# SPDX-License-Identifier: Apache-2.0

description: lowRISC OpenTitan HMAC / SHA-256 accelerator

compatible: "lowrisc,opentitan-hmac"

include: base.yaml

properties:
  reg:
    required: true

  interrupts:
    required: true
```

## dts/bindings/crypto/realtek,bee-aes.yaml
```yaml
# Copyright (c) 2026, Realtek Semiconductor Corporation
# SPDX-License-Identifier: Apache-2.0

description: |
  Realtek Bee family AES hardware accelerator.

  Supports AES-128 and AES-256 in ECB, CBC, CFB, OFB and CTR modes on Realtek Bee family SoCs.

compatible: "realtek,bee-aes"

include: base.yaml
```

## dts/bindings/crypto/realtek,bee-sha256.yaml
```yaml
# Copyright (c) 2026, Realtek Semiconductor Corporation
# SPDX-License-Identifier: Apache-2.0

description: |
  Realtek Bee family SHA-256 hardware accelerator.

  Supports one-shot SHA-256 calculation on Realtek Bee family SoCs.

compatible: "realtek,bee-sha256"

include: base.yaml
```

## dts/bindings/crypto/silabs,series3-crypto.yaml
```yaml
# Copyright (c) 2026 Silicon Laboratories Inc.
# SPDX-License-Identifier: Apache-2.0

title: Silicon Labs Series 3 Crypto

description: |
  Crypto engine on Silicon Labs Series 3 devices.

compatible: "silabs,series3-crypto"

include: base.yaml

properties:
  reg:
    required: true

  clocks:
    required: true

  interrupts:
    required: true
```

## dts/bindings/crypto/st,stm32-hash.yaml
```yaml
# Copyright (c) 2025 Bayrem Gharsellaoui
# SPDX-License-Identifier: Apache-2.0

title: STM32 HASH Processor

description: |
  STM32 hardware hash accelerator supporting SHA-224, SHA-256
  and optionally SHA-384, SHA-512, and SHA-3 hashing algorithms.

compatible: "st,stm32-hash"

include: [base.yaml, reset-device.yaml]

properties:
  reg:
    required: true

  clocks:
    required: true

  resets:
    required: true

  st,has-sha384-algorithm:
    type: boolean
    description: |
      Support SHA384 algorithm.

  st,has-sha512-algorithm:
    type: boolean
    description: |
      Support SHA512 algorithm.

  st,has-sha3-algorithm:
    type: boolean
    description: |
      Support SHA3-224, SHA3-256, SHA3-384, and SHA3-512 algorithms.
      Currently supported by the STM32MP13 HASH peripheral.
```

## dts/bindings/crypto/st,stm32-pka.yaml
```yaml
# Copyright (c) 2024 STMicroelectronics
# SPDX-License-Identifier: Apache-2.0

description: STM32 Public Key Accelerator (PKA)

compatible: "st,stm32-pka"

include: st,stm32-crypto-common.yaml
```

## dts/bindings/crypto/st,stm32wba-pka.yaml
```yaml
# Copyright (c) 2024 STMicroelectronics
# SPDX-License-Identifier: Apache-2.0

description: STM32WBA Public Key Accelerator (PKA)

compatible: "st,stm32wba-pka"

include: [base.yaml, reset-device.yaml]

properties:
  reg:
    required: true

  interrupts:
    required: true

  clocks:
    required: true

  resets:
    required: true
```

## dts/bindings/crypto/ti,cc35xx-hsm-crypto.yaml
```yaml
# Copyright (c) 2025 Conclusive Engineering Sp. z o.o.
# SPDX-License-Identifier: Apache-2.0

description: TI SimpleLink CC35xx HSM Crypto

compatible: "ti,cc35xx-hsm-crypto"

include: base.yaml
```

## dts/bindings/crypto/ti,msp-aes-adv.yaml
```yaml
# Copyright (c) 2026 Texas Instruments Inc.
# SPDX-License-Identifier: Apache-2.0

description: |
  Texas Instruments MSP Advanced Encryption Standard Advanced (AESADV) Engine
  This peripheral provides AES-128 and AES-256 encryption and decryption.

compatible: "ti,msp-aes-adv"

include: ti,msp-aes-common.yaml
```

## dts/bindings/crypto/ti,msp-aes-common.yaml
```yaml
# Copyright (c) 2026 Texas Instruments Inc.
# SPDX-License-Identifier: Apache-2.0

include: base.yaml

properties:
  reg:
    required: true

  interrupts:
    required: true
```

## dts/bindings/crypto/ti,mspm0-aes-adv.yaml
```yaml
# Copyright (c) 2026 Texas Instruments Inc.
# SPDX-License-Identifier: Apache-2.0

description: |
  Texas Instruments MSP Advanced Encryption Standard Advanced (AESADV) Engine
  This peripheral provides AES-128 and AES-256 encryption and decryption.

compatible: "ti,mspm0-aes-adv"

include: ti,mspm0-aes-common.yaml
```

## dts/bindings/dac/ite,it51xxx-dac.yaml
```yaml
# Copyright (c) 2026 ITE Corporation. All Rights Reserved.
# SPDX-License-Identifier: Apache-2.0

description: ITE IT51xxx two-channel 8-bit DAC

compatible: "ite,it51xxx-dac"

include: [dac-controller.yaml, pinctrl-device.yaml]

properties:
  reg:
    required: true

  pinctrl-0:
    required: true

  pinctrl-names:
    required: true

  "#io-channel-cells":
    const: 1

io-channel-cells:
  - output
```

## dts/bindings/dac/ti,dacx0501.yaml
```yaml
# Copyright (c) 2024 Google, LLC.
# SPDX-License-Identifier: Apache-2.0

include: base.yaml

description: TI DACx0501 12 to 16 bit DAC series for DAC60501, DAC70501 and DAC80501 devices.

compatible: "ti,dacx0501"

properties:
  voltage-reference:
    type: string
    required: true
    enum:
      - "internal"
      - "external"
    description: |
      DAC voltage reference select: either internal (2.5 V) or external

  output-gain:
    type: string
    required: true
    enum:
      - "mul2"
      - "mul1"
      - "div2"
      - "div2-mul2"
    description: |
      This setting can be used to control the output voltage range within the supported bit
      resolution. mul2 will double the output range but lower the resolution, while div2 will
      lower the range but double the resolution.
      div2-mul2 is needed for 2.7 V ≤ VDD ≤ 3.3 V and internal reference to get full scale output
      up to internal (2.5 V) reference.
examples:
  - |
    #VDD=3.3V, internal reference
    dac80501: dac80501@48 {
      compatible = "ti,dacx0501";
      voltage-reference = "internal";
      output-gain = "div2-mul2";
      reg = <0x48>;
    }
```

## dts/bindings/dac/ti,mspm0-dac.yaml
```yaml
# Copyright (c) 2026 Linumiz
# SPDX-License-Identifier: Apache-2.0

description: Texas Instruments MSPM0 G-Series Digital-to-Analog Converter (DAC)

compatible: "ti,mspm0-dac"

include: dac-controller.yaml

properties:
  reg:
    required: true

  vref:
    type: phandle

  fifo-enable:
    type: boolean
    description: |
      Enable the 4-slot hardware FIFO. When set, the sample time generator
      clocks samples out of the FIFO at sample-rate-hz, decoupling DAC output
      timing from CPU write timing.

  sample-rate-hz:
    type: int
    enum: [500, 1000, 2000, 4000, 8000, 16000, 100000, 200000, 500000, 1000000]
    description: |
      DAC output sample rate in Hz. Maps directly to the sample time generator
      STIMCONFIG preset. Requires fifo-enable.

  "#io-channel-cells":
    const: 1

io-channel-cells:
  - output
```
