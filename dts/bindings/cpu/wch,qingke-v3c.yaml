## dts/bindings/cpu/wch,qingke-v3c.yaml
```yaml
# Copyright (c) 2025 SMILE (smile.eu)
# SPDX-License-Identifier: Apache-2.0

description: WCH QingKe V3C RISC-V MCU

compatible: "wch,qingke-v3c"

include: riscv-common.yaml
```

## dts/bindings/cpu/wch,qingke-v3f.yaml
```yaml
# Copyright (c) 2026 Liu Changjie
# SPDX-License-Identifier: Apache-2.0

description: WCH QingKe V3F RISC-V MCU

compatible: "wch,qingke-v3f"

include: riscv-common.yaml
```

## dts/bindings/cpu/wch,qingke-v4.yaml
```yaml
# Copyright (c) 2024 MASSDRIVER EI (massdriver.space)
# SPDX-License-Identifier: Apache-2.0

description: WCH QingKe V4 RISC-V MCU

compatible: "wch,qingke-v4"

include: cpu.yaml
```

## dts/bindings/cpu/wch,qingke-v4b.yaml
```yaml
# Copyright (c) 2025 MASSDRIVER EI (massdriver.space)
# SPDX-License-Identifier: Apache-2.0

description: WCH QingKe V4B RISC-V MCU

compatible: "wch,qingke-v4b"

include: riscv,cpus.yaml
```

## dts/bindings/cpu/wch,qingke-v4c.yaml
```yaml
# Copyright (c) 2024 MASSDRIVER EI (massdriver.space)
# SPDX-License-Identifier: Apache-2.0

description: WCH QingKe V4C RISC-V MCU

compatible: "wch,qingke-v4c"

include: riscv,cpus.yaml
```

## dts/bindings/cpu/wch,qingke-v4f.yaml
```yaml
# Copyright (c) 2025 Bootlin
# SPDX-License-Identifier: Apache-2.0

description: WCH QingKe V4F RISC-V MCU

compatible: "wch,qingke-v4f"

include: riscv,cpus.yaml
```

## dts/bindings/cpu/wch,qingke-v5f.yaml
```yaml
# Copyright (c) 2026 Liu Changjie
# SPDX-License-Identifier: Apache-2.0

description: WCH QingKe V5F RISC-V MCU

compatible: "wch,qingke-v5f"

include: riscv-common.yaml
```

## dts/bindings/cpu/xlnx,microblaze.yaml
```yaml
# Copyright (c) 2023 Advanced Micro Devices, Inc. (AMD)
# Copyright (c) 2023 Alp Sayin <alpsayin@gmail.com>
# SPDX-License-Identifier: Apache-2.0


description: AMD Xilinx MicroBlaze

compatible: "xlnx,microblaze"

include: cpu.yaml

properties:
  i-cache-base:
    type: int
    description: i-cache base
      ICACHE_BASEADDR parameter defined in xparameters.
  d-cache-base:
    type: int
    description: d-cache base
      DCACHE_BASEADDR parameter defined in xparameters.
  i-cache-size:
    type: int
    description: i-cache size in bytes
      ICACHE_BYTE_SIZE parameter defined in xparameters.
  d-cache-size:
    type: int
    description: d-cache size in bytes
      DCACHE_BYTE_SIZE parameter defined in xparameters.
  d-cache-use-writeback:
    type: int
    description: If CPU supports flushing without invalidating
      C_DCACHE_USE_WRITEBACK parameter defined in xparameters.
```

## dts/bindings/cpu/xuantie,c908.yaml
```yaml
# Copyright (c) 2025 Xuantie Technology Corporation
# SPDX-License-Identifier: Apache-2.0

description: Xuantie C908 Core CPU

compatible: "xuantie,c908"

include: xuantie,riscv.yaml
```

## dts/bindings/cpu/xuantie,e907.yaml
```yaml
# Copyright (c) 2025 Andes Technology Corporation
# SPDX-License-Identifier: Apache-2.0

description: Xuantie E907 Core CPU

compatible: "xuantie,e907"

include: xuantie,riscv.yaml
```

## dts/bindings/cpu/xuantie,riscv.yaml
```yaml
# Copyright (c) 2025 Xuantie Technology Corporation
# SPDX-License-Identifier: Apache-2.0

description: Xuantie RISCV Core CPU

compatible: "xuantie,riscv"

include: xuantie-common.yaml
```

## dts/bindings/cpu/xuantie-common.yaml
```yaml
# Copyright (c) 2025 Xuantie Technology Corporation
# SPDX-License-Identifier: Apache-2.0

# Common fields for Xuantie RISC-V CPUs

include: riscv,cpus.yaml
```

## dts/bindings/cpu/zephyr,native-posix-cpu.yaml
```yaml
# Copyright (c) 2021 Nordic Semiconductor ASA
# SPDX-License-Identifier: Apache-2.0

description: A representation for native_posix CPU.

compatible: "zephyr,native-posix-cpu"

include: cpu.yaml
```

## dts/bindings/cpu/zephyr,native-sim-cpu.yaml
```yaml
# Copyright (c) 2021 Nordic Semiconductor ASA
# SPDX-License-Identifier: Apache-2.0

description: native_sim CPU

compatible: "zephyr,native-sim-cpu"

include: cpu.yaml
```

## dts/bindings/cpu_enable/raspberrypi,pico-pcbs.yaml
```yaml
# Copyright (c) Qualcomm Technologies, Inc. and/or its subsidiaries.
# SPDX-License-Identifier: Apache-2.0

title: Raspberry Pi Pico Processor Controlled Boot Sequence

description: |
  The Raspberry Pi Pico family of SoCs uses a series of SIO inter-processor
  FIFO reads/writes to bring CPU1 out of its quiescent state. The launch
  sequence points CPU1 to its stack pointer and program counter.

  CPU0 is responsible for relocating CPU1's image if necessary (e.g. if
  CPU1 is built to execute from SRAM but is loaded into flash).

  Example:
    / {
        cpu1-launcher {
            compatible = "raspberrypi,pico-pcbs";
            execution-memory = <&sram0_cpu1>;
            source-memory = <&cpu1_slot0_partition>;
            status = "okay";
        };
    };

compatible: "raspberrypi,pico-pcbs"

include: base.yaml

properties:
  execution-memory:
    type: phandle
    required: true
    description: |
      Phandle to the memory region or partition from which the secondary CPU executes.

  source-memory:
    type: phandle
    description: |
      Phandle to the memory region or partition from which the secondary CPU's image is
      copied into execution-memory.
```

## dts/bindings/cpu_freq/cpu-freq.yaml
```yaml
# Copyright (c) 2025 Intel Corp.
# SPDX-License-Identifier: Apache-2.0

# Common fields for CPU Frequency

include: base.yaml

description: CPU Frequency Configuration Node
compatible: "zephyr,cpu-freq"
properties:
  cfgdata:
    type: array
    required: true
    description:  |
      List of configuration pairs representing a CPU usage threshold and
      corresponding CPU frequency in Hz. Each configuration pair consists of
      [threshold, frequency].
      For example
        cfgdata = <75 1000000000>, <50 800000000>, <25 300000000>;
      This means
        - If threshold is 75% or higher, set frequency to 1 GHz
        - If threshold is 50% or higher, set frequency to 800 MHz
        - If threshold is 25% or higher, set frequency to 300 MHz
```

## dts/bindings/cpu_freq/zephyr,cpu-freq-thermal-cap.yaml
```yaml
# Copyright 2026 NXP
# SPDX-License-Identifier: Apache-2.0

description: |
  CPU frequency thermal cap.

  Thermal cap constraints use the performance-states child order as the
  CPU frequency ordering: lower index P-states are treated as higher-performance,
  higher index P-states are treated as lower-performance and more restrictive.

compatible: "zephyr,cpu-freq-thermal-cap"

properties:
  sensor:
    type: phandle
    required: true
    description: |
      Temperature sensor used to compute the CPU frequency thermal cap.

  sensor-channel:
    type: string
    default: "die-temp"
    enum:
      - "die-temp"
      - "ambient-temp"
    description: |
      Sensor channel used for temperature samples.

  polling-delay-ms:
    type: int
    default: 1000
    description: |
      Polling interval in milliseconds while no thermal trip is active.

  trip-active-polling-delay-ms:
    type: int
    default: 100
    description: |
      Polling interval in milliseconds while one or more thermal trips are active.
      This is typically shorter than polling-delay-ms so cap changes and release
      decisions are reflected promptly.

child-binding:
  description: |
    CPU frequency thermal trip point

  properties:
    temperature-millicelsius:
      type: int
      required: true
      description: |
        Temperature threshold in millicelsius. When this threshold is reached, the
        trip becomes active and constrains CPU frequency to cap-pstate or lower.

    hysteresis-millicelsius:
      type: int
      required: true
      description: |
        Hysteresis in millicelsius. An active trip is released when the measured
        temperature falls to temperature-millicelsius minus this value.

    cap-pstate:
      type: phandle
      required: true
      description: |
        Highest-performance P-state allowed while this trip is active.
        The referenced P-state must belong to the ordered performance-states table.
```

## dts/bindings/crc/ambiq,hw-crc32.yaml
```yaml
# Copyright (c) 2025, Ambiq
# Author: Richard S Wheatley
# SPDX-License-Identifier: Apache-2.0

description: |
    Hardware CRC32 Cyclic Redundancy Check Module.

    This module implements a hardware-based CRC32 calculation.

compatible: "ambiq,hw-crc32"

include: base.yaml

properties:
  reg:
    required: true
```

## dts/bindings/crc/nxp,crc.yaml
```yaml
# Copyright 2025 NXP
# SPDX-License-Identifier: Apache-2.0

title: NXP CRC (Cyclic Redundancy Check) device

description: NXP CRC (Cyclic Redundancy Check) driver

compatible: "nxp,crc"

include: [base.yaml]

properties:
  reg:
    required: true
```

## dts/bindings/crc/nxp,lpc-crc.yaml
```yaml
# Copyright 2025 NXP
# SPDX-License-Identifier: Apache-2.0

title: NXP LPC CRC (Cyclic Redundancy Check) device

description: NXP LPC CRC (Cyclic Redundancy Check) driver

compatible: "nxp,lpc-crc"

include: [base.yaml]

properties:
  reg:
    required: true
```

## dts/bindings/crc/renesas,ra-crc.yaml
```yaml
# Copyright (c) 2025 Renesas Electronics Corporation
# SPDX-License-Identifier: Apache-2.0

title: Renesas RA CRC (Cyclic Redundancy Check) device

description: Renesas RA CRC (Cyclic Redundancy Check) driver

compatible: "renesas,ra-crc"

include: [base.yaml]

properties:
  reg:
    required: true

  clocks:
    required: true
```

## dts/bindings/crc/sifli,sf32lb-crc.yaml
```yaml
# Copyright (c) 2025 SiFli Technologies(Nanjing) Co., Ltd
# SPDX-License-Identifier: Apache-2.0

title: SiFli SF32LB CRC (Cyclic Redundancy Check) device

description: |
  Binding for the CRC peripheral found on SiFli SF32LB SoCs.

compatible: "sifli,sf32lb-crc"

include: [base.yaml]

properties:
  reg:
    required: true

  clocks:
    required: true
```

## dts/bindings/crc/silabs,gpcrc.yaml
```yaml
# Copyright 2026 Phuc Hoang
# SPDX-License-Identifier: Apache-2.0

title: Silabs General Purpose CRC (Cyclic Redundancy Check)

description: |
  Silabs General Purpose CRC (Cyclic Redundancy Check) driver

  The GPCRC module is a peripheral that implements a Cyclic Redundancy Check (CRC) function.
  It supports a fixed 32-bit polynomial and a user configurable 16-bit polynomial.
  The fixed 32-bit polynomial is the commonly used IEEE 802.3 polynomial 0x04C11DB7.

compatible: "silabs,gpcrc"

include: [base.yaml]

properties:
  reg:
    required: true
```

## dts/bindings/crc/st,stm32-crc.yaml
```yaml
# Copyright (c) 2026 STMicroelectronics
# SPDX-License-Identifier: Apache-2.0

title: STM32 CRC calculation unit

description: |
  Cyclic Redundancy Check (CRC) calculation unit with
  programmable initial value and programmable polynomials
  of 7-, 8-, 16- and 32-bit size.

compatible: "st,stm32-crc"

include: [base.yaml, reset-device.yaml]

properties:
  reg:
    required: true

  clocks:
    required: true
```

## dts/bindings/crypto/arm,cryptocell-310.yaml
```yaml
# Copyright (c) 2018, Nordic Semiconductor ASA
# SPDX-License-Identifier: Apache-2.0

description: ARM TrustZone CryptoCell 310

compatible: "arm,cryptocell-310"

include: base.yaml

properties:
  reg:
    required: true

  interrupts:
    required: true
```
