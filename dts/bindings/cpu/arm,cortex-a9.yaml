## dts/bindings/cpu/arm,cortex-a9.yaml
```yaml
# Copyright (c) 2025 Muhammad Waleed Badar
# SPDX-License-Identifier: Apache-2.0

description: ARM Cortex-A9 CPU

compatible: "arm,cortex-a9"

include: cpu.yaml
```

## dts/bindings/cpu/arm,cortex-m.yaml
```yaml
# Copyright (c) 2021 Nordic Semiconductor ASA
# SPDX-License-Identifier: Apache-2.0

# Common fields for ARM Cortex-M CPU

include: cpu.yaml

properties:
    swo-ref-frequency:
      type: int
      required: false
      description: Reference clock frequency for SWO if different than CPU clock.
```

## dts/bindings/cpu/arm,cortex-m0+.yaml
```yaml
# Copyright (c) 2018 Nordic Semiconductor ASA
# SPDX-License-Identifier: Apache-2.0

description: ARM Cortex-M0+ CPU

compatible: "arm,cortex-m0+"

include: cpu.yaml
```

## dts/bindings/cpu/arm,cortex-m1.yaml
```yaml
# Copyright (c) 2020 Henrik Brix Andersen <henrik@brixandersen.dk>
# SPDX-License-Identifier: Apache-2.0

description: ARM Cortex-M1 CPU

compatible: "arm,cortex-m1"

include: arm,cortex-m.yaml
```

## dts/bindings/cpu/arm,cortex-m23.yaml
```yaml
# Copyright (c) 2019 Nordic Semiconductor ASA
# SPDX-License-Identifier: Apache-2.0

description: ARM Cortex-M23 CPU

compatible: "arm,cortex-m23"

include: arm,cortex-m.yaml
```

## dts/bindings/cpu/arm,cortex-m3.yaml
```yaml
# Copyright (c) 2018 Nordic Semiconductor ASA
# SPDX-License-Identifier: Apache-2.0

description: ARM Cortex-M3 CPU

compatible: "arm,cortex-m3"

include: arm,cortex-m.yaml
```

## dts/bindings/cpu/arm,cortex-m33.yaml
```yaml
# Copyright (c) 2019 Nordic Semiconductor ASA
# SPDX-License-Identifier: Apache-2.0

description: ARM Cortex-M33 CPU

compatible: "arm,cortex-m33"

include: arm,cortex-m.yaml
```

## dts/bindings/cpu/arm,cortex-m33f.yaml
```yaml
# Copyright (c) 2020 Nordic Semiconductor ASA
# SPDX-License-Identifier: Apache-2.0

description: ARM Cortex-M33F CPU

compatible: "arm,cortex-m33f"

include: arm,cortex-m.yaml
```

## dts/bindings/cpu/arm,cortex-m4.yaml
```yaml
# Copyright (c) 2018 Nordic Semiconductor ASA
# SPDX-License-Identifier: Apache-2.0

description: ARM Cortex-M4 CPU

compatible: "arm,cortex-m4"

include: arm,cortex-m.yaml
```

## dts/bindings/cpu/arm,cortex-m4f.yaml
```yaml
# Copyright (c) 2018 Nordic Semiconductor ASA
# SPDX-License-Identifier: Apache-2.0

description: ARM Cortex-M4F CPU

compatible: "arm,cortex-m4f"

include: arm,cortex-m.yaml
```

## dts/bindings/cpu/arm,cortex-m52.yaml
```yaml
# Copyright (c) 2025 Synaptics Incorporated
# SPDX-License-Identifier: Apache-2.0

description: ARM Cortex-M52 CPU

compatible: "arm,cortex-m52"

include: arm,cortex-m.yaml
```

## dts/bindings/cpu/arm,cortex-m52f.yaml
```yaml
# Copyright (c) 2025 Synaptics Incorporated
# SPDX-License-Identifier: Apache-2.0

description: ARM Cortex-M52F CPU

compatible: "arm,cortex-m52f"

include: arm,cortex-m.yaml
```

## dts/bindings/cpu/arm,cortex-m55.yaml
```yaml
# Copyright (c) 2024 Meta Platforms
# SPDX-License-Identifier: Apache-2.0

description: ARM Cortex-M55 CPU

compatible: "arm,cortex-m55"

include: arm,cortex-m.yaml
```

## dts/bindings/cpu/arm,cortex-m55f.yaml
```yaml
# Copyright (c) 2024 Meta Platforms
# SPDX-License-Identifier: Apache-2.0

description: ARM Cortex-M55F CPU

compatible: "arm,cortex-m55f"

include: arm,cortex-m.yaml
```

## dts/bindings/cpu/arm,cortex-m7.yaml
```yaml
# Copyright (c) 2018 Nordic Semiconductor ASA
# SPDX-License-Identifier: Apache-2.0

description: ARM Cortex-M7 CPU

compatible: "arm,cortex-m7"

include: arm,cortex-m.yaml
```

## dts/bindings/cpu/arm,cortex-m85.yaml
```yaml
# Copyright (c) 2024 Renesas Electronics Corporation
# SPDX-License-Identifier: Apache-2.0

description: ARM Cortex-M85 CPU

compatible: "arm,cortex-m85"

include: arm,cortex-m.yaml
```

## dts/bindings/cpu/arm,cortex-m85f.yaml
```yaml
# Copyright (c) 2024 Renesas Electronics Corporation
# SPDX-License-Identifier: Apache-2.0

description: ARM Cortex-M85F CPU

compatible: "arm,cortex-m85f"

include: arm,cortex-m.yaml
```

## dts/bindings/cpu/arm,cortex-r4.yaml
```yaml
# Copyright (c) 2019 Stephanos Ioannidis <root@stephanos.io>
# SPDX-License-Identifier: Apache-2.0

description: ARM Cortex-R4 CPU

compatible: "arm,cortex-r4"

include: cpu.yaml
```

## dts/bindings/cpu/arm,cortex-r4f.yaml
```yaml
# Copyright (c) 2019 Stephanos Ioannidis <root@stephanos.io>
# SPDX-License-Identifier: Apache-2.0

description: ARM Cortex-R4F CPU

compatible: "arm,cortex-r4f"

include: cpu.yaml
```

## dts/bindings/cpu/arm,cortex-r5.yaml
```yaml
# Copyright (c) 2019 Stephanos Ioannidis <root@stephanos.io>
# SPDX-License-Identifier: Apache-2.0

title: ARM Cortex-R5 CPU

description: |
    This is a representation of ARM Cortex-R5 CPU.

compatible: "arm,cortex-r5"

include: cpu.yaml
```

## dts/bindings/cpu/arm,cortex-r52.yaml
```yaml
# Copyright (c) 2021 Arm Limited (or its affiliates). All rights reserved.
# SPDX-License-Identifier: Apache-2.0

description: ARM Cortex-R52 CPU

compatible: "arm,cortex-r52"

include: cpu.yaml
```

## dts/bindings/cpu/arm,cortex-r5f.yaml
```yaml
# Copyright (c) 2019 Stephanos Ioannidis <root@stephanos.io>
# SPDX-License-Identifier: Apache-2.0

description: ARM Cortex-R5F CPU

compatible: "arm,cortex-r5f"

include: cpu.yaml
```

## dts/bindings/cpu/arm,cortex-r7.yaml
```yaml
# Copyright (c) 2021 IoT.bzh
# SPDX-License-Identifier: Apache-2.0

description: ARM Cortex-R7 CPU

compatible: "arm,cortex-r7"

include: cpu.yaml
```

## dts/bindings/cpu/arm,cortex-r8.yaml
```yaml
# Copyright (c) 2025 Renesas Electronics Corporation
# SPDX-License-Identifier: Apache-2.0

description: ARM Cortex-R8 CPU

compatible: "arm,cortex-r8"

include: cpu.yaml
```

## dts/bindings/cpu/arm,cortex-r82.yaml
```yaml
# Copyright (c) 2021 Arm Limited (or its affiliates). All rights reserved.
# SPDX-License-Identifier: Apache-2.0

description: ARM Cortex-R82 CPU

compatible: "arm,cortex-r82"

include: cpu.yaml
```
