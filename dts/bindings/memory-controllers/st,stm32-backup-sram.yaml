## dts/bindings/memory-controllers/st,stm32-xspi-psram.yaml
```yaml
# Copyright (c) 2025 STMicroelectronics
# SPDX-License-Identifier: Apache-2.0

description: |
  STM32 XSPI PSRAM.

compatible: "st,stm32-xspi-psram"

include: [base.yaml]

properties:
  reg:
    required: true

  size:
    type: int
    required: true
    description: Flash Memory size in bits

  max-frequency:
    type: int
    required: true
    description: Maximum clock frequency of device's xSPI interface in Hz

  fixed-latency:
    type: boolean
    description: |
      Read latency type: variable if not set, fixed if set.

  read-latency:
    type: int
    default: 2
    description: |
      Read latency code
      - 0: LCx2 3 / Fmax 66 MHz
      - 1: LCx2 4 / Fmax 109 MHz
      - 2: LCx2 5 / Fmax 133 MHz
      - 3: LCx2 6 / Fmax 166 MHz
      - 4: LCx2 7 / Fmax 200 MHz
    enum:
      - 0
      - 1
      - 2
      - 3
      - 4

  drive-strength:
    type: int
    default: 0
    description: |
      Drive strength code:
      - 0: Full
      - 1: Half
      - 2: 1/4
      - 3: 1/8
    enum:
      - 0
      - 1
      - 2
      - 3

  write-latency:
    type: int
    default: 2
    description: |
      Write latency code:
      - 0: WLC 3 / Fmax 66 MHz
      - 4: WLC 4 / Fmax 109 MHz
      - 2: WLC 5 / Fmax 133 MHz
      - 5: WLC 6 / Fmax 166 MHz
      - 1: WLC 7 / Fmax 200 MHz
    enum:
      - 0
      - 1
      - 2
      - 4
      - 5

  refresh-rate:
    type: int
    default: 0
    description: |
      - 0: Always 4x refresh
      - 1: Enables 1x refesh when temperature allows
      - 3: Enables 0.5x refresh when temperature allows
    enum:
      - 0
      - 1
      - 3

  pasr:
    type: int
    default: 0
    description: |
      Refresh coverage:
      - 0: Full array
      - 1: Bottom 1/2 array
      - 2: Bottom 1/4 array
      - 3: Bottom 1/8 array
      - 4: None
      - 5: Top 1/2 array
      - 6: Top 1/4 array
      - 7: Top 1/8 array
    enum:
      - 0
      - 1
      - 2
      - 3
      - 4
      - 5
      - 6
      - 7

  io-x16-mode:
    type: boolean
    description: |
      Mode is x8 if not set, and x16 if set.

  rbx:
    type: boolean
    description: |
      If not enabled, reads stay within page (row) boundary.
      If enabled, allows reads cross page (row) boundary.

  burst-length:
    type: int
    default: 1
    description: |
      Burst length:
      0: 16 Byte/Word Wrap
      1: 32 Byte/Word Wrap
      2: 64 Byte/Word Wrap
      3: 2K Byte/1K Word Wrap
    enum:
      - 0
      - 1
      - 2
      - 3

  burst-type-hybrid-wrap:
    type: boolean
    description: |
      If not enabled, burst-length sets the burst address space in which the
      device will continually wrap within.
      If enabled, the device will burst through the initial wrapped burst length
      once, then continue to burst incrementally up to maximum column address
      (2K in X8 mode/1K in X16 mode) before wrapping around within the entire
      column address space

  st,csbound:
    type: int
    default: 3
    description: |
      Limit a transaction to a boundary of aligned addresses. The size of the
      alignment is given by the value: 2^(csbound) bits.
      A csbound value of 0 means the feature is disabled.
      The default is the minimum recommended value in the Reference Manual. It
      is recommended to set this value according to the length of the burst wrap
      of the PSRAM device for the linear burst command.
    enum: [0, 1, 2, 3, 4, 5, 6, 7, 8, 9, 10, 11, 12, 13, 14, 15, 16, 17, 18, 19, 20,
           21, 22, 23, 24, 25, 26, 27, 28, 29, 30, 31]
```

## dts/bindings/memory-controllers/st,stm32h7-fmc.yaml
```yaml
# Copyright (c) 2022 Georgij Cernysiov
# SPDX-License-Identifier: Apache-2.0

description: |
  STM32H7 Flexible Memory Controller (FMC).

  The FMC allows to interface with static-memory mapped external devices such as
  SRAM, NOR Flash, NAND Flash, SDRAM...

  All external memories share the addresses, data and control signals with the
  controller. Each external device is accessed by means of a unique chip select.
  The FMC performs only one access at a time to an external device.

  The flexible memory controller includes three memory controllers:

    - NOR/PSRAM memory controller
    - NAND memory controller (some devices also support PC Card)
    - Synchronous DRAM (SDRAM/Mobile LPSDR SDRAM) controller

  Each memory controller is defined below the FMC DeviceTree node and is managed
  by a separate Zephyr device. However, because signals are shared the FMC
  device handles the signals and the peripheral clocks. FMC can be enabled
  in your board DeviceTree file like this:

  &fmc {
      status = "okay";
      pinctrl-0 = <&fmc_nbl0_pe0 &fmc_nbl1_pe1 &fmc_nbl2_pi4...>;
  };

compatible: "st,stm32h7-fmc"

include: ["st,stm32-fmc.yaml"]

properties:
  st,mem-swap:
    type: string
    default: "disable" # reset state
    enum:
      - "disable"
      - "sdram-sram"
      - "sdramb2"
    description: |
      The FMC bank mapping configuration (BMAP bits of FMC_BCR1).

      * disable    - Default mapping.
      * sdram-sram - Swap the NOR/PSRAM bank with SDRAM.
      * sdramb2    - Remaps the SDRAM bank2.

      If absent, then default mapping (disable) is used (reset state).
```

## dts/bindings/memory-controllers/zephyr,bbram-emul.yaml
```yaml
# Copyright (c) 2021 Google Inc.
# SPDX-License-Identifier: Apache-2.0

description: Zephyr, Battery Backed RAM emulator node

compatible: "zephyr,bbram-emul"

include: base.yaml

properties:
  size:
    type: int
    required: true
    description: Size of the BBRAM region in bytes.
```

## dts/bindings/memory-controllers/zephyr,bbram-retained_mem..yaml
```yaml
# Copyright (c) 2026 Google Inc.
# SPDX-License-Identifier: Apache-2.0

description: |
  Battery Backed RAM based on retained memory feature.

compatible: "zephyr,bbram-retained-mem"

include: base.yaml

properties:
  "#address-cells":
    const: 1

  "#size-cells":
    const: 1

examples:
  - |
    memory@100 {
      compatible = "zephyr,memory-region", "mmio-sram";
      reg = <0x100 256>;
      zephyr,memory-region = "RetainedMem";
      status = "okay";

      retained-ram {
        compatible = "zephyr,retained-ram";
        status = "okay";
        #address-cells = <1>;
        #size-cells = <1>;

        retained - bbram: bbram@0 {
          compatible = "zephyr,bbram-retained-mem";
          status = "okay";
          reg = <0x0 256>;
        };
      };
    };
```

## dts/bindings/memory-window/intel,adsp-mem-window.yaml
```yaml
description: ADSP Memory Window

compatible: "intel,adsp-mem-window"

include: [base.yaml]

properties:
  reg:
    required: true

  initialize:
    type: boolean
    description: Initialize memory region and flush cache.

  memory:
    required: true
    type: phandle
    description: memory region the windows are exposed through.

  offset:
    type: int
    description: offset from memory base.

  read-only:
    type: boolean
```

## dts/bindings/memory/microchip,47l16.yaml
```yaml
# Copyright (c) 2025, Ambiq Micro Inc. <www.ambiq.com>
# SPDX-License-Identifier: Apache-2.0

description: |
  Microchip 47L16 2KB I2C SRAM with EEPROM backup (EERAM).

  The device provides 2048 bytes of SRAM accessible over I2C at address
  0x50 (default, adjustable via A2:A1:A0). A second I2C address at 0x18
  provides access to the control and status registers used to trigger
  or configure the automatic EEPROM backup/restore.

  SRAM writes are immediate with no page-crossing restrictions or write
  delays. The driver uses the standard Zephyr EEPROM API.

compatible: "microchip,47l16"

include: [i2c-device.yaml]

properties:
  size:
    type: int
    required: true
    description: Total SRAM size in bytes.

  pagesize:
    type: int
    required: true
    description: |
      Nominal page size in bytes (for compatibility with EEPROM API).
      Note: SRAM writes are not page-restricted.

  address-width:
    type: int
    required: true
    description: |
      Number of address bits (8 or 16).
```

## dts/bindings/mfd/adi,ad5592.yaml
```yaml
# Copyright (C) 2023 Grinn
# SPDX-License-Identifier: Apache-2.0

description: Analog AD5592 ADC/DAC/GPIO chip

compatible: "adi,ad5592"

include: spi-device.yaml

properties:
  reset-gpios:
    type: phandle-array
    description: RESET pin
```

## dts/bindings/mfd/adi,ad559x-i2c.yaml
```yaml
# Copyright (C) 2024, Vitrolife A/S
# SPDX-License-Identifier: Apache-2.0

description: Analog AD559X ADC/DAC/GPIO chip via I2C bus

compatible: "adi,ad559x"

include: [i2c-device.yaml, "adi,ad559x-common.yaml"]
```

## dts/bindings/mfd/adi,ad559x-spi.yaml
```yaml
# Copyright (c) 2024, Vitrolife A/S
# SPDX-License-Identifier: Apache-2.0

description: Analog AD559X ADC/DAC/GPIO chip via SPI bus

compatible: "adi,ad559x"

include: [spi-device.yaml, "adi,ad559x-common.yaml"]
```

## dts/bindings/mfd/adi,adp5360.yaml
```yaml
# Copyright (c) 2023, Nordic Semiconductor ASA
# Copyright (c) 2026, Analog Devices, Inc.
# SPDX-License-Identifier: Apache-2.0

description: Analog Devices ADP5360

compatible: "adi,adp5360"

include: i2c-device.yaml

properties:
  reg:
    required: true

  disable-vout-buck-reset:
    type: boolean
    description: |
      Enables the reset pin to be triggered by the buck voltage (VOUT1) monitor.

  enable-vout-buckboost-reset:
    type: boolean
    description: |
      Enables the reset pin to be triggered by the buck boost voltage (VOUT2) monitor.

  set-reset-timeout-1p6sec:
    type: boolean
    description: |
      Sets the reset timeout period to 1.6sec. if unset, timeout is set to 200ms.

  watchdog-timeout-period:
    type: int
    default: 0
    enum:
      - 0 # 12.5s
      - 1 # 25.6s
      - 2 # 50s
      - 3 # 100s
    description: |
      Sets the watchdog timeout period.

  enable-watchdog-timer:
    type: boolean
    description: |
      Enables the watchdog timer on the device to trigger on timeout.

  enable-manual-reset-to-shipment:
    type: boolean
    description: |
      Enables the device to enter shipment mode for 12 seconds upon triggering
      the manual reset (MR) pin.

  interrupt-gpios:
    type: phandle-array
    description: |
      MCU GPIO input pin for sensing Interrupt status flags.

  manual-reset-gpios:
    type: phandle-array
    description: |
      MCU GPIO output pin for triggering software device reset via trigger.

  reset-status-gpios:
    type: phandle-array
    description: |
      MCU GPIO input pin for sensing device reset status flags.

  charger-en-gpios:
    type: phandle-array
    description: |
      MCU GPIO output pin for triggering charger enable via trigger.

  pgood1-gpios:
    type: phandle-array
    description: |
      MCU GPIO input pin for sensing device PGOOD1 status flags.

  pgood2-gpios:
    type: phandle-array
    description: |
      MCU GPIO input pin for sensing device PGOOD2 status flags.
```

## dts/bindings/mfd/adi,adp5585.yaml
```yaml
# Copyright 2024 NXP
# SPDX-License-Identifier: Apache-2.0

description: Analog ADP5585 GPIO/keypad/PWM chip

compatible: "adi,adp5585"

include: i2c-device.yaml

properties:
  reset-gpios:
    type: phandle-array
    description: RESET pin

  nint-gpios:
    type: phandle-array
    description: |
      Connection for the NINT signal. This signal is active-low when
      produced by adp5585 GPIO node.
```

## dts/bindings/mfd/adi,max22017.yaml
```yaml
# Copyright (c) 2024 Analog Devices Inc.
# Copyright (c) 2024 BayLibre SAS
# SPDX-License-Identifier: Apache-2.0

include: spi-device.yaml

description: Analog MAX22017 DAC/GPIO chip common properties

properties:
  rst-gpios:
    description: Reset pin for max22017.
    type: phandle-array

  crc-mode:
    description: Enables CRC over SPI.
    type: boolean

  int-gpios:
    description: Interrupt gpio
    type: phandle-array

compatible: "adi,max22017"
```

## dts/bindings/mfd/adi,max2221x.yaml
```yaml
# Copyright (c) 2025 Analog Devices Inc.
# SPDX-License-Identifier: Apache-2.0

include: spi-device.yaml

description: Analog Devices MAX2221X multi-function device driver

compatible: "adi,max2221x"
```

## dts/bindings/mfd/adi,maxq10xx.yaml
```yaml
# Copyright (c) 2025 Vogl Electronic GmbH
# SPDX-License-Identifier: Apache-2.0

description: ADI MAXQ10XX

compatible: "adi,maxq10xx"

include: spi-device.yaml
```

## dts/bindings/mfd/ambiq,iom.yaml
```yaml
# Copyright (c) 2025 Ambiq Micro Inc.
# SPDX-License-Identifier: Apache-2.0

description: Ambiq SPI/I2C controller common properties

compatible: "ambiq,iom"

include: [base.yaml]

properties:
  reg:
    required: true

  interrupts:
    required: true

  dma-mode:
    description: Enables DMA over SPI/I2C.
    type: boolean

  cmdq-buffer-location:
    type: string
    description: |
      Define the DMA command queue buffer location section

  cmdq-buffer-size:
    type: int
    description: |
      Define the DMA command queue buffer size in (4-byte) words
```
