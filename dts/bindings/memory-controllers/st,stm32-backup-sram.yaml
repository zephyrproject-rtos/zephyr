## dts/bindings/memory-controllers/st,stm32-fmc-sdram.yaml
```yaml
# Copyright (c) 2020, Teslabs Engineering S.L.
# SPDX-License-Identifier: Apache-2.0

description: |
  STM32 Flexible Memory Controller (SDRAM controller).

  The FMC SDRAM controller can be used to interface with external SDRAM
  memories. Up to 2 SDRAM banks are supported with independent configuration. It
  is worth to note that while settings are independent, some are shared or are
  required to be set according to the most constraining device. Refer to the
  properties description or the datasheet for more details.

  The FMC SDRAM controller is defined below the FMC node and SDRAM banks are
  defined as child nodes of the FMC SDRAM node. You can either have bank 1 (@0),
  bank 2 (@1) or both. You can enable the FMC SDRAM controller in your board
  DeviceTree file like this:

  &fmc {
      status = "okay";
      pinctrl-0 = <&fmc_nbl0_pe0 &fmc_nbl1_pe1 &fmc_nbl2_pi4...>;

      sdram {
          status = "okay";

          power-up-delay = <100>;
          num-auto-refresh = <8>;
          mode-register = <0x220>;
          refresh-rate = <603>;

          bank@0 {
              reg = <0>;

              st,sdram-control = <STM32_FMC_SDRAM_NC_9
                                  STM32_FMC_SDRAM_NR_12
                                  STM32_FMC_SDRAM_MWID_32
                                  STM32_FMC_SDRAM_NB_4
                                  STM32_FMC_SDRAM_CAS_2
                                  STM32_FMC_SDRAM_SDCLK_PERIOD_2
                                  STM32_FMC_SDRAM_RBURST_ENABLE
                                  STM32_FMC_SDRAM_RPIPE_0>;
              st,sdram-timing = <2 6 4 6 2 2 2>;
          };

          bank@1 {
              reg = <1>;
              ...
          };
      };
  };

  Note that you will find definitions for the st,sdram-control field at
  dt-bindings/memory-controller/stm32-fmc-sdram.h. This file is already included
  in the SoC DeviceTree files.

  Finally, in order to make the memory available you will need to define new
  memory device/s in DeviceTree:

  sdram1: sdram@c0000000 {
      compatible = "mmio-sram";
      device_type = "memory";
      reg = <0xc000000 DT_SIZE_M(X)>;
      zephyr,memory-region = "SDRAM1";
  };

  sdram2: sdram@d0000000 {
      compatible = "mmio-sram";
      device_type = "memory";
      reg = <0xd000000 DT_SIZE_M(X)>;
      zephyr,memory-region = "SDRAM2";
  };

  It is important to use sdram1 and sdram2 node labels for bank 1 and bank 2
  respectively. Memory addresses are 0xc0000000 and 0xd0000000 for bank 1 and
  bank 2 respectively.

compatible: "st,stm32-fmc-sdram"

include: base.yaml

properties:
  label:
    required: true

  "#address-cells":
    required: true
    const: 1

  "#size-cells":
    required: true
    const: 0

  power-up-delay:
    type: int
    default: 100
    description: Power-up delay in microseconds.

  num-auto-refresh:
    type: int
    default: 8
    description: Number of auto-refresh commands issued.

  mode-register:
    type: int
    required: true
    description:
      A 14-bit field that defines the SDRAM Mode Register content. The mode
      register bits are also used to program the extended mode register for
      mobile SDRAM.

  refresh-rate:
    type: int
    required: true
    description:
      A 13-bit field defines the refresh rate of the SDRAM device. It is
      expressed in number of memory clock cycles. It must be set at least to
      41 SDRAM clock cycles.

child-binding:
  description: SDRAM bank.

  properties:
    reg:
      type: int
      required: true

    st,sdram-control:
      type: array
      required: true
      description: |
        SDRAM control configuration. Expected fields, in order, are,

        - NC: Number of bits of a column address.
        - NR: Number of bits of a row address.
        - MWID: Memory device width.
        - NB: Number of internal banks.
        - CAS: SDRAM CAS latency in number of memory clock cycles.
        - SDCLK: SDRAM clock period. If two SDRAM devices are used both should
          have the same value.
        - RBURST: Enable burst read mode. If two SDRAM devices are used both
          should have the same value.
        - RPIPE: Delay, in fmc_ker_ck clock cycles, for reading data after CAS
          latency. If two SDRAM devices are used both should have the same
          value.

    st,sdram-timing:
      type: array
      required: true
      description: |
        SDRAM timing configuration. Expected fields, in order, are,

        - TMRD: Delay between a Load Mode Register command and an Active or
          Refresh command in number of memory clock cycles.
        - TXSR: Delay from releasing the Self-refresh command to issuing the
          Activate command in number of memory clock cycles. If two SDRAM
          devices are used, the FMC_SDTR1 and FMC_SDTR2 must be programmed with
          the same TXSR timing corresponding to the slowest SDRAM device
        - TRAS: Minimum Self-refresh period in number of memory clock cycles.
        - TRC: Delay between the Refresh command and the Activate command, as
          well as the delay between two consecutive Refresh commands. It is
          expressed in number of memory clock cycles. If two SDRAM devices are
          used, the TRC must be programmed with the timings of the slowest
          device in both banks.
        - TWP: Delay between a Write and a Precharge command in number of memory
          clock cycles
        - TRP: Delay between a Precharge command and another command in number
          of memory clock cycles. If two SDRAM devices are used, the TRP must be
          programmed with the timing of the slowest device in both banks.
        - TRCD: Delay between the Activate command and a Read/Write command in
          number of memory clock cycles.
```

## dts/bindings/memory-controllers/st,stm32-fmc.yaml
```yaml
# Copyright (c) 2020, Teslabs Engineering S.L.
# SPDX-License-Identifier: Apache-2.0

description: |
  STM32 Flexible Memory Controller (FMC).

  The FMC allows to interface with static-memory mapped external devices such as
  SRAM, NOR Flash, NAND Flash, SDRAM...

  All external memories share the addresses, data and control signals with the
  controller. Each external device is accessed by means of a unique chip select.
  The FMC performs only one access at a time to an external device.

  The flexible memory controller includes three memory controllers:

    - NOR/PSRAM memory controller
    - NAND memory controller (some devices also support PC Card)
    - Synchronous DRAM (SDRAM/Mobile LPSDR SDRAM) controller

  Each memory controller is defined below the FMC DeviceTree node and is managed
  by a separate Zephyr device. However, because signals are shared the FMC
  device handles the signals and the peripheral clocks. FMC can be enabled
  in your board DeviceTree file like this:

  &fmc {
      status = "okay";
      pinctrl-0 = <&fmc_nbl0_pe0 &fmc_nbl1_pe1 &fmc_nbl2_pi4...>;
  };

compatible: "st,stm32-fmc"

include: [base.yaml, pinctrl-device.yaml]

properties:
    reg:
      required: true

    clocks:
      required: true

    pinctrl-0:
      required: true

    pinctrl-names:
      required: true
```

## dts/bindings/memory-controllers/st,stm32-ospi-psram-v2.yaml
```yaml
# Copyright (c) 2025 ZAL Zentrum für Angewandte Luftfahrtforschung GmbH
# SPDX-License-Identifier: Apache-2.0

title: STM32 OSPI PSRAM Controller

description: |
  STM32 OSPI PSRAM memory controller.
  Provides a communication interface allowing the microcontroller
  to communicate with an external PSRAM memory via the OSPI peripheral.
  The PSRAM can be configured as memory mapped and allows read/write
  operations like an internal device. In some STM32 series the D-CACH strictly recommend 
  to be enabled when using PSRAM in memory mapped mode.

compatible: "st,stm32-ospi-psram-v2"

include: [base.yaml]

properties:

  size:
    type: int
    required: true
    description: Memory size in bits

  max-frequency:
    type: int
    required: true
    description: Maximum clock frequency of device's OSPI interface in Hz

  st,csbound:
    type: int
    default: 5
    description: |
      Limit a transaction to a boundary of aligned addresses. The size of the
      alignment is given by the value: 2^(csbound) bits.
      A csbound value of 0 means the feature is disabled.
      The default is the minimum recommended value in the Reference Manual. It
      is recommended to set this value according to the length of the burst wrap
      of the PSRAM device for the linear burst command.
    enum: [0, 1, 2, 3, 4, 5, 6, 7, 8, 9, 10, 11, 12, 13, 14, 15, 16, 17, 18, 19, 20,
           21, 22, 23, 24, 25, 26, 27, 28, 29, 30, 31]

  cs-high-time-cycles:
    type: int
    description: |
      Minimum number of OSPI clock cycles that the CS signal is held high between
      two consecutive transactions. 
      If not specified, it will be calculated by the driver to ensure a 50-nanosecond delay between transactions.

  refresh-cycles:
    type: int
    default: 256
    description: |
      It enables the refresh rate feature. The chip select is released every
      Refresh+1 clock cycles.
      This parameter can be a value between 0 and 0xFFFFFFFF. 
      The default value is the minimum recommended value in the Reference Manual, 
      which corresponds to a refresh time of PSRAM device.
      100 MHz ESP-PSRAM64   < 600 
      100 MHz ISSI PSRAM (IS66/67WVS) < 300
      40 MHz ESP-PSRAM64    < 320
      40 MHz ISSI PSRAM (IS66/67WVS) < 160
```

## dts/bindings/memory-controllers/st,stm32-ospi-psram.yaml
```yaml
# Copyright (c) 2025 ZAL Zentrum für Angewandte Luftfahrtforschung GmbH
# SPDX-License-Identifier: Apache-2.0

title: STM32 OSPI PSRAM Controller

description: |
  STM32 OSPI PSRAM memory controller.
  Provides a communication interface allowing the microcontroller
  to communicate with an external PSRAM memory via the OSPI peripheral.
  The PSRAM can be configured as memory mapped and allows read/write
  operations like an internal device.

compatible: "st,stm32-ospi-psram"

include: [base.yaml]

properties:
  reg:
    required: true

  size:
    type: int
    required: true
    description: Memory size in bits

  max-frequency:
    type: int
    required: true
    description: Maximum clock frequency of device's OSPI interface in Hz

  fixed-latency:
    type: boolean
    description: Read latency — fixed when set, variable otherwise.

  drive-strength:
    type: int
    default: 0
    description: |
      Drive strength code:
      - 0: Full
      - 1: Half
      - 2: 1/4
      - 3: 1/8
    enum:
      - 0
      - 1
      - 2
      - 3

  read-latency:
    type: int
    default: 5
    description: |
      Read latency code
      - 0: LCx2 3 / Fmax 66 MHz
      - 1: LCx2 4 / Fmax 104 MHz
      - 2: LCx2 5 / Fmax 133 MHz
      - 3: LCx2 6 / Fmax 133 MHz
      - 4: LCx2 7 / Fmax 133 MHz
      - 5: LCx2 8 / Fmax 133 MHz
    enum:
      - 0
      - 1
      - 2
      - 3
      - 4
      - 5

  write-latency:
    type: int
    default: 2
    description: |
      Write latency code:
      - 0: LC 3 / Fmax 66 MHz
      - 1: LC 4 / Fmax 104 MHz
      - 2: LC 5 / Fmax 133 MHz
      - 3: LC 6 / Fmax 133 MHz
      - 4: LC 7 / Fmax 133 MHz
      - 5: LC 8 / Fmax 133 MHz
    enum:
      - 0
      - 1
      - 2
      - 3
      - 4
      - 5

  adaptive-refresh-rate:
    type: int
    default: 0
    description: |
      - 0: Fast Refresh
      - 1: Enables Slow Refresh when temperature allows
    enum:
      - 0
      - 1

  pasr:
    type: int
    default: 0
    description: |
      Partial Array Self-Refresh coverage:
      - 0: Full array
      - 1: Bottom 1/2 array
      - 2: Bottom 1/4 array
      - 3: Bottom 1/8 array
      - 4: None
      - 5: Top 1/2 array
      - 6: Top 1/4 array
      - 7: Top 1/8 array
    enum:
      - 0
      - 1
      - 2
      - 3
      - 4
      - 5
      - 6
      - 7

  rbx:
    type: boolean
    description: |
      If not enabled, reads stay within page (row) boundary.
      If enabled, allows reads cross page (row) boundary.

  burst-length:
    type: int
    default: 1
    description: |
      Burst length:
      0: 16 Byte/Word Wrap
      1: 32 Byte/Word Wrap
      2: 64 Byte/Word Wrap
      3: 1K Word Wrap
    enum:
      - 0
      - 1
      - 2
      - 3

  burst-type-hybrid-wrap:
    type: boolean
    description: |
      If not enabled, burst-length sets the burst address space in which the
      device will continually wrap within.
      If enabled, the device will burst through the initial wrapped burst length
      once, then continue to burst incrementally up to maximum column address
      (1K) before wrapping around within the entire column address space.
```

## dts/bindings/memory-controllers/st,stm32-xspi-hyperram.yaml
```yaml
# SPDX-FileCopyrightText: Copyright The Zephyr Project Contributors
# SPDX-License-Identifier: Apache-2.0

description: |
  STM32 XSPI HyperRAM (HyperBus).

  Configures an XSPI controller for HyperBus-protocol DRAM (e.g.
  Winbond W958D8NBYA5I) in memory-mapped mode.  The node must be a child
  of an st,stm32-xspi node.

compatible: "st,stm32-xspi-hyperram"

include: [base.yaml]

properties:
  reg:
    required: true

  size:
    type: int
    required: true
    description: Memory size in bits.

  max-frequency:
    type: int
    required: true
    description: Maximum clock frequency of the HyperBus interface in Hz.

  rw-recovery-time-cycle:
    type: int
    default: 7
    description: |
      Read-Write recovery time (tRWR) in XSPI clock cycles.
      Minimum CS-high time between consecutive transactions.

  access-time-cycle:
    type: int
    default: 7
    description: |
      Initial access (read) latency (tACC) in XSPI clock cycles.
      Passed as the HLCR.TACC field; must match the memory's configured
      read latency at the target operating frequency.

  fixed-latency:
    type: boolean
    description: |
      Use fixed latency mode.  When not set, variable latency is used
      and the memory drives RWDS low during the latency phase to signal
      additional wait cycles.

  write-zero-latency:
    type: boolean
    description: |
      Enable zero-latency writes.  When set, write transactions have no
      initial latency (HLCR.WZL=1).  When not set, writes use the same
      latency as reads.

  st,refresh:
    type: int
    required: true
    description: |
      Maximum number of XSPI clock cycles the chip select may remain
      asserted (tCSM).  A value of 0 disables the limit.  Set according
      to the memory datasheet and the actual XSPI clock frequency.
```

## dts/bindings/memory-controllers/st,stm32-xspi-psram-aps6404.yaml
```yaml
# Copyright (c) 2025 Mario Paja
# SPDX-License-Identifier: Apache-2.0

description: |
  STM32 XSPI PSRAM.

compatible: "st,stm32-xspi-psram-aps6404"

include: [base.yaml]

properties:
  reg:
    required: true

  size:
    type: int
    required: true
    description: Flash Memory size in bits

  max-frequency:
    type: int
    required: true
    description: Maximum clock frequency of device's xSPI (SPI) interface in Hz

  qspi-enable:
    type: boolean
    description: |
      Enable QSPI, SPI otherwise.

  st,csbound:
    type: int
    default: 3
    description: |
      Limit a transaction to a boundary of aligned addresses. The size of the
      alignment is given by the value: 2^(csbound) bits.
      A csbound value of 0 means the feature is disabled.
      The default is the minimum recommended value in the Reference Manual. It
      is recommended to set this value according to the length of the burst wrap
      of the PSRAM device for the linear burst command.
    enum: [0, 1, 2, 3, 4, 5, 6, 7, 8, 9, 10, 11, 12, 13, 14, 15, 16, 17, 18, 19, 20,
           21, 22, 23, 24, 25, 26, 27, 28, 29, 30, 31]
```
