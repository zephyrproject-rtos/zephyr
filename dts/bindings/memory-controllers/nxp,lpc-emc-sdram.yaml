## dts/bindings/misc/espressif,esp32-brownout.yaml
```yaml
# Copyright (c) 2026 Espressif Systems (Shanghai) Co., Ltd.
# SPDX-License-Identifier: Apache-2.0

description: |
  Espressif VDD brown-out detector.

  The threshold is the supply voltage below which the detector fires. The
  values are the ESP-IDF levels for the SoC; a value that the SoC does not
  implement fails the build. On ESP32-P4 revision 0.x the hardware ignores
  the programmed level and uses a fixed threshold of about 2.52 V.

  The action selects a hardware reset or an interrupt that resets from
  software. Flash suspend and RF power-down are enabled by default and
  can each be disabled. The detector does not cover the ESP32-P4 VBAT
  monitor.

compatible: "espressif,esp32-brownout"

include: base.yaml

properties:
  brownout-threshold-microvolt:
    type: int
    required: true
    enum:
      - 2400000
      - 2420000
      - 2430000
      - 2440000
      - 2480000
      - 2510000
      - 2520000
      - 2560000
      - 2570000
      - 2580000
      - 2600000
      - 2620000
      - 2640000
      - 2650000
      - 2670000
      - 2700000
      - 2730000
      - 2760000
      - 2770000
      - 2780000
      - 2790000
      - 2800000
      - 2830000
      - 2840000
      - 2880000
      - 2920000
      - 2940000
      - 2950000
      - 2980000
      - 3100000
      - 3140000
      - 3190000
      - 3270000
      - 3300000
    description: |
      Brown-out threshold in microvolts. The register code is selected from
      the level table of the SoC.

  espressif,brownout-action:
    type: string
    default: "reset"
    enum:
      - "reset"
      - "interrupt"
    description: |
      Action taken when the supply drops below the threshold. "reset" uses
      the hardware brown-out reset. "interrupt" disables that reset and
      resets from the brown-out interrupt. On ESP32 chip revision 1 the
      hardware reset does not work, so "reset" uses the interrupt path.

  espressif,flash-power-down:
    type: string
    default: "enabled"
    enum:
      - "enabled"
      - "disabled"
    description: |
      Suspend flash when the supply drops below the threshold. "enabled"
      suspends flash. "disabled" leaves flash running.

  espressif,rf-power-down:
    type: string
    default: "enabled"
    enum:
      - "enabled"
      - "disabled"
    description: |
      Power down the RF when the supply drops below the threshold.
      "enabled" powers the RF down. "disabled" leaves the RF powered.

  interrupts:
    required: true
```

## dts/bindings/misc/nordic,nrf-ain.yaml
```yaml
# Copyright (c) 2026 Nordic Semiconductor ASA
# SPDX-License-Identifier: Apache-2.0

description: |
  Nordic external analog input (AIN) to GPIO pin mapping

  Describes which GPIO pin is connected to each external analog input of the
  SoC. The mapping is shared by all analog peripherals that use AIN inputs
  (SAADC, COMP and LPCOMP).

  Entry index is the AIN number, so the n-th entry describes AINn. AIN inputs
  that do not exist on the SoC are described with an empty entry (<0>).
  Internal inputs (for example VDD) are not listed.

  Example for a SoC with only AIN2 (P0.04) and AIN3 (P0.05):

    nrf_ain: analog-inputs {
            compatible = "nordic,nrf-ain";
            ain-gpios = <0>, <0>, <&gpio0 4 0>, <&gpio0 5 0>;
    };

  In SoC devicetree files the property is generated from the NRFX_AIN_TABLE
  definition provided by nrfx, which is also used to build the nrfx analog
  input tables:

    #include <nrfx_analog/nrf54l_05_10_15_ain.h>
    #include <zephyr/dt-bindings/misc/nordic-nrf-ain.h>

    nrf_ain: analog-inputs {
            compatible = "nordic,nrf-ain";
            ain-gpios = <NRF_AIN_DT_GPIOS>;
    };

compatible: "nordic,nrf-ain"

properties:
  ain-gpios:
    type: phandle-array
    required: true
    description: |
      GPIO pin connected to each external analog input, indexed by AIN number.
      Use <0> for AIN inputs that are not available on the SoC.
```

## dts/bindings/misc/nxp,lcu.yaml
```yaml
# SPDX-FileCopyrightText: Copyright 2026 NXP
# SPDX-License-Identifier: Apache-2.0

description: |
  NXP logic control unit. Each instance contains three logic cells,
  each with four shared inputs and four independently programmable LUT
  outputs. Drivers use the NXP LCU API to reserve an entire logic cell,
  not individual inputs or outputs.

compatible: "nxp,lcu"

include: base.yaml

properties:
  reg:
    required: true

  clocks:
    required: true
```

## dts/bindings/misc/ti,cc13x4-cc26x4-idau.yaml
```yaml
# Copyright (c) 2026 Texas Instruments
# SPDX-License-Identifier: Apache-2.0

description: |
  TI CC13x4/CC26x4 TrustZone IDAU boundary configuration, written to the CCFG.

  When this node is enabled, its boundaries replace the TI factory defaults.
  Example:

    &idau {
            status = "okay";
            flash-ns-boundary = <0x10>;
            sram-ns-boundary = <0x8>;
    };

compatible: "ti,cc13x4-cc26x4-idau"

include: base.yaml

properties:
  flash-ns-boundary:
    type: int
    default: 0
    description: |
      Flash non-secure address boundary (CCFG TRUSTZONE_FLASH_CFG NSADDR
      field, 10 bits). 0 means all flash except the lowest 8 KB is
      non-secure.

  sram-ns-boundary:
    type: int
    default: 0
    description: |
      SRAM non-secure address boundary (CCFG TRUSTZONE_SRAM_CFG NSADDR
      field, 9 bits). 0 means all SRAM is non-secure.
```

## dts/bindings/misc/ti,cc13x4-cc26x4-sram-config.yaml
```yaml
# Copyright (c) 2026 Texas Instruments
# SPDX-License-Identifier: Apache-2.0

description: |
  TI CC13x4/CC26x4 SRAM configuration, written to the CCFG.

  SRAM parity is enabled by default. To disable it:

    &sram_config {
            parity-disable;
    };

compatible: "ti,cc13x4-cc26x4-sram-config"

include: base.yaml

properties:
  parity-disable:
    type: boolean
    description: |
      Disable SRAM parity. TI recommends keeping parity enabled for any
      application with run-time security requirements.
```

## dts/bindings/misc/ti,k3-esm.yaml
```yaml
# Copyright (c) 2026 BeagleBoard.org Foundation
# SPDX-License-Identifier: Apache-2.0

description: |
  Texas Instruments K3 Error Signaling Module (ESM).

  Aggregates SoC error/event inputs and can raise high/low/config priority
  interrupts to a CPU (and optionally drive an external ERROR pin). Compatible
  with the U-Boot / Linux "ti,j721e-esm" register layout.

  Optional ti,esm-pins lists events to enable at init (high priority + pin +
  interrupt). Runtime control is through the ti_k3_esm driver API.

compatible: "ti,k3-esm"

include: [base.yaml]

properties:
  reg:
    required: true

  interrupts:
    description: |
      Optional CPU interrupts for the ESM. When three are present the expected
      order is config, high-priority, low-priority. Without interrupts the
      driver still supports enable/clear/pending polling.

  interrupt-names:
    type: string-array
    description: |
      Optional names "cfg", "hi", "low" matching the interrupts property.

  ti,esm-pins:
    type: array
    description: |
      Event numbers to enable at probe time (high priority). See
      <zephyr/dt-bindings/misc/ti-k3-esm.h>.

  max-events:
    type: int
    default: 1024
    description: |
      Highest valid event index + 1 for this ESM instance.
```

## dts/bindings/modem/modem-sims.yaml
```yaml
# Copyright (c) 2026 Pedro Ramos
# SPDX-License-Identifier: Apache-2.0

description: |
  SIM slots of a cellular modem.

  A node with this compatible, named "sim-slots", is a child of the modem node.
  Each of its children is one SIM slot: a SIM holder, or a SIM interface of the
  modem. A slot with a mux-states property is selected by applying that MUX
  state, for example with a gpio-mux driving a switch that routes the SIM lines
  of the modem to one of several SIM holders. A slot without it is a SIM
  interface of the modem, which the modem driver selects, for example with an
  AT command. Either all slots have a mux-states property, or none.

  A modem node without a sim-slots child has a single SIM.

  Example of a modem with one SIM interface, switched between two SIM holders
  by one GPIO:

    sim_mux: sim-mux {
            compatible = "gpio-mux";
            #mux-control-cells = <0>;
            #mux-state-cells = <1>;
            mux-gpios = <&gpio0 5 GPIO_ACTIVE_HIGH>;
    };

    &uart1 {
            modem {
                    compatible = "quectel,bg95";

                    sim-slots {
                            compatible = "modem-sims";
                            #address-cells = <1>;
                            #size-cells = <0>;

                            sim0: sim-slot@0 {
                                    reg = <0>;
                                    mux-states = <&sim_mux 0>;
                                    default-sim;
                            };

                            sim1: sim-slot@1 {
                                    reg = <1>;
                                    mux-states = <&sim_mux 1>;
                            };
                    };
            };
    };

  Example of a modem with two SIM interfaces, which it selects itself:

    &uart1 {
            modem {
                    compatible = "simcom,a76xx";

                    sim-slots {
                            compatible = "modem-sims";
                            #address-cells = <1>;
                            #size-cells = <0>;

                            sim-slot@0 {
                                    reg = <0>;
                            };

                            sim-slot@1 {
                                    reg = <1>;
                            };
                    };
            };
    };

compatible: "modem-sims"

properties:
  "#address-cells":
    type: int
    required: true
    const: 1

  "#size-cells":
    type: int
    required: true
    const: 0

child-binding:
  description: |
    One SIM slot.

  include:
    - name: mux-consumer.yaml
      property-allowlist:
        - mux-states

  properties:
    reg:
      type: array
      required: true
      description: |
        Index of the SIM slot, from 0 to 255. This is the slot index of the
        cellular API. For a SIM interface of the modem, it is the index the
        modem gives that interface.

    mux-states:
      description: |
        MUX state that routes the modem to this SIM slot. Without it, the
        modem selects the slot.

    default-sim:
      type: boolean
      description: |
        Select this SIM slot when the device starts. At most one slot can have
        this property. Without it, the first slot is selected.
```

## dts/bindings/mspi/aspeed,ast2700-fmc.yaml
```yaml
# Copyright (c) 2026 ASPEED Technology Inc.
#
# SPDX-License-Identifier: Apache-2.0

description: ASPEED AST2700 firmware SPI flash controller (FMC), three chip selects

compatible: "aspeed,ast2700-fmc"

include: aspeed,mspi-common.yaml
```

## dts/bindings/mspi/aspeed,ast2700-spi.yaml
```yaml
# Copyright (c) 2026 ASPEED Technology Inc.
#
# SPDX-License-Identifier: Apache-2.0

description: ASPEED AST2700 SPI memory controller, two chip selects

compatible: "aspeed,ast2700-spi"

include: aspeed,mspi-common.yaml
```

## dts/bindings/mspi/raspberrypi,pico-mspi-pio.yaml
```yaml
# Copyright (c) 2026 WIZnet Co., Ltd.
# SPDX-License-Identifier: Apache-2.0

description: |
  Raspberry Pi Pico (RP2040/RP2350) PIO-based MSPI controller.

  Implements MSPI_IO_MODE_QUAD_1_4_4: a 1-wire serial instruction byte
  followed by 4-wire quad address, dummy, and data phases.

  The node must be a child of a PIO device node (&pio0 or &pio1).

  The state machine spends four cycles on every SCLK period, so SCLK cannot
  go above clk_sys / 4: 37.5 MHz on the RP2350 and 31.25 MHz on the RP2040.
  clock-frequency, when given, lowers that limit.  The controller rejects a
  device configuration it cannot clock.

  The controller works in controller mode, half duplex, single data rate and
  clock mode 0, without DQS.  It has no hardware chip enable: each device is
  selected through the ce-gpios entry its reg value indexes.  More than one
  device on the bus needs software-multiperipheral, as the controller moves
  between their settings in mspi_dev_config().

  Example:

    &pio0 {
      mspi0: mspi0 {
        compatible = "raspberrypi,pico-mspi-pio";
        clocks = <&clocks RPI_PICO_CLKID_CLK_SYS>;
        #address-cells = <1>;
        #size-cells = <0>;
        pinctrl-0 = <&pio0_qspi_default>;
        pinctrl-names = "default";
        clk-gpios = <&gpio0 17 GPIO_ACTIVE_HIGH>;
        io0-gpios = <&gpio0 18 GPIO_ACTIVE_HIGH>;
        io1-gpios = <&gpio0 19 GPIO_ACTIVE_HIGH>;
        io2-gpios = <&gpio0 20 GPIO_ACTIVE_HIGH>;
        io3-gpios = <&gpio0 21 GPIO_ACTIVE_HIGH>;
        ce-gpios = <&gpio0 16 GPIO_ACTIVE_LOW>;
        dmas = <&dma 0 0 0>, <&dma 1 0 0>;
        dma-names = "tx", "rx";
        op-mode = "MSPI_OP_MODE_CONTROLLER";
        duplex = "MSPI_HALF_DUPLEX";
        status = "okay";

        w6300: w6300@0 {
          compatible = "wiznet,w6300";
          reg = <0>;
          mspi-max-frequency = <33000000>;
          mspi-io-mode = "MSPI_IO_MODE_QUAD_1_4_4";
          mspi-data-rate = "MSPI_DATA_RATE_SINGLE";
          ...
        };
      };
    };

compatible: "raspberrypi,pico-mspi-pio"

include: [mspi-controller.yaml, pinctrl-device.yaml]

properties:
  clk-gpios:
    type: phandle-array
    required: true
    description: SPI clock (SCLK) GPIO.

  io0-gpios:
    type: phandle-array
    required: true
    description: Data line IO0.  Also carries the instruction byte.

  io1-gpios:
    type: phandle-array
    required: true
    description: Data line IO1.  Must be io0 pin + 1.

  io2-gpios:
    type: phandle-array
    required: true
    description: Data line IO2.  Must be io0 pin + 2.

  io3-gpios:
    type: phandle-array
    required: true
    description: Data line IO3.  Must be io0 pin + 3.

  ce-gpios:
    required: true
    description: |
      Chip enable GPIOs, one per device, indexed by the device's reg value.

  clocks:
    required: true
    description: Clock source for computing the PIO clock divider.

  dmas:
    required: true
    description: |
      TX and RX DMA channels used to feed and drain the PIO FIFOs.
      Only the channel cell is used; the data request line is derived at
      runtime from the PIO state machine the driver is given, so the slot
      cell is ignored.

  dma-names:
    required: true
    description: Must be "tx" and "rx".
```

## dts/bindings/mtd/micron,mt35xu512aba.yaml
```yaml
# Copyright 2026 NXP
# SPDX-License-Identifier: Apache-2.0

description: Micron MT35XU512ABA Octal SPI NOR flash

compatible: "micron,mt35xu512aba"

include: soc-nv-flash.yaml
```

## dts/bindings/mtd/nordic,mram-bank.yaml
```yaml
# Copyright (c) 2026 Nordic Semiconductor ASA
# SPDX-License-Identifier: Apache-2.0

description: |
  A single MRAM bank within a Nordic MRAM memory node.

compatible: "nordic,mram-bank"

include: base.yaml

properties:
  reg:
    required: true

  nordic,mutexes:
    type: phandle-array
    specifier-space: mutex
    min-len: 1
    max-len: 1
    description: |
      Hardware mutexes used to serialize MRAM access across CPU domains.
```
