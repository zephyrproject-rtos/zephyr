## dts/bindings/memory-controllers/nxp,lpc-emc-sdram.yaml
```yaml
# SPDX-FileCopyrightText: Copyright The Zephyr Project Contributors
# SPDX-License-Identifier: Apache-2.0

description: |
  SDRAM chip attached to an NXP LPC EMC dynamic chip-select.

  All timing properties are given in nanoseconds (or, where noted, in EMC clock
  cycles) and are taken from the SDRAM datasheet.

compatible: "nxp,lpc-emc-sdram"

include: base.yaml

properties:
  reg:
    required: true
    description: EMC dynamic chip-select index this SDRAM is wired to (0 = DYCS0, 0-3).

  nxp,address-mapping:
    type: int
    required: true
    description: |
      Dynamic device address mapping (the DYNAMICCONFIG AM field). Selects the
      bus width / bank / row / column organisation of the device per the EMC
      address-mapping table in the reference manual.

  nxp,sdram-mode-register:
    type: int
    required: true
    description: |
      Value written to the SDRAM mode register during initialisation. Encodes
      the CAS latency and burst configuration; the driver derives the CAS
      latency from it.

  nxp,ras-latency:
    type: int
    required: true
    min: 1
    max: 3
    description: Active-to-read/write delay (tRCD), in EMC clock cycles.

  nxp,mode-register-delay:
    type: int
    required: true
    min: 1
    max: 16
    description: Load-mode-register to active-command time (tMRD), in EMC clock cycles.

  refresh-period-ns:
    type: int
    required: true
    description: Auto-refresh interval per row, in nanoseconds.

  t-rp-ns:
    type: int
    required: true
    description: Precharge command period (tRP), in nanoseconds.

  t-ras-ns:
    type: int
    required: true
    description: Active-to-precharge command period (tRAS), in nanoseconds.

  t-srex-ns:
    type: int
    required: true
    description: Self-refresh exit time (tSREX), in nanoseconds.

  t-apr-ns:
    type: int
    required: true
    description: Last-data-out to active command time (tAPR), in nanoseconds.

  t-wr-ns:
    type: int
    required: true
    description: |
      Write recovery time (tWR), in nanoseconds. One EMC clock period is
      added to it.

  t-rc-ns:
    type: int
    required: true
    description: Active-to-active command period (tRC), in nanoseconds.

  t-rfc-ns:
    type: int
    required: true
    description: Auto-refresh period / refresh-to-active command period (tRFC), in nanoseconds.

  t-xsr-ns:
    type: int
    required: true
    description: Exit self-refresh to active command time (tXSR), in nanoseconds.

  t-rrd-ns:
    type: int
    required: true
    description: Active bank A to active bank B latency (tRRD), in nanoseconds.
```

## dts/bindings/memory-controllers/nxp,lpc-emc.yaml
```yaml
# SPDX-FileCopyrightText: Copyright The Zephyr Project Contributors
# SPDX-License-Identifier: Apache-2.0

description: |
  NXP LPC External Memory Controller (EMC).

  The EMC drives external static and dynamic (SDRAM) memories. Each attached
  dynamic memory chip is described by a "nxp,lpc-emc-sdram" child node whose
  unit address is the EMC dynamic chip-select index (0 -> DYCS0 at 0xA0000000,
  1 -> DYCS1, ...). The SDRAM address window itself is declared separately as a
  "zephyr,memory-region" node so the linker can place data in it.

compatible: "nxp,lpc-emc"

include: [base.yaml, pinctrl-device.yaml]

properties:
  reg:
    required: true

  clocks:
    required: true

  "#address-cells":
    required: true
    const: 1

  "#size-cells":
    required: true
    const: 0

  nxp,emc-clock-div:
    type: int
    required: true
    max: 255
    description: |
      EMC clock divider (SYSCON EMCCLKDIV DIV field, 0-255). The EMC clock is
      the CPU clock / (nxp,emc-clock-div + 1). The SoC data sheet limits the
      EMC clock to 100 MHz.

  nxp,emc-big-endian:
    type: boolean
    description: |
      Configure the EMC data bus in big-endian mode. Omit for the default
      little-endian mode.

  nxp,emc-external-feedback-clock:
    type: boolean
    description: |
      Use the external EMC_FBCLK input as the read feedback clock instead of the
      internal loopback of the EMC_CLK output. Omit for internal loopback, which
      is correct for the common case where EMC_FBCLK is not routed on the board.

  nxp,emc-feedback-clock-delay:
    type: int
    max: 31
    description: |
      Feedback-clock delay (SYSCON EMCDLYCTRL FBCLK_DELAY field, 0-31) that
      aligns read-data capture with the SDRAM round-trip delay at the
      configured EMC clock. The delay is roughly (value + 1) * 250 ps. The
      right value depends on the board and the EMC clock; a memory test over
      the whole range finds the valid window. Without this property the field
      keeps its reset value.
```

## dts/bindings/memory-controllers/silabs,siwx91x-psram.yaml
```yaml
# Copyright (c) 2026 Silicon Laboratories Inc.
# SPDX-License-Identifier: Apache-2.0

description: |
  PSRAM device attached to the Silicon Labs SiWx91x QSPI memory controller.

compatible: "silabs,siwx91x-psram"

include: [base.yaml, "zephyr,memory-region.yaml"]

properties:
  reg:
    required: true

  half-sleep-supported:
    type: boolean
    description: |
      Indicates that the PSRAM supports the C0 half-sleep command sequence.

  external-ldo:
    type: boolean
    description: |
      Present if the PSRAM is powered from the external LDO.
      If absent, the internal PSRAM LDO is assumed.
```

## dts/bindings/mfd/infineon,hppass-analog-v3.yaml
```yaml
# SPDX-FileCopyrightText: Copyright (c) 2026 Infineon Technologies AG,
# SPDX-FileCopyrightText: or an affiliate of Infineon Technologies AG. All rights reserved.
#
# SPDX-License-Identifier: Apache-2.0

description: |
  Infineon HPPASS analog subsystem with the MCPASS v3 register layout
  (PSOC Control C3M6/P6).

  v3 routes 16 triggers rather than 8, which moves the INFRA and MMIO
  trigger registers. It has nine CSG slices rather than five, with wider
  AC state fields and different trigger and CSG condition encodings. Use constants
  from <dt-bindings/mfd/infineon-hppass.h> for ac-states; the MFD driver
  translates condition identifiers to v3 hardware encodings.
  The base binding infineon,hppass-analog must be listed as the fallback
  compatible so the MFD driver still binds:

    compatible = "infineon,hppass-analog-v3", "infineon,hppass-analog";

compatible: "infineon,hppass-analog-v3"

include: infineon,hppass-analog.yaml

properties:
  trig-in-8-type:
    type: int
    default: 0
    description: Trigger input 8 type. Use IFX_HPPASS_TR_* constants.

  trig-in-8-hw-mode:
    type: int
    default: 0
    description: Trigger input 8 HW mode. Use IFX_HPPASS_TR_HW_* constants.

  trig-in-9-type:
    type: int
    default: 0
    description: Trigger input 9 type. Use IFX_HPPASS_TR_* constants.

  trig-in-9-hw-mode:
    type: int
    default: 0
    description: Trigger input 9 HW mode. Use IFX_HPPASS_TR_HW_* constants.

  trig-in-10-type:
    type: int
    default: 0
    description: Trigger input 10 type. Use IFX_HPPASS_TR_* constants.

  trig-in-10-hw-mode:
    type: int
    default: 0
    description: Trigger input 10 HW mode. Use IFX_HPPASS_TR_HW_* constants.

  trig-in-11-type:
    type: int
    default: 0
    description: Trigger input 11 type. Use IFX_HPPASS_TR_* constants.

  trig-in-11-hw-mode:
    type: int
    default: 0
    description: Trigger input 11 HW mode. Use IFX_HPPASS_TR_HW_* constants.

  trig-in-12-type:
    type: int
    default: 0
    description: Trigger input 12 type. Use IFX_HPPASS_TR_* constants.

  trig-in-12-hw-mode:
    type: int
    default: 0
    description: Trigger input 12 HW mode. Use IFX_HPPASS_TR_HW_* constants.

  trig-in-13-type:
    type: int
    default: 0
    description: Trigger input 13 type. Use IFX_HPPASS_TR_* constants.

  trig-in-13-hw-mode:
    type: int
    default: 0
    description: Trigger input 13 HW mode. Use IFX_HPPASS_TR_HW_* constants.

  trig-in-14-type:
    type: int
    default: 0
    description: Trigger input 14 type. Use IFX_HPPASS_TR_* constants.

  trig-in-14-hw-mode:
    type: int
    default: 0
    description: Trigger input 14 HW mode. Use IFX_HPPASS_TR_HW_* constants.

  trig-in-15-type:
    type: int
    default: 0
    description: Trigger input 15 type. Use IFX_HPPASS_TR_* constants.

  trig-in-15-hw-mode:
    type: int
    default: 0
    description: Trigger input 15 HW mode. Use IFX_HPPASS_TR_HW_* constants.
```

## dts/bindings/mfd/infineon,hppass-csg-v3.yaml
```yaml
# SPDX-FileCopyrightText: Copyright (c) 2026 Infineon Technologies AG,
# SPDX-FileCopyrightText: or an affiliate of Infineon Technologies AG. All rights reserved.
#
# SPDX-License-Identifier: Apache-2.0

description: |
  Infineon MCPASS v3 Comparator Slope Generator (CSG) with nine slices,
  grouped power control and per-slice analog routing.

  List infineon,hppass-csg as the fallback compatible so the shared driver
  binds. The parent must use infineon,hppass-analog-v3; its revision selects
  the shared HPPASS, CSG comparator and DAC register layouts.

compatible: "infineon,hppass-csg-v3"

include: infineon,hppass-csg.yaml

properties:
  infineon,aroute-inputs:
    type: string-array
    default: ["none", "none", "none", "none", "none", "none", "none", "none", "none"]
    enum:
      - "none"
      - "ain-a"
      - "ain-b"
      - "ain-c"
      - "ain-d"
    description: |
      Analog input selections for the nine CSG route muxes, in mux index
      order 0 through 8. Each entry programs CSG_AROUTEMUX_SEL[index]:
      "none" disconnects the mux; "ain-a" through "ain-d" select its
      analog input A through D. Pin availability depends on the device
      and package.

      Mux outputs can feed neighboring comparators as well as their own
      slice. All consumers of a mux share this selection. The CSG MFD
      configures all nine muxes, regardless of which comparator nodes
      are enabled, and restores them after power loss.
```

## dts/bindings/mfd/ti,tps65214.yaml
```yaml
# SPDX-FileCopyrightText: Copyright The Zephyr Project Contributors
# SPDX-License-Identifier: Apache-2.0

title: TI TPS65214 PMIC

description: |
  TI TPS65214 PMIC: three buck converters and two LDOs.

  The regulators are described in a child node with the
  "ti,tps6521x-regulator" compatible.

compatible: "ti,tps65214"

include: i2c-device.yaml

properties:
  int-gpios:
    type: phandle-array
    description: |
      Host GPIO wired to the open-drain nINT output. nINT is active low, so
      the flags must include GPIO_ACTIVE_LOW. Without it the driver has no
      interrupt support and children that need interrupts, such as the power
      button, are not available.
```

## dts/bindings/mfd/ti,tps65215.yaml
```yaml
# SPDX-FileCopyrightText: Copyright The Zephyr Project Contributors
# SPDX-License-Identifier: Apache-2.0

title: TI TPS65215 PMIC

description: |
  TI TPS65215 PMIC: three buck converters and two LDOs.

  The regulators are described in a child node with the
  "ti,tps6521x-regulator" compatible.

compatible: "ti,tps65215"

include: i2c-device.yaml
```

## dts/bindings/mipi-dsi/alif,mipi-dsi.yaml
```yaml
# Copyright (C) 2024 Alif Semiconductor
# SPDX-License-Identifier: Apache-2.0

description: |
  Alif implementation of designware MIPI DSI host controller with
  integrated Synopsys MIPI D-PHY.

compatible: "alif,mipi-dsi"

include:
  - mipi-dsi-host.yaml
  - snps,designware-dsi.yaml

properties:
  ldo-phy:
    required: true
    description: "LDO PHY regulator"
    type: phandle
  tx-dphy:
    required: true
    description: "TX D-PHY controller"
    type: phandle
  pll-dphy:
    required: true
    description: "PLL D-PHY controller"
    type: phandle
```

## dts/bindings/mipi-dsi/snps,designware-dsi.yaml
```yaml
# Copyright (C) 2024 Alif Semiconductor
# SPDX-License-Identifier: Apache-2.0

description: |
  Designware MIPI DSI host controller with integrated Synopsys MIPI D-PHY.

compatible: "snps,designware-dsi"

include: mipi-dsi-host.yaml

properties:
  reg:
    required: true

  reg-names:
    required: true
    description: |
      Must contain "dsi_regs" for the DSI host controller registers and
      "clkctl_regs" for the SoC clock control block holding the D-PHY
      control registers.

  interrupts:
    required: true

  dpi-in:
    type: phandle
    dependency-mode: ignore
    description: |
      Reference to the DPI input. Required in video mode, the DPI timings will
      be taken from the "display-timings" child node of this phandle.

  eotp-lp-tx-en:
    type: boolean
    description:
      Automatically insert an EoTp short packet at the end of LP transmission.

  eotp-rx-en:
    type: boolean
    description:
      Enable reception of an EoTp short packet at the end of LPDT reception
      from peripheral.

  ecc-recv-en:
    type: boolean
    description:
      DSI controller should support ECC reception, error correction and
      reporting.

  crc-recv-en:
    type: boolean
    description:
      DSI controller should support CRC reception and error reporting.

  frame-ack-en:
    type: boolean
    description:
      DSI controller should request Peripheral ACK at the end of frames.

  dpi-colorm-active:
    type: int
    description:
      Color-Mode command pulse polarity.
      If dpicolorm is active low, use 0,
      otherwise use 1.
    enum:
      - 0
      - 1

  dpi-shutdn-active:
    type: int
    required: true
    description:
      Shutdown command pulse polarity.
      If dpishutdn is active low, use 0,
      otherwise use 1.
    enum:
      - 0
      - 1

  vid-pkt-size:
    type: int
    required: true
    description:
      Video packet size in MIPI Video mode pixel stream in bytes. The product of
      number of chunks and video packet size should be active line width.

  dpi-video-pattern-gen:
    type: string
    enum:
      - "vertical-color-bar"
      - "horizontal-color-bar"
      - "vertical-bit-error-rate"
    description:
      Video pattern generator for testing MIPI-DSI without DPI inputs.

  max-bit-clk:
    type: int
    description:
      The highest bit clock that a panel supports. All the calculations for DPHY
      PLL should be limited to half of the above value for a panel.
```
