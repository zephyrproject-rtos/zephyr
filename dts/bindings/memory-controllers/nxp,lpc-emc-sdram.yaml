## dts/bindings/mtd/nxp,lpc546xx-eeprom.yaml
```yaml
# SPDX-FileCopyrightText: Copyright The Zephyr Project Contributors
# SPDX-License-Identifier: Apache-2.0

description: |
  NXP LPC546xx on-chip EEPROM.

  The controller registers and the storage array live in separate regions, so
  the node needs both. The last page of the array holds the controller's
  initialization data and cannot be written, so size excludes it:

      eeprom0: eeprom@40014000 {
              compatible = "nxp,lpc546xx-eeprom";
              reg = <0x40014000 0x1000>, <0x40108000 DT_SIZE_K(16)>;
              reg-names = "control", "memory";
              interrupts = <52 0>;
              clocks = <&syscon MCUX_BUS_CLK>;
              resets = <&reset NXP_SYSCON_RESET(0, 9)>;
              size = <(DT_SIZE_K(16) - 128)>;
      };

compatible: "nxp,lpc546xx-eeprom"

include: [eeprom-base.yaml, reset-device.yaml]

properties:
  reg:
    required: true

  reg-names:
    required: true

  clocks:
    required: true

  resets:
    required: true

  size:
    required: true
```

## dts/bindings/nvmem/fixed-layout.yaml
```yaml
# Copyright (c) 2025 Basalte bv
# SPDX-License-Identifier: Apache-2.0

description: |
  Fixed layout for Non-Volatile memory.

compatible: "fixed-layout"

properties:
  "#address-cells":
    type: int
    const: 1
    description: |
      Number of cells required to represent a child node's
      reg property address.

  "#size-cells":
    type: int
    const: 1
    description: |
      Number of cells required to represent a child node's size.

child-binding:
  description: |
    Each child node of the NVMEM provider node represents
    an individual NVMEM cell. These should usually
    look like this:

      cell_nodelabel: cell@START_OFFSET {
              reg = <0xSTART_OFFSET 0xSIZE>;
              #nvmem-cell-cells = <0>;
      };

  properties:
    reg:
      type: array
      required: true
      description: |
        This should be in the format <OFFSET SIZE>, where OFFSET
        is the offset of the NVMEM cell relative to the base
        address of the parent memory, and SIZE is the size of
        the cell in bytes.

    read-only:
      type: boolean
      description: Set this property if the cell is read-only.

    zephyr,byte-order:
      type: string
      default: "raw"
      enum:
        - "raw"
        - "little-endian"
        - "big-endian"
      description: |
        Byte order metadata for consumers interpreting the contents of the
        NVMEM cell. The raw default preserves existing consumer behavior
        when no byte order is specified. Select little-endian or big-endian
        when a consumer must decode data stored in that byte order.

        This property does not change NVMEM read or write operations,
        including the explicitly little-endian and big-endian helpers.
        Consumers must explicitly use this metadata to interpret the data.
```
