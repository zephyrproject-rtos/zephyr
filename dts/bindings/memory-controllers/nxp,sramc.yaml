## dts/bindings/mfd/infineon,tle927x.yaml
```yaml
# SPDX-FileCopyrightText: Copyright (c) 2026 Deere & Company
# SPDX-FileCopyrightText: Copyright (c) 2026 Linumiz
# SPDX-License-Identifier: Apache-2.0

description: |
  Infineon TLE927x high-end System Basis Chip (SBC).

  The binding covers all TLE927x variants. They differ only in the VCC1
  voltage and the number of LIN transceivers (FAM_PROD_STAT.PROD), which the
  driver does not depend on.

  The SPI interface runs at up to 4 MHz, so spi-max-frequency must be set
  accordingly. The SBC requires SPI mode 1 (CPOL=0, CPHA=1) and LSB-first
  transfers, which the driver sets itself.

  The watchdog, the VCC2 regulator, the HS-CAN transceiver and the reset cause
  (hwinfo) are exposed as child nodes. VCC1 has no software enable, voltage or
  mode, so it is not a regulator device: its supervision is configured by the
  properties below and its faults are reported through
  mfd_tle927x_read_faults() in SUP_STAT (VCC1_UV, VCC1_OV, VCC1_SC).

  The fail-safe input (FSI) and the WK pin wake source are not supported. The
  driver disables both at init: HW_CTRL.FSI_FO2 is set, so the FSI pin works
  as the FO2 output, and WK_CTRL_2.WK_EN is cleared.

  The application must install and set up the watchdog early. The long open
  window starts when RO is released, not when the first SPI command is sent
  (datasheet 5.1.1), so the deadline covers the whole boot: startup software,
  clock init, driver init and the first watchdog feed together must fit inside
  the minimum 240 ms. A boot that takes longer causes a watchdog reset.

compatible: "infineon,tle927x"

include: spi-device.yaml

bus: tle927x

properties:
  reset-threshold:
    type: string
    default: "vrt1"
    enum:
      - "vrt1"
      - "vrt2"
      - "vrt3"
      - "disabled"
    description: |
      VCC1 undervoltage reset threshold, M_S_CTRL.VCC1_RT. VCC1 is the buck
      output supplying the microcontroller. "vrt1" is the highest threshold and
      matches the power-on-reset value. "disabled" turns off the VCC1 undervoltage
      reset entirely, in which case undervoltage detection must be done outside the SBC.

  overvoltage-reset:
    type: boolean
    description: |
      Set M_S_CTRL.VCC1_OV_RST so a VCC1 overvoltage triggers a reset and the
      SBC enters Restart mode. Off by default, matching the power-on-reset
      value.
```

## dts/bindings/mfd/ite,it51xxx-mfd.yaml
```yaml
# Copyright (c) 2026 ITE Corporation. All Rights Reserved.
# SPDX-License-Identifier: Apache-2.0

description: ITE IT51XXX multi-function device driver.

compatible: "ite,it51xxx-mfd"

include: [base.yaml]

properties:
  reg:
    required: true

  interrupts:
    required: true
```

## dts/bindings/mfd/microchip,atecc608a.yaml
```yaml
# Copyright (c) 2026 RAKwireless Technology Limited
# SPDX-License-Identifier: Apache-2.0

description: |
  Microchip ATECC608A CryptoAuthentication device.

  This node is the I2C parent that owns wake, command framing, CRC, and the
  shared access lock. Child nodes expose standard Zephyr classes, for example
  the on-chip TRNG:

    &i2c0 {
            clock-frequency = <I2C_BITRATE_STANDARD>;

            atecc608a: atecc608a@60 {
                    compatible = "microchip,atecc608a";
                    reg = <0x60>;

                    atecc608a_trng: atecc608a_trng {
                            compatible = "microchip,atecc608a-trng";
                    };
            };
    };

  The 7-bit I2C address is programmed in the device configuration zone and
  is not assumed by this binding. The factory default for many modules,
  including the RAKwireless RAK5814, is 0x60. The I2C controller must not
  exceed 100 kHz (I2C_BITRATE_STANDARD).

compatible: "microchip,atecc608a"

include: [i2c-device.yaml]

properties:
  reset-gpios:
    type: phandle-array
    description: |
      Optional module reset pin. Configure the specifier active-low when the
      pin resets the device while driven low.
```

## dts/bindings/mfd/nxp,sc18is602.yaml
```yaml
#
# SPDX-FileCopyrightText: Copyright Alif Semiconductor
# SPDX-License-Identifier: Apache-2.0
#
description: |
  NXP SC18IS602/SC18IS602B I2C to SPI/GPIO bridge.
  4 chip-selects and a 200-byte buffer.
  Child SPI/GPIO controllers must be added in the device tree. The device
  itself must be a child of an I2C controller.

  An example configuration:

    &i2c0 {
      status = "okay";

      sc18is602: sc18is602@28 {
        compatible = "nxp,sc18is602";
        status = "okay";
        reg = <0x28>;

        spi_ext: sc18is602_spi {
          compatible = "nxp,sc18is60x-spi";
          status = "okay";
          #address-cells = <1>;
          #size-cells = <0>;
        };

        gpio_ext: sc18is602_gpio {
          compatible = "nxp,sc18is60x-gpio";
          status = "okay";
          gpio-controller;
          #gpio-cells = <2>;
          ngpios = <4>;
        };
      };
    };

compatible: "nxp,sc18is602"
include: ["i2c-device.yaml", "nxp,sc18is60x-common.yaml"]

properties:
  buffer-size:
    const: 200
    default: 200
  ss-count:
    const: 4
    default: 4
```

## dts/bindings/mfd/nxp,sc18is606.yaml
```yaml
#
# SPDX-FileCopyrightText: Copyright tinyvision.ai
# SPDX-License-Identifier: Apache-2.0
#
description: |
  NXP SC18IS606 I2C to SPI/GPIO bridge.
  Functional sibling of nxp,sc18is602: 3 chip-selects and a 1024-byte buffer.
  Child SPI/GPIO controllers must be added in the device tree. The device
  itself must be a child of an I2C controller.

  An example configuration:

    &i2c0 {
      status = "okay";

      sc18is606: sc18is606@28 {
        compatible = "nxp,sc18is606";
        status = "okay";
        reg = <0x28>;

        spi_ext: sc18is606_spi {
          compatible = "nxp,sc18is60x-spi";
          status = "okay";
          #address-cells = <1>;
          #size-cells = <0>;
        };

        gpio_ext: sc18is606_gpio {
          compatible = "nxp,sc18is60x-gpio";
          status = "okay";
          gpio-controller;
          #gpio-cells = <2>;
          ngpios = <3>;
        };
      };
    };

compatible: "nxp,sc18is606"
include: ["i2c-device.yaml", "nxp,sc18is60x-common.yaml"]

properties:
  buffer-size:
    const: 1024
    default: 1024
  ss-count:
    const: 3
    default: 3
```

## dts/bindings/mfd/nxp,sc18is60x-common.yaml
```yaml
#
# SPDX-FileCopyrightText: Copyright Alif Semiconductor
# SPDX-FileCopyrightText: Copyright tinyvision.ai
#
# SPDX-License-Identifier: Apache-2.0

description: |
  Common properties for NXP SC18IS60x bridge MFD parents.

properties:
  reset-gpios:
    type: phandle-array
    description:
      Driver reset pin of the bridge.
      If connected directly to the MCU, this pin should be configured
      as active low.

  int-gpios:
    type: phandle-array
    description:
      Driver interrupt pin of the bridge. Allows the driver to wait until
      a command has finished before starting another.
      If connected directly to the MCU, this pin should be configured
      as active low.

  buffer-size:
    type: int
    description: Internal data buffer size in bytes (silicon limit).

  ss-count:
    type: int
    description: Number of hardware SPI chip-selects.

bus: nxp,sc18is60x
```

## dts/bindings/mfd/silabs,emu.yaml
```yaml
# Copyright (c) 2026 Nahuel Mesa <nahuel.mesa@focus.uy>
# SPDX-License-Identifier: Apache-2.0

title: Silicon Labs EMU (Energy Management Unit)

description: |
  Energy Management Unit (EMU) for Silicon Labs Series 2 SoCs. The EMU
  controls power and energy mode management and hosts additional
  functional blocks, such as the internal die temperature sensor. Child
  nodes are used to represent each functional block.

compatible: "silabs,emu"

include: base.yaml

properties:
  reg:
    required: true
```

## dts/bindings/mfd/silabs,ncp-sd.yaml
```yaml
# Copyright (c) 2026 Silicon Laboratories Inc.
# SPDX-License-Identifier: Apache-2.0

# The file is named after the bus of the binding ("sd"), as the binding
# checks require, although the co-processor speaks SDIO.

description: |
  Silicon Labs network co-processor (NCP) connected over SDIO.

  The NCP runs the Silicon Labs CPC (Co-Processor Communication) protocol in
  the secondary role. This node is the CPC primary. Every radio protocol
  offered by the co-processor (Bluetooth LE, Bluetooth Classic, Wi-Fi,
  802.15.4, ...) is exposed by a child node bound to a CPC endpoint.

  The node is a child of the SD host controller the co-processor is wired
  to. The co-processor uses SDIO function 1.

  Example:

    &sdhc0 {
        ncp: ncp {
            compatible = "silabs,ncp";
            reset-gpios = <&gpio0 6 GPIO_ACTIVE_LOW>;
        };
    };

compatible: "silabs,ncp"

include: sd-device.yaml

properties:
  wake-gpios:
    type: phandle-array
    description: |
      Optional wake line driven by the host to wake the co-processor from
      sleep before a transaction.

  reset-gpios:
    type: phandle-array
    description: |
      Optional reset line of the co-processor. It is pulsed during
      initialization.
```

## dts/bindings/mfd/silabs,ncp-spi.yaml
```yaml
# Copyright (c) 2026 Silicon Laboratories Inc.
# SPDX-License-Identifier: Apache-2.0

description: |
  Silicon Labs network co-processor (NCP) connected over SPI.

  The NCP runs the Silicon Labs CPC (Co-Processor Communication) protocol in
  the secondary role. This node is the CPC primary. Every radio protocol
  offered by the co-processor (Bluetooth LE, Bluetooth Classic, Wi-Fi,
  802.15.4, ...) is exposed by a child node bound to a CPC endpoint.

  Example:

    &spi0 {
        ncp: ncp@0 {
            compatible = "silabs,ncp";
            reg = <0>;
            spi-max-frequency = <10000000>;
            irq-gpios = <&gpio0 5 GPIO_ACTIVE_LOW>;
            reset-gpios = <&gpio0 6 GPIO_ACTIVE_LOW>;
        };
    };

compatible: "silabs,ncp"

include: spi-device.yaml

properties:
  irq-gpios:
    type: phandle-array
    required: true
    description: |
      Interrupt line driven by the co-processor. It is asserted when the
      co-processor has a frame to send and, after a header exchange, when it
      is ready for the payload exchange. Must be declared GPIO_ACTIVE_LOW.

  wake-gpios:
    type: phandle-array
    description: |
      Optional wake line driven by the host to wake the co-processor from
      sleep before a transaction.

  reset-gpios:
    type: phandle-array
    description: |
      Optional reset line of the co-processor. It is pulsed during
      initialization.
```

## dts/bindings/mfd/silabs,ncp-uart.yaml
```yaml
# Copyright (c) 2026 Silicon Laboratories Inc.
# SPDX-License-Identifier: Apache-2.0

description: |
  Silicon Labs network co-processor (NCP) connected over UART.

  The NCP runs the Silicon Labs CPC (Co-Processor Communication) protocol in
  the secondary role. This node is the CPC primary. Every radio protocol
  offered by the co-processor (Bluetooth LE, Bluetooth Classic, Wi-Fi,
  802.15.4, ...) is exposed by a child node bound to a CPC endpoint.

  The node is a child of the UART controller the co-processor is wired to.
  The speed and the flow control of the link are the ones of the controller
  (current-speed, hw-flow-control) and must match the co-processor firmware.
  The driver uses the asynchronous UART API: the controller must support it,
  which usually requires DMA channels (dmas, dma-names).

  Example:

    &usart2 {
        current-speed = <115200>;
        hw-flow-control;
        dmas = <&dmamux1 2 44 STM32_DMA_PERIPH_TX>,
               <&dmamux1 3 43 STM32_DMA_PERIPH_RX>;
        dma-names = "tx", "rx";

        ncp: ncp {
            compatible = "silabs,ncp";
            reset-gpios = <&gpio0 6 GPIO_ACTIVE_LOW>;
        };
    };

compatible: "silabs,ncp"

include: uart-device.yaml

properties:
  wake-gpios:
    type: phandle-array
    description: |
      Optional wake line driven by the host to wake the co-processor from
      sleep before a transaction.

  reset-gpios:
    type: phandle-array
    description: |
      Optional reset line of the co-processor. It is pulsed during
      initialization.
```

## dts/bindings/mfd/silergy,sy6970.yaml
```yaml
# SPDX-FileCopyrightText: Copyright The Zephyr Project Contributors
# SPDX-License-Identifier: Apache-2.0

title: Silergy SY6970 battery charger

description: |
  Silergy SY6970 I2C controlled 5 A single cell switching battery charger
  with power path management and USB OTG boost. Register compatible with
  the TI BQ2589X family.

  Its functions are described by child nodes.

compatible: "silergy,sy6970"

include: i2c-device.yaml

examples:
  - |
    sy6970@6a {
      compatible = "silergy,sy6970";
      reg = <0x6a>;

      charger {
        compatible = "silergy,sy6970-charger";
        constant-charge-current-max-microamp = <512000>;
        constant-charge-voltage-max-microvolt = <4208000>;
      };
    };
```

## dts/bindings/mfd/ti,bq25620.yaml
```yaml
# Copyright (c) 2026 Testo SE & Co. KGaA
# SPDX-License-Identifier: Apache-2.0

title: TI BQ25620 battery charger

description: |
  TI BQ25620 I2C controlled single cell buck battery charger with power path
  management, USB BC1.2 adapter detection, OTG boost and an integrated ADC.

  The parent node represents the I2C device. It disables the I2C watchdog and
  distributes the interrupts to the function child nodes. The charger function
  is described by a child node with the "ti,bq25620-charger" compatible.

compatible: "ti,bq25620"

include: i2c-device.yaml

properties:
  reg:
    required: true

  int-gpios:
    type: phandle-array
    description: |
      Interrupt pin. The device signals status changes and faults with a
      256 us low pulse, so the pin is typically flagged GPIO_ACTIVE_LOW.

examples:
  - |
    #include <zephyr/dt-bindings/gpio/gpio.h>

    i2c {
        #address-cells = <1>;
        #size-cells = <0>;

        bq25620@6b {
            compatible = "ti,bq25620";
            reg = <0x6b>;
            int-gpios = <&gpio0 5 GPIO_ACTIVE_LOW>;

            charger {
                compatible = "ti,bq25620-charger";
                constant-charge-current-max-microamp = <1040000>;
                constant-charge-voltage-max-microvolt = <4200000>;
            };
        };
    };
```

## dts/bindings/mfd/ti,bq25896.yaml
```yaml
# SPDX-FileCopyrightText: Copyright The Zephyr Project Contributors
# SPDX-License-Identifier: Apache-2.0

title: TI BQ25896 battery charger

description: |
  TI BQ25896 I2C controlled 3 A single cell switching battery charger with
  power path management and USB OTG boost.

  Its functions are described by child nodes.

compatible: "ti,bq25896"

include: i2c-device.yaml

examples:
  - |
    bq25896@6b {
      compatible = "ti,bq25896";
      reg = <0x6b>;

      charger {
        compatible = "ti,bq25896-charger";
        constant-charge-current-max-microamp = <512000>;
        constant-charge-voltage-max-microvolt = <4208000>;
      };
    };
```
