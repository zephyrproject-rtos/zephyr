## dts/bindings/memory-controllers/nxp,sramc.yaml
```yaml
# Copyright 2026 NXP
# SPDX-License-Identifier: Apache-2.0

description: |
  NXP AHB SRAM Controller (SRAMC).

  Controller for an external asynchronous parallel SRAM (or SRAM-like FPGA)
  interface. The SRAMCR0/SRAMCR1 configuration registers physically reside in
  the BLK_CTRL_WAKEUPMIX block, so this node references that block through the
  "nxp,blk-ctrl" phandle instead of mapping the same registers with its own
  "reg" (the BLK_CTRL_WAKEUPMIX block is already described by the
  "nxp,imx-blkctrl-wakeup" node).

  Each chip-select (up to 4, each up to 128 KB) that carries an external SRAM
  is described as an "mmio-sram" child node whose "reg" is the CS memory window
  (e.g. CS0 at 0x43880000 on i.MX RT118x). Example:

    sramc: sramc {
        compatible = "nxp,sramc";
        nxp,blk-ctrl = <&blkctrl_wakeup>;
        pinctrl-0 = <&pinmux_sramc>;
        pinctrl-names = "default";
        port-size = "16-bit";
        address-mode = "admux";
        #address-cells = <1>;
        #size-cells = <1>;
        status = "okay";

        ext_sram: sram@43880000 {
            compatible = "mmio-sram";
            reg = <0x43880000 DT_SIZE_K(128)>;
        };
    };

compatible: "nxp,sramc"

include: [base.yaml, pinctrl-device.yaml]

properties:
  nxp,blk-ctrl:
    type: phandle
    required: true
    description: |
      Reference to the BLK_CTRL_WAKEUPMIX block node that hosts the SRAMCR0 and
      SRAMCR1 configuration registers. The driver takes the controller base
      address from this referenced node.

  "#address-cells":
    const: 1

  "#size-cells":
    const: 1

  turnaround-time:
    type: int
    default: 1
    min: 0
    max: 15
    description: Turnaround time TA. Actual = (TA+1) * granularity.

  address-hold-time:
    type: int
    default: 1
    min: 0
    max: 15
    description: Address hold time AH. Actual = (AH+1) * granularity.

  address-setup-time:
    type: int
    default: 4
    min: 0
    max: 15
    description: Address setup time AS. Actual = AS * granularity.

  ce-hold-time:
    type: int
    default: 1
    min: 0
    max: 15
    description: Chip-enable hold time CEH. Actual = CEH * granularity.

  ce-setup-time:
    type: int
    default: 1
    min: 0
    max: 15
    description: Chip-enable setup time CES. Actual = CES * granularity.

  adv-polarity:
    type: string
    default: "active-low"
    enum:
      - "active-low"
      - "active-high"
    description: ADV# signal polarity.

  address-mode:
    type: string
    default: "admux"
    enum:
      - "admux"       # Address/Data multiplexed
      - "non-admux"   # Address/Data non-multiplexed
    description: SRAM address mode.

  port-size:
    type: string
    default: "16-bit"
    enum:
      - "8-bit"
      - "16-bit"
    description: External SRAM data port width.

  bus-timeout-enable:
    type: boolean
    description: Enable AHB bus timeout (BTOEN).

  bus-timeout-counter:
    type: int
    default: 0
    min: 0
    max: 255
    description: AHB bus timeout wait cycles BTO. Timeout = BTO * 1024 hclk.

  # --- SRAMCR1 timing ---
  prescaler:
    type: string
    default: "prescaler-4"
    enum:
      - "prescaler-1" # granularity 1 hclk cycle
      - "prescaler-2" # granularity 2 hclk cycles
      - "prescaler-3" # granularity 3 hclk cycles
      - "prescaler-4" # granularity 4 hclk cycles
    description: Prescaler that sets the timing granularity.

  read-enable-high-time:
    type: int
    default: 9
    min: 0
    max: 15
    description: Read-enable (OE#) high time REH. Actual = (REH+1) * granularity.

  read-enable-low-time:
    type: int
    default: 16
    min: 0
    max: 63
    description: Read-enable (OE#) low time REL. Actual = (REL+1) * granularity.

  write-enable-high-time:
    type: int
    default: 10
    min: 0
    max: 15
    description: Write-enable (WE#) high time WEH. Actual = (WEH+1) * granularity.

  write-enable-low-time:
    type: int
    default: 31
    min: 0
    max: 63
    description: Write-enable (WE#) low time WEL. Actual = (WEL+1) * granularity.
```

## dts/bindings/memory-controllers/st,stm32mp13-ddr.yaml
```yaml
# SPDX-FileCopyrightText: Copyright The Zephyr Project Contributors
# SPDX-License-Identifier: Apache-2.0

description: STM32MP13 DDR (Double Data Rate) controller and PHY (Physical Interface)

compatible: "st,stm32mp13-ddr"

include: base.yaml

properties:
  reg:
    required: true

  reg-names:
    required: true

  memory-region:
    type: phandle
    required: true
    description: Memory region containing the base address of the DDR device

  st,mem-size:
    type: int
    required: true
    enum:
      - 0x20000000
      - 0x40000000
    description: |
      DDR capacity in bytes. The capacity selects the corresponding STM32 HAL
      DDR3 configuration.
```

## dts/bindings/mfd/adi,ad559x-common.yaml
```yaml
# Copyright (C) 2023 Grinn
# SPDX-License-Identifier: Apache-2.0

description: Analog AD559x ADC/DAC/GPIO chip common properties

properties:
  reset-gpios:
    type: phandle-array
    description: RESET pin

  reset-recovery-time-us:
    type: int
    default: 250
    description: |
      Time to wait after releasing reset-gpios before communicating with the
      device, in microseconds. Defaults to the chip's datasheet
      reset-recovery time. Boards whose reset line has extra settling time
      (e.g. external RC filtering) should override this with a larger value.
```

## dts/bindings/mfd/adi,max20356.yaml
```yaml
# Copyright (c) 2026 Analog Devices, Inc.
# SPDX-License-Identifier: Apache-2.0

description: |
  Analog Devices MAX20356 wearable PMIC (MFD parent).

  The MAX20356 integrates three bucks, one buck-boost, four LDOs, three load
  switches, a battery charger, a fuel gauge (separate I2C target), eight
  multi-purpose control (MPC) GPIOs, and a watchdog. Selecting this compatible
  configures the driver for the MAX20356 variant; the LDO4Cfg.LDO4RTC bit is
  rejected on this variant (MAX20358 only).

compatible: "adi,max20356"

include: "adi,max2035x-common.yaml"
```

## dts/bindings/mfd/adi,max20358.yaml
```yaml
# Copyright (c) 2026 Analog Devices, Inc.
# SPDX-License-Identifier: Apache-2.0

description: |
  Analog Devices MAX20358 wearable PMIC (MFD parent).

  Register-compatible with the MAX20356. Selecting this compatible configures the
  driver for the MAX20358 variant, which additionally permits setting
  LDO4Cfg.LDO4RTC (0x67 bit 7, "Always-On LDO Off Through PFN1"); that bit is
  rejected on the MAX20356.

compatible: "adi,max20358"

include: "adi,max2035x-common.yaml"
```

## dts/bindings/mfd/adi,max2035x-common.yaml
```yaml
# Copyright (c) 2026 Analog Devices, Inc.
# SPDX-License-Identifier: Apache-2.0

description: |
  Common properties for the Analog Devices MAX20356/MAX20358 wearable PMIC.

  Subsystems are exposed as child nodes (regulator, charger, gpio, watchdog),
  each with its own compatible.

include: i2c-device.yaml

properties:
  reg:
    required: true

  int-gpios:
    type: phandle-array
    description: |
      Host GPIO connected to the PMIC INTB pin (open-drain, active-low). When
      present, the driver uses INTB as an interrupt trigger source: it decodes
      the pending Int0-5/Status0-4 sources and dispatches registered callbacks.
      When absent, the driver operates in a poll-only fallback.

  spi-dvs:
    type: phandle
    description: |
      SPI controller wired to MPC0/MPC1/MPC2 (CS/SCLK/DIN) for SPI dynamic
      voltage scaling (DVS Mode 2). Required only when a buck child selects
      adi,dvs-mode = "spi".

  adi,buck1-pgood-int-gpios:
    type: phandle-array
    description: |
      Host GPIO wired to the MPC pin that Buck1 power-good is routed to (via
      mfd_max20356_mpc_int_route()). When present, a transition on this line
      dispatches the MAX20356_EVT_DVS_DONE event group. Independent of int-gpios
      (the buck-PGOOD/USBOK interrupts assert on MPC pins, not on INTB).

  adi,buck2-pgood-int-gpios:
    type: phandle-array
    description: |
      Host GPIO wired to the MPC pin that Buck2 power-good is routed to. A
      transition dispatches MAX20356_EVT_DVS_DONE. See adi,buck1-pgood-int-gpios.

  adi,buck3-pgood-int-gpios:
    type: phandle-array
    description: |
      Host GPIO wired to the MPC pin that Buck3 power-good is routed to. A
      transition dispatches MAX20356_EVT_DVS_DONE. See adi,buck1-pgood-int-gpios.

  adi,usbok-int-gpios:
    type: phandle-array
    description: |
      Host GPIO wired to the MPC pin that the USBOK status is routed to. A
      transition dispatches the MAX20356_EVT_USB event group. See
      adi,buck1-pgood-int-gpios.

  adi,intb-unmasked-in-shutdown:
    type: boolean
    description: |
      Leave INTB unmasked during shutdown (PwrCfg.INTBootMsk = 1). When absent
      INTB is masked during shutdown (OTP default), which prevents the INTB line
      from locking up the application processor while the PMIC powers down.

  adi,stay-on:
    type: boolean
    description: |
      Set PwrCfg.StayOn at init to keep the part powered on (StayOn = 1). The
      hardware requires this within 5s of power-on or it shuts down and returns
      to the power-off condition; the bit has no effect once already set. Only
      set this when the driver, rather than the application, owns the keep-alive
      handshake.

  adi,active-discharge-constant:
    type: boolean
    description: |
      Discharge a disabled block's output constantly rather than for 50ms
      (MiscFunctions.MiscFunc[0] = 1). When absent the OTP default (50ms pulse)
      is kept. Only applies to blocks that have active discharge enabled.

  adi,rtc-ldo-off:
    type: boolean
    description: |
      Turn the RTC-LDO feature off (MiscFunctions.MiscFunc[1] = 1). When absent
      the OTP default (RTC-LDO on) is kept.

  adi,factory-mode-disabled:
    type: boolean
    description: |
      Disable factory mode (MiscFunctions.MiscFunc[2] = 1). When absent the OTP
      default (factory mode enabled) is kept.

  adi,ivmon-high-impedance:
    type: boolean
    description: |
      Force the IVMON monitor-mux output high-impedance at init (MONCfg.MONHiZ =
      1); effective while the mux is disabled (MONCtr = 0000). When absent the OTP
      default is kept. Runtime channel selection via mfd_max20356_mon_select()
      does not change this bit.

  adi,input-current-limit-milliamp:
    type: int
    enum: [90, 150, 200, 300, 400, 450, 1000, 1500]
    description: |
      CHGIN programmable input current limit (ILimCtrl1.ILimCntl). Selects the
      steady-state input current limit in mA.

  adi,input-current-limit-max-milliamp:
    type: int
    enum: [90, 150, 200, 300, 400, 450, 1000, 1500]
    description: |
      CHGIN input overcurrent limit during the blanking time
      (ILimCtrl1.ILimMax).

  adi,input-current-limit-blanking-microsec:
    type: int
    enum: [50, 500, 1000, 10000]
    description: |
      CHGIN input current-limiter blanking time (ILimCtrl1.ILimBlank), in
      microseconds.

  adi,sys-discharge-in-recovery:
    type: boolean
    description: |
      Enable SYS discharge in battery recovery mode (ILimCtrl2.SysDSCEn).

  adi,sys-min-voltage-microvolt:
    type: int
    enum: [3300000, 3400000, 3500000, 3600000, 3700000, 3800000, 3900000,
           4000000, 4100000, 4200000, 4300000, 4400000, 4500000, 4600000,
           4700000, 4800000]
    description: |
      SYS minimum regulated voltage (ILimCtrl2.SysMinVlt), 3.3V..4.8V in 0.1V
      steps.

  adi,sys-uvlo-threshold-microvolt:
    type: int
    enum: [2750000, 2900000, 3000000, 3200000]
    description: |
      SYS UVLO falling threshold (DropCtrl.SysUVLOThSel). Typical VSYS-falling
      thresholds: 2.75V, 2.90V, 3.00V, 3.20V.

  adi,power-reset-config:
    type: int
    enum: [0, 1, 2, 3, 4, 5, 6, 7, 8, 9, 10, 11, 12]
    description: |
      Power reset configuration (BootCfg.PwrRstCfg[3:0]), selecting how the
      device turns on, off, and resets. Use the MAX20356_PWRRSTCFG_* macros from
      <zephyr/dt-bindings/mfd/max20356.h>.

  adi,soft-reset-keeps-registers:
    type: boolean
    description: |
      Hold (rather than reset) registers on a soft reset (BootCfg.SftRstCfg).

  adi,boot-delay-milliseconds:
    type: int
    enum: [80, 120, 220, 420]
    description: |
      Boot delay the sequencing engine waits before enabling features with
      sequence bits 010, 011, 100 (BootCfg.BootDly[1:0]), in milliseconds.

  adi,sys-uvlo-auto-retry:
    type: boolean
    description: |
      Enable SYS UVLO automatic retry (BootCfg.ChgAlwTry).
```

## dts/bindings/mfd/infineon,hppass-analog-v3.yaml
```yaml
# SPDX-FileCopyrightText: Copyright (c) 2026 Infineon Technologies AG,
# SPDX-FileCopyrightText: or an affiliate of Infineon Technologies AG. All rights reserved.
#
# SPDX-License-Identifier: Apache-2.0

description: |
  Infineon HPPASS analog subsystem with the MCPASS v3 register layout
  (PSOC Control C3M6/P6).

  v3 routes 16 triggers rather than 8, which moves the INFRA and MMIO
  trigger registers.  Everything else follows infineon,hppass-analog, which
  must be listed as the fallback compatible so the MFD driver still binds:

    compatible = "infineon,hppass-analog-v3", "infineon,hppass-analog";

compatible: "infineon,hppass-analog-v3"

include: infineon,hppass-analog.yaml
```

## dts/bindings/mfd/infineon,tle9271.yaml
```yaml
# SPDX-FileCopyrightText: Copyright (c) 2026 Deere & Company
# SPDX-FileCopyrightText: Copyright (c) 2026 Linumiz
# SPDX-License-Identifier: Apache-2.0

description: |
  Infineon TLE9271 System Basis Chip (SBC), a member of the TLE927x family.

  The node must list both compatibles so the family driver binds:

    compatible = "infineon,tle9271", "infineon,tle927x";

  See infineon,tle927x.yaml for the properties and the child nodes.

compatible: "infineon,tle9271"

include: infineon,tle927x.yaml
```
