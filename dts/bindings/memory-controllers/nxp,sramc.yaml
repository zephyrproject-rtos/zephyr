## dts/bindings/mfd/ti,tlc6c59xx.yaml
```yaml
#
# Copyright (c) 2026 iomico
#
# SPDX-License-Identifier: Apache-2.0
#

description: |
  Texas Instruments 8/12-Channel Shift-Register LED Driver.

  Describe every physical chip as an enabled GPIO child. A chain supports
  at most 255 chips, all with the same ngpios value. Child reg values must
  be unique and cover positions 0 through the number of chips minus one.
  Disabled children are not supported because their physical shift registers
  still consume clock pulses.

  SPI transfers use 8-bit words, most significant bit first. The farthest
  chip's word is sent first. Leading zero bits pad the transfer to a whole
  number of bytes without changing the physical chip positions. Connect the
  SPI chip-select signal to the chain's latch input.

  Example of two daisy-chained 12-output chips:

    &spi0 {
        shift_register: shift-register@0 {
            compatible = "ti,tlc6c59xx";
            reg = <0>;
            spi-max-frequency = <1000000>;
            #address-cells = <1>;
            #size-cells = <0>;

            gpio@0 {
                compatible = "ti,tlc6c59xx-gpio";
                reg = <0>;
                gpio-controller;
                #gpio-cells = <2>;
                ngpios = <12>;
            };

            gpio@1 {
                compatible = "ti,tlc6c59xx-gpio";
                reg = <1>;
                gpio-controller;
                #gpio-cells = <2>;
                ngpios = <12>;
            };
        };
    };

compatible: "ti,tlc6c59xx"

include: spi-device.yaml

bus: tlc6c59xx

properties:
  reset-gpios:
    type: phandle-array
    description: |
      An optional GPIO connected to the reset input of the shift register(s).
      The driver configures it inactive, pulses it active, and leaves it
      inactive during initialization. Use GPIO_ACTIVE_LOW for an active-low
      reset input.
```

## dts/bindings/mfd/waveshare,ch32v003.yaml
```yaml
# Copyright 2026, Kim Bøndergaard <kim@fam-boendergaard.dk>
# SPDX-License-Identifier: Apache-2.0

description: Waveshare CH32V003 I2C IO expander (MFD)

compatible: "waveshare,ch32v003"

include: [i2c-device.yaml]

bus: waveshare-ch32v003

properties:
  reg:
    required: true
```

## dts/bindings/mipi-dbi/nxp,mipi-dbi-dcif.yaml
```yaml
# Copyright 2026 NXP
# SPDX-License-Identifier: Apache-2.0

description: |
  DBI settings for NXP DCIF display controller. DCIF is used in DPI mode by default,
  when used in DBI mode the compatible needs to change in a board/shield overlay.

compatible: "nxp,mipi-dbi-dcif"

include: ["mipi-dbi-controller.yaml", "pinctrl-device.yaml", "reset-device.yaml"]

properties:
  clock-frequency:
    type: int
    required: true
    description: |
      The DBI clock source frequency. DCIF drives the DBI bus directly from a
      fixed clock root with no on-chip divider, so this value is not read by
      the driver -- it documents the frequency the wr-high/wr-low/cs-setup/
      cs-hold cycle counts below were computed against.

  reset-gpios:
    type: phandle-array
    description: |
      Reset GPIO pin.

  wr-high:
    type: int
    required: true
    description: |
      WRX (Type B) or E (Type A) signal high time, in DBI clock cycles.

  wr-low:
    type: int
    required: true
    description: |
      WRX (Type B) or E (Type A) signal low time, in DBI clock cycles.

  cs-setup:
    type: int
    required: true
    description: |
      CSX setup time before WRX/E toggles, in DBI clock cycles.

  cs-hold:
    type: int
    required: true
    description: |
      CSX hold time after WRX/E toggles, in DBI clock cycles.

examples: |
  &dcif {
      compatible = "nxp,mipi-dbi-dcif";
      clock-frequency = <200000000>;
      wr-high = <13>;
      wr-low = <13>;
      cs-setup = <3>;
      cs-hold = <2>;
  };
```

## dts/bindings/mipi-dbi/nxp,mipi-dbi-flexio-lcdif.yaml
```yaml
# Copyright 2024 NXP
# SPDX-License-Identifier: Apache-2.0

description: NXP FlexIO LCD controller

compatible: "nxp,mipi-dbi-flexio-lcdif"

include: [mipi-dbi-controller.yaml, base.yaml, pinctrl-device.yaml, mux-consumer.yaml]

properties:
  mux-states:
    description: |
      Optional INPUTMUX route needed by some SmartDMA back-ends to connect
      the FlexIO IRQ to a SmartDMA trigger input, given as
      <&inputmuxN index connection>. "connection" is the numeric value of
      the inputmux_connection_t enum from the SoC's fsl_inputmux_connections.h
      that routes the FlexIO IRQ to the SmartDMA trigger (e.g.
      kINPUTMUX_FlexioIrqToSmartdma0Trigger). Leave unset on back-ends/SoCs
      that need no such route.

  shifters-count:
    type: int
    required: true
    description: |
      Number of FlexIO shifters needed.

  timers-count:
    type: int
    required: true
    description: |
      Number of FlexIO timers needed.

  enwr-pin:
    type: int
    required: true
    description: |
      Pin select for WR(8080 mode), EN(6800 mode).

  rd-pin:
    type: int
    description: |
      Pin select for RD(8080 mode), not used in 6800 mode.

  data-pin-start:
    type: int
    required: true
    description: |
      Start index of the data pin.

  cs-gpios:
    type: phandle-array
    required: true
    description: |
      CS Pin
      GPIO to drive the CS pin.

  rs-gpios:
    type: phandle-array
    required: true
    description: |
      RS Pin
      GPIO to drive the RS pin.

  rdwr-gpios:
    type: phandle-array
    description: |
      RDWR Pin
      GPIO to drive the RDWR pin. This is required for Motorola 68K bus.

  reset-gpios:
    type: phandle-array
    description: |
      Reset GPIO pin.
```
