## dts/bindings/memory-controllers/nxp,xspi-psram.yaml
```yaml
# Copyright 2025 NXP
# SPDX-License-Identifier: Apache-2.0

description: NXP XSPI PSRAM Controller

compatible: "nxp,xspi-psram"

include: ["nxp,xspi-device.yaml"]
```

## dts/bindings/memory-controllers/realtek,rts5912-bbram.yaml
```yaml
# Copyright (c) 2025, Realtek, SIBG-SD7
# SPDX-License-Identifier: Apache-2.0

description: Realtek, RTS5912 Battery Backed RAM node

compatible: "realtek,rts5912-bbram"

include: base.yaml

properties:
  reg:
    required: true
```

## dts/bindings/memory-controllers/renesas,ra-sdram.yaml
```yaml
# Copyright (c) 2024 Renesas Electronics Corporation
# SPDX-License-Identifier: Apache-2.0

description: |
  Renesas RA SDRAM controller.
  sdram {
      pinctrl-0 = <&sdram_default>;
      pinctrl-names = "default";
      status = "okay";
      auto-refresh-interval = <10>;
      auto-refresh-count = <8>;
      precharge-cycle-count = <3>;
      multiplex-addr-shift = "10-bit";
      edian-mode = "little-endian";
      continuous-access;
      bus-width = "16-bit";
      bank@0 {
        reg = <0>;
        renesas,ra-sdram-timing = <RENESAS_RA_SDRAM_TRAS_6CYCLES
                  RENESAS_RA_SDRAM_TRCD_3CYCLES
                  RENESAS_RA_SDRAM_TRP_3CYCLES
                  RENESAS_RA_SDRAM_TWR_2CYCLES
                  RENESAS_RA_SDRAM_TCL_3CYCLES
                  937
                  RENESAS_RA_SDRAM_TREFW_8CYCLES>;
      };

  Note that you will find definitions for the renesas,ra-sdram-control field at
  dt-bindings/memory-controller/renesas,ra-sdram.h. This file is already included
  in the SoC DeviceTree files.

  Finally, in order to make the memory available you will need to define new
  memory device/s in DeviceTree:

  sdram1: sdram@68000000 {
      compatible = "zephyr,memory-region", "mmio-sram";
      device_type = "memory";
      reg = <0x68000000 DT_SIZE_M(X)>;
      zephyr,memory-region = "SDRAM";
  };

compatible: "renesas,ra-sdram"

include: [base.yaml, pinctrl-device.yaml]

properties:
  "#address-cells":
    required: true
    const: 1

  "#size-cells":
    required: true
    const: 0

  pinctrl-0:
    required: true

  pinctrl-names:
    required: true

  auto-refresh-interval:
    type: int
    default: 10
    description: Number of auto-refresh-interval.

  auto-refresh-count:
    type: int
    default: 8
    description: Number of auto-refresh-count.

  precharge-cycle-count:
    type: int
    default: 3
    description: Number of precharge-cycle-count.

  multiplex-addr-shift:
    type: string
    default: "10-bit"
    enum:
      - "8-bit"
      - "9-bit"
      - "10-bit"
      - "11-bit"
    description: |
      Select the size of the shift towards the lower half of the row address in row address/column
      address multiplexing.

  edian-mode:
    type: string
    default: "little-endian"
    enum:
      - "little-endian"
      - "big-endian"
    description: Specifies the endianness for the SDRAM address space.

  continuous-access:
    type: boolean
    description: Enables or disables continuous access to the SDRAM access space.

  bus-width:
    type: string
    default: "16-bit"
    enum:
      - "16-bit"
      - "32-bit"
      - "8-bit"
    description: Specify the data bus width for SDRAM

child-binding:
  description: SDRAM bank.

  properties:
    reg:
      type: int
      required: true

    renesas,ra-sdram-timing:
      type: array
      required: true
      description: |
        SDRAM timing configuration. Expected fields, in order, are,

        - TRAS: Row active interval. The effective value from 1 to 7 cycles
        - TRCD: Row column latency. The effective value from 1 to 4 cycles
        - TRP: Row precharge interval. The effective value from 1 to 8 cycles
        - TWR: Write recovery interval. The effective value from 1 to 2 cycles
        - TCL: Column latency. The effective value from 1 to 3 cycles
        - TRFC: Auto-Refresh Request Interval Setting.
        - TREFW: Auto-Refresh Cycle/Self-Refresh Clearing Cycle Count Setting.
          The effective value from 1 to 16 cycles
```

## dts/bindings/memory-controllers/renesas,smartbond-nor-psram.yaml
```yaml
# Copyright (c) 2023 Renesas Electronics Corporation
# SPDX-License-Identifier: Apache-2.0

description: Renesas Smartbond(tm) NOR/PSRAM controller

include: base.yaml

compatible: "renesas,smartbond-nor-psram"

properties:
  reg:
    required: true

  is-ram:
    type: boolean
    description: |
      If present, the memory controller will be configured to drive PSRAM devices.

  dev-size:
    type: int
    required: true
    description: |
      Memory size/capacity in bits.

  dev-type:
    type: int
    required: true
    description: |
      Device type, part of device ID, used to verify the memory device used.

  dev-density:
    type: int
    required: true
    description: |
      Device density, part of device ID, used to verify the memory device used.
      [7:0] should reflect the density value itself and [15:8] should reflect
      the mask that should be applied to the returned device ID value.
      This is because part of its byte value might contain invalid bits.

  dev-id:
    type: int
    required: true
    description: |
      Manufacturer ID, part of device ID, used to verify the memory device used.

  reset-delay-us:
    type: int
    required: true
    description: |
      Time in microseconds (us) the memory device can accept the next command following a SW reset.

  read-cs-idle-min-ns:
    type: int
    required: true
    description: |
      Min. time, in nanoseconds, the #CS line should remain inactive between
      the transmission of two different instructions.

  erase-cs-idle-min-ns:
    type: int
    description: |
      Min. time, in nanoseconds, the #CS line should remain inactive after the execution
      of a write enable, erase, erase suspend or erase resume instruction. This setting
      is not used if is-ram property is present.

  enter-qpi-cmd:
    type: int
    description: |
      Command to enter the QPI mode supported by a memory device
      (should be transmitted in single bus mode).

  exit-qpi-cmd:
    type: int
    description: |
      Command to exit the QPI mode supported by a memory device
      (should be transmitted in quad bus mode).

  enter-qpi-mode:
    type: boolean
    description: |
      If present, the memory device will enter the QPI mode which typically reflects that
      all bytes be sent in quad bus mode. It's a pre-requisite that read and write
      commands, that should be read-cmd and write-cmd respectively, reflect the QPI mode.

  read-cmd:
    type: int
    default: 0x03
    description: |
      Read command for single/burst read accesses in auto mode. Default value is the opcode
      for single mode which is supported by all memory devices.

  write-cmd:
    type: int
    default: 0x02
    description: |
      Write command for single/burst write accesses in auto mode. Default value is the opcode
      for single mode which is supported by all memory devices.

  clock-mode:
    type: string
    enum:
      - "spi-mode0"
      - "spi-mode3"
    default: "spi-mode0"
    description: |
      Clock mode when #CS is idle/inactive

      - Mode0: #CLK is low when #CS is inactive
      - Mode3: #CLK is high when #CS is inactive

      Mode0 is selected by default as it should be supported by all memory devices.

  addr-range:
    type: string
    enum:
      - "addr-range-24bit"
      - "addr-range-32bit"
    default: "addr-range-24bit"
    description: |
      Address size to use in auto mode. In 24-bit mode up to 16MB can be
      accessed whilst in 32-bit mode up to 32MB can be accessed which is
      the max. address space supported by QSPICx. Default value is 24-bit
      mode which is supported by all memory devices.

  clock-div:
    type: int
    description: |
      Clock divider for QSPIC2 controller. The clock path of
      this block is always DIV1 which reflects the current
      system clock.

  tcem-max-us:
    type: int
    description: |
      If a non zero value is applied, then Tcem should be taken into
      consideration by QSPIC2 so that it can split a burst read/write
      access in case the total time exceeds the defined value
      (at the cost of extra cycles required for re-sending the instruction,
      address and dummy bytes, if any). This setting is meaningful only if
      is-ram is present. This value reflects the max. time in microseconds
      the #CS line can be driven low in a write/read burst access
      (required for the auto-refresh mechanism, when supported).

  dummy-bytes-count:
    type: string
    required: true
    enum:
      - "dummy-bytes-count0"
      - "dummy-bytes-count1"
      - "dummy-bytes-count2"
      - "dummy-bytes-count4"
    description: |
      Number of dummy bytes to send for single/burst read access in auto mode.

  extra-byte-enable:
    type: boolean
    description: |
      If present, the extra byte will be sent after the dummy bytes, if any.
      This should be useful if 3 dummy bytes are required. In such a case,
      dummy-bytes-count should be set to 2.

  extra-byte:
    type: int
    description: |
      Extra byte to be sent, if extra-byte-enable is present.

  rx-addr-mode:
    type: string
    enum:
      - "single-spi"
      - "dual-spi"
      - "quad-spi"
    default: "single-spi"
    description: |
      Describes the mode of SPI bus during the address phase for single/burst
      read accesses in auto mode. Default value is single mode which should be
      supported by all memory devices.

  rx-inst-mode:
    type: string
    enum:
      - "single-spi"
      - "dual-spi"
      - "quad-spi"
    default: "single-spi"
    description: |
      Describes the mode of SPI bus during the instruction phase for single/burst
      read accesses in auto mode. Default value is single mode which should be
      supported by all memory devices.

  rx-data-mode:
    type: string
    enum:
      - "single-spi"
      - "dual-spi"
      - "quad-spi"
    default: "single-spi"
    description: |
      Describes the mode of SPI bus during the data phase for single/burst
      read accesses in auto mode. Default value is single mode which should
      be supported by all memory devices.

  rx-dummy-mode:
    type: string
    enum:
      - "single-spi"
      - "dual-spi"
      - "quad-spi"
    default: "single-spi"
    description: |
      Describes the mode of SPI bus during the dummy bytes phase for single/burst
      read accesses in auto mode. The single mode should be supported by all
      memory devices.

  rx-extra-mode:
    type: string
    enum:
      - "single-spi"
      - "dual-spi"
      - "quad-spi"
    description: |
      Describes the mode of SPI bus during the extra byte phase for single/burst
      read accesses in auto mode. Default value is single mode which should be
      supported by all memory devices.

  tx-addr-mode:
    type: string
    enum:
      - "single-spi"
      - "dual-spi"
      - "quad-spi"
    default: "single-spi"
    description: |
      Describes the mode of SPI bus during the address phase for single/burst
      write accesses in auto mode. Default value is single mode which should
      be supported by all memory devices.

  tx-inst-mode:
    type: string
    enum:
      - "single-spi"
      - "dual-spi"
      - "quad-spi"
    default: "single-spi"
    description: |
      Describes the mode of SPI bus during the instruction phase for single/burst
      write accesses in auto mode. The single mode should be supported by all
      memory devices.

  tx-data-mode:
    type: string
    enum:
      - "single-spi"
      - "dual-spi"
      - "quad-spi"
    default: "single-spi"
    description: |
      Describes the mode of SPI bus during the data phase for single/burst
      write accesses in auto mode. Default value is single mode which should
      be supported by all memory devices.
```

## dts/bindings/memory-controllers/sifive,fu740-c000-ddr.yaml
```yaml
# Copyright (c) 2023 Antmicro <www.antmicro.com>
# SPDX-License-Identifier: Apache-2.0
#
description: |
  Sifive Fu740 memory controller

compatible: "sifive,fu740-c000-ddr"

include: base.yaml

properties:
  reg:
    required: true
```

## dts/bindings/memory-controllers/sifli,sf32lb-mpi.yaml
```yaml
# Copyright 2025 Core Devices LLC
# SPDX-License-Identifier: Apache-2.0

description: SiFli SF32LB Memory Peripheral Interface (MPI)

compatible: "sifli,sf32lb-mpi"

include: base.yaml

properties:
  reg:
    required: true

  clocks:
    required: true

  "#address-cells":
    required: true
    const: 1

  "#size-cells":
    required: true
    const: 1
```

## dts/bindings/memory-controllers/silabs,siwx91x-qspi-memory.yaml
```yaml
description: |
  Silicon Labs QSPI (Quad Serial Protocol Interface) memory controller.

  This driver expects a children node compatible with "zephyr,memory-region".
  The size of the PSRAM is taken from this node. It also used by Zephyr to
  declare the area in the linker script.

  Note after the chip reset, the bootloader may automatically configure the
  Memory Controller. So, the user may be able to properly use the PSRAM without
  this driver (in this case, only the "zephyr,memory-region" node is required).

  This driver allows for non default configurations. In this case, if the users
  want to take advantage of the automatic data relocation of Zephyr, they have
  to tune the MEMC_INIT_PRIORITY value to initialize this driver before the
  initialization of the kernel resources. Then, they will probably want to also
  initialize the clock driver before this driver.

  Otherwise, it is also possible to start this driver later in the boot
  sequence, but the user will have to manage the memory region manually.

include: [base.yaml, pinctrl-device.yaml]

compatible: "silabs,siwx91x-qspi-memory"

properties:
  reg:
    required: true

  device-id:
    type: uint8-array
    required: true
    description: |
      Value returned by the chip on READ_ID command. An array of 8 bytes is
      expected. However only the two first bytes (should be "Manufacturer ID"
      and "Known Good Die") are used. The driver won't continue if the value
      returned by the chip does not match this field.

  normal-freq:
    type: int
    required: true

  fast-freq:
    type: int
    required: true
```
