## dts/bindings/memory-controllers/atmel,sam-smc.yaml
```yaml
# Copyright (c) 2022, Basalte bv
# SPDX-License-Identifier: Apache-2.0

description: |
  Atmel Static Memory Controller (SMC).

  The SMC allows to interface with static-memory mapped external devices such as
  SRAM, PSRAM, PROM, EPROM, EEPROM, LCD Module, NOR Flash and NAND Flash.

  The SMC is clocked through the Master Clock (MCK) which is controlled by the
  Power Management Controller (PMC).

  The SMC controller can have up to 4 children defining the connected external
  memory devices. The reg property is set to the device's Chip Select.
  Device Tree example taken from the sam4_xplained board:

  &smc {
    status = "okay";
    pinctrl-0 = <&smc_default>;
    pinctrl-names = "default";

    is66wv51216dbll@0 {
      reg = <0>;

      atmel,smc-write-mode = "nwe";
      atmel,smc-read-mode = "nrd";
      atmel,smc-setup-timing = <1 1 1 1>;
      atmel,smc-pulse-timing = <6 6 6 6>;
      atmel,smc-cycle-timing = <7 7>;
    };
  };

  The above example configures a is66wv51216dbll-55 device. The device is a
  low power static RAM which uses NWE and NRD signals connected to the WE
  and OE inputs respectively. Assuming that MCK is 120MHz (cpu at full speed)
  each MCK cycle will be equivalent to 8ns. Since the memory full cycle is
  55ns, as per specification, it requires atmel,smc-cycle-timing of at least
  7 pulses (56ns). The atmel,smc-cycle-timing is composed of three parts:
  setup, pulse and hold. The setup is used to address the memory. The pulse
  is the time used to read/write. The hold is used to release memory. For the
  is66wv51216dbll-55 a minimum setup of 5ns (1 cycle) with at least 45ns
  (6 cycles) for CPU read/write and no hold time is required.
  Note: Since no hold parameter is available at SMC the atmel,smc-cycle-timing
  should have additional cycles to accommodate for hold values.

    No Hold Time:
    cycle-timing (7) = setup (1) + pulse (6) + hold (0)

    With 3 Hold Times:
    cycle-timing (10) = setup (1) + pulse (6) + hold (3)

  Finally, in order to make the memory available you will need to define new
  memory device/s in DeviceTree:

  sram1: sram@60000000 {
      compatible = "zephyr,memory-region", "mmio-sram";
      device_type = "memory";
      reg = <0x60000000 DT_SIZE_K(512)>;
      zephyr,memory-region = "SRAM1";
  };

compatible: "atmel,sam-smc"

include: [base.yaml, pinctrl-device.yaml]

properties:
  reg:
    required: true

  clocks:
    required: true

  "#address-cells":
    required: true
    const: 1

  "#size-cells":
    required: true
    const: 0

child-binding:
  description: |
    Child device nodes are representing devices connected to the EBI/SMC bus.

  properties:
    reg:
      type: int
      required: true
      description: |
        The device's SMC Chip Select number.
        Valid range: 0 - 3

    atmel,smc-write-mode:
      type: string
      required: true
      description: |
        Select which signal is used for the write operation, either the chip
        select (ncs) or a dedicated write enable pin (nwe). The data is put
        on the bus during the pulse and hold steps of that signal.
        The internal data buffers are switched to output mode after the NCS_WR
        or NWE setup time.
      enum:
        - "ncs"
        - "nwe"

    atmel,smc-read-mode:
      type: string
      required: true
      description: |
        Select which signal is used for the read operation, either the chip
        select (ncs) or a dedicated output enable pin (nrd). The data is read
        from the bus during the pulse and hold steps of that signal.
      enum:
        - "ncs"
        - "nrd"

    atmel,smc-setup-timing:
      type: array
      required: true
      description: |
        This value is used to setup memory region (set address). The setup
        values is an array of the signals NWE, NCS_WR, NRD and NCS_RD
        where each value is configured in terms of MCK cycles. The SMC
        controller allows use of setups value of 0 (no delays) when
        consecutive reads/writes are used. Each value is encoded in
        6 bits where the highest bit adds an offset of 128 cycles.
        The effective value for each element is: 128 x setup[5] + setup[4:0]

    atmel,smc-pulse-timing:
      type: array
      required: true
      description: |
        This value is used to effectivelly read/write at memory region (pulse phase).
        The pulse value is an array of the signals NWE, NCS_WR, NRD and NCS_RD where
        each value is configured in terms of MCK cycles and a value of 0 is forbidden.
        Each value is encoded in 7 bits where the highest bit adds an offset of 256
        cycles. The effective value for each element is: 256 x setup[6] + setup[5:0]

    atmel,smc-cycle-timing:
      type: array
      required: true
      description: |
        SMC timing configurations in cycles for the total write and read
        length respectively.
        This value describes the entire write/read operation timing which
        is defined as: cycle = setup + pulse + hold
        Value has to be greater or equal to setup + pulse timing and
        is encoded in 9 bits where the two highest bits are multiplied
        with an offset of 256.
        Effective value for each element: 256 x cycle[8:7] + cycle[6:0]
```

## dts/bindings/memory-controllers/bflb,bl61x-psram.yaml
```yaml
# Copyright (c) 2025 MASSDRIVER EI (massdriver.space)
# SPDX-License-Identifier: Apache-2.0

description: BL61x pseudo-static RAM controller

compatible: "bflb,bl61x-psram"

include: base.yaml

properties:
  clock-divider:
    type: int
    required: true
    enum:
      - 1
      - 2
      - 3
      - 4
    description: Divide PLL div1 (WIFIPLL 320M or AUPLL) by this to PSRAM clock
```

## dts/bindings/memory-controllers/bflb,bl808-psram-uhs-controller.yaml
```yaml
# Copyright The Zephyr Project Contributors
# SPDX-License-Identifier: Apache-2.0

title: BL808 UHS PSRAM Controller

description: BL808 UHS PSRAM controller (MM subsystem)

compatible: "bflb,bl808-psram-uhs-controller"

include: base.yaml

properties:
  clocks:
    required: true
    description: |
      UHS PLL clock that drives the PSRAM PHY (BL808_CLKID_CLK_UHSPLL). Its
      rate is the PSRAM PCK frequency; the driver reads it at runtime and
      derives the PHY/timing/refresh/calibration parameters from it. Set the
      frequency on the clk_uhspll node's clock-frequency (supported 1800-2100 MHz).
```

## dts/bindings/memory-controllers/bflb,bl808-psram-uhs.yaml
```yaml
# Copyright The Zephyr Project Contributors
# SPDX-License-Identifier: Apache-2.0

title: BL808 UHS PSRAM Chip

description: |
  PSRAM chip attached to a BL808x UHS PSRAM controller. Combine with
  zephyr,memory-region (or another window-describing compatible) on the
  same node to expose the memory window.

compatible: "bflb,bl808-psram-uhs"

include: ["base.yaml", "zephyr,memory-region.yaml"]

properties:
  page-size:
    type: int
    required: true
    enum:
      - 2048
      - 4096
    description: |
      Chip page size in bytes. Maps to the controller's LINEAR_BND_B
      field (2 KB = 0x0B, 4 KB = 0x16) per the BL808 SDK
      PSRAM_UHS_Page_Size_Type enum.

  high-temp:
    type: boolean
    description: |
      Operate the chip in high-temperature refresh mode (refresh window
      halved from 32ms to 16ms). Set when the PSRAM is expected to run
      above ~85°C — depends on both the chip's operating-temperature
      grade and the board's thermal environment.
```

## dts/bindings/memory-controllers/bflb,sf-bank.yaml
```yaml
# Copyright (c) 2026 MASSDRIVER EI
# SPDX-License-Identifier: Apache-2.0

title: Serial Flash Controller Bank

description: |
  Bouffalolab Serial Flash Controller Bank.
  Not necessarily a flash chip.

compatible: "bflb,sf-bank"

include:
  - "zephyr,memory-common.yaml"
  - flash-controller.yaml
  - pinctrl-device.yaml

properties:
  reg:
    required: true
```

## dts/bindings/memory-controllers/bflb,sf-controller.yaml
```yaml
# Copyright (c) 2026 MASSDRIVER EI
# SPDX-License-Identifier: Apache-2.0

title: Serial Flash controller

description: |
  The Bouffalolab Serial Flash controller controls two banks of SPI devices.
  Unlike the name indicate, it is not limited to serial flashes,
  and the second bank can execute memory-mapped writes and allows PSRAMs and other byte-addressable
  devices to be used optimally.
  Using banks other than the embedded flash require pinctrl settings.

compatible: "bflb,sf-controller"

include: [base.yaml]

properties:
  reg:
    required: true

  override-bank1:
    type: boolean
    description: |
      Force using DTS provided settings instead of the flash header's for bank1's settings.

  use-32b-addresses:
    type: boolean
    description: |
      Enables using 32 bits length addresses. Must be supported by all devices connected.

  no-header:
    type: boolean
    description: |
      Do not use the bootheader for flash information.
```

## dts/bindings/memory-controllers/espressif,esp32-psram.yaml
```yaml
# Copyright (c) 2025 Espressif Systems (Shanghai) Co., Ltd.
# SPDX-License-Identifier: Apache-2.0

description: ESP32 pseudo-static RAM controller

compatible: "espressif,esp32-psram"

include: base.yaml

properties:
  size:
    type: int
    required: true
```
