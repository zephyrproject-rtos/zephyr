## dts/bindings/memory-controllers/infineon,xmc4xxx-ebu.yaml
```yaml
# Copyright (c) 2022, Schlumberger
# SPDX-License-Identifier: Apache-2.0

description: |
  Infineon XMC4XXX external bus unit (EBU).

  The EBU is used to connect to various types of memory devices such as
  Asynchronous SRAM, SDRAM and NAND flash. Up to four memory regions are supported
  and each can have its own timing/device configurations.

  The EBU supports up to four devices, where each one is enabled via chip select line.
  Each device has a separate executable address space. The address space for the executable
  regions are

  Region 0: 0x60000000 - 0x63ffffff
  Region 1: 0x64000000 - 0x67ffffff
  Region 2: 0x68000000 - 0x6bffffff
  Region 3: 0x6c000000 - 0x6fffffff

  An alternative address space which does not allow executing instructions is
  available at

  Region 0: 0xa0000000 - 0xa3ffffff
  Region 1: 0xa4000000 - 0xa7ffffff
  Region 2: 0xa8000000 - 0xabffffff
  Region 3: 0xac000000 - 0xafffffff

  The alternative or standard address space can be enabled using options below.

  The EBU has a set of global configuration (i.e. clock, pinctrl, ...) and a per
  region read/write timing configurations. The dts example below sets up region 0
  to use SDRAM (IS45S16400F) with the Infineon XMC4800 automation board.

  &ebu {
      pinctrl-0 = <&ebu_p0_2_ad0 &ebu_p0_3_ad1 ... >;
      pinctrl-names = "default";
      clk-config = <XMC4XXX_EBU_SET_CLC(0, 1, 0)>;
      modes-config = <XMC4XXX_EBU_SET_MODCON(0, 0, 0, 3, 0, 0)>;
      gpio-control-config = <XMC4XXX_EBU_SET_USERCON(0x1ff, 0)>;
      sdram-control = <XMC4XXX_EBU_SET_SDRMCON(0, 0, 0, 0, 2, 1, 5, 1, 1, 1, 0, 0, 0)>;
      sdram-operation-mode = <XMC4XXX_EBU_SDRMOD(0, 0, 1, 0, 3, 0)>;
      sdram-refresh-control = <XMC4XXX_EBU_SDRMREF(7, 1, 255, 0, 1, 1, 1, 2)>;
      ebu_sdram@0 {
              reg = <0>;
              device-type = "SDRAM";
              address-bus-width = "16-bit";
              region-enable;
              alternate-region-enable;
              bus-read-config = <XMC4XXX_EBU_SET_BUSRCON(3, 0, 0, 1, 0, 0, 0, 0, 0, 0, 1, 0, 0)>;
              bus-read-timing = <XMC4XXX_EBU_SET_BUSRAP(15, 7, 4, 0, 0, 0, 15, 15, 15)>;
              bus-write-config = <XMC4XXX_EBU_SET_BUSWCON(3, 0, 0, 0, 0, 0, 1, 0, 0, 0)>;
              bus-write-timing = <XMC4XXX_EBU_SET_BUSWAP(15, 7, 4, 0, 0, 0, 15, 15, 15)>;
      };
      status = "okay";
  };

  The memory region is accessible by defining the node

  sdram1: sdram@60000000 {
      compatible = "zephyr,memory-region", "mmio-sram";
      device_type = "memory";
      reg = <0x60000000 DT_SIZE_M(8)>;
      zephyr,memory-region = "SDRAM1";
  };

  The following properties define the EBU registers outlined in the XMC4XXX reference
  manual. A large number of configurations are exposed and it is recommended
  to carefully review the XMC4XXX manual to choose the proper settings for your
  target device.

  Each of the properties has a macro to simplify setting the values. The bitflags
  use the same names as defined in the reference manual.

compatible: "infineon,xmc4xxx-ebu"

include: [base.yaml, pinctrl-device.yaml]

properties:
  reg:
    required: true

  "#address-cells":
    required: true
    const: 1

  "#size-cells":
    required: true
    const: 0

  clk-config:
    type: int
    required: true
    description: |
      Configures Clock Control (CLC) register. Controls which clock is used for the EBU and
      the clock divider. Use XMC4XXX_EBU_SET_CLC(sync, div2, ebudiv).

  modes-config:
    type: int
    required: true
    description: |
      Sets Modes Configuration (MODCON) register. This mainly sets the arbitration parameters.
      Also it is used to configure whether address latch enable (ALE) is active high or low and
      whether SDRAM pins CKE, SDCLKO, CAS, and RAS are in tri-state when the EBU does not own
      the external bus.
      Use macro XMC4XXX_EBU_SET_MODCON(sdtri, extlock, arbsync, arbmode, timeoutc, ale).

  gpio-control-config:
    type: int
    required: true
    description: |
      Configures USERCON register. This register allows the user to free unused gpio pins.
      Use macro XMC4XXX_EBU_SET_USERCON(addio, advio).

  sdram-control:
    type: int
    description: |
      Configures SDRMCON register.
      Use macro XMC4XXX_EBU_SET_SDRMCON(sdcmsel, pwr_mode, clkdis, crce, bankm,
      rowm, crc, crcd, awidth, crp, crsc, crfsh, cras).

  sdram-operation-mode:
    type: int
    description: |
      Configures SDRMOD register.
      Use macro XMC4XXX_EBU_SDRMOD(xba, xopm, coldstart, opmode, caslat, burstl).

  sdram-refresh-control:
    type: int
    description: |
      Configures SDRMREF register.
      Use macro XMC4XXX_EBU_SDRMREF(res_dly, arfsh, selfrex_dly, erfshc, autoselfr,
      selfrex, refreshr, refreshc).

child-binding:
  description: |
    Child device nodes are representing devices connected to the EBU bus.

  properties:
    reg:
      type: int
      required: true
      description: |
        Selects the region to configure. All the following properties apply to this region.

    infineon,device-type:
      type: string
      required: true
      description: Device type.
      enum:
        - "Muxed Asynchronous Type"
        - "Muxed Burst Type"
        - "NAND Flash"
        - "Muxed Cellular RAM"
        - "Demuxed Asynchronous Type"
        - "Demuxed Burst Type"
        - "Demuxed Page Mode"
        - "Demuxed Cellular RAM"
        - "SDRAM"

    infineon,address-bus-width:
      type: string
      required: true
      description: Address bus width configuration.
      enum:
        - "16-bit"
        - "Twin-16-bit"
        - "32-bit"

    infineon,region-enable:
      type: boolean
      description: |
        The driver supports an executable and a non-executable address space, both pointing
        to the same physical memory. This option enables the executable address space for
        the region at 0x6X000000 - 0x6Xffffff, where X will depend on the region selected.

    infineon,alternate-region-enable:
      type: boolean
      description: |
        The driver supports an executable and a non-executable address space, both pointing
        to the same physical memory. This option enables the non-executable address space for
        the region at 0xaX000000 - 0xaXffffff, where X will depend on the region selected.

    infineon,write-protect-enable:
      type: boolean
      description: Enables write protection for the address space.

    infineon,bus-read-config:
      type: int
      required: true
      description: |
        Sets Bus Read Configuration Register (BUSRCON). This register mainly sets
        burst read configurations. Note that BUSRCON.AGEN and BUSRCON.PORTW are set
        using device-type and address-bus-width properties, respectively.
        Use macro XMC4XXX_EBU_SET_BUSRCON(fetblen, fbbmsel, bfsss, fdbken, bfcmsel, naa, ecse, ebse,
        dba, waitinv, bcgen, wait, aap).

    infineon,bus-write-config:
      type: int
      required: true
      description: |
        Sets Bus Write Configuration Register (BUSWCON). This register mainly sets the
        burst write configurations. Note that BUSWCON.AGEN is set using device-type property.
        Use macro XMC4XXX_EBU_SET_BUSWCON(fetblen, fbbmsel, naa, ecse, ebse, waitinv, bcgen,
        wait, aap, lockcs).

    infineon,bus-read-timing:
      type: int
      required: true
      description: |
        Configures Bus Read Access Parameters (BUSRAP) register.
        Use macro XMC4XXX_EBU_SET_BUSRAP(rddtacs, rdrecovc, waitrdc, datac, extclock, extdata,
        cmddelay, aholdc, addrc).

    infineon,bus-write-timing:
      type: int
      required: true
      description: |
        Configures Bus Write Access Parameters (BUSWAP) register.
        Use macro XMC4XXX_EBU_SET_BUSWAP(wrdtacs, wrrecovc, waitwrc, datac, extclock, extdata,
        cmddelay, aholdc, addrc).
```

## dts/bindings/memory-controllers/ite,it8xxx2-bbram.yaml
```yaml
# Copyright (c) 2021 Google Inc.
# SPDX-License-Identifier: Apache-2.0

description: ITE, IT8XXX2 Battery Backed RAM node

compatible: "ite,it8xxx2-bbram"

include: base.yaml

properties:
    reg:
        required: true
```

## dts/bindings/memory-controllers/ite,it8xxx2-ilm.yaml
```yaml
# Copyright (c) 2022 The ChromiumOS Authors
# SPDX-License-Identifier: Apache-2.0

description: ITE IT8XXX2 Instruction Local Memory
compatible: "ite,it8xxx2-ilm"
include: base.yaml
properties:
  reg:
    required: true
```

## dts/bindings/memory-controllers/microchip,xec-bbram.yaml
```yaml
# Copyright (c) 2021 Microchip Technologies Inc.
# SPDX-License-Identifier: Apache-2.0

description: Microchip, XEC family Battery Backed RAM node

compatible: "microchip,xec-bbram"

include: base.yaml

properties:
    reg:
        required: true
```

## dts/bindings/memory-controllers/motorola,mc146818-bbram.yaml
```yaml
# Copyright (c) 2025, Intel Corporation
#
# SPDX-License-Identifier: Apache-2.0

description: Motorola MC146818 compatible Real Timer Clock Battery Backed RAM

compatible: "motorola,mc146818-bbram"

include: base.yaml

on-bus: mc146818-mfd

properties:
  size:
    type: int
    required: true
    description: Memory capacity in bytes.
```

## dts/bindings/memory-controllers/nuvoton,nct-bbram.yaml
```yaml
# Copyright (c) 2021 Google Inc.
# SPDX-License-Identifier: Apache-2.0

description: Nuvoton, NCT Battery Backed RAM node

compatible: "nuvoton,nct-bbram"

include: base.yaml

properties:
  reg:
    required: true
```

## dts/bindings/memory-controllers/nuvoton,npcx-bbram.yaml
```yaml
# Copyright (c) 2021 Google Inc.
# SPDX-License-Identifier: Apache-2.0

description: Nuvoton, NPCX Battery Backed RAM node

compatible: "nuvoton,npcx-bbram"

include: base.yaml

properties:
  reg:
    required: true
  support-npckn-v1:
    type: boolean
    description: |
        This option enables the bbram driver for NPCKn.
```

## dts/bindings/memory-controllers/nxp,flexram.yaml
```yaml
# Copyright 2023 NXP
# SPDX-License-Identifier: Apache-2.0

description: |
  NXP FlexRAM on-chip ram controller
  If the flexram,bank-spec property is specified, then the flexram will be
  dynamically reconfigured to the configuration specified at runtime. An
  example to configure the flexram dynamically using the
  flexram,bank-spec property for rt1060 is as follows:

  &itcm {
          reg = < 0x0 DT_SIZE_K(64) >;
  };
  &dtcm {
          reg = < 0x20000000 DT_SIZE_K(384) >;
  };
  &ocram {
          reg = < 0x20280000 DT_SIZE_K(64) >;
  };
  &flexram {
          flexram,bank-spec = <FLEXRAM_OCRAM>,
                              <FLEXRAM_OCRAM>,
                              <FLEXRAM_DTCM>,
                              <FLEXRAM_DTCM>,
                              <FLEXRAM_DTCM>,
                              <FLEXRAM_DTCM>,
                              <FLEXRAM_DTCM>,
                              <FLEXRAM_DTCM>,
                              <FLEXRAM_ITCM>,
                              <FLEXRAM_ITCM>,
                              <FLEXRAM_DTCM>,
                              <FLEXRAM_DTCM>,
                              <FLEXRAM_DTCM>,
                              <FLEXRAM_DTCM>,
                              <FLEXRAM_DTCM>,
                              <FLEXRAM_DTCM>;
  };

  This will configure the flexram for 384K of DTCM, 64K of ITCM,
  and 64K of OCRAM.


include: base.yaml

compatible: "nxp,flexram"

properties:
  reg:
    required: true

  interrupts:
    required: true

  flexram,has-magic-addr:
    type: boolean
    description: |
      Whether or not the flexram on the SOC has the
      magic address feature, which allows for an interrupt
      on arbitrary address access in any on chip RAM region.

  flexram,num-ram-banks:
    type: int
    required: true
    description: |
      Number of RAM banks in the SOC ram array

  flexram,bank-size:
    type: int
    required: true
    description: |
      Size of each RAM bank in KB

  flexram,bank-spec:
    type: array
    description: |
      Custom mapping of runtime RAM bank partitions. If this
      property is present, then it will be used. If this
      property is not present, then the fusemap configuration
      will be used.

  flexram,tcm-read-wait-mode:
    type: boolean
    description: |
      TCM RAM read will finish in 2 cycles instead of 1.

  flexram,tcm-write-wait-mode:
    type: boolean
    description: |
      TCM RAM write will finish in 2 cycles instead of 1.
```

## dts/bindings/memory-controllers/nxp,imx-semc.yaml
```yaml
# Copyright (c) 2018, NXP
# SPDX-License-Identifier: Apache-2.0

description: NXP Smart External Memory Controller (SEMC)

compatible: "nxp,imx-semc"

bus: semc

include: [base.yaml, pinctrl-device.yaml]

properties:
    reg:
      required: true

    interrupts:
      required: true
```

## dts/bindings/memory-controllers/nxp,imx-snvs-gpr.yaml
```yaml
# SPDX-FileCopyrightText: 2026 Basalte bv
# SPDX-License-Identifier: Apache-2.0

description: |
  NXP i.MX SNVS Low-Power General Purpose Registers used as battery-backed
  RAM.

  The SNVS LPGPR bank retains its contents across resets as long as the SNVS
  Low-Power domain is powered (typically via VBAT). A security violation
  detected by the SNVS tamper logic will zeroize this bank when LPCR.GPR_Z_DIS
  is clear (the reset default).

compatible: "nxp,imx-snvs-gpr"

include: base.yaml
```

## dts/bindings/memory-controllers/nxp,lpc-emc.yaml
```yaml
# Private Porting
# by David Hor - Xtooltech 2025
# david.hor@xtooltech.com

# Copyright (c) 2025 Xtooltech
# SPDX-License-Identifier: Apache-2.0

description: NXP LPC External Memory Controller (EMC)

compatible: "nxp,lpc-emc"

include: [base.yaml, pinctrl-device.yaml]

properties:
  reg:
    required: true

  clocks:
    required: true

  "#address-cells":
    const: 1

  "#size-cells":
    const: 1

  nxp,emc-clock-div:
    type: int
    default: 1
    description: |
      EMC clock divider. The EMC clock is derived from the CPU clock divided by this value.
      Valid values are 0 (same as CPU clock) or 1 (half of CPU clock).
    enum:
      - 0
      - 1

  nxp,command-delay:
    type: int
    default: 0
    description: |
      Programmable delay value for EMC outputs in command delayed mode.
      Range 0-15.

child-binding:
  description: SDRAM chip configuration

  properties:
    compatible:
      type: string
      required: true
      enum:
        - "nxp,lpc-emc-sdram"

    reg:
      type: array
      required: true
      description: |
        Memory mapped address and size of the SDRAM chip.

    nxp,sdram-config:
      type: array
      required: true
      description: |
        SDRAM configuration array:
        [0] - Device type (0=SDR SDRAM)
        [1] - Data bus width (0=16-bit, 1=32-bit)
        [2] - Number of banks (0=2 banks, 1=4 banks)
        [3] - Row address bits (11-13)
        [4] - Column address bits (8-12)

    nxp,sdram-timing:
      type: array
      required: true
      description: |
        SDRAM timing parameters in nanoseconds:
        [0] - tRP (RAS precharge time)
        [1] - tRAS (RAS active time)
        [2] - tSREX (Self-refresh exit time)
        [3] - tAPR (Last data out to active time)
        [4] - tDAL (Data-in to active time)
        [5] - tWR (Write recovery time)
        [6] - tRC (RAS cycle time)
        [7] - tRFC (Auto-refresh period)
        [8] - tXSR (Exit self-refresh time)
        [9] - tRRD (RAS to RAS delay)
        [10] - tMRD (Mode register delay cycles)

    nxp,refresh-period:
      type: int
      required: true
      description: |
        Refresh period in microseconds. Typically 64000 for 64ms refresh.

    nxp,cas-latency:
      type: int
      required: true
      description: |
        CAS latency in clock cycles (2 or 3).
      enum:
        - 2
        - 3

    nxp,mode-register:
      type: int
      default: 0x33
      description: |
        SDRAM mode register value.
```
