## dts/bindings/lin/renesas,ra-lin-sci-b.yaml
```yaml
# Copyright (c) 2025 Renesas Electronics Corporation
# SPDX-License-Identifier: Apache-2.0

description: Renesas RA LIN SCI controller

compatible: "renesas,ra-lin-sci-b"

include: [lin-controller.yaml, pinctrl-device.yaml]

properties:
  noise-filter:
    type: boolean
    description: Enable digital filter on RXD pin

  noise-filter-clk:
    type: string
    default: "base-clock"
    enum: ["base-clock", "baudrate-generator-clock"]
    description: |
      Select the clock source for the digital noise filter.
      - base-clock: calculated by: base-clock = 1 / [ (1 / baud_rate) / cycles_per_bit_period ]
      - baudrate-generator-clock: clock source of the baud rate generator
      Notes:
      - When noise-filter is false, this property is ignored.
      - When noise-filter-clk is "baudrate-generator-clock", the property
        noise-filter-clock-select must be specified.
      - When noise-filter-clk is "base-clock", the property noise-filter-clk-div must be specified.

  noise-filter-clk-div:
    type: int
    default: 1
    enum: [1, 2, 4, 8]
    description: |
      Select the division ratio of the clock source for the digital noise filter.
      Notes:
      - When noise-filter-clk is "base-clock", this property is ignored (always divide by 1).
      - When noise-filter is false, this property is ignored.

  bus-conflict-detection-clk-div:
    type: int
    default: 1
    enum: [1, 2, 4]
    description: |
      Select the base clock divider for sampling clock of the bus conflict detection circuit.
      Notes:
      - When bus-conflict-detection is false, this property is ignored.
```

## dts/bindings/lin/renesas,rh850-rlin3.yaml
```yaml
# Copyright (c) 2026 Renesas Electronics Corporation
# SPDX-License-Identifier: Apache-2.0

description: Renesas RH850 RLIN3 controller

compatible: "renesas,rh850-rlin3"

include: [base.yaml, pinctrl-device.yaml]

properties:
  reg:
    required: true
```

## dts/bindings/lin/zephyr,lin-skeleton.yaml
```yaml
# Copyright (c) 2025 Renesas Electronics Corporation
# SPDX-License-Identifier: Apache-2.0

description: Skeleton for LIN controller

compatible: "zephyr,lin-skeleton"

include: lin-controller.yaml
```

## dts/bindings/lora/reyax,rylrxxx.yaml
```yaml
# Copyright (c) 2024 David Ullmann
# SPDX-License-Identifier: Apache-2.0

description: Reyax lora module with AT-command serial interface

compatible: "reyax,rylrxxx"

include: uart-device.yaml

properties:
  reset-gpios:
    type: phandle-array
    required: true
```

## dts/bindings/lora/seed,wm1110-radio.yaml
```yaml
# Copyright (c) 2025 Hasan Albinsaid (mail@hasanabs.com)
# SPDX-License-Identifier: Apache-2.0

description: Semtech LR1110 LoRa transceiver on Seed WM1110

compatible: "seed,wm1110-radio"

include:
  - spi-device.yaml

properties:
  reset-gpios:
    type: phandle-array
    required: true
    description: Reset pin

  busy-gpios:
    type: phandle-array
    required: true
    description: Busy pin

  irq-gpios:
    type: phandle-array
    required: true
    description: Interrupt pin
```

## dts/bindings/lora/semtech,llcc68.yaml
```yaml
# Copyright (c) 2025 MASSDRIVER EI (massdriver.space)
# SPDX-License-Identifier: Apache-2.0

description: |
  Semtech LLCC68 LoRa Modem
  A cost-cut version of sx126x with limited Spreading Factors and Bandwidth selections:
  SF=5-6-7-8-9 for BW=125kHz,
  SF=5-6-7-8-9-10 for BW =250 kHz,
  SF=5-6-7-8-9-10-11 for BW=500 kHz.

compatible: "semtech,llcc68"

include: semtech,sx126x-base.yaml

properties:
  reset-gpios:
    required: true
  busy-gpios:
    required: true
  dio1-gpios:
    required: true
```

## dts/bindings/lora/semtech,lr1110-basic.yaml
```yaml
# Copyright (c) 2025 Hasan Albinsaid (mail@hasanabs.com)
# SPDX-License-Identifier: Apache-2.0

description: Semtech LR1110 LoRa transceiver

compatible: "semtech,lr1110-basic"

include:
  - spi-device.yaml

properties:
  reset-gpios:
    type: phandle-array
    required: true
    description:   |
      GPIO connected to the LR1110 NRESET pin.
      This signal is active-low.

  busy-gpios:
    type: phandle-array
    required: true
    description: |
      GPIO connected to the LR1110 BUSY pin.
      Indicates when the device is processing commands.

  event-gpios:
    type: phandle-array
    required: true
    description: |
      GPIO connected to the LR1110 EVENT (DIO9) pin.
      Used to signal interrupts and radio events.
```

## dts/bindings/lora/semtech,lr1121.yaml
```yaml
# Copyright (c) 2026 MASSDRIVER EI (massdriver.space)
# SPDX-License-Identifier: Apache-2.0

title: Semtech LR1121 LoRa Modem

description: |
  Semtech LR1121 LoRa Modem. It supports 150-960MHz sub-GHz ISM bands, 1.9-2.1GHz Satellite bands,
  and the 2.4GHz ISM band.
  Unlike LR1110 or LR1120, it is not capable of receiving GNSS or WiFi signals.

compatible: "semtech,lr1121"

include: semtech,lr11xx-base.yaml

properties:
  reset-gpios:
    required: true
  busy-gpios:
    required: true
  irq-gpios:
    required: true
  lf-clk:
    required: true
```

## dts/bindings/lora/semtech,lr11xx-base.yaml
```yaml
# Copyright (c) 2026 MASSDRIVER EI (massdriver.space)
# SPDX-License-Identifier: Apache-2.0

include: spi-device.yaml

properties:
  reset-gpios:
    type: phandle-array
    description: |
      Pin connected to the modem's typically active-low RESET signal.

  busy-gpios:
    type: phandle-array
    description: |
      Pin connected to the modem's typically active-high BUSY signal.

  irq-gpios:
    type: phandle-array
    description: |
      Pin connected to the modem's typically active-high IRQ Pin. It is DIO9 for this driver.

  lf-clk:
    type: string
    enum:
      - "RC"
      - "XTAL"
      - "DIO11"
    description: |
      Low frequency clock source for the radio.
      - RC: 32.768KHz RC Oscillator.
      - XTAL: 32.768KHz Crystal Oscillator.
      - DIO11: 32.768KHz Signal on DIO11.

  tcxo-voltage:
    type: int
    default: 0
    enum:
      - 1600
      - 1700
      - 1800
      - 2200
      - 2400
      - 2700
      - 3000
      - 3300
      - 0
    description: |
      TCXO voltage in mV, except 0 where TCXO is disabled.
      The default is no TCXO is used.

  tcxo-power-startup-delay-ms:
    type: int
    default: 5
    description: |
      Startup delay to let the TCXO stabilize after TCXO power on. 5 ms is usually sufficient.

  rfsw-enable:
    type: int
    default: 0
    description: |
      RF switch DIO enable bitmask. Pins set here are used to set RF path, unset pins are kept Hi-Z.
      - A[0]: DIO5 (RFSW0)
      - A[1]: DIO6 (RFSW1)
      - A[2]: DIO7 (RFSW2)
      - A[3]: DIO8 (RFSW3)
      - A[4]: DIO10 (RFSW4)

      The default has no pins controlling amplifiers.

  rfsw-standby:
    type: int
    default: 0
    description: |
      RF switch state in standby mode. See rfsw-enable for mask bit meaning.
      Defines which RFSW GPIOs are set high (bit set) or low (bit unset) in the mode.

  rfsw-rx:
    type: int
    default: 0
    description: RF switch state in RX mode. See rfsw-standby.

  rfsw-tx:
    type: int
    default: 0
    description: RF switch state in sub-GHz, low-power TX mode. See rfsw-standby.

  rfsw-tx-hp:
    type: int
    default: 0
    description: RF switch state in sub-GHz, high-power TX mode. See rfsw-standby.

  rfsw-tx-hf:
    type: int
    default: 0
    description: RF switch state in high-frequency TX mode. See rfsw-standby.

  rfsw-gnss:
    type: int
    default: 0
    description: RF switch state in GNSS RX mode. See rfsw-standby.

  rfsw-wifi:
    type: int
    default: 0
    description: RF switch state in WIFI RX mode. See rfsw-standby.

  use-dcdc:
    type: boolean
    description: Use DCDC regulator instead of LDO (RegMode = 1).

  force-ldro:
    type: boolean
    description: |
      Force usage of Low Data Rate Optimization even in cases where the symbol time is shorter than
      16.38ms. Useful for designs using no TCXO or with bad heat dissipation.

  rx-boosted:
    type: boolean
    description: |
      Enable RX boosted mode, which increases the power consumption of
      RX mode by ~2mA in exchange for ~2dB sensitivity improvement.
```

## dts/bindings/lora/semtech,sx1261.yaml
```yaml
# Copyright (c) 2020 Andreas Sandberg
# SPDX-License-Identifier: Apache-2.0

description: Semtech SX1261 LoRa Modem

compatible: "semtech,sx1261"

include: semtech,sx126x-base.yaml

properties:
    reset-gpios:
      required: true
    busy-gpios:
      required: true
    dio1-gpios:
      required: true
```

## dts/bindings/lora/semtech,sx1262.yaml
```yaml
# Copyright (c) 2020 Andreas Sandberg
# SPDX-License-Identifier: Apache-2.0

description: Semtech SX1262 LoRa Modem

compatible: "semtech,sx1262"

include: semtech,sx126x-base.yaml

properties:
    reset-gpios:
      required: true
    busy-gpios:
      required: true
    dio1-gpios:
      required: true
```

## dts/bindings/lora/semtech,sx1268.yaml
```yaml
# Copyright (c) 2025 MASSDRIVER EI (massdriver.space)
# SPDX-License-Identifier: Apache-2.0

description: |
  Semtech SX1268 LoRa Modem
  A variant of sx1262 targeting Chinese regulations compliance.

compatible: "semtech,sx1268"

include: semtech,sx126x-base.yaml

properties:
  reset-gpios:
    required: true
  busy-gpios:
    required: true
  dio1-gpios:
    required: true
```

## dts/bindings/lora/semtech,sx126x-base.yaml
```yaml
# Copyright (c) 2019 Manivannan Sadhasivam
# Copyright (c) 2020 Andreas Sandberg
# SPDX-License-Identifier: Apache-2.0

include: spi-device.yaml

properties:
  reset-gpios:
    type: phandle-array
    description: |
      GPIO connected to the modem's NRESET signal.

      This signal is open-drain, active-low as interpreted by the
      modem.

  busy-gpios:
    type: phandle-array
    description: |
      GPIO connected to the modem's BUSY signal.

  antenna-enable-gpios:
    type: phandle-array
    description: |
      Antenna power enable pin.

  tx-enable-gpios:
    type: phandle-array
    description: |
      Antenna switch TX enable GPIO. If set, the driver tracks the
      state of the radio and controls the RF switch.

  rx-enable-gpios:
    type: phandle-array
    description: |
      Antenna switch RX enable GPIO. If set, the driver tracks the
      state of the radio and controls the RF switch.

  dio1-gpios:
    type: phandle-array
    description: |
      GPIO connected to DIO1. This GPIO will be used as a generic
      IRQ line from the chip.

  dio2-tx-enable:
    type: boolean
    description: |
      Use DIO2 to drive an RF switch selecting between the TX and RX
      paths. When enabled, DIO2 goes high when the chip is
      transmitting.

  dio3-tcxo-voltage:
    type: int
    description: |
      TCXO supply voltage controlled by DIO3 if present.

      See constants in dt-bindings/lora/sx126x.h.

  tcxo-power-startup-delay-ms:
    type: int
    description: |
      Startup delay to let the TCXO stabilize after TCXO power on.

  rx-boosted:
    type: boolean
    description: |
      Enable RX boosted mode, which increases the power consumption of
      RX mode by ~2mA in exchange for ~3dB sensitivity improvement.
```

## dts/bindings/lora/semtech,sx1272.yaml
```yaml
# Copyright (c) 2021, Ilya Tagunov
# SPDX-License-Identifier: Apache-2.0

description: Semtech SX1272 LoRa Modem

compatible: "semtech,sx1272"

include: semtech,sx127x-base.yaml
```

## dts/bindings/lora/semtech,sx1276.yaml
```yaml
# Copyright (c) 2021, Ilya Tagunov
# SPDX-License-Identifier: Apache-2.0

description: Semtech SX1276 LoRa Modem

compatible: "semtech,sx1276"

include: semtech,sx127x-base.yaml
```

## dts/bindings/lora/semtech,sx1278.yaml
```yaml
# Copyright (c) 2025 MASSDRIVER EI (massdriver.space)
# SPDX-License-Identifier: Apache-2.0

description: |
  Semtech SX1278 LoRa Modem
  A variant of sx1276 targeting sub-525MHz bands.

compatible: "semtech,sx1278"

include: semtech,sx127x-base.yaml
```

## dts/bindings/lora/semtech,sx127x-base.yaml
```yaml
# Copyright (c) 2019, Manivannan Sadhasivam
# Copyright (c) 2020, Grinn
# SPDX-License-Identifier: Apache-2.0

include: spi-device.yaml

properties:
  reset-gpios:
    type: phandle-array
    required: true
    description: |
      GPIO connected to the modem's RESET/NRESET signal.

      This signal is open-drain, active-high (SX1272/3) or
      active-low (SX1276/7/8/9) as interpreted by the modem.

  dio-gpios:
    type: phandle-array
    required: true
    description: |
      Up to six pins that produce service interrupts from the modem.

      These signals are normally active-high.

  power-amplifier-output:
    type: string
    description: |
      Selects power amplifier output pin. This is required when neither
      'rfo-enable-gpios' nor 'pa-boost-enable-gpios' is specified. In other
      case this property is simply ignored.
    enum:
      - "rfo"
      - "pa-boost"

  antenna-enable-gpios:
    type: phandle-array
    description: |
      Antenna power enable pin.

  rfi-enable-gpios:
    type: phandle-array
    description: |
      RFI antenna input enable pin.

  rfo-enable-gpios:
    type: phandle-array
    description: |
      RFO antenna output enable pin.

  pa-boost-enable-gpios:
    type: phandle-array
    description: |
      PA_BOOST antenna output enable pin.

  tcxo-power-gpios:
    type: phandle-array
    description: |
      TCXO power enable pin.

  tcxo-power-startup-delay-ms:
    type: int
    description: |
      Delay which has to be applied after enabling TCXO power.
```

## dts/bindings/lora/st,stm32wl-subghz-radio.yaml
```yaml
# Copyright (c) 2021 Fabio Baltieri
# SPDX-License-Identifier: Apache-2.0

description: STM32WL SUBGHZ Radio

compatible: "st,stm32wl-subghz-radio"

include: semtech,sx126x-base.yaml

properties:
  interrupts:
    required: true
    description: |
      Position of the "Radio IRQ, Busy" interrupt line.

  power-amplifier-output:
    type: string
    required: true
    description: |
      Selects between the low- and high-power power amplifier output pin.
    enum:
      - "rfo-lp"
      - "rfo-hp"

  rfo-lp-max-power:
    type: int
    default: 14
    description: |
      Maximum design power for the board's RFO_LP output matching network.

      The default setting of +14 dBm is a prevalent board configuration;
      however, for optimal performance, it is advisable to align the value with
      the board's RF design.

      See ST application note AN5457, chapter 5.1.2 for more information.
    enum:
      - 10
      - 14
      - 15

  rfo-hp-max-power:
    type: int
    default: 22
    description: |
      Maximum design power for the board's RFO_HP output matching network.

      The default setting of +22 dBm is a prevalent board configuration;
      however, for optimal performance, it is advisable to align the value with
      the board's RF design.

      See ST application note AN5457, chapter 5.1.2 for more information.
    enum:
      - 14
      - 17
      - 20
      - 22
```

## dts/bindings/lora/we,wsen-daphnis-i.yaml
```yaml
# Copyright (c) 2025 Würth Elektronik eiSos GmbH & Co. KG
# SPDX-License-Identifier: Apache-2.0

description: |
  Daphnis-I (EU868) Module
  Refer to https://www.we-online.com/en/components/products/manual/2618011181000

compatible: "we,wsen-daphnis-i"

include: uart-device.yaml

properties:
  reset-gpios:
    required: true
    type: phandle-array
    description: |
      Reset pin. This pin shall be connected to the reset pin of the module.

  wakeup-gpios:
    required: true
    type: phandle-array
    description: |
      Wake up pin. This pin shall be connected to the wake up pin of the module.

  boot-gpios:
    required: true
    type: phandle-array
    description: |
      Boot pin. This pin shall be connected to the Boot pin of the module.

  duty-cycle-restriction:
    type: boolean
    description: |
      If set it will keep track of TOA of the sent packets and make sure
      that the limit is not reached.
```
