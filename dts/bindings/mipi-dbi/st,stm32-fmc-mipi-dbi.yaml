## dts/bindings/mipi-dbi/st,stm32-fmc-mipi-dbi.yaml
```yaml
# Copyright (c) 2024 Bootlin
# SPDX-License-Identifier: Apache-2.0

description: |
  STM32 Flexible Memory Controller (FMC) display controller supporting
  parallel MIPI-DBI interfaces in both 8-bit and 16-bit configurations.
  The hardware bus width is configured in the parent NOR/PSRAM memory controller
  bank node (st,control property MWID field).

compatible: "st,stm32-fmc-mipi-dbi"

include: ["mipi-dbi-controller.yaml"]

properties:
  bank-address:
    type: int
    description: |
      Optional property to provide FMC Bank address.

  reset-gpios:
    type: phandle-array
    description: |
      Reset GPIO pin. Set high to reset the display

  power-gpios:
    type: phandle-array
    description: |
      Power GPIO pin. Set high to power the display.

  register-select-pin:
    type: int
    required: true
    description: |
      Address pin used as Register Select for the display controller.
      In 16-bit bus mode, pin FMC_Ax is driven by internal address line HADDR[x + 1].
      In 8-bit bus mode, pin FMC_Ax is driven by internal address line HADDR[x].
```

## dts/bindings/mipi-dbi/zephyr,mipi-dbi-spi.yaml
```yaml
# Copyright 2023 NXP
# SPDX-License-Identifier: Apache-2.0

description: |
  MIPI-DBI Mode C compatible SPI controller. This driver emulates MIPI DBI
  mode C using a SPI controller and GPIO pins
compatible: "zephyr,mipi-dbi-spi"

include: ["mipi-dbi-controller.yaml", "pinctrl-device.yaml"]

properties:
  spi-dev:
    type: phandle
    required: true
    description: |
      SPI device to use for data transfers with MIPI DBI commands. This SPI
      device should be connected to the MIPI DBI display.

  dc-gpios:
    type: phandle-array
    description: |
      Data/command gpio pin. Required when using 4 wire SPI mode (Mode C1).
      Set to low when sending a command, or high when sending data.

  dc-gpios-shared:
    type: boolean
    description: |
      Set this property if the data/command pin is physically shared with
      another function of the SPI bus, such as a controller MISO line that
      pinctrl also assigns to the same pad. When set, the driver takes
      ownership of the bus, drives the pin only for the duration of a
      transfer, and then re-applies the default pin control state of the bus
      before dropping that ownership, which hands the pad back so another
      device can use it while the display is idle. The bus must therefore be
      described with pin control.

      A pin shared with the MISO line cannot carry a 4 wire read, and a read
      of any mode would hand the bus over while the pad is still muxed away
      from it, so reads are refused on a shared pin and the controllers on
      such a bus have to be write-only.

  te-gpios:
    type: phandle-array
    description: |
      Tearing Effect GPIO pin. Set to high when the display is blanking
      (i.e., not actively reading pixels from its RAM).

  reset-gpios:
    type: phandle-array
    description: |
      Reset GPIO pin. Set high to reset the display

  xfr-min-bits:
    type: string
    default: "MIPI_DBI_SPI_XFR_8BIT"
    description:
      On rare types of SPI interfaces, discrete shift registers can be found
      whose task is to convert the serial SPI bit stream to the parallel MCU
      interface with clock and bit accuracy. Typically, these are 16 bits wide.
      These definitions should match those in dt-bindings/mipi_dbi/mipi_dbi.h
    enum:
      - "MIPI_DBI_SPI_XFR_8BIT"
      - "MIPI_DBI_SPI_XFR_16BIT"

  write-only:
    type: boolean
    description: |
      Only writes to display controller, do not perform reads.
      If all controllers are write-only, read functions will be
      optimized out for size.
      It can also be used as an alternative to half duplex when
      only one data line is connected.
```

## dts/bindings/mipi-dsi/espressif,esp-mipi-dsi.yaml
```yaml
#
# Copyright (c) 2026 Espressif Systems (Shanghai) Co., Ltd.
#
# SPDX-License-Identifier: Apache-2.0
#

description: Espressif ESP32 MIPI DSI host controller

compatible: "espressif,esp-mipi-dsi"

include: mipi-dsi-host.yaml

properties:
  reg:
    required: true

  data-lanes:
    type: int
    required: true
    min: 1
    max: 2
    description: |
      Number of MIPI DSI data lanes. The D-PHY is brought up before a panel
      attaches, so the count is needed here as well as on the panel node,
      and the two have to agree.

  dpi-clock-frequency:
    type: int
    required: true
    description: |
      DPI pixel clock frequency in Hz. It is derived from the fixed 240 MHz
      source through an integer divider, so a value that does not divide it
      evenly is rounded to the nearest achievable rate.
```

## dts/bindings/mipi-dsi/nxp,mipi-dsi-split.yaml
```yaml
#
# SPDX-FileCopyrightText: Copyright 2026 NXP
#
# SPDX-License-Identifier: Apache-2.0
#
description:
  NXP MIPI DSI Split controller.
  The controller's registers are split into 5 functional blocks in IP level, including
  host controller(status control), DPI interface, DBI interface, APB packet interface,
  and D-PHY. The register regions and their names shall be specified properly in device
  tree for driver to access.

compatible: "nxp,mipi-dsi-split"

include: mipi-dsi-host.yaml

properties:
  reg:
    required: true
    description:
      Register regions for the host controller, DPI interface, DBI interface,
      APB packet interface, and D-PHY.

  reg-names:
    required: true
    description:
      Names of the register regions. Must include "host", "dpi", "dbi",
      "apb", and "dphy".

  interrupts:
    required: true

  nxp,lcdif:
    type: phandle
    description:
      Instance of the LCDIF peripheral. Only required when using the MIPI
      in video mode

  dpi-pixel-packet:
    type: string
    enum:
      - "16-bit"
      - "18-bit"
      - "18-bit-loose"
      - "24-bit"
    description:
      MIPI DSI pixel packet type send through DPI interface.

  dpi-video-mode:
    type: string
    enum:
      - "non-burst-sync-pulse"
      - "non-burst-sync-event"
      - "burst"
    description:
      DPI video mode.

  dpi-bllp-mode:
    type: string
    enum:
      - "blank"
      - "null"
      - "vertical-low-power"
      - "horizontal-low-power"
      - "low-power"
    description:
      Behavior in BLLP (Blanking or Low-Power Interval). "low-power" is both
      vertical and horizontal low power combined, for compatibility with
      boards/shields written against nxp,mipi-dsi-2l's enum of the same name.

  autoinsert-eotp:
    type: boolean
    description:
      Automatically insert an EoTp short packet when switching from HS to LP mode.

  esc-rx-clock:
    type: int
    default: 200000000
    description: |
      Target D-PHY RX escape clock frequency, in Hz (DSI D-PHY spec: 100-300 MHz).
      The achieved rate is the escape-clock-source frequency divided down to the
      nearest integer divider; see esc-tx-clock for the second stage.

  esc-tx-clock:
    type: int
    default: 20000000
    description: |
      Target D-PHY TX escape clock frequency, in Hz (DSI D-PHY spec: 12-20 MHz max).
      The achieved rate is esc-rx-clock's achieved frequency divided down further to
      the nearest integer divider.

  continuous-hs-clk:
    type: boolean
    description:
      Enable continuous high speed clock. Non-continuous clock mode Saves power but
      introduces latency when transitioning to high speed mode.
```

## dts/bindings/mipi-dsi/st,stm32mp25-mipi-dsi.yaml
```yaml
# Copyright (C) 2025 Savoir-faire Linux, Inc.
# SPDX-License-Identifier: Apache-2.0

description: |
    STM32MP25 series MIPI DSI controller.

    On the STM32MP25 the DSI PHY reference clock and the LTDC pixel clock
    are generated by the RCC flexgen, which is configured by the Cortex-A35
    firmware. The "refclk" entry returns the DSI PHY reference clock rate
    (ck_ker_dsiphy) and the "pixelclk" entry the LTDC pixel clock rate
    (ck_ker_ltdc).

compatible: "st,stm32mp25-mipi-dsi"

include:
  - name: st,stm32-mipi-dsi.yaml
    property-blocklist:
      - lp-rx-filter
```

## dts/bindings/misc/espressif,crosscore-interrupt.yaml
```yaml
# Copyright (c) 2026 Espressif Systems (Shanghai) Co., Ltd.
# SPDX-License-Identifier: Apache-2.0

description: |
  Espressif cross-core interrupt (FROM_CPU) trigger register.

  Each node describes one FROM_CPU software interrupt source. Writing the
  register raises the corresponding interrupt on the core the source is
  routed to, which is how the SoC signals the scheduler IPI and, on SoCs
  with a shared cache, the cross-core stall used around flash operations.

compatible: "espressif,crosscore-interrupt"

include: [base.yaml]

properties:
  reg:
    required: true

  interrupts:
    required: true
```

## dts/bindings/misc/espressif,esp32-ppa.yaml
```yaml
# Copyright (c) 2026 Espressif Systems (Shanghai) Co., Ltd.
# SPDX-License-Identifier: Apache-2.0

description: |
  Espressif pixel processing accelerator.

  The accelerator scales, rotates, mirrors and blends blocks of pixels, and
  moves them with its own 2D DMA.

  This binding only describes the registers and the transfer completion
  interrupt.

compatible: "espressif,esp32-ppa"

include: base.yaml

properties:
  reg:
    required: true

  reg-names:
    required: true
    description: |
      Two entries, "ppa" for the accelerator and "dma2d" for the 2D DMA
      that moves the pixels for it.

  interrupts:
    required: true
```

## dts/bindings/misc/espressif,esp32-sdm.yaml
```yaml
# Copyright (c) 2026 Espressif Systems (Shanghai) Co., Ltd.
# SPDX-License-Identifier: Apache-2.0

title: Espressif Sigma-Delta Modulator (SDM)

description: |
  Sigma-delta modulator. Each channel outputs a pulse-density stream on one
  GPIO. Route the channel with pinctrl: SDM_CHn selects channel n, and the
  child node's reg value must use that same index.

    &sdm0 {
      pinctrl-0 = <&sdm0_default>;
      pinctrl-names = "default";
      status = "okay";

      channel0@0 {
        reg = <0>;
        sample-rate-hz = <1000000>;
      };
    };

    sdm0_default: sdm0_default {
      group1 {
        pinmux = <SDM_CH0_GPIO4>;
        output-enable;
      };
    };

  The driver divides the default SDM clock by an integer prescaler from 1 to
  256 to obtain sample-rate-hz. Density is changed at run time with
  esp32_sdm_set_pulse_density().

compatible: "espressif,esp32-sdm"

include: [base.yaml, pinctrl-device.yaml]

properties:
  reg:
    required: true

child-binding:
  description: SDM channel configuration.

  properties:
    reg:
      type: int
      required: true
      enum:
        - 0
        - 1
        - 2
        - 3
        - 4
        - 5
        - 6
        - 7
      description: |
        Channel index. It must match the SDM_CHn signal used in pinctrl.
        ESP32, ESP32-S2, ESP32-S3 and ESP32-P4 have channels 0 through 7.
        ESP32-C3, ESP32-C5, ESP32-C6 and ESP32-H2 have channels 0 through 3.

    sample-rate-hz:
      type: int
      required: true
      description: |
        Target sample rate, in Hz. The hardware prescaler is the integer
        ratio of the default source clock to this rate and must fall in
        the range 1 to 256.
```

## dts/bindings/misc/infineon,mpc.yaml
```yaml
# SPDX-FileCopyrightText: Copyright (c) 2026 Infineon Technologies AG,
# SPDX-FileCopyrightText: or an affiliate of Infineon Technologies AG. All rights reserved.
#
# SPDX-License-Identifier: Apache-2.0

title: Infineon Memory Protection Controller (MPC)

description: |
  Infineon MPC hardware block. Each instance controls access to
  a specific memory region (RRAM, SRAM, SoC memory, or external flash).

  Memory regions governed by this MPC are described as child nodes. Each
  child defines an (offset, size) range within the controlled memory and
  the protection-context (PC) configuration that grants access to it.  The
  MPC block size is read from the hardware, so no size property is needed.

  The pc-configs value uses the field constants from
  <zephyr/dt-bindings/mpc/infineon-mpc.h>.

  Example (RAMC0 MPC, granting M33-S PC2/PC7 secure RW to an SRAM slice):

    #include <zephyr/dt-bindings/mpc/infineon-mpc.h>

    mpc_ramc0: mpc@52234000 {
        compatible = "infineon,mpc";
        reg = <0x52234000 0x1000>;
        violation-response = "bus-error";
        #address-cells = <1>;
        #size-cells = <1>;
        status = "okay";

        region@1000 {
            reg = <0x00001000 0x00057000>;
            pc-configs = <2 INFINEON_MPC_SECURE INFINEON_MPC_ACCESS_RW
                          7 INFINEON_MPC_SECURE INFINEON_MPC_ACCESS_RW>;
        };
    };

include: arm,mpc-base.yaml

compatible: "infineon,mpc"

properties:
  skip-auto-config:
    type: boolean
    description: |
      When set, the driver skips automatic region configuration for this MPC.
      Required for controllers (e.g. RRAMC0) whose block-level programming must
      go through SROM.

child-binding:
  description: |
    A single MPC-controlled memory region. The reg property encodes the
    byte offset and size of the region within the memory controlled by
    the parent MPC instance.

  properties:
    reg:
      type: array
      required: true
      description: "<offset size> within the MPC-controlled memory, in bytes."

    pc-configs:
      type: array
      required: true
      description: |
        Flat array of <protection-context secure access> 3-tuples that configure
        which protection contexts may access this region. The secure and access
        fields use the INFINEON_MPC_SECURE / INFINEON_MPC_NON_SECURE and
        INFINEON_MPC_ACCESS_* constants from
        <zephyr/dt-bindings/mpc/infineon-mpc.h>.

    bus-nonsecure:
      type: boolean
      description: |
        When set, the driver also marks this region Non-Secure in the MPC's
        non-ROT (bus) security-attribute LUT, in addition to the per-PC ROT
        configuration from pc-configs. This is the attribute the IDAU / BXNS
        check consults, so it is required for a Non-Secure code region (e.g. the
        NS image in external flash) to be reachable from the Non-Secure world.
```

## dts/bindings/misc/infineon,mxcordic.yaml
```yaml
# SPDX-FileCopyrightText: Copyright (c) 2026 Infineon Technologies AG,
# SPDX-FileCopyrightText: or an affiliate of Infineon Technologies AG. All rights reserved.
#
# SPDX-License-Identifier: Apache-2.0

description: |
  Infineon MXCORDIC hardware math accelerator.

  The MXCORDIC IP block is a CORDIC (COordinate Rotation DIgital Computer)
  engine found on PSOC Control C3 (PSC3) devices. It supports circular and
  hyperbolic operating modes and is used to accelerate trigonometric,
  hyperbolic and square-root computations.

compatible: "infineon,mxcordic"

include: base.yaml

properties:
  reg:
    required: true

  interrupts:
    required: true
```
