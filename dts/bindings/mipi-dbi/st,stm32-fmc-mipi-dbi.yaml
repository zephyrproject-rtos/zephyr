## dts/bindings/misc/infineon,mxs40-mpc.yaml
```yaml
# SPDX-FileCopyrightText: <text>Copyright (c) 2026 Infineon Technologies AG,
# or an affiliate of Infineon Technologies AG. All rights reserved.</text>
#
# SPDX-License-Identifier: Apache-2.0

title: Infineon MXS40 Memory Protection Controller (MPC)

description: |
  Infineon MXS40 MPC hardware block. Each instance controls access to
  a specific memory region (RRAM, SRAM, SoC memory, or external flash).

  Memory regions governed by this MPC are described as child nodes. Each
  child defines an (offset, size) range within the controlled memory and
  the protection-context (PC) configuration that grants access to it.

  Example (RAMC0 MPC, granting M33-S and M33-NS access to separate SRAM
  slices):

    mpc_ramc0: mpc@52234000 {
        compatible = "infineon,mxs40-mpc";
        reg = <0x52234000 0x1000>;
        violation-response = "bus-error";
        #address-cells = <1>;
        #size-cells = <1>;
        status = "okay";

        /* M33 Secure domain: PC2 and PC7, Secure RW */
        region@1000 {
            reg = <0x00001000 0x00057000>;
            pc-configs = <2 0 3  7 0 3>;
        };
    };

  pc-configs is a flat array of 3-tuples:
    (pc_index, secure, access)
    pc_index : 2, 5, 6, or 7
    secure   : 0 = Secure, 1 = Non-Secure  (cy_en_mpc_sec_attr_t)
    access   : 1 = Read-only, 3 = Read-Write  (cy_en_mpc_access_attr_t)

include: arm,mpc-base.yaml

compatible: "infineon,mxs40-mpc"

properties:
  skip-auto-config:
    type: boolean
    description: |
      When set, the driver skips automatic region configuration for this MPC.
      Required for RRAMC0 whose block-level programming must go through SROM.

  infineon,enable-socmem:
    type: boolean
    description: |
      When set, the driver calls Cy_SysEnableSOCMEM() before configuring
      this MPC. Required for the SOCMEM SRAM MPC.

child-binding:
  description: |
    A single MPC-controlled memory region. The reg property encodes the
    byte offset and size of the region within the memory controlled by
    the parent MPC instance.

  properties:
    reg:
      type: array
      required: true
      description: "<offset size> within the MPC-controlled memory, in bytes."

    pc-configs:
      type: array
      required: true
      description: |
        Flat array of (pc, secure, access) 3-tuples that configure which
        protection contexts may access this region.
        pc     : Protection context index (2, 5, 6, or 7)
        secure : 0 = Secure bus attribute,  1 = Non-Secure bus attribute
        access : 1 = Read-only,  3 = Read-Write

    bus-nonsecure:
      type: boolean
      description: |
        When set, the driver also marks this region Non-Secure in the MPC's
        non-ROT (bus) security-attribute LUT via Cy_Mpc_ConfigMpcStruct(),
        in addition to the per-PC ROT configuration from pc-configs. This is
        the security attribute the IDAU / BXNS check consults, so it is
        required for a Non-Secure code region (e.g. the NS image in external
        flash) to be reachable from the Non-Secure world.
```

## dts/bindings/misc/ite,general-config.yaml
```yaml
# Copyright (c) 2026 ITE Corporation. All Rights Reserved.
# SPDX-License-Identifier: Apache-2.0

description: ITE general configuration

properties:
  "#extend-ctrl-cells":
    type: int
    const: 3
    description: |
      Number of cells in an extend-control specifier.

  ite,extend-ctrl:
    type: phandle-array
    specifier-space: extend-ctrl
    description: |
      Extend-control register configurations. Each entry references
      an extend-control provider and supplies register address, enable
      bitmap, and disable bitmap. Set the disable bitmap to zero when
      only the enable bitmap is required, and vice versa.

extend-ctrl-cells:
  - addr
  - enable-bitmap
  - disable-bitmap

examples:
  - |
    &i3c2 {
      #extend-ctrl-cells = <3>;
      ite,extend-ctrl = <&i3c2 0xf016de BIT(0) 0>;
    };
```

## dts/bindings/misc/ite,it51xxx-crypto.yaml
```yaml
# Copyright (c) 2026 ITE Corporation. All Rights Reserved.
# SPDX-License-Identifier: Apache-2.0

description: ITE IT51XXX PSA crypto driver

compatible: "ite,it51xxx-crypto"

include: [base.yaml]

properties:
  reg:
    required: true

  interrupts:
    required: true
```

## dts/bindings/misc/ite,it51xxx-hw-rsa.yaml
```yaml
# Copyright (c) 2026 ITE Corporation. All Rights Reserved.
# SPDX-License-Identifier: Apache-2.0

description: IT51XXX crypto (RSA) controller

compatible: "ite,it51xxx-hw-rsa"

include: [base.yaml]
```

## dts/bindings/misc/ite,it51xxx-psa-rsa.yaml
```yaml
# Copyright (c) 2026 ITE Corporation. All Rights Reserved.
# SPDX-License-Identifier: Apache-2.0

description: IT51XXX PAS crypto RSA driver

compatible: "ite,it51xxx-psa-rsa"

include: [base.yaml]
```

## dts/bindings/misc/ite,it51xxx-psa-sha.yaml
```yaml
# Copyright (c) 2026 ITE Corporation. All Rights Reserved.
# SPDX-License-Identifier: Apache-2.0

description: IT51XXX PAS crypto SHA driver

compatible: "ite,it51xxx-psa-sha"

include: [base.yaml]
```

## dts/bindings/misc/microchip,evsys-g1.yaml
```yaml
# Copyright (c) 2026 Muhammed Asif P
# SPDX-License-Identifier: Apache-2.0

title: Microchip Event System module

description: |
  Microchip Event System module group g1

  The Event System (EVSYS) allows autonomous, low-latency and configurable
  communication between peripherals. Several peripherals can be configured to
  generate and/or respond to signals known as events. The exact condition to
  generate an event, or the action taken upon receiving an event, is specific
  to each peripheral.Peripherals that respond to events are called event users.
  Peripherals that generate events are called event generators. A peripheral can
  have one or more event generators and can have one or more event users.
  Communication is made without CPU intervention and without consuming system
  resources such as bus or RAM bandwidth. This reduces the load on the CPU and
  other system resources, compared to a traditional interrupt-based system.

  This binding supports the evsys of following versions:
   - id="U2504" version="1.0.0"

compatible: "microchip,evsys-g1"

include: base.yaml

properties:
  reg:
    required: true

  interrupts:
    required: true

  clocks:
    required: true

  max-channels:
    type: int
    default: 32
    description: |
      Maximum number of channels supported by this EVSYS instance.

child-binding:
  description: |
    EVSYS provider child (event generator) node

    Can add as many evgen child nodes as needed.
    The limitation is the max-channels property of the evsys node.
    Each evgen child node must have a unique channel number.

  properties:
    channel:
      type: int
      description: |
        Channel number assigned to this generator.
      required: true

    event-generator:
      type: int
      description: |
        Event generator identifier (see dt-bindings header for values).
      required: true

    event-users:
      type: array
      min-len: 1
      description: |
        Array of event user numeric identifiers associated with this
        generator. Each entry is an integer value matching an EVSYS event
        user (see dt-bindings header values). This allows a single
        generator to target multiple users.

examples:
- |
  The following example shows a single evgen child node with channel 0,
  event generator EVSYS_MCHP_EVGEN_EIC_EXTINT15 and two event users
  EVSYS_MCHP_EVUSER_PORT_EV0 and EVSYS_MCHP_EVUSER_PORT_EV1.
  The channel number must be unique for each evgen child node.

  &evsys {
    status = "okay";

    evgen0 {
      channel = <0>;
      event-generator = <EVSYS_MCHP_EVGEN_EIC_EXTINT15>;
      event-users = <EVSYS_MCHP_EVUSER_PORT_EV0 EVSYS_MCHP_EVUSER_PORT_EV1>;
    };
  };
```

## dts/bindings/misc/nxp,trdc.yaml
```yaml
# SPDX-FileCopyrightText: Copyright 2026 NXP
# SPDX-License-Identifier: Apache-2.0

description: |
  NXP Trusted Resource Domain Controller master assignments.

  Each child represents one Master Domain Assignment Controller (MDAC),
  not necessarily one peripheral or DMA channel. A child's reg is
  the MDAC index within this TRDC instance. Masters that share an MDAC
  must be represented by one child and cannot be assigned independently.
  Valid MDAC indices and master mappings depend on the TRDC instance.

  SoC devicetrees describe the masters and their default assignments as
  children. Boards and applications may override a child's domain-id or
  disable it to leave its assignment unchanged.

compatible: "nxp,trdc"

include: base.yaml

properties:
  reg:
    required: true

  "#address-cells":
    const: 1

  "#size-cells":
    const: 0

child-binding:
  description: One MDAC assignment for a non-core master or a group of shared non-core masters.
  include:
    - name: base.yaml
      property-allowlist: [reg, status]
  properties:
    reg:
      required: true
      description: MDAC index within the parent TRDC, not a DMA channel number.

    domain-id:
      type: int
      required: true
      min: 0
      max: 15
      description: |
        Domain ID assigned to this master. The ID must be supported by the
        parent controller; the number of implemented domains depends on the SoC.
```

## dts/bindings/misc/puppy,udma-filter.yaml
```yaml
# Copyright (c) Ana Clara Forcelli <ana.forcelli@lsitec.org.br>
# SPDX-License-Identifier: Apache-2.0

description: puppy's UDMA Filter DSP Accelerator

compatible: "puppy,udma-filter"

include: base.yaml

properties:
  reg:
    required: true
```

## dts/bindings/misc/raspberrypi,pico-pio.yaml
```yaml
# Copyright (c) 2023, TOKITA Hiroshi
# SPDX-License-Identifier: Apache-2.0

description: Raspberry Pi Pico PIO

compatible: "raspberrypi,pico-pio"

include: [base.yaml, reset-device.yaml]

properties:
  gpio-base:
    type: int
    default: 0
    enum: [0, 16]
    description: |
      Lowest GPIO number this PIO instance can address.

      RP2350 PIO addresses a 32-pin window selected by the GPIOBASE register.
      With 0 the instance sees GP0-GP31; with 16 it sees GP16-GP47. Set this
      to 16 to access pins GP32-GP47 on the RP2350B and RP2354B.
```

## dts/bindings/misc/raspberrypi,pico-powman.yaml
```yaml
# SPDX-FileCopyrightText: 2026 Gabriel Germano
# SPDX-License-Identifier: Apache-2.0

description: Raspberry Pi Pico POWMAN (power manager)

compatible: "raspberrypi,pico-powman"

include: base.yaml

properties:
  reg:
    required: true
  interrupts:
    required: true
```

## dts/bindings/misc/renesas,rx-sci-b.yaml
```yaml
# Copyright (c) 2026 Renesas Electronics Corporation
# SPDX-License-Identifier: Apache-2.0

description: Renesas RX SCI B controller

compatible: "renesas,rx-sci-b"

include: [base.yaml, pinctrl-device.yaml]

properties:
  reg:
    required: true

  clocks:
    required: true

  channel:
    type: int
    description: |
      Specifies the SCI channel number.
```

## dts/bindings/misc/renesas,rx-system-controller.yaml
```yaml
# Copyright (c) 2026 Renesas Electronics Corporation
# SPDX-License-Identifier: Apache-2.0

description: Renesas RX System controller

compatible: "renesas,rx-system-controller"

include: [base.yaml]

properties:
  reg:
    required: true
```
