## dts/bindings/mipi-dbi/zephyr,mipi-dbi-intel8080.yaml
```yaml
# Copyright 2024 Kim Bøndergaard <kim@fam-boendergaard.dk>
# SPDX-License-Identifier: Apache-2.0
#
# Common fields for MIPI DBI devices using Mode A (Intel8080)

description: |
  MIPI-DBI Mode A compatible parallel controller. This driver emulates
  MIPI-DBI mode A (known as Intel 8080 mode) using GPIO pins

compatible: "zephyr,mipi-dbi-intel8080"

include: base.yaml

bus: mipi-dbi

properties:
  rd-gpios:
    type: phandle-array
    description: |
      RD strobe. Active low.

  wr-gpios:
    type: phandle-array
    required: true
    description: |
      Wr strobe.
      Active low. On low to high transition, device will
      latch data pins

  dc-gpios:
    type: phandle-array
    required: true
    description: |
      Data/Command gpio pin. Set to low when sending a command,
      or high when sending data

  cs-gpios:
    type: phandle-array
    required: true
    description: |
      CS pin
      Active low.
      When high RD, WR, DC/RS are ignored

  reset-gpios:
    type: phandle-array
    description: |
      Reset GPIO pin. Set high to reset display

  data-gpios:
    type: phandle-array
    required: true
    description: |
      Data pins

  write-only:
    type: boolean
    description: |
      Only writes to display controller, do not perform reads.
      If all controllers are write-only, read functions will be
      optimized out for size.
      It can also be used as an alternative to half duplex when
      only one data line is connected.
```

## dts/bindings/mipi-dsi/ambiq,mipi-dsi.yaml
```yaml
#
# Copyright (c) 2025 Ambiq Micro Inc.
#

description: Ambiq MIPI DSI host

compatible: "ambiq,mipi-dsi"

include: [mipi-dsi-host.yaml, pinctrl-device.yaml]

properties:
  dbi-width:
    type: int
    enum: [8, 16]
    description: |
      Specifies the data bus interface (DBI) width for communication between the
      host and the display over the DSI interface. The DBI width determines the
      number of bits used for data transfer. A width of 16 bits typically has a
      higher performace than 8 bits.

  disp-te:
    type: boolean
    description: |
      Enable or Disable the TE feature.

  vdd18-gpios:
    type: phandle-array
    description: |
      Optional. User can define a GPIO to control the power of VDD1.8V, if it
      is necessary.
```

## dts/bindings/mipi-dsi/mipi-dsi-device.yaml
```yaml
# Copyright (c) 2020 Teslabs Engineering S.L.
# SPDX-License-Identifier: Apache-2.0

# Common fields for MIPI-DSI devices

include: base.yaml

on-bus: mipi-dsi

properties:
    reg:
      required: true

    data-lanes:
      type: array
      required: true
      description:
        Number of data lanes.

    pixel-format:
      type: int
      required: true
      description:
        Pixel format. Available formats in dt-bindings/mipi_dsi/mipi_dsi.h.
```

## dts/bindings/mipi-dsi/mipi-dsi-host.yaml
```yaml
# Copyright (c) 2020 Teslabs Engineering S.L.
# SPDX-License-Identifier: Apache-2.0

# Common fields for MIPI-DSI hosts

include: base.yaml

bus: mipi-dsi

properties:
  "#address-cells":
    required: true
    const: 1

  "#size-cells":
    required: true
    const: 0

  phy-clock:
    type: int
    description:
      MIPI PHY clock frequency. Should be set to ensure clock frequency is at
      least (pixel clock * bits per output pixel) / number of mipi data lanes
```

## dts/bindings/mipi-dsi/nxp,imx-mipi-dsi.yaml
```yaml
#
# Copyright 2022, NXP
#
# SPDX-License-Identifier: Apache-2.0
#
description: NXP MCUX MIPI DSI

compatible: "nxp,imx-mipi-dsi"

include: mipi-dsi-host.yaml

properties:
  interrupts:
    required: true

  nxp,lcdif:
    type: phandle
    description:
      Instance of the LCDIF peripheral. Only required when using the MIPI
      DSI in video mode.

  dpi-color-coding:
    type: string
    enum:
      - "16-bit-config-1"
      - "16-bit-config-2"
      - "16-bit-config-3"
      - "18-bit-config-1"
      - "18-bit-config-2"
      - "24-bit"
    description:
      MIPI DPI interface color coding. Sets the distribution of RGB bits within
      the 24-bit d bus, as specified by the DPI specification.

  dpi-pixel-packet:
    type: string
    enum:
      - "16-bit"
      - "18-bit"
      - "18-bit-loose"
      - "24-bit"
    description:
      MIPI DSI pixel packet type send through DPI interface.

  dpi-video-mode:
    type: string
    enum:
      - "non-burst-sync-pulse"
      - "non-burst-sync-event"
      - "burst"
    description:
      DPI video mode.

  dpi-bllp-mode:
    type: string
    enum:
      - "low-power"
      - "blank"
      - "null"
    description:
      Behavior in BLLP (Blanking or Low-Power Interval).

  autoinsert-eotp:
    type: boolean
    description:
      Automatically insert an EoTp short packet when switching from HS to LP mode.

  dphy-ref-frequency:
    type: int
    required: true
    description:
      Maximum clock speed supported by the device, in Hz.
```

## dts/bindings/mipi-dsi/nxp,mipi-dsi-dwc.yaml
```yaml
#
# Copyright 2025 NXP
#
# SPDX-License-Identifier: Apache-2.0
#
description: NXP MCUX MIPI DSI DWC

compatible: "nxp,mipi-dsi-dwc"

include: mipi-dsi-host.yaml

properties:
  interrupts:
    required: true

  nxp,dc:
    type: phandle
    description:
      Instance of the display controller peripheral. Only required when using the MIPI
      in video mode

  dpi-color-coding:
    type: string
    enum:
      - "16-bit-config-1"
      - "16-bit-config-2"
      - "16-bit-config-3"
      - "18-bit-config-1"
      - "18-bit-config-2"
      - "24-bit"
    description:
      MIPI DPI interface color coding. Sets the distribution of RGB bits within
      the 24-bit d bus, as specified by the DPI specification.

  dpi-video-mode:
    type: string
    enum:
      - "non-burst-sync-pulse"
      - "non-burst-sync-event"
      - "burst"
    description:
      DPI video mode.

  dphy-ref-frequency:
    type: int
    required: true
    description:
      Maximum clock speed supported by the device, in Hz.

  data-rate-clock:
    type: int
    description:
      MIPI data rate clock frequency. Should be set to ensure clock frequency is equal to
      (pixel clock * bits per pixel) / number of mipi data lanes
```

## dts/bindings/mipi-dsi/nxp,mipi-dsim.yaml
```yaml
# Copyright 2026 NXP
# SPDX-License-Identifier: Apache-2.0

description: |
  Samsung SEC MIPI DSIM controller.
  Serialises parallel RGB input from a display controller to a MIPI DSI panel.

  The PLL parameters (P, M, S) are computed at runtime from the reference
  clock frequency and target burst clock frequency using a brute-force search
  that respects i.MX8MP hardware constraints (M in [64, 1023], Fvco in
  [1050, 2100] MHz, fin in [2, 30] MHz).

  D-PHY timing parameters are computed automatically from the burst clock
  using MIPI D-PHY specification formulas.

  The pixel clock frequency is read at runtime from the "pixel" clock (the
  display controller's DISP1_PIX root) and is used to compute video-mode
  blanking word counts.

compatible: "nxp,mipi-dsim"

include: mipi-dsi-host.yaml

properties:
  reg:
    required: true

  clocks:
    required: true

  clock-names:
    required: true
    description: |
      Must contain "phy_ref" (D-PHY PLL reference clock) and "pixel" (the
      display controller's DISP1_PIX pixel clock, used for blanking math).

  samsung,burst-clock-frequency:
    type: int
    required: true
    description: |
      Target D-PHY bit clock (burst clock) frequency in Hz. The PLL search
      will compute P, M, S to achieve this frequency (or the closest match
      within hardware constraints). Typical value: 864000000 (864 Mbps).

  samsung,esc-clock-frequency:
    type: int
    required: true
    description: |
      Escape clock frequency in Hz. Used to compute the ESC prescaler
      (EscClk = ByteClk / EscPrescaler). The D-PHY specification allows up to
      20 MHz; 10000000 (10 MHz) is a conservative typical value.
      The prescaler is computed as ceil(ByteClk / esc_clk_freq).
```

## dts/bindings/mipi-dsi/renesas,ra-mipi-dsi.yaml
```yaml
# Copyright (c) 2024 Renesas Electronics Corporation
# SPDX-License-Identifier: Apache-2.0

description: Renesas RA MIPI DSI host

compatible: "renesas,ra-mipi-dsi"

include: [mipi-dsi-host.yaml]

properties:
  clocks:
    required: true

  interrupts:
    required: true

  interrupt-names:
    type: string-array
    required: true
    description: name of each interrupt
```

## dts/bindings/mipi-dsi/renesas,rz-mipi-dsi.yaml
```yaml
# Copyright (c) 2025 Renesas Electronics Corporation
# SPDX-License-Identifier: Apache-2.0

description: Renesas RZ MIPI DSI host

compatible: "renesas,rz-mipi-dsi"

include: [mipi-dsi-host.yaml]

properties:
  interrupts:
    required: true

  interrupt-names:
    type: string-array
    required: true
    description: name of each interrupt

  ulps-wakeup-period:
    type: int
    description: ULPS wakeup period.

  video-mode-delay:
    type: int
    description: |
      Set the delay value inside DSI Host until the transfer begins.

  timing:
    type: array
    description: |
      MIPI DSI timing parameter: <CLKSTPT CLKBFHT CLKKPT GOLPBKT>

child-binding:
  description: |
    MIPI PHY timing configuration. The child node must be named "phys-timing".

  properties:
    t-init:
      type: int
      required: true
      description: |
        Minimum duration of the TINIT state (Units: PCLKA cycles).

    t-clk-prep:
      type: int
      required: true
      description: |
        Duration of the clock lane LP-00 state (immediately before entry to the HS-0 state).

    t-hs-prep:
      type: int
      required: true
      description: |
        Duration of the data lane LP-00 state (immediately before entry to the HS-0 state.

    t-clk-zero:
      type: int
      required: true
      description: |
        TCLKZERO setting.

    t-clk-pre:
      type: int
      required: true
      description: |
        TCLKPRE setting.

    t-clk-post:
      type: int
      required: true
      description: |
        TCLKPOST setting.

    t-clk-trail:
      type: int
      required: true
      description: |
        TCLKTRAIL setting.

    t-hs-zero:
      type: int
      required: true
      description: |
        THSZERO setting.

    t-hs-trail:
      type: int
      required: true
      description: |
        THSTRAIL setting.

    t-hs-exit:
      type: int
      required: true
      description: |
        THSEXIT setting.

    t-lp-exit:
      type: int
      required: true
      description: |
        Low-power transition time to High-Speed mode.
```

## dts/bindings/mipi-dsi/st,stm32-mipi-dsi.yaml
```yaml
#
# Copyright (c) 2023 bytes at work AG
#
# SPDX-License-Identifier: Apache-2.0
#

description: STM32 MIPI DSI host

compatible: "st,stm32-mipi-dsi"

include: [mipi-dsi-host.yaml, reset-device.yaml]

properties:
  clocks:
    required: true

  clock-names:
    required: true
    description: |
      "dsiclk" DSI clock enable.
      "refclk" External crystal or oscillator clock.
      "pixelclk" LTDC pixel clock.
      "refclk" and "pixelclk" are only used to retrieve the frequency for timing calculation.

  resets:
    required: true

  hs-active-high:
    type: boolean
    description: |
      DSI host horizontal synchronization is active high.

  vs-active-high:
    type: boolean
    description: |
      DSI host vertical synchronization is active high.

  de-active-high:
    type: boolean
    description: |
      DSI host data enable is active high.

  non-continuous:
    type: boolean
    description: |
      DSI host enable non continuous clock.

  pll-ndiv:
    required: true
    type: int
    description: |
      DSI host dedicated PLL loop division factor.

  pll-idf:
    required: true
    type: int
    description: |
      DSI host dedicated PLL input division factor.

  pll-odf:
    required: true
    type: int
    description: |
      DSI HOST dedicated PLL output division factor.

  active-errors:
    type: int
    description: |
      Indicates which error interrupts will be enabled.
      This parameter can be any combination of DSI_Error_Data_Type and
      defaults to HAL_DSI_ERROR_NONE.

  lp-rx-filter:
    type: int
    description: |
      Use Low-Power Reception Filter. Cutoff frequency of low-pass filter at the input of LPRX.
      Defaults to 0 which disables the filter.

  host-timeouts:
    type: array
    description: |
      DSI HOST timeout parameters.

  phy-timings:
    type: array
    description: |
      DSI HOST PHY timing parameters.

  test-pattern:
    type: int
    enum:
      - 0
      - 1
    description: |
      Show DSI host color bars, select color bar orientation
      0 : Vertical color bars
      1 : Horizontal color bars
```
