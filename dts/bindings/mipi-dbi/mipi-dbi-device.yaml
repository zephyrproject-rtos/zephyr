## dts/bindings/mipi-dbi/mipi-dbi-device.yaml
```yaml
# Copyright 2023-2024 NXP
# SPDX-License-Identifier: Apache-2.0
#
# Common fields for MIPI-DBI devices

include: [base.yaml, power.yaml]

on-bus: mipi-dbi

properties:
  mipi-max-frequency:
    type: int
    description: Maximum clock frequency of device's MIPI interface in Hz

  mipi-mode:
    type: string
    description: |
      MIPI DBI mode in use. These definitions should match those in
      dt-bindings/mipi_dbi/mipi_dbi.h
    enum:
      - "MIPI_DBI_MODE_SPI_3WIRE"
      - "MIPI_DBI_MODE_SPI_4WIRE"
      - "MIPI_DBI_MODE_6800_BUS_16_BIT"
      - "MIPI_DBI_MODE_6800_BUS_9_BIT"
      - "MIPI_DBI_MODE_6800_BUS_8_BIT"
      - "MIPI_DBI_MODE_8080_BUS_16_BIT"
      - "MIPI_DBI_MODE_8080_BUS_9_BIT"
      - "MIPI_DBI_MODE_8080_BUS_8_BIT"

  color-coding:
    type: string
    description: |
      Color coding for MIPI DBI Type A or Type B(6800/8080) interface. These definitions
      should match those in dt-bindings/mipi_dbi/mipi_dbi.h
    enum:
      - "MIPI_DBI_MODE_RGB332"
      - "MIPI_DBI_MODE_RGB444"
      - "MIPI_DBI_MODE_RGB565"
      - "MIPI_DBI_MODE_RGB666_1"
      - "MIPI_DBI_MODE_RGB666_2"
      - "MIPI_DBI_MODE_RGB888_1"
      - "MIPI_DBI_MODE_RGB888_2"

  te-mode:
    type: string
    default: "MIPI_DBI_TE_NO_EDGE"
    description: |
      MIPI DBI tearing enable signal mode. Defaults to disabled.
    enum:
      - "MIPI_DBI_TE_NO_EDGE"
      - "MIPI_DBI_TE_RISING_EDGE"
      - "MIPI_DBI_TE_FALLING_EDGE"

  te-delay:
    type: int
    default: 0
    description: |
      Delay in microseconds to wait before transmitting display data after a
      tearing enable synchronization signal is seen. Defaults to 0 since most
      controllers will not need a delay.
```

## dts/bindings/mipi-dbi/mipi-dbi-spi-device.yaml
```yaml
# Copyright 2023 NXP
# SPDX-License-Identifier: Apache-2.0
#
# Common fields for MIPI DBI devices using Mode C (SPI)

include: [mipi-dbi-device.yaml]

properties:
  duplex:
    type: int
    default: 0
    description: |
      SPI Duplex mode, full or half. By default it's always full duplex thus 0
      as this is, by far, the most common mode.
      Selecting half duplex allows to use SPI MOSI as a bidirectional line,
      typically used when only one data line is connected.
      Use the macros, not the actual enum value. Here is the concordance
      list (see dt-bindings/spi/spi.h)
        0    SPI_FULL_DUPLEX
        2048 SPI_HALF_DUPLEX
  mipi-cpol:
    type: boolean
    description: |
      SPI clock polarity which indicates the clock idle state.
      If it is used, the clock idle state is logic high; otherwise, low.
  mipi-cpha:
    type: boolean
    description: |
      SPI clock phase that indicates on which edge data is sampled.
      If it is used, data is sampled on the second edge; otherwise, on the first edge.
  mipi-hold-cs:
    type: boolean
    description: |
      In some cases, it is necessary for the master to manage SPI chip select
      under software control, so that multiple spi transactions can be performed
      without releasing it. A typical use case is variable length SPI packets
      where the first spi transaction reads the length and the second spi transaction
      reads length bytes.
```

## dts/bindings/mipi-dbi/nxp,lcdic.yaml
```yaml
# Copyright 2023 NXP
# SPDX-License-Identifier: Apache-2.0

description: |
  NXP LCDIC Controller. This controller implements 8080 and SPI mode MIPI-DBI
  compliant transfers.
compatible: "nxp,lcdic"

include: ["mipi-dbi-controller.yaml", "pinctrl-device.yaml"]

properties:
  reg:
    required: true

  interrupts:
    required: true

  clocks:
    required: true

  nxp,swap-bytes:
    type: boolean
    description: |
      Swap bytes while transferring on LCDIC. When set, the LCDIC will send
      the most significant byte first when using multibyte pixel formats.

  reset-gpios:
    type: phandle-array
    description: |
      Reset GPIO pin. The controller will set this pin to logic high to reset
      the display. If not provided, the LCDIC module's reset pin will be used
      to reset attached displays.

  nxp,write-inactive-cycles:
    type: int
    default: 6
    description: |
      Set minimum count of write inactive cycles, as a multiple of the module
      clock frequency. This controls the length of the inactive period of the
      WRX signal. Default is IP reset value. Only valid in 8080 mode.

  nxp,write-active-cycles:
    type: int
    default: 6
    description: |
      Set minimum count of write active cycles, as a multiple of the module
      clock frequency. This controls the length of the active period of the
      WRX signal. Default is IP reset value. Only valid in 8080 mode.

  nxp,timer0-ratio:
    type: int
    default: 8
    description: |
      Ratio for timer0, used for setting timer0 period (which is used for reset
      and TX/RX short command timeout). Formula is:
      timer0_period = (2 ^ timer0_ratio) / lcdic_freq
      Default is IP reset value

  nxp,timer1-ratio:
    type: int
    default: 9
    description: |
      Ratio for timer1, used for setting timer1 period (which is used for TE
      wait time, timeout, and long command timeout). Formula is:
      timer1_period = (2 ^ timer1_ratio) * timer0_period
      Default is IP reset value
```

## dts/bindings/mipi-dbi/nxp,mipi-dbi-dcnano-lcdif.yaml
```yaml
# Copyright 2025 NXP
# SPDX-License-Identifier: Apache-2.0

description: |
  DBI settings for NXP DCnano LCD controller. DCNano is used in DPI mode by default,
  when used in DBI mode the compatible need to change in example overlay. For example:

  &lcdif {
      compatible = "nxp,mipi-dbi-dcnano-lcdif";
      clock-frequency = <279000000>;
      wr-period = <14>;
      wr-assert = <6>;
      wr-deassert = <13>;
      cs-assert = <1>;
      cs-deassert = <4>;
  };

compatible: "nxp,mipi-dbi-dcnano-lcdif"

include: [base.yaml]

properties:
  clock-frequency:
    type: int
    required: true
    description: |
      The DBI clock source frequency.

  reset-gpios:
    type: phandle-array
    description: |
      Reset GPIO pin.

  divider:
    type: int
    description: |
      Divider of the DBI clock source frequency, the final DBI frequency is
      clock-frequency / divider.

  wr-period:
    type: int
    required: true
    description: |
      How many clock cycles does one write cycle take.

  wr-assert:
    type: int
    required: true
    description: |
      At which clock cycle to assert E signal for TypeA_ClockedE, or WRX signal for TypeB.

  wr-deassert:
    type: int
    required: true
    description: |
      At which clock cycle to deassert E signal for TypeA_ClockedE, or WRX signal for TypeB.

  cs-assert:
    type: int
    required: true
    description: |
      At which clock cycle to assert CSX signal for TypeA_FixedE or TypeB.

  cs-deassert:
    type: int
    required: true
    description: |
      At which clock cycle to deassert CSX signal for TypeA_FixedE or TypeB.

  endian:
    type: string
    description: |
      Input data endian mode.
    enum:
      - "no-swap"
      - "half-word"
      - "word"

  swizzle:
    type: string
    description: |
      Bus data output order.
    enum:
      - "RGB"
      - "BGR"
```

## dts/bindings/mipi-dbi/raspberrypi,pico-mipi-dbi-pio.yaml
```yaml
# Copyright 2025 Christoph Schnetzler
# SPDX-License-Identifier: Apache-2.0

description: |
  MIPI-DBI Mode B controller. It emulates MIPI DBI mode B
  (8080 parallel interface) using PIO peripherals.

compatible: "raspberrypi,pico-mipi-dbi-pio"

include: ["mipi-dbi-controller.yaml", "pinctrl-device.yaml"]

properties:

  dc-gpios:
    type: phandle-array
    required: true
    description: |
      Data/command GPIO pin. Set to low when sending a command, or high when sending data.

  reset-gpios:
    type: phandle-array
    required: true
    description: |
      Reset GPIO pin. Set high to reset the display.

  wr-gpios:
    type: phandle-array
    required: true
    description: |
      Write GPIO pin for type B (Intel 8080) mode.

  cs-gpios:
    type: phandle-array
    required: true
    description: |
      Chip-select GPIO pin.

  data-pin-splits:
    type: phandle-array
    required: true
    description: |
      Pin assignment for parallel data bus. Pins can be split in up to 4 pairs. The sum
      of consecutive pins of all splits must be equal to the bits specified in the selected
      mipi-mode.

      For example a 16 Bit parallel data bus with pins assigned in 4 splits:

      mipi_dbi: mipi_dbi {
        compatible = "raspberrypi,pico-mipi-dbi-pio";
        ...
        data-pin-splits = <&mipi_dbi  2 8>, // base pin =  2 consecutive pins = 8
                          <&mipi_dbi 12 4>, // base pin = 12 consecutive pins = 4
                          <&mipi_dbi 20 2>, // base pin = 20 consecutive pins = 2
                          <&mipi_dbi 25 2>; // base pin = 25 consecutive pins = 2
        ...
        #data-pin-split-cells = <2>;
      };

  "#data-pin-split-cells":
    type: int
    const: 2

  pio-clock-div:
    type: int
    default: 1
    description: |
      Clock divisor for PIO state machine

      Range [1, 65536]

      Rather than slowing the system clock itself, the clock divider
      redefines how many system clock periods are considered to be
      "one cycle", for execution purposes. This is useful if the display
      driver needs a slower clock speed to meet its specifications.
      The implementation needs four pio instructions to send a bit. Each
      instruction takes exactly one cycle. This means the clock speed
      seen by the display driver is already system clock divided by 4.
      Bits are shifted out with the following speed:

      Bit output shift rate [MHz] = system clock [MHz] / pio-clock-div / 4

      For example:
        system clock = 125 MHz
        pio-clock-div = 1
        The pios clock is as fast as the system clock. Each cycle takes 8ns.
        Each bit takes 4 pio clock cycles, this results in 32ns or 31.25MHz

        system clock = 125 MHz
        pio-clock-div = 2
        The pios clock is half the speed of the system clock. Each cycle takes 16ns.
        Each bit takes 4 pio clock cycles, this results in 64ns or 15.625MHz

data-pin-split-cells:
  - base_pin
  - consecutive_pins
```

## dts/bindings/mipi-dbi/renesas,smartbond-mipi-dbi.yaml
```yaml
# Copyright (c) 2023 Renesas Electronics Corporation
# SPDX-License-Identifier: Apache-2.0

include: [mipi-dbi-controller.yaml, pinctrl-device.yaml]

description: Renesas Smartbond(tm) MIPI DBI Host

compatible: "renesas,smartbond-mipi-dbi"

properties:
  reg:
    required: true

  interrupts:
    required: true

  reset-gpios:
    type: phandle-array
    description: |
      Reset GPIO pin. Used to reset the display during initialization.

  te-enable:
    type: boolean
    description: |
      Boolean to indicate whether the tearing effect (TE) signal is available or not.

  te-inversion:
    type: boolean
    description: |
      Boolean to apply an inversion on the TE signal that triggers the MIPI DBI controller.

  dma-prefetch:
    type: string
    enum:
      - "no-prefetch"
      - "prefetch-44-bytes"
      - "prefetch-84-bytes"
      - "prefetch-116-bytes"
      - "prefetch-108-bytes"
    description: |
      Host controller will wait for at least the specified number of bytes before triggering
      a single frame update. The prefetch mechanism should be enabled when frame buffer(s)
      is stored into external storage mediums, e.g. PSRAM, that introduce comparable delays.
      In such a case it might case that the controller runs into underrun conditions which
      results in correpting the whole frame update. It's user's responsibility to ensure that
      the selected value does not exceed frame's total size as otherwise the controller will
      not be able to trigger the frame update.

  spi-dev:
    type: phandle
    description: |
      SPI bus to use for display read operations. When this property is present, MIPI DBI read
      operations will be exhibited by the driver. This is because, the LCDC IP block does not
      support read functionality, natively.
```

## dts/bindings/mipi-dbi/sifli,sf32lb-lcdc-mipi-dbi.yaml
```yaml
# Copyright (c) 2025, Qingsong Gou <gouqs@hotmail.com>
# SPDX-License-Identifier: Apache-2.0

description: SF32LB LCDC MIPI DBI controller

compatible: "sifli,sf32lb-lcdc-mipi-dbi"

include: [mipi-dbi-controller.yaml, pinctrl-device.yaml]

properties:
  pinctrl-0:
    required: true

  pinctrl-names:
    required: true
```

## dts/bindings/mipi-dbi/sifli,sf32lb-mipi-dbi.yaml
```yaml
# Copyright (c) 2025, Qingsong Gou <gouqs@hotmail.com>
# SPDX-License-Identifier: Apache-2.0

description: SF32LB MIPI DBI controller

compatible: "sifli,sf32lb-mipi-dbi"

include: [mipi-dbi-controller.yaml, pinctrl-device.yaml]

properties:
  reg:
    required: true

  clocks:
    required: true

  pinctrl-0:
    required: true

  pinctrl-names:
    required: true

  reset-gpios:
    type: phandle-array
    description: Reset GPIO specification, active low
```

## dts/bindings/mipi-dbi/st,mipi-dbi-fmc.yaml
```yaml
# Copyright (c) 2024 Bootlin
# SPDX-License-Identifier: Apache-2.0

description: STM32 FMC display controller
compatible: "st,stm32-fmc-mipi-dbi"

include: ["mipi-dbi-controller.yaml"]

properties:
  reset-gpios:
    type: phandle-array
    description: |
      Reset GPIO pin. Set high to reset the display

  power-gpios:
    type: phandle-array
    description: |
      Power GPIO pin. Set high to power the display.

  register-select-pin:
    type: int
    required: true
    description: |
      Address pin used as Register Select for the display controller.
```

## dts/bindings/mipi-dbi/zephyr,mipi-dbi-bitbang.yaml
```yaml
# Copyright 2024 Stefan Gloor
#
# SPDX-License-Identifier: Apache-2.0

description: |
  MIPI-DBI Mode A and B bit banging controller. This driver emulates MIPI DBI mode A and B (6800
  and 8080 parallel interfaces) using GPIO pins.

compatible: "zephyr,mipi-dbi-bitbang"

include: ["mipi-dbi-controller.yaml", "pinctrl-device.yaml"]

properties:

  dc-gpios:
    type: phandle-array
    required: true
    description: |
      Data/command GPIO pin. Set to low when sending a command, or high when sending data.

  reset-gpios:
    type: phandle-array
    required: true
    description: |
      Reset GPIO pin. Set high to reset the display.

  rd-gpios:
    type: phandle-array
    description: |
      Read GPIO pin. Set high when reading from the display. Required for type B (Intel 8080) mode,
      unused for type A (Motorola 6800).

  wr-gpios:
    type: phandle-array
    required: true
    description: |
      Write GPIO pin for type B (Intel 8080) mode, Read/!Write pin for type A (Motorola 6800) mode.

  e-gpios:
    type: phandle-array
    description: |
      Clocked enable/strobe pin for type A (Motorola 6800) mode, unused for type B (Intel 8080).
      Fixed E mode is not supported.

  cs-gpios:
    type: phandle-array
    required: true
    description: |
      Chip-select GPIO pin.

  data-gpios:
    type: phandle-array
    required: true
    description: |
      GPIO pins used for the parallel data bus. This must have as many entries as the bus is wide
      of the selected mipi-mode.
```
