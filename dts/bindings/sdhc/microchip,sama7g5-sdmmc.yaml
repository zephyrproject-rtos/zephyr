## dts/bindings/sdhc/microchip,sama7g5-sdmmc.yaml
```yaml
# Copyright (C) 2025 Microchip Technology Inc. and its subsidiaries
#
# SPDX-License-Identifier: Apache-2.0
#

description: Microchip SAM SDMMC SD host controller

compatible: "microchip,sama7g5-sdmmc"

include: [sdhc.yaml, pinctrl-device.yaml]

properties:
  reg:
    required: true

  interrupts:
    required: true

  pinctrl-0:
    required: true

  pinctrl-names:
    required: true

  clocks:
    required: true

  assigned-clock-rates:
    type: int
    required: true
    description: |
      The frequency of input GCLK rate.

  non-removable:
    type: boolean
    description: |
      Indicates a non-removable device such as an e.MMC card.
      The SDMMC_CD signal will be bypassed, force card detect is enableded.

  bus-width:
    type: int
    default: 4
    enum:
      - 1
      - 4
      - 8
    description: |
      Not all SDMMC instances have 8-bit data lines, but all have 4-bit data lines.
      By default 4-bit data line is enabled and can be adjusted based on the SDMMC
      instance or hardware board design.

  no-1-8-v:
    type: boolean
    description: |
      The SD/MMC bus on the board doesn't support the 1.8V voltage,
      Which disables UHS-I, HS200 and HS400 support.

  rstn-power-en:
    type: boolean
    description: |
      Indicates that the SDMMC_RSTN signal is present on the board.

  auto-cmd12:
    type: boolean
    description: |
      Enable auto command CMD12.

  auto-cmd23:
    type: boolean
    description: |
      Enable auto command CMD23.
```

## dts/bindings/sdhc/microchip,sdhc-g1.yaml
```yaml
# Copyright (c) 2026 Microchip Technology Inc.
# SPDX-License-Identifier: Apache-2.0

title: Microchip SDHC controller

description: |
  Microchip SDHC controller

  Microchip G1 SDHC controller supports the following hardware peripheral:
    - module name="SDHC" compatible="microchip,sdhc-g1"

compatible: "microchip,sdhc-g1"

include:
  - name: sdhc.yaml
  - name: pinctrl-device.yaml

properties:
  reg:
    required: true

  clocks:
    required: true

  clock-names:
    required: true
    description: |
      Names of the clock sources listed in "clocks", in the same order.
      Must be "mclk" (main clock), "gclk" (generic clock) and "gclk-slow"
      (slow generic clock).

  interrupts:
    required: true

  pinctrl-0:
    required: true

  pinctrl-names:
    required: true
    description: |
      Names of the pinctrl states defined for this controller. Must include
      "default" matching pinctrl-0.

examples:
  - |
    #Example devicetree configuration for Microchip G1 SDHC controller:

    sdhc0: sdhc@46000000 {
            compatible = "microchip,sdhc-g1";
            reg = <0x46000000 0x234>;
            interrupts = <136 0>;
            clocks = <&mclkperiph CLOCK_MCHP_MCLKPERIPH_ID_AHB_SDHC1>,
                     <&gclkperiph CLOCK_MCHP_GCLKPERIPH_ID_SDHC1>,
                     <&gclkperiph CLOCK_MCHP_GCLKPERIPH_ID_SDHC1_SLOW>;
            clock-names = "mclk", "gclk", "gclk-slow";
            min-bus-freq = <400000>;
            max-bus-freq = <25000000>;
            pinctrl-0 = <&sdhc0_default>;
            pinctrl-names = "default";
            status = "okay";
    };
```

## dts/bindings/sdhc/nuvoton,numaker-sdhc.yaml
```yaml
# SPDX-FileCopyrightText: Copyright (c) 2026 Nuvoton Technology Corporation
# SPDX-License-Identifier: Apache-2.0

description: Nuvoton NuMaker SD host controller

compatible: "nuvoton,numaker-sdhc"

include: [sdhc.yaml, reset-device.yaml, pinctrl-device.yaml]

properties:
  reg:
    required: true

  interrupts:
    required: true

  resets:
    required: true

  clocks:
    required: true

  card-detect-from-gpio:
    type: boolean
    description: |
        Use GPIO instead of DAT3 for card detection
```

## dts/bindings/sdhc/nxp,imx-usdhc.yaml
```yaml
# Copyright (c) 2022, NXP
# SPDX-License-Identifier: Apache-2.0

description: NXP imx USDHC controller

compatible: "nxp,imx-usdhc"

include: [sdhc.yaml, pinctrl-device.yaml]

properties:
  reg:
    required: true

  data-timeout:
    type: int
    default: 0xF
    description: |
      Data timeout, as multiple of the SD clock. See DTOCV field of USDHC

  read-watermark:
    type: int
    default: 0x80
    description: |
      Number of words used as read watermark level in FIFO queue for USDHC

  write-watermark:
    type: int
    default: 0x80
    description: |
      Number of words used as write watermark level in FIFO queue for USDHC

  max_current_330:
    type: int
    default: 0
    description: |
      Max drive current in mA at 3.3V. A value of zero indicates no maximum
      is specified by the driver.
  clocks:
    required: true

  pwr-gpios:
    type: phandle-array
    description: |
      Power pin
      This pin defaults to active high when consumed by the SD card. The
      property value should ensure the flags properly describe the signal
      that is presented to the driver.

  cd-gpios:
    type: phandle-array
    description: |
      Detect pin
      This pin defaults to active low when produced by the SD card. The
      property value should ensure the flags properly describe the signal
      that is presented to the driver.

  no-1-8-v:
    type: boolean
    description: |
      When the external SD card circuit does not support 1.8V, add this
      property to disable 1.8v card voltage of SD card controller.

  detect-dat3:
    type: boolean
    description: |
      Enable the host to detect an SD card via the DAT3 line of the SD card
      connection. Requires the board to define a function to pull DAT3 low or
      high using pullup/pulldown resistors.
```

## dts/bindings/sdhc/nxp,lpc-sdif.yaml
```yaml
# Copyright 2022, NXP
# SPDX-License-Identifier: Apache-2.0

description: NXP LPC SDIF SD host controller

compatible: "nxp,lpc-sdif"

include: [sdhc.yaml, pinctrl-device.yaml]

properties:
  reg:
    required: true

  data-timeout:
    type: int
    default: 0xFFFFFF
    description: |
      Data timeout, as multiple of the SD clock. See DATA_TIMEOUT field of SDIF.
      Default value is the reset value of SOC

  response-timeout:
    type: int
    default: 0xFF
    description: |
      Response timeout, as multiple of the SD clock. See RESPONSE_TIMEOUT field
      of SDIF. Default value is the maximum possible timeout

  cd-debounce-clocks:
    type: int
    default: 0xFFFFFF
    description: |
      Number of SD host clocks to use as a chip detect debounce filter. See
      DEBOUNCE_COUNT field of SDIF. Default value is the reset value of SOC.

  cd-gpios:
    type: phandle-array
    description: |
      Optional GPIO for card presence. When set, the driver uses software GPIO
      read instead of the SDIF hardware card-detect input. Use when the socket
      CD must be muxed as GPIO rather than SD0_CARD_DET_N. GPIO flags must
      match the wiring; CD is typically active-low.

  pinctrl-0:
    required: true

  pinctrl-names:
    required: true
```

## dts/bindings/sdhc/realtek,ameba-sdhost.yaml
```yaml
# SPDX-License-Identifier: Apache-2.0
#
# Copyright (c) 2026 Realtek Semiconductor Corporation
#

description: AMEBA SD Host controller

compatible: "realtek,ameba-sdhost"

include:
  - sdhc.yaml
  - pinctrl-device.yaml

properties:
  reg:
    required: true

  clocks:
    required: true

  interrupts:
    required: true

  cd-gpios:
    type: phandle-array
    description: Card detect pin.

  pinctrl-0:
    required: true

  pinctrl-names:
    required: true

  bus-width:
    type: int
    default: 4
    description: |
      SD bus width in bits.
      Default is 4, as the AMEBA SD host controller is commonly wired
      for 4-bit operation on most boards, which provides better
      performance than 1-bit mode.
      Only 1-bit and 4-bit modes are supported by the hardware.
      Boards that require 1-bit mode must explicitly set this property
      in the device tree.
    enum:
      - 1
      - 4
```

## dts/bindings/sdhc/renesas,ra-sdhc.yaml
```yaml
# Copyright (c) 2024 Renesas Electronics Corporation
# SPDX-License-Identifier: Apache-2.0

description: Renesas RA SDHC

compatible: "renesas,ra-sdhc"


include: [sdhc.yaml, pinctrl-device.yaml]

properties:
  channel:
    type: int
    required: true

  bus-width:
    type: int
    enum:
      - 1
      - 4
    default: 4

  sd-support:
    type: boolean

  mmc-support:
    type: boolean

  card-detect:
    type: boolean

  write-protect:
    type: boolean

  reg:
    required: true

  pinctrl-0:
    required: true

  pinctrl-names:
    required: true

  enable-gpios:
    type: phandle-array
    description: |
      GPIO to use to enable/disable the SDHI. This GPIO is driven active when
      the SDHI is enabled and inactive when the SDHI is disabled

  interrupts:
    required: true

  interrupt-names:
    required: true
```

## dts/bindings/sdhc/st,stm32-sdhc.yaml
```yaml
# Copyright (c) 2025 EXALT Technologies.
#
# SPDX-License-Identifier: Apache-2.0

description: stm32 sdmmc disk access

compatible: "st,stm32-sdhc"
bus: sd

include: ["st,stm32-sdmmc.yaml", "sdhc.yaml"]

properties:  
  hw-flow-control:
    type: boolean
    description: Set to enable RTS/CTS flow control at boot time

  support-1-8-v:
    type: boolean
    description: |
        When defined, it indicates that the external SDIO circuit supports 1.8V signaling.

  sdhi-on-gpios:
    type: phandle-array
    description: GPIO used to enable/disable the SDHI.
```

## dts/bindings/sdhc/st,stm32-sdio.yaml
```yaml
# Copyright (c) 2025 EXALT Technologies.
#
# SPDX-License-Identifier: Apache-2.0

title: STM32 SDIO Host Controller

description: Common properties for STM32 SDIO Host Controller peripheral.

compatible: "st,stm32-sdio"

bus: sd

include: [sdhc.yaml, pinctrl-device.yaml, reset-device.yaml]

properties:
  hw-flow-control:
    type: boolean
    description: Set to enable RTS/CTS flow control at boot time.

  sdhi-on-gpios:
    type: phandle-array
    description: GPIO used to enable/disable the SDHI.

  cd-gpios:
    type: phandle-array
    description: Card detect pin.

  clocks:
    required: true

  reg:
    required: true

  pinctrl-0:
    required: true

  pinctrl-names:
    required: true

  support-1-8-v:
    type: boolean
    description: |
        When defined, it indicates that the external SDIO circuit supports 1.8V signaling.

  bus-width:
    type: int
    default: 1
    description: |
        Bus width for SDMMC access, defaults to the minimum necessary
        number of bus lines.
    enum:
      - 1
      - 4
      - 8

  clk-div:
    type: int
    default: 1
    description: |
        Clock division factor for SDMMC. Typically the clock operates at 25MHz so
        a division factor of 2 would be 25MHz / 2 = 12.5MHz.
        The valid range is 0 to 1023.
```

## dts/bindings/sdhc/ti,am654-sdhci.yaml
```yaml
description: TI SD/eMMC Host Controller

compatible: "ti,am654-sdhci"

include: [sdhc.yaml, pinctrl-device.yaml]

properties:
  reg:
    required: true

  ti,is-embedded:
    description: Whether the slot type is embedded or not
    type: boolean

  ti,dll-present:
    description: Whether PHY requires DLL configuration or not
    type: boolean

  ti,fails-without-test-cd:
    description:
      When present, indicates that the CD line is not connected
      and the controller is required to be forced into Test mode
      to set the TESTCD bit.
    type: boolean


  ti,clkbuf-sel:
    description: Clock Delay Buffer Select
    type: int
    required: true

  ti,strobe-sel:
    description: Strobe Select Delay
    type: int

  ti,strobe-sel-4-bit:
    description: Whether Strobe Select Delay uses 4 bit field instead of 8
    type: boolean

  ti,dll-frqsel-2-bit:
    description: Whether DLL frequency select uses 2 bit field instead of 3
    type: boolean

  ti,driver-strength-ohm:
    description: DLL drive strength in ohms
    type: int
    enum:
      - 33
      - 40
      - 50
      - 66
      - 100

  ti,trm-icp:
    description: DLL trim select
    type: int

  ti,itap-del-sel-legacy:
    description: Input tap delay for SD/MMC legacy timing
    type: int

  ti,otap-del-sel-legacy:
    description: Output tap delay for SD/MMC legacy timing
    type: int

  # HS200 input tap delay as calculated during tuning
  ti,otap-del-sel-hs200:
    description: Output tap delay for eMMC HS200 timing
    type: int

  ti,itap-del-sel-hs:
    description: Input tap delay for SD/MMC High Speed timing
    type: int

  ti,otap-del-sel-hs:
    description: Output tap delay for SD/MMC High Speed timing
    type: int

  ti,itap-del-sel-sdr12:
    description: Input tap delay for SD UHS SDR12 timing
    type: int

  ti,otap-del-sel-sdr12:
    description: Output tap delay for SD UHS SDR12 timing
    type: int

  ti,itap-del-sel-sdr25:
    description: Input tap delay for SD UHS SDR25 timing
    type: int

  ti,otap-del-sel-sdr25:
    description: Output tap delay for SD UHS SDR25 timing
    type: int

  ti,otap-del-sel-sdr50:
    description: Output tap delay for SD UHS SDR50 timing
    type: int

  ti,otap-del-sel-ddr50:
    description: Output tap delay for SD UHS DDR50 timing
    type: int

  ti,itap-del-sel-ddr52:
    description: Input tap delay for eMMC DDR52 timing
    type: int

  ti,otap-del-sel-ddr52:
    description: Output tap delay for eMMC DDR52 timing
    type: int

  # SDR104 input tap delay as calculated during tuning
  ti,otap-del-sel-sdr104:
    description: Output tap delay for SD UHS SDR104 timing
    type: int

  vmmc-supply:
    type: phandle
    description: |
      Phandle to the regulator that provides the main power supply voltage
      to the MMC/SD card.

  vqmmc-supply:
    type: phandle
    description: |
      Phandle to the regulator that provides the I/O signaling voltage
      (VDDIO) to the MMC/SD card.
```

## dts/bindings/sdhc/xlnx,sdhc.yaml
```yaml
description: Xilinx SD/EMMC host controller

compatible: "xlnx,versal-8.9a"

include: [sdhc.yaml]

properties:
  reg:
    required: true

  clocks:
    required: true

  broken-cd:
    type: boolean
    description:
      There is no card detection available; polling must be used.
```

## dts/bindings/sdhc/xlnx,zynq-sdhc.yaml
```yaml
# Copyright (c) 2023, iCNC Precision Metal
# SPDX-License-Identifier: Apache-2.0

description: |
  XLNX Zynq SDHC Controller
  Here is an example for sdhc0:

  sdhc0: sdhc@e0100000 {
     status = "disabled";
     compatible = "xlnx,zynq-sdhc";
     reg = <0xe0100000 0x1000>;
     clock-frequency = <50000000>;
     max-bus-freq = <50000000>;
     min-bus-freq = <400000>;
     power-delay-ms = <500>;
     bus-width = <4>;
     interrupts = <GIC_SPI 24 IRQ_TYPE_LEVEL IRQ_DEFAULT_PRIORITY>;
     interrupt-names = "irq_0";
     slot-type = <1>;
     no-1-8-v; 
  };

  See the Xilinx Zynq-7000 SoC Technical Reference Manual (UG585) for further details
 
compatible: "xlnx,zynq-sdhc"

include: [sdhc.yaml, pinctrl-device.yaml]

properties:
  reg:
    required: true

  clock-frequency:
    type: int
    required: true
    default: 50000000
    description: |
      The clock frequency of the SDHC controller. If not specified, the default
      value is 50000000.
  
  bus-width:
    type: int
    enum:
      - 4
      - 8
    description: |
      The bus width of the SDHC controller. 4 for 4-bit bus, 8 for 8-bit bus.
      If not specified, the default value is 4.
  slot-type:
    type: int
    enum:
      - 1 # SD
      - 2 # mmc
      - 3 # SDIO
      - 4 # SDCOMBO
      - 5 # emmc
    description: |
      The slot type of the SDHC controller. 1 for SD, 2 for mmc, 3 for SDIO,
      4 for SDCOMBO, 5 for emmc. If not specified, the default value is 1.

  no-1-8-v:
    type: boolean
    description: |
      When the external SD card circuit does not support 1.8V, add this
      property to disable 1.8v card voltage of SD card controller.
```
