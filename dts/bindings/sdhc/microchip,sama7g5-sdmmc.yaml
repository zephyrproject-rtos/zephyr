## dts/bindings/sdhc/zephyr,sdhc-emul-controller.yaml
```yaml
# Copyright 2026 Alif Semiconductor
# SPDX-License-Identifier: Apache-2.0

description: |
  Zephyr SDHC emulation controller.

  A virtual SD host controller bus that hosts emulated card peripherals.
  Child nodes with compatible "zephyr,sdhc-emul-card" are registered as
  card emulators on this bus.

compatible: "zephyr,sdhc-emul-controller"

include: [sdhc.yaml]

properties:
  "#address-cells":
    const: 1
  "#size-cells":
    const: 0
```

## dts/bindings/sdhc/zephyr,sdhc-spi-slot.yaml
```yaml
description: Generic Zephyr SPI based SDHC controller

compatible: "zephyr,sdhc-spi-slot"

include: [spi-device.yaml]

properties:
  power-delay-ms:
    type: int
    default: 1
    description: |
      Time in ms for SPI SDHC to delay when toggling power to the SD card. This
      delay gives the card time to power up or down fully. It can be increased
      if you observe issues initializing your card.

  spi-clock-mode-cpol:
    type: boolean
    description: |
      Clock polarity to use for SPI SDHC. Some cards respond properly
      only when the clock goes low when not active.

  spi-clock-mode-cpha:
    type: boolean
    description: |
      Clock phase: this dictates when is the data captured, and depends
      on the clock's polarity. When mode-cpol is set and this option as well,
      capture will occur on low to high transition and high to low if
      this option is not set (default).

  pwr-gpios:
    type: phandle-array
    description: |
      Power pin
      This pin defaults to active high when consumed by the SPI SDHC driver.
      It can be used to toggle card power via an external control circuit

bus: sd
```

## dts/bindings/sdmmc/st,stm32-sdmmc.yaml
```yaml
#
# Copyright (c) 2019, Yurii Hamann
#
# SPDX-License-Identifier: Apache-2.0
#
---
title: STM32 SDMMC
version: 0.1

description: >
    This is a representation of the STM32 SDMMC nodes

properties:
    compatible:
      type: string
      category: required
      description: compatible strings
      constraint: "st,stm32-sdmmc"
      generation: define

    reg:
      type: int
      description: mmio register space
      generation: define
      category: required

    clocks:
      type: array
      category: optional
      description: Clock gate information
      generation: define

    label:
      type: string
      category: required
      description: Human readable string describing the device (used by Zephyr for API name)
      generation: define
...
```

## dts/bindings/sensing/sensing,accel-based-angle.yaml
```yaml
# Copyright (c) 2023 Google LLC
# SPDX-License-Identifier: Apache-2.0

description: Accelerometer based lid angle virtual sensor

compatible: "sensing,accel-based-angle"

include: [sensor-device.yaml, base.yaml]

properties:
  plane0:
    type: phandle
    required: true
    description: |
      Node owning the sensing_sensor_info for the first plane's accelerometer

  plane1:
    type: phandle
    required: true
    description: |
      Node owning the sensing_sensor_info for the second plane's accelerometer
```

## dts/bindings/sensing/sensing,emul.yaml
```yaml
# Copyright (c) 2023 Google LLC
# SPDX-License-Identifier: Apache-2.0

description: Emulated virtual sensor

compatible: "sensing,emul"

include: [sensor-device.yaml, base.yaml]

properties:

  sensor-types:
    type: array
    required: true
    description: |
      One or more sensor data types that are provided by this device. For
      example, a 'dev' pointing to a bmi160 may report accel/gyro/die_temp or
      any subset of those types.

  rotation-matrix:
    type: array
    description: |
      3x3 matrix to rotation x, y, and z axes.
      In order to make application logic agnostic to how the device was placed
      on the board, it's possible to enter the rotation matrix which will be
      applied to every sample produced by this sensor. The final orientation
      will be:
      * X-axis is horizontal and positive toward the right
      * Y-axis is vertical and positive toward the top
      * Z-axis is depth and positive toward the user
      
      If not provided, the rotation matrix will be the identity matrix.
      Otherwise, the following will be used:
      
      +-        -+   +-        -+   +- -+
      | v1 v2 v3 |   | sensor_X | = | X |
      | v4 v5 v6 | * | sensor_Y | = | Y |
      | v7 v8 v9 |   | sensor_Z | = | Z |
      +-        -+   +-        -+   +- -+
```

## dts/bindings/sensor/adi,ad2s1210.yaml
```yaml
# Copyright (c) 2025 Kickmaker
# SPDX-License-Identifier: Apache-2.0
#
# This file contains the binding for ad2s1210 sensor

title: AD2S1210 resolution tracking resolver-to-digital converter

description: |
  The AD2S1210 is a complete 10-bit to 16-bit resolution tracking
  resolver-to-digital converter, integrating an on-board programmable
  sinusoidal oscillator that provides sine wave excitation for
  resolvers.

  The AD2S1210 allows the user to read the angular position or the
  angular velocity data directly from the parallel outputs or through
  the serial interface.

  The mode of operation of the communication channel (parallel or serial) is
  selected by the A0 and A1 input pins. In normal mode, data is latched by
  toggling the SAMPLE line and can then be read directly. In configuration mode,
  data is read or written using a register access scheme (address byte with
  read/write flag and data byte).

    A1  A0  Result
     0   0  Normal mode - position output
     0   1  Normal mode - velocity output
     1   0  Reserved
     1   1  Configuration mode

  In normal mode, the resolution of the digital output is selected using
  the RES0 and RES1 input pins. In configuration mode, the resolution is
  selected by setting the RES0 and RES1 bits in the control register.

  RES1  RES0  Resolution (Bits)
     0     0  10
     0     1  12
     1     0  14
     1     1  16

  Note on SPI connections: The CS line on the AD2S1210 should hard-wired to
  logic low and the WR/FSYNC line on the AD2S1210 should be connected to the
  SPI CSn output of the SPI controller.

  Datasheet:
  https://www.analog.com/media/en/technical-documentation/data-sheets/ad2s1210.pdf

compatible: "adi,ad2s1210"

include: [spi-device.yaml, sensor-device.yaml]

properties:
  sample-gpios:
    type: phandle-array
    required: true
    description: GPIO connected to the /SAMPLE pin. As the line needs to be low to trigger
      a sample, it should be configured as GPIO_ACTIVE_LOW.

  mode-gpios:
    type: phandle-array
    required: true
    description:
      GPIO lines connected to the A0 and A1 pins. These pins select the data
      transfer mode.

  reset-gpios:
    type: phandle-array
    required: true
    description:
      GPIO connected to the /RESET pin. As the line needs to be low for the
      reset to be active, it should be configured as GPIO_ACTIVE_LOW.

  resolution-gpios:
    type: phandle-array
    description:
      GPIO lines connected to the RES0 and RES1 pins. These pins select the
      resolution of the digital output. If omitted, it is assumed that the
      RES0 and RES1 pins are hard-wired to match the assigned-resolution-bits
      property.

  fault-gpios:
    type: phandle-array
    description:
      GPIO lines connected to the LOT and DOS pins. These pins combined indicate
      the type of fault present, if any. As these pins a pulled low to indicate
      a fault condition, they should be configured as GPIO_ACTIVE_LOW.

  assigned-resolution-bits:
    type: int
    default: 12
    description:
      Resolution of the digital output required by the application. This
      determines the precision of the angle and/or the maximum speed that can
      be measured. If resolution-gpios is omitted, it is assumed that RES0 and
      RES1 are hard-wired to match this value. Default resolution at power up
      for the configuration mode is 12 bits so we are using 12 bits as default
      here as well.
    enum: [10, 12, 14, 16]

  clock-frequency:
    type: int
    required: true
    description: Frequency of the resolver clock input signal in Hz. Range is 6144000 and 10240000.
```

## dts/bindings/sensor/adi,ad74115h.yaml
```yaml
description: |
    Analog Devices AD74115H Single-Channel Software Configurable I/O.
    Supports ADC (Sensor), DAC, and GPIO modes.
compatible: "analog,ad74115h"
include: [spi-device.yaml, gpio-controller.yaml]
properties:
  reset-gpios:
    type: phandle-array
    description: GPIO specifier for the RESET pin (active low).
  adc-rdy-gpios:
    type: phandle-array
    description: GPIO specifier for the ADC_RDY pin.
  analog,ext-charge-pump:
    type: boolean
    description: Enable internal charge pump for negative AVSS generation.
  "#gpio-cells":
    const: 2
gpio-cells:
  - pin
  - flags
```

## dts/bindings/sensor/adi,ad74416h.yaml
```yaml
description: |
    Analog Devices AD74416H Quad-Channel Software Configurable I/O.
    This driver supports ADC (Sensor), DAC, and GPIO (Digital I/O) modes.

compatible: "analog,ad74416h"

include: [spi-device.yaml, gpio-controller.yaml]

properties:
  reg:
    required: true
  reset-gpios:
    type: phandle-array
    description: GPIO specifier for the RESET pin (active low).
  adc-rdy-gpios:
    type: phandle-array
    description: GPIO specifier for the ADC_RDY pin.
  alert-gpios:
    type: phandle-array
    description: GPIO specifier for the ALERT pin.
  adi,adaptive-power:
    type: boolean
    description: Enable adaptive power switching (AVDD_HI/AVDD_LO tracking).
  adi,wdt-timeout-ms:
    type: int
    default: 1000
    enum: [1, 5, 10, 25, 50, 100, 250, 500, 750, 1000, 2000]
    description: Watchdog timeout in milliseconds.

  "#gpio-cells":
    const: 2

gpio-cells:
  - pin
  - flags
```

## dts/bindings/sensor/adi,ade7978.yaml
```yaml
# Copyright (c) 2026 Filip Stojanovic
# SPDX-License-Identifier: Apache-2.0

description: ADE7978 Isolated energy metering chipset for polyphase shunt meters

compatible: "adi,ade7978"

include: [sensor-device.yaml, spi-device.yaml]
```

## dts/bindings/sensor/adi,ade9153a-common.yaml
```yaml
# Copyright (c) 2024 Plentify (Pty) Ltd.
# SPDX-License-Identifier: Apache-2.0

description: ADE9153a Energy Metering IC with Autocalibration

include: sensor-device.yaml

properties:
  cf-gpios:
    type: phandle-array
    description: |
      The CF1 pin is a Calibration Frequency (CF) Logic Output. The CF1 and CF2 outputs provide
      proportional power information based on the CFxSEL bits in the CFMODE register. Use these
      outputs for operational and calibration purposes. Scale the full-scale output frequency by
      writing to the CFxDEN registers, respectively.

  irq-gpios:
    type: phandle-array
    description: |
      Interrupt Request Output (IRQn). This pin is an active low logic output. See the
      Interrupts/Events section for information about events that trigger interrupts..

  reset-gpios:
    type: phandle-array
    description: |
      RESETn is an Active Low Reset Input. To initiate a hardware reset, this pin must be brought
      low for a minimum of 10 μs.
```

## dts/bindings/sensor/adi,ade9153a-spi.yaml
```yaml
# Copyright (c) 2025 Plentify (Pty) Ltd.
# SPDX-License-Identifier: Apache-2.0

description: ADE9153A

compatible: "adi,ade9153a"

include: ["spi-device.yaml", "adi,ade9153a-common.yaml"]
```

## dts/bindings/sensor/adi,adis1647x.yaml
```yaml
# Copyright (c) 2026 Analog Devices, Inc.
# SPDX-License-Identifier: Apache-2.0

description: ADIS1647x 6-DoF MEMS IMU with SPI connection

compatible: "adi,adis1647x"

include: spi-device.yaml

properties:
  drdy-gpios:
    type: phandle-array
    description: |
      Data ready interrupt pin. Active high by default as produced by the sensor.

  reset-gpios:
    type: phandle-array
    description: |
      Hardware reset pin. Active low — assert (drive low) to reset, deassert
      (drive high) for normal operation.

  model:
    type: string
    required: true
    enum:
      - "adis16470"
      - "adis16475-1"
      - "adis16475-2"
      - "adis16475-3"
      - "adis16477-1"
      - "adis16477-2"
      - "adis16477-3"
    description: |
      IMU model variant. Selects accelerometer sensitivity and gyroscope
      full-scale range at compile time without runtime register reads.

  dec-rate:
    type: int
    default: 19
    min: 0
    max: 1999
    description: |
      Decimation rate applied to the 2000 Hz internal sample rate.
      Output data = 2000 / (dec_rate + 1) Hz
      0 # 2000 Hz
      1 # 1000 Hz
      ...
      19 # 100 Hz (default)
      199 # 10 Hz

      Default is 19 (100 Hz output rate). This is a common output rate for
      general motion-sensing applications (AHRS, robotics, vibration
      monitoring) — high enough to capture typical platform dynamics while
      keeping SPI/CPU load on the host modest.

examples:
  - |
    #include <zephyr/dt-bindings/gpio/gpio.h>

    &spi1 {
      /* ... */

      adis1647x: adis1647x@0 {
        compatible = "adi,adis1647x";
        reg = <0>;
        spi-max-frequency = <421875>;
        spi-cpol;
        spi-cpha;
        drdy-gpios = <&gpiof 12 GPIO_ACTIVE_HIGH>;
        reset-gpios = <&gpiod 15 GPIO_ACTIVE_LOW>;
        model = "adis16477-1";
        dec-rate = <99>;
      };
    };
```
