## dts/bindings/lora/semtech,sx1280.yaml
```yaml
# Copyright (c) 2026 Giuseppe Fabiano <gfabiano40@gmail.com>
# SPDX-License-Identifier: Apache-2.0

description: Semtech SX1280 2.4 GHz LoRa, FLRC and GFSK transceiver

compatible: "semtech,sx1280"

include: semtech,sx128x-base.yaml
```

## dts/bindings/lora/semtech,sx1281.yaml
```yaml
# Copyright (c) 2026 Giuseppe Fabiano <gfabiano40@gmail.com>
# SPDX-License-Identifier: Apache-2.0

description: Semtech SX1281 2.4 GHz LoRa, FLRC and GFSK transceiver without the ranging engine

compatible: "semtech,sx1281"

include: semtech,sx128x-base.yaml
```

## dts/bindings/lora/semtech,sx128x-base.yaml
```yaml
# Copyright (c) 2026 Giuseppe Fabiano <gfabiano40@gmail.com>
# SPDX-License-Identifier: Apache-2.0

include: spi-device.yaml

properties:
  reset-gpios:
    type: phandle-array
    description: |
      GPIO connected to the modem's NRESET signal, active-low. If absent,
      initialization relies on the modem's power-on reset.

  busy-gpios:
    type: phandle-array
    required: true
    description: |
      GPIO connected to the modem's BUSY signal.

  dio1-gpios:
    type: phandle-array
    description: |
      GPIO connected to DIO1. The driver routes the radio interrupts to the
      lowest-numbered DIO wired to the host, and polls the interrupt status
      over SPI when none is.

  dio2-gpios:
    type: phandle-array
    description: |
      GPIO connected to DIO2, used for the radio interrupts when DIO1 is
      not wired to the host.

  dio3-gpios:
    type: phandle-array
    description: |
      GPIO connected to DIO3, used for the radio interrupts when neither
      DIO1 nor DIO2 is wired to the host.

  tx-enable-gpios:
    type: phandle-array
    description: |
      RF front-end control line asserted for the duration of each
      transmission and released otherwise.

  rx-enable-gpios:
    type: phandle-array
    description: |
      RF front-end control line asserted while the radio listens (receive
      and channel activity detection) and released otherwise.

  regulator-ldo:
    type: boolean
    description: |
      Use the internal LDO instead of the DC-DC converter, for designs
      without the DC-DC inductor.

  tx-power-max-dbm:
    type: int
    description: |
      Highest output power, in dBm, the driver may program into the chip.
      Requests above it are clamped.

      Needed on designs with an external power amplifier or front-end
      module between the SX128x and the antenna, where driving the chip's
      output above the amplifier's rated input can damage it.
```

## dts/bindings/lora/zephyr,fake-lora.yaml
```yaml
# Copyright (c) 2026 Embeint Inc
# SPDX-License-Identifier: Apache-2.0

description: |
  This binding provides a fake LoRa modem for use as either a stub or a mock in Zephyr tests.

compatible: "zephyr,fake-lora"
```

## dts/bindings/mbox/allwinner,sunxi-msgbox-riscv.yaml
```yaml
# SPDX-FileCopyrightText: Copyright The Zephyr Project Contributors
# SPDX-License-Identifier: Apache-2.0

description: |
  Allwinner V851S MSGBOX, RISC (E907) side. Two register windows: the local
  (RISC) MSGBOX block for RX and the peer CPUX block for TX.

compatible: "allwinner,sunxi-msgbox-riscv"

include: [base.yaml, mailbox-controller.yaml]

properties:
  "#mbox-cells":
    const: 1
  reg:
    required: true
  reg-names:
    required: true
  interrupts-extended:
    required: true
  allwinner,ccu-base:
    type: int
    description: |
      CCU base address, used to ungate and de-assert the RISC-V MSGBOX block.
      The A7 only enables CPUX MSGBOX, so the E907 has to turn its own block on.
  allwinner,ccu-bgr-off:
    type: int
    default: 0x71c
    description: Offset of MSGBOX_BGR_REG inside the CCU
  allwinner,ccu-riscv-bits:
    type: int
    default: 0x20002
    description: |
      Bits in MSGBOX_BGR_REG that gate (bit 1) and de-assert the reset
      (bit 17) of the RISC-V MSGBOX block.

mbox-cells:
  - channel
```

## dts/bindings/mbox/arm,mhuv3.yaml
```yaml
# SPDX-FileCopyrightText: Copyright 2024 Arm Limited and/or its
# SPDX-FileCopyrightText: affiliates <open-source-office@arm.com>
#
# SPDX-License-Identifier: Apache-2.0

description: ARM MHUv3 (Message Handling Unit v3)

compatible: "arm,mhuv3"

include: [base.yaml, mailbox-controller.yaml]

properties:
  reg:
    required: true

  interrupts:
    required: true

  interrupt-names:
    required: true

mbox-cells:
  - channel
```

## dts/bindings/mbox/infineon,mbox.yaml
```yaml
# SPDX-FileCopyrightText: Copyright (c) 2026 Infineon Technologies AG,
# SPDX-FileCopyrightText: or an affiliate of Infineon Technologies AG. All rights reserved.
#
# SPDX-License-Identifier: Apache-2.0

description: |
  Infineon IPC block exposed as a Zephyr MBOX controller.

  This driver implements the Multi-Channel Inter-Processor Mailbox (MBOX) API
  on top of the Infineon inter-processor communication (IPC) block using direct
  register access. Each mailbox channel carries one or two 32-bit data words,
  selected per controller by "msg-size-bytes".

  A mailbox channel is described by one "ipc-configs" entry and one
  "interrupts" entry, at the same index:

    * ipc-configs = <&ipcX channel interrupt>
        &ipcX     - phandle of the IPC instance the channel belongs to,
        channel   - IPC channel index within that instance,
        interrupt - IPC interrupt-structure index within that instance the
                    receiver watches on this channel.
    * interrupts  - NVIC vector, on this core, of that interrupt structure.

  The channel index passed by consumers through "#mbox-cells = <1>" is the
  index into these arrays, not an IPC channel number.

  Any core may use any IPC instance; there is no fixed instance-to-core
  mapping. A controller may reference any instance and may even mix instances
  across its channels. Only the "interrupts" entry is core-specific: it must be
  the NVIC vector of the chosen interrupt structure in the servicing core's own
  vector table.

  Example:

    &ipc0 {
        status = "okay";
    };

    mbox0: mbox {
        compatible = "infineon,mbox";
        #mbox-cells = <1>;
        ipc-configs = <&ipc0 3 3>, <&ipc0 4 4>;
        interrupts = <73 4>, <74 4>;
        status = "okay";
    };

compatible: "infineon,mbox"

include: [base.yaml, mailbox-controller.yaml]

properties:
  interrupts:
    required: true

  ipc-configs:
    type: phandle-array
    required: true
    description: |
      One entry per mailbox channel, selecting the IPC instance, channel and
      interrupt structure that channel uses. Its length must match the number
      of "interrupts" entries.

  msg-size-bytes:
    type: int
    default: 8
    enum: [4, 8]
    description: |
      Fixed message size, in bytes, carried by every channel of this
      controller. 4 bytes uses IPC DATA0 only; 8 bytes uses DATA0 and DATA1 and
      requires an IPC block that implements DATA1 (M33SYSCPUSS, M7CPUSS or
      M4CPUSS v2, e.g. PSE84 and TRAVEO T2G). Use 4 on IP that has only DATA0
      (e.g. M4CPUSS v1). Defaults to 8 to match the PSE84 series.

mbox-cells:
  - channel
```

## dts/bindings/mbox/realtek,rtl8730e-ipc.yaml
```yaml
# Copyright (c) 2026 Realtek Semiconductor Corp.
# SPDX-License-Identifier: Apache-2.0

description: |
  Realtek RTL8730E (AmebaSmart) per-core IPC doorbell block, 8 channels per
  direction on one interrupt line. The mbox cell is the absolute register bit
  (0..31), since the TX/RX group shift depends on the link direction.

compatible: "realtek,rtl8730e-ipc"

include: [mailbox-controller.yaml, base.yaml]

properties:
  reg:
    required: true

  interrupts:
    required: true

  "#mbox-cells":
    const: 1

# The mbox API reads the cell named "channel". Any other name silently resolves to 0.
mbox-cells:
  - channel
```

## dts/bindings/mbox/renesas,rz-mhu-mbox.yaml
```yaml
# Copyright (c) 2025 Renesas Electronics Corporation
# SPDX-License-Identifier: Apache-2.0

description: |
  Renesas MHU MBOX

  Notes:
  - With Renesas MHU MBOX, both TX and RX functions can be used on a single channel.

compatible: "renesas,rz-mhu-mbox"

include: [base.yaml, mailbox-controller.yaml]

properties:
  unit:
    type: int
    required: true
    description: |
      Index of the underlying MHU hardware channel used by this MBOX controller.
      This value is independent of MBOX channel numbering.

  reg:
    required: true

  interrupts:
    required: true

  channel-mask:
    type: int
    required: true
    description: |
      Bitmask of available valid MBOX channels (bit n enables channel n).

  channels-count:
    type: int
    required: true
    description: |
      Number of channels supported for a MBOX instance.

  shared-memory:
    type: phandle
    description: |
      Reference to the shared memory region that is going
      to be used for the buffer communication between
      MHU units. This property is optional and should not be set
      in most cases.

      When omitted, the driver uses the default shared memory region defined
      by the "zephyr,memory-region" node named "mhu_shmem" in the devicetree.
      Set this property only when this MHU hardware channel requires a dedicated
      shared memory region separate from the default.

mbox-cells:
  - channel
```

## dts/bindings/mbox/zephyr,mbox-gic-sw.yaml
```yaml
# SPDX-FileCopyrightText: 2026 Muhammad Waleed Badar
# SPDX-License-Identifier: Apache-2.0

description: |
  Signal-only mailbox between operating systems that run on different
  cores and share one GIC distributor, such as Zephyr and Linux.

  Each channel uses two SPIs that no device drives. Sending on channel n
  sets tx-spis[n] pending, an SPI the other side owns. The interrupt at
  index n of "interrupts" is the SPI the other side sets pending to
  signal this core; it must be edge-triggered.

compatible: "zephyr,mbox-gic-sw"

include: [base.yaml, mailbox-controller.yaml]

properties:
  interrupts:
    required: true

  tx-spis:
    type: array
    required: true
    description: |
      SPI numbers (INTID minus 32) set pending to signal the other side,
      one per channel.

mbox-cells:
  - channel

examples:
  - |
    /* Receive on SPI 220, signal the other side on SPI 221 */
    mbox {
        compatible = "zephyr,mbox-gic-sw";
        interrupts = <GIC_SPI 220 IRQ_TYPE_EDGE IRQ_DEFAULT_PRIORITY>;
        tx-spis = <221>;
        #mbox-cells = <1>;
    };
```

## dts/bindings/mcumgr/zephyr,smp-i2c-client.yaml
```yaml
# Copyright (c) 2026 Aerlync Labs Inc.
# SPDX-License-Identifier: Apache-2.0

title: MCUmgr SMP transport over I2C (controller mode)

description: |
  Describes an MCUmgr SMP target peer connected to this I2C bus controller.
  Raw SMP packets are exchanged, with the length taken from the SMP header.
  An optional data-ready GPIO line (data-ready-gpios) can be monitored to
  signal when an SMP response is ready on the target. If omitted, the controller
  polls by reading the SMP header until it is non-zero.

compatible: "zephyr,smp-i2c-client"

include: zephyr,smp-i2c-common.yaml

examples:
  - |
    #include <zephyr/dt-bindings/gpio/gpio.h>

    &i2c0 {
        smp_i2c_client: smp-i2c-client@54 {
            compatible = "zephyr,smp-i2c-client";
            reg = <0x54>;
            data-ready-gpios = <&gpio0 15 GPIO_ACTIVE_HIGH>;
        };
    };
```

## dts/bindings/mcumgr/zephyr,smp-i2c-common.yaml
```yaml
# Copyright (c) 2026 Aerlync Labs Inc.
# SPDX-License-Identifier: Apache-2.0

description: |
  Properties shared by the SMP-over-I2C target (zephyr,smp-i2c) and controller
  (zephyr,smp-i2c-client) nodes. Not matched directly. Included by both.

include: i2c-device.yaml

properties:
  data-ready-gpios:
    type: phandle-array
    min-len: 1
    max-len: 1
    description: |
      Optional single GPIO signalling that an SMP response is ready. The
      target node describes the pin it drives high when a response is
      buffered. The controller node describes the pin it samples with a
      rising-edge interrupt. When omitted, the controller polls by reading the
      SMP header until it is non-zero.
```

## dts/bindings/mcumgr/zephyr,smp-i2c.yaml
```yaml
# Copyright (c) 2026 Aerlync Labs Inc.
# SPDX-License-Identifier: Apache-2.0

title: MCUmgr SMP transport over I2C

description: |
  The device operates as an I2C target and receives raw SMP packets from an
  I2C controller. The packet length is taken from the SMP header, so nothing is
  added to the SMP data. The target optionally asserts data-ready-gpios when an
  SMP response is available for the controller to read. When data-ready-gpios
  is omitted the controller polls by reading the SMP header, and an all-zero
  header indicates that no response is ready yet.

compatible: "zephyr,smp-i2c"

include: zephyr,smp-i2c-common.yaml

examples:
  - |
    #include <zephyr/dt-bindings/gpio/gpio.h>

    &i2c0 {
        smp_i2c: smp-i2c@55 {
            compatible = "zephyr,smp-i2c";
            reg = <0x55>;
            data-ready-gpios = <&gpio0 22 GPIO_ACTIVE_HIGH>;
        };
    };
```

## dts/bindings/mcumgr/zephyr,smp-uart-raw.yaml
```yaml
# Copyright The Zephyr Project Contributors
# SPDX-License-Identifier: Apache-2.0

title: MCUmgr raw SMP transport on a UART

description: |
  Runs the MCUmgr raw UART transport, CONFIG_MCUMGR_TRANSPORT_RAW_UART, on the
  parent UART. Packets are sent without encoding, so the UART must not carry
  anything else.

  The node must be the only enabled child of its UART.

  The zephyr,uart-mcumgr chosen UART is used by the MCUmgr UART transports only
  when no zephyr,smp-uart or zephyr,smp-uart-raw node of an enabled transport
  exists. Nodes whose transport is disabled are ignored. Boards set the chosen
  node; applications add these nodes to run MCUmgr on other or several UARTs.

compatible: "zephyr,smp-uart-raw"

include: uart-device.yaml

examples:
  - |
    &zephyr_udc0 {
        cdc_acm_uart0: cdc_acm_uart0 {
            compatible = "zephyr,cdc-acm-uart";

            smp-uart-raw {
                compatible = "zephyr,smp-uart-raw";
            };
        };
    };
```

## dts/bindings/mcumgr/zephyr,smp-uart.yaml
```yaml
# Copyright The Zephyr Project Contributors
# SPDX-License-Identifier: Apache-2.0

title: MCUmgr SMP over console transport on a UART

description: |
  Runs the MCUmgr UART transport, CONFIG_MCUMGR_TRANSPORT_UART, on the parent
  UART. Packets use the SMP over console framing: base64-encoded frames with a
  CRC16, each ending in a newline, so the UART can also carry text such as logs.

  The node must be the only enabled child of its UART.

  The zephyr,uart-mcumgr chosen UART is used by the MCUmgr UART transports only
  when no zephyr,smp-uart or zephyr,smp-uart-raw node of an enabled transport
  exists. Nodes whose transport is disabled are ignored. Boards set the chosen
  node; applications add these nodes to run MCUmgr on other or several UARTs.

compatible: "zephyr,smp-uart"

include: uart-device.yaml

examples:
  - |
    &uart1 {
        status = "okay";

        smp-uart {
            compatible = "zephyr,smp-uart";
        };
    };
```

## dts/bindings/memory-controllers/aifoundry,erbium-mram-controller.yaml
```yaml
# SPDX-License-Identifier: Apache-2.0

description: |
  Erbium AXI-to-MRAM bridge and per-bank controller registers. The controller
  provides configuration, ECC status and bank test registers for the 16 MiB
  MRAM data window. Firmware initializes the banks before entering Zephyr.

  The CPU register map and interrupt routing are documented at:
  https://github.com/openhwfoundation/core-et-erbium/blob/325b32b7efaa2c2ab9c91001c89d3f49a4740826/doc/cpu_mm.md
  https://github.com/openhwfoundation/core-et-erbium/blob/325b32b7efaa2c2ab9c91001c89d3f49a4740826/doc/interrupts.md

compatible: "aifoundry,erbium-mram-controller"

include: base.yaml

properties:
  reg:
    required: true

  interrupts:
    required: true
```
