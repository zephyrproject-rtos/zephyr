## dts/bindings/memory-controllers/arm,tz-mpc.yaml
```yaml
# SPDX-FileCopyrightText: Copyright (c) 2026 Infineon Technologies AG,
# SPDX-FileCopyrightText: or an affiliate of Infineon Technologies AG. All rights reserved.
#
# SPDX-License-Identifier: Apache-2.0

title: ARM TrustZone Memory Protection Controller (TZ-MPC)

description: |
  ARM TrustZone MPC (PL523 or compatible). Programs the block-LUT to mark
  selected address ranges as Non-Secure on the AHB bus.

  Governed memory regions are expressed as child nodes. Each child's reg
  property encodes <offset size> in bytes, relative to block 0 of the memory
  controlled by this MPC instance. The driver marks every block that falls
  within [offset, offset+size) as Non-Secure in the block-LUT.

  Offsets and sizes should be aligned to the MPC block size, which is read
  at runtime from the BLK_CFG register (typically 32 B to 256 KB).

  Example (mps2-an521 code SRAM, NS partition at offset 1 MB, 512 KB):

    mpc_sram1: mpc@58007000 {
        compatible = "arm,tz-mpc";
        reg = <0x58007000 0x1000>;
        #address-cells = <1>;
        #size-cells = <1>;
        status = "okay";

        region@100000 {
            reg = <0x00100000 0x00080000>;
        };
    };

include: arm,mpc-base.yaml

compatible: "arm,tz-mpc"

child-binding:
  description: |
    A Non-Secure memory region governed by this TZ-MPC instance.
    The reg property encodes <offset size> within the MPC-controlled memory.
    Every block in this range is marked Non-Secure in the block-LUT.

  properties:
    reg:
      type: array
      required: true
      description: "<offset size> within the MPC-controlled memory, in bytes."
```

## dts/bindings/memory-controllers/microchip,ebi-g1-memc.yaml
```yaml
# Copyright (c) 2026 Microchip Technology Inc.
# SPDX-License-Identifier: Apache-2.0

description: |
  Microchip External Bus Interface (EBI) G1.

  SAM EBI includes the following hardware peripheral:
    - module name="EBI" id="0" version="0"

examples:
  - |
    Example devicetree configuration:

      pinctrl_nand_default: nand-default {
        group1 {
          pinmux = <PIN_PD9__D0>,
                   <PIN_PD10__D1>,
                   <PIN_PD11__D2>,
                   <PIN_PC21__D3>,
                   <PIN_PC22__D4>,
                   <PIN_PC23__D5>,
                   <PIN_PC24__D6>,
                   <PIN_PD2__D7>,
                   <PIN_PD3__NANDRDY>,
                   <PIN_PD4__GPIO>,
                   <PIN_PD5__NWE_NWR0_NANDWE>,
                   <PIN_PD6__NRD_NANDOE>,
                   <PIN_PD7__A21_NANDALE>,
                   <PIN_PD8__A22_NANDCLE>;
          bias-disable;
        };
      };

      &ebi {
        pinctrl-names = "default";
        pinctrl-0 = <&pinctrl_nand_default>;
        status = "okay";

        cs3: cs@58000000 {
          reg = <0x3 0x0 0x800000>;
          status = "okay";

          smc-tdf-mode;
          smc-write-mode = "nwe";
          smc-read-mode = "nrd";
          smc-bus-width = "8-bit";
          smc-setup-timing = <4 0 0 0>;
          smc-pulse-timing = <10 20 10 20>;
          smc-cycle-timing = <20 20>;
        };
      };

    The above example configure a NAND Flash with default timing mode.
    TDF mode is enabled (and the maximum clock cycle 15 will be set by default).
    The NWE and NRD signals are used to contril write and read operations.
    For SAMA7G54, the clock source of EBI is MCK1 with frenqucy 200MHz,
    so one clock cycle is 1 s / 200MHz = 5 ns
    Setup timing:
      NWE setup time is 4 * 5 ns = 20 ns
      NCS and NRD setup time is 0 ns
    Pulse timing:
      NWE pulse time is 10 * 5 ns = 50 ns
      NCS pulse time in write access is 20 * 5 ns = 100 ns
      NRD pulse time is 10 * 5 ns = 50 ns
      NCS pulse time in read access is 20 * 5 ns = 100 ns
    Cycle timing:
      Total write cycle time is 20 * 5 ns = 100 ns
      Total read cycle time is 20 * 5 ns = 100 ns

compatible: "microchip,ebi-g1-memc"

include:
  - name: base.yaml
  - name: pinctrl-device.yaml

properties:
  reg:
    required: true

  clocks:
    required: true

  smc:
    type: phandle
    required: true
    description: |
      Hold a phandle reference to the smc controller.

  "#address-cells":
    required: true
    const: 2

  "#size-cells":
    required: true
    const: 1

child-binding:
  description: |
    Child device nodes are representing devices connected to the EBI/SMC bus.

  properties:
    reg:
      type: array
      required: true
      description: |
        The device's EBI Chip Select number and address.

    smc-write-mode:
      type: string
      required: true
      description: |
        Selection of the Control Signal for Write Operation.
        ncs - The Write operation is controller by the NCS signal
        nwe - The Write operation is controlled by the NWE signal
      enum:
        - "ncs"
        - "nwe"

    smc-read-mode:
      type: string
      required: true
      description: |
        Selection of the Control Signal for Read Operation.
        ncs - The Read operation is controlled by the NCS signal
        nrd - The Read operation is controlled by the NRD signal
      enum:
        - "ncs"
        - "nrd"

    smc-bus-width:
      type: string
      required: true
      description: |
        Data bus width.
      enum:
        - "8-bit"
        - "16-bit"

    smc-tdf-mode:
      type: boolean
      description: |
        TDF Optimization Enable.

    smc-tdf-cycles:
      type: int
      default: 15
      description: |
        The number of clock cycles required by the external device to release
        the data after the rising edge of the read controlling signal.
      enum: [0, 1, 2, 3, 4, 5, 6, 7, 8, 9, 10, 11, 12, 13, 14, 15]

    smc-setup-timing:
      type: array
      required: true
      description: |
        Array[0] is NWE_SETUP[5:0], defines the NWE signal setup length.
        Array[1] is NCS_WR_SETUP[5:0], defines the NCS signal setup length in write access.
        Array[2] is NRD_SETUP[5:0], defines the NRD signal setup length.
        Array[3] is NCS_RD_SETUP[5:0], defines the NCS signal setup length in read access.
        Setup length = (128 * SETUP[5] + SETUP[4:0]) clock cycles

    smc-pulse-timing:
      type: array
      required: true
      description: |
        Array[0] is NWE_PULSE[6:0], defines the NWE signal pulse length.
        Array[1] is NCS_WR_PULSE[6:0], defines the NCS signal pulse length in write access.
        Array[2] is NRD_PULSE[6:0], defines the NRD signal pulse length.
        Array[3] is NCS_RD_PULSE[6:0], defines the NCS signal pulse length in read access.
        Pulse length = (256 * PULSE[6] + PULSE[5:0]) clock cycles.

    smc-cycle-timing:
      type: array
      required: true
      description: |
        Array[0] is NWE_CYCLE[8:0], defines the total write cycle length.
        Array[1] is NRD_CYCLE[8:0], defines the total read cycle length.
        Cycle length = (CYCLE[8:7] * 256) + CYCLE[6:0] clock cycles.

    nfc-timings-nfsel:
      type: boolean
      description: |
        NAND Flash Selection.

    nfc-timings-twb:
      type: int
      description: |
        WEN High to REN to Busy
        Write Enable rising edge to Ready/Busy falling edge timing.
        Write Enable to Read/Busy = (TWB[3] * 64) + TWB[2:0] clock cycles.
      enum: [0, 1, 2, 3, 4, 5, 6, 7, 8, 9, 10, 11, 12, 13, 14, 15]

    nfc-timings-trr:
      type: int
      description: |
        Ready to REN Low Delay
        Ready/Busy signal to Read Enable falling edge timing.
        Read to REN = (TRR[3] * 64) + TRR[2:0] clock cycles.
      enum: [0, 1, 2, 3, 4, 5, 6, 7, 8, 9, 10, 11, 12, 13, 14, 15]

    nfc-timings-ocms:
      type: boolean
      description: |
        Off Chip Memory Scrambling Enable.

    nfc-timings-tar:
      type: int
      description: |
        ALE to REN Low Delay
        Address Latch Enable falling edge to Read Enable falling edge timing.
        Address Latch Enable to Read Enable = (TAR[3] * 64) + TAR[2:0] clock cycles.
      enum: [0, 1, 2, 3, 4, 5, 6, 7, 8, 9, 10, 11, 12, 13, 14, 15]

    nfc-timings-tadl:
      type: int
      description: |
        ALE to Data Start
        Last address latch cycle to the first rising edge of WEN for data input.
        Last address latch to first rising edge of WEN = (TADL[3] * 64) + TADL[2:0] clock cycles.
      enum: [0, 1, 2, 3, 4, 5, 6, 7, 8, 9, 10, 11, 12, 13, 14, 15]

    nfc-timings-tclr:
      type: int
      description: |
        CLE to REN Low Delay
        Command Latch Enable falling edge to Read Enable falling edge timing.
        Latch Enable Falling to Read Enable Falling = (TCLR[3] * 64) + TCLR[2:0] clock cycles.
      enum: [0, 1, 2, 3, 4, 5, 6, 7, 8, 9, 10, 11, 12, 13, 14, 15]
```

## dts/bindings/memory-controllers/microchip,smc-g1-memc.yaml
```yaml
# Copyright (c) 2026 Microchip Technology Inc.
# SPDX-License-Identifier: Apache-2.0

description: |
  Microchip Static Memory Controller (SMC) G1.

  SAM SMC includes the following hardware peripheral:
    - module name="SMC" id="6105" version="312"
    - module name="SMC" id="11036" version="304"

examples:
  - |
    Example devicetree configuration:

      &smc {
        status = "okay";
      };

compatible: "microchip,smc-g1-memc"

include:
  - name: base.yaml

properties:
  reg:
    required: true
```

## dts/bindings/memory-controllers/nxp,ahb-sramc-sram.yaml
```yaml
# Copyright 2026 NXP
# SPDX-License-Identifier: Apache-2.0

description: |
  External asynchronous SRAM (or SRAM-like FPGA) attached to one chip select
  of the NXP AHB SRAM Controller.

  The node's "reg" is the memory-mapped window the chip select maps the device
  into: up to 128 KB that the core reads and writes directly -- for example,
  0x25000000 for CS0 and 0x25020000 for CS1 on i.MX RT266x.

  Timings are given in nanoseconds, one property per register field of this
  chip select. All of them are required.

compatible: "nxp,ahb-sramc-sram"

include: [base.yaml, "zephyr,memory-common.yaml"]

properties:
  reg:
    required: true
    description: |
      Memory-mapped window of the chip select that carries this device.

  cs:
    type: int
    required: true
    min: 0
    description: |
      Chip-select index this device is wired to.

  ce-setup-time-ns:
    type: int
    required: true
    description: |
      Time CE# is asserted before the access starts (CFG0_CS[CES]). May be 0.

  ce-hold-time-ns:
    type: int
    required: true
    description: |
      Time CE# stays asserted after the access ends (CFG0_CS[CEH]). May be 0.

  address-setup-time-ns:
    type: int
    required: true
    description: |
      Time the address is driven before the access strobe (CFG0_CS[AS]).
      May be 0, except in admux mode where the hardware always inserts one
      clock cycle.

  address-hold-time-ns:
    type: int
    required: true
    description: |
      Time the address is held after its setup phase (CFG0_CS[AH]). The
      field counts from one granularity period, so 0 selects that minimum.

  turnaround-time-ns:
    type: int
    required: true
    description: |
      Dead time during which neither the controller nor the device drives
      the data lines (CFG0_CS[TA]). The field counts from one granularity
      period, so 0 selects that minimum.

  write-enable-low-time-ns:
    type: int
    required: true
    description: |
      WE# asserted time, which is the write pulse width (CFG1_CS[WEL]).
      Counts from one granularity period, so 0 selects that minimum.

  write-enable-high-time-ns:
    type: int
    required: true
    description: |
      WE# deasserted time between writes (CFG1_CS[WEH]). Counts from one
      granularity period, so 0 selects that minimum.

  read-enable-low-time-ns:
    type: int
    required: true
    description: |
      OE# asserted time, which has to cover the part's access time
      (CFG1_CS[REL]). Counts from one granularity period, so 0 selects that
      minimum.

  read-enable-high-time-ns:
    type: int
    required: true
    description: |
      OE# deasserted time between reads (CFG1_CS[REH]). Counts from one
      granularity period, so 0 selects that minimum.

  wait-pin:
    type: int
    min: 0
    max: 3
    description: |
      Index of the SRAMC_WP wait pin this device drives. Setting it enables
      wait-state monitoring for this chip select (CFG0_CS[WM_EN] and
      [WP_MUX]) and makes wait-mode required; omit it for a device that does
      not use a wait signal.

  wait-mode:
    type: int
    enum: [0, 1, 2, 4, 5, 6]
    description: |
      What ends a wait state (CFG0_CS[WM_SEL]). The numbers are the register
      encoding, the same values as the MCUXpresso SDK's sramc_wait_mode_t:
      - 0 kSRAMC_WaitMode_Level (wait pin level alone)
      - 1 kSRAMC_WaitMode_LevelAndCounter (level and counter must both end)
      - 2 kSRAMC_WaitMode_LevelOrCounter (either one ends the wait)
      - 4 kSRAMC_WaitMode_Edge (wait pin edge alone)
      - 5 kSRAMC_WaitMode_EdgeAndCounter (edge and counter must both end)
      - 6 kSRAMC_WaitMode_EdgeOrCounter (either one ends the wait)

  wait-active-high:
    type: boolean
    description: |
      The wait pin is asserted high (CFG0_CS[WP_POL]). Omit it for a
      low-asserted wait pin. Ignored unless wait-pin is set.

examples:
  - |
    &sramc {
        status = "okay";

        ext_sram0: sram@25000000 {
            compatible = "nxp,ahb-sramc-sram";
            reg = <0x25000000 DT_SIZE_K(128)>;
            cs = <0>;

            ce-setup-time-ns = <0>;
            ce-hold-time-ns = <0>;
            address-setup-time-ns = <10>;
            address-hold-time-ns = <5>;
            turnaround-time-ns = <10>;
            write-enable-low-time-ns = <45>;
            write-enable-high-time-ns = <10>;
            read-enable-low-time-ns = <55>;
            read-enable-high-time-ns = <10>;
        };
    };
```
