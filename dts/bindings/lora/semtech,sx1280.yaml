## dts/bindings/memory-controllers/nxp,ahb-sramc.yaml
```yaml
# Copyright 2026 NXP
# SPDX-License-Identifier: Apache-2.0

description: |
  NXP AHB SRAM Controller (AHB_SRAMC).

  Controller for external asynchronous parallel SRAM (or SRAM-like FPGA)
  devices.

  This node describes the controller only. The settings the hardware keeps in
  MCR -- data-port width, address mode, ADV# polarity, AHB bus timeout and
  internal clock gating -- are shared by every chip select. Each external
  device attached to one of the chip selects is described by a separate
  "nxp,ahb-sramc-sram" child node, which carries that device's bus timings,
  wait configuration and memory window.

compatible: "nxp,ahb-sramc"

include: [base.yaml, pinctrl-device.yaml]

properties:
  reg:
    required: true

  clocks:
    required: true
    description: |
      The controller's functional clock (hclk). Every timing field of every
      chip select is counted in its rate.

  "#address-cells":
    required: true
    const: 1

  "#size-cells":
    required: true
    const: 1

  port-size:
    type: int
    required: true
    enum: [8, 16]
    description: |
      External data-port width in bits, shared by every chip select
      (MCR[PS]). Must match the data width of the connected SRAM.

  address-mode:
    type: string
    required: true
    enum:
      - "admux"
      - "non-admux"
    description: |
      Whether the low address bits are multiplexed onto the data lines
      (MCR[AM]). In admux mode ADDR[15:0] ride SRAMC_DA[15:0], while
      ADDR[16] stays on its dedicated SRAMC_ADDR[16] pin.

  adv-polarity:
    type: string
    default: "active-low"
    enum:
      - "active-low"
      - "active-high"
    description: |
      Polarity of the ADV# address-valid strobe (MCR[ADVP]), used in admux
      mode only.

  bus-timeout:
    type: int
    default: 0
    min: 0
    max: 255
    description: |
      AHB bus timeout, in units of 1024 hclk cycles (MCR[BTO]). An AHB access
      that is not granted within that many cycles completes with a bus error.
      Zero disables the timeout counter.

  function-clock-always-on:
    type: boolean
    description: |
      Disable the controller's internal clock gating, so its functional clock
      runs even when no access is in flight (MCR[CG_DIS]). Omit it to leave
      gating enabled.

examples:
  - |
    &sramc {
        pinctrl-0 = <&pinmux_sramc>;
        pinctrl-names = "default";
        port-size = <16>;
        address-mode = "admux";
        status = "okay";

        ext_sram0: sram@25000000 {
            compatible = "nxp,ahb-sramc-sram";
            reg = <0x25000000 DT_SIZE_K(128)>;
            cs = <0>;

            ce-setup-time-ns = <0>;
            ce-hold-time-ns = <0>;
            address-setup-time-ns = <10>;
            address-hold-time-ns = <5>;
            turnaround-time-ns = <10>;
            write-enable-low-time-ns = <45>;
            write-enable-high-time-ns = <10>;
            read-enable-low-time-ns = <55>;
            read-enable-high-time-ns = <10>;
        };
    };
```

## dts/bindings/memory-controllers/nxp,mcux-semc-sdram.yaml
```yaml
# Copyright 2026 NXP
# SPDX-License-Identifier: Apache-2.0

description: NXP SEMC SDRAM device

compatible: "nxp,mcux-semc-sdram"

include: base.yaml

properties:
  reg:
    required: true
    description: |
      SDRAM base address and size. The base address is programmed into the
      SEMC base address register of the selected chip-select.

  cs:
    type: int
    required: true
    enum: [0, 1, 2, 3]
    description: |
      SEMC SDRAM chip-select number. The SEMC controller supports up to four
      chip-selects, so several SDRAM nodes (one per enabled chip-select) can
      be attached to the same controller.

  clk-frequency:
    type: int
    required: true
    description: SEMC clock frequency in Hz used to derive SDRAM timing.

  port-size:
    type: int
    required: true
    enum: [8, 16, 32]
    description: SDRAM data bus width in bits.

  burst-length:
    type: int
    required: true
    enum: [1, 2, 4, 8]
    description: SDRAM burst length.

  column-bits:
    type: int
    required: true
    enum: [8, 9, 10, 11, 12]
    description: SDRAM column address bit width.

  cas-latency:
    type: int
    required: true
    enum: [1, 2, 3]
    description: CAS latency in clock cycles.

  t-precharge-to-act-ns:
    type: int
    required: true
    max: 255
    description: Precharge to activate wait time in nanoseconds (tRP).

  t-act-to-readwrite-ns:
    type: int
    required: true
    max: 255
    description: Activate to read/write wait time in nanoseconds (tRCD).

  t-refresh-recovery-ns:
    type: int
    required: true
    max: 255
    description: Refresh recovery time in nanoseconds (max of tRFC, tXSR).

  t-write-recovery-ns:
    type: int
    required: true
    max: 255
    description: Write recovery time in nanoseconds (tWR).

  t-cke-off-ns:
    type: int
    required: true
    max: 255
    description: CKE off minimum time in nanoseconds.

  t-act-to-precharge-ns:
    type: int
    required: true
    max: 255
    description: Activate to precharge time in nanoseconds (tRAS).

  t-self-ref-recovery-ns:
    type: int
    required: true
    max: 255
    description: Self refresh recovery time in nanoseconds (tXSR).

  t-refresh-to-refresh-ns:
    type: int
    required: true
    max: 255
    description: Refresh to refresh wait time in nanoseconds (tRFC).

  t-act-to-act-ns:
    type: int
    required: true
    max: 255
    description: Activate to activate wait time in nanoseconds (tRRD).

  refresh-period-ns-per-row:
    type: int
    required: true
    description: |
      Refresh period in nanoseconds per row, e.g. 64 ms / 8192 rows for a
      64 ms refresh period.

  t-prescale-period-ns:
    type: int
    default: 0
    description: |
      Prescaler timer period in nanoseconds. When 0, the driver derives it
      as 160 * (1000000000 / clk-frequency), matching the MCUX SDK example.

  refresh-urgent-threshold:
    type: int
    default: 0
    description: |
      Refresh urgent threshold. When 0, the driver uses the value of
      refresh-period-ns-per-row.

  refresh-burst-length:
    type: int
    default: 1
    description: Refresh burst length.

  delay-chain:
    type: int
    default: 0
    description: |
      DQS delay chain value used to compensate timing when DQS is faster than
      read data. Only used on SoCs with SEMC delay chain control.

  auto-refresh-times:
    type: int
    default: 8
    description: |
      Additional auto refresh cycles run after mode register programming.
```

## dts/bindings/memory-controllers/nxp,mcux-semc.yaml
```yaml
# Copyright (c) 2018, NXP
# SPDX-License-Identifier: Apache-2.0

description: NXP Smart External Memory Controller (SEMC)

compatible: "nxp,mcux-semc"

include: [base.yaml, pinctrl-device.yaml]

properties:
  reg:
    required: true

  interrupts:
    required: true

  nxp,cmd-timeout-cycles:
    type: int
    default: -1
    description: |
      SEMC command execution timeout in cycles. -1 keeps the MCUX HAL
      default.

  nxp,bus-timeout-cycles:
    type: int
    default: -1
    description: |
      SEMC AXI bus timeout in cycles. -1 keeps the MCUX HAL default.

  nxp,dqs-pad-loopback:
    type: boolean
    description: |
      Use the DQS pad loopback as the dummy read strobe source.
```

## dts/bindings/memory-controllers/nxp,semc-sdram.yaml
```yaml
# Copyright 2026 NXP
# SPDX-License-Identifier: Apache-2.0

description: NXP SEMC SDRAM device

compatible: "nxp,semc-sdram"

include: base.yaml

properties:
  reg:
    required: true
    description: |
      SDRAM base address and size. The base address is programmed into the
      SEMC base address register of the selected chip-select.

  cs:
    type: int
    required: true
    enum: [0, 1, 2, 3]
    description: |
      SEMC SDRAM chip-select number. The SEMC controller supports up to four
      chip-selects, so several SDRAM nodes (one per enabled chip-select) can
      be attached to the same controller.

  clk-frequency:
    type: int
    required: true
    description: SEMC clock frequency in Hz used to derive SDRAM timing.

  port-size:
    type: int
    required: true
    enum: [8, 16, 32]
    description: SDRAM data bus width in bits.

  burst-length:
    type: int
    required: true
    enum: [1, 2, 4, 8]
    description: SDRAM burst length.

  column-bits:
    type: int
    required: true
    enum: [8, 9, 10, 11, 12]
    description: SDRAM column address bit width.

  cas-latency:
    type: int
    required: true
    enum: [1, 2, 3]
    description: CAS latency in clock cycles.

  t-precharge-to-act-ns:
    type: int
    required: true
    max: 255
    description: Precharge to activate wait time in nanoseconds (tRP).

  t-act-to-readwrite-ns:
    type: int
    required: true
    max: 255
    description: Activate to read/write wait time in nanoseconds (tRCD).

  t-refresh-recovery-ns:
    type: int
    required: true
    max: 255
    description: Refresh recovery time in nanoseconds (max of tRFC, tXSR).

  t-write-recovery-ns:
    type: int
    required: true
    max: 255
    description: Write recovery time in nanoseconds (tWR).

  t-cke-off-ns:
    type: int
    required: true
    max: 255
    description: CKE off minimum time in nanoseconds.

  t-act-to-precharge-ns:
    type: int
    required: true
    max: 255
    description: Activate to precharge time in nanoseconds (tRAS).

  t-self-ref-recovery-ns:
    type: int
    required: true
    max: 255
    description: Self refresh recovery time in nanoseconds (tXSR).

  t-refresh-to-refresh-ns:
    type: int
    required: true
    max: 255
    description: Refresh to refresh wait time in nanoseconds (tRFC).

  t-act-to-act-ns:
    type: int
    required: true
    max: 255
    description: Activate to activate wait time in nanoseconds (tRRD).

  refresh-period-ns-per-row:
    type: int
    required: true
    description: |
      Refresh period in nanoseconds per row, e.g. 64 ms / 8192 rows for a
      64 ms refresh period.

  t-prescale-period-ns:
    type: int
    default: 0
    description: |
      Prescaler timer period in nanoseconds. When 0, this value is derived
      as 160 * (1000000000 / clk-frequency), matching the MCUX SDK example.

  refresh-urgent-threshold:
    type: int
    default: 0
    description: |
      Refresh urgent threshold. When 0, this value is set to the value of
      refresh-period-ns-per-row.

  refresh-burst-length:
    type: int
    default: 1
    description: Refresh burst length.

  delay-chain:
    type: int
    default: 1
    enum: [1, 2, 3, 4, 5, 6, 7, 8, 9, 10, 11, 12, 13, 14, 15, 16,
           17, 18, 19, 20, 21, 22, 23, 24, 25, 26, 27, 28, 29, 30, 31, 32]
    description: |
      DQS delay chain value used to compensate timing when DQS is faster than
      read data. Selects 1 to 32 delay cells, with 1 selecting the minimum
      delay. Only used on SoCs with SEMC delay chain control.

  auto-refresh-times:
    type: int
    default: 8
    description: |
      Additional auto refresh cycles run after mode register programming.
```
