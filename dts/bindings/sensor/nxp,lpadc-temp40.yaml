## dts/bindings/sensor/nxp,lpadc-temp40.yaml
```yaml
description: NXP LPADC_TEMP40 temperature sensor

compatible: "nxp,lpadc-temp40"

include: sensor-device.yaml

properties:
  io-channels:
    required: true
    description: This should point to an ADC channel (e.g., <&lpadc0 0>). That
      will be used for reading from the internal temperature sensor.
```

## dts/bindings/sensor/nxp,lpc-temperature.yaml
```yaml
# Copyright (c) 2025 Nova Dynamics LLC
# SPDX-License-Identifier: Apache-2.0

description: NXP LPC temperature sensor

compatible: "nxp,lpc-temperature"

include: sensor-device.yaml

properties:
  io-channels:
    required: true
    description: This should point to an ADC channel (e.g., <&adc0 0>). That
      will be used for reading from the internal temperature sensor.
```

## dts/bindings/sensor/nxp,lpcmp.yaml
```yaml
# Copyright 2024 NXP
# SPDX-License-Identifier: Apache-2.0

description: NXP low-power analog comparator (LPCMP)

compatible: "nxp,lpcmp"

include: [sensor-device.yaml, pinctrl-device.yaml]

properties:
  interrupts:
    required: true

  reg:
    required: true

  enable-output-pin:
    type: boolean
    description: |
      Decide whether to enable the comparator is available in selected pin.

  use-unfiltered-output:
    type: boolean
    description: |
      Decide whether to use the unfiltered output.

  enable-output-invert:
    type: boolean
    description: |
      Decide whether to invert the comparator output.

  hysteresis-level:
    type: int
    enum:
      - 0
      - 1
      - 2
      - 3
    default: 0
    description: |
      LPCMP hysteresis mode.
      The default corresponds to the reset value of the register field.

  power-level:
    type: string
    enum:
      - "low"
      - "high"
      - "nano"
    default: "low"
    description: |
      LPCMP power mode.
      The default corresponds to the reset value of the register field.

  function-clock:
    type: string
    enum:
      - "Reserved"
      - "FRO_16K"
      - "XTAL32K"
      - "CMP_CLOCK"
    default: "Reserved"
    description: |
      LPCMP function clock.
      The default corresponds to the reset value of the register field.

  "#io-channel-cells":
    type: int
    const: 2

io-channel-cells:
  - positive
  - negative
```

## dts/bindings/sensor/nxp,mcux-eqdc.yaml
```yaml
# SPDX-FileCopyrightText: 2026 NXP
# SPDX-License-Identifier: Apache-2.0

description: NXP MCUX Enhanced Quadrature Decoder (EQDC)

compatible: "nxp,mcux-eqdc"

include: [sensor-device.yaml, pinctrl-device.yaml]

properties:
  reg:
    required: true

  interrupts:
    required: true

  counts-per-revolution:
    type: int
    required: true
    min: 1
    description: |
      Number of encoder counts per full revolution (360 degrees).
      This is used to convert position to angle. The value is scaled
      internally by the count multiplier of the active decode mode, so the
      effective modulus is (counts-per-revolution * multiplier - 1):
      - Quadrature X4 (default): multiplier 4
      - single-phase-mode: multiplier 1

  input-filter-count:
    type: int
    default: 0
    enum: [0, 1, 2, 3, 4, 5, 6, 7]
    description: |
      Input filter sample count
      The Input Filter Sample Count represents the number of consecutive samples
      that must agree, before the input filter accepts an input transition:
      - A value of 0x0 represents 3 samples
      - A value of 0x7 represents 10 samples
      The value of the Input Filter Sample Count (FILT_CNT) affects the
      input latency.

  input-filter-period:
    type: int
    default: 0
    min: 0
    max: 255
    description: |
      The Input Filter Sample Period represents the sampling period
      (in IPBus clock cycles) of the decoder input signals. Each input
      is sampled multiple times at the rate specified by the Input Filter
      Sample Period.
      - If it is set to 0x0(default), then the input filter is bypassed.
      The value of the Input Filter Sample Period (FILT_PER) affects the
      input latency.

  prescaler:
    type: int
    default: 0
    min: 0
    max: 15
    description: |
      The Prescaler field is used to prescale the peripheral clock that
      is used by the LASTEDGE and POSDPER counters as well as watchdog timer
      and Input Filter.
      The clock is prescaled by a value of 2^PRSC. For example:
      prescaler = 0, divide by 1
      prescaler = 1, divide by 2
      ...
      prescaler = 15, divide by 32768

  reverse-direction:
    type: boolean
    description: |
      Selects the direction of the count and position counter initial value.
      false: Count normally.
      true: Count in the reverse direction.

  single-phase-mode:
    type: boolean
    description: |
      Bypass the quadrature decoder and use single-phase decode mode. A
      transition on the PHASEA input generates a count; PHASEB and the
      reverse-direction setting control the count direction. In this mode the
      controller counts one edge per pulse (no X4 quadrature multiply), so
      counts-per-revolution is the raw pulse count per revolution.
      When unset (default), standard quadrature X4 decoding is used.

  revolution-count-mode:
    type: int
    default: 1
    enum: [0, 1]
    description: |
      0: Use INDEX pulse to increment/decrement revolution counter.
      1: Use modulus counting roll-over or roll-under events instead of the
      INDEX pulse.

  inputmux-connections:
    type: phandle-array
    specifier-space: inputmux
    description: |
      INPUTMUX routing for the EQDC PHASEA/PHASEB inputs. Each phandle-array
      entry is <&inputmuxN channel connection> where:
        - &inputmuxN is the INPUTMUX node providing the route
        - channel is the INPUTMUX destination index
        - connection is an inputmux_connection_t value from the NXP HAL
          header fsl_inputmux_connections.h

      Example (MCXA153: route TRIG_IN10 to EQDC PHASEA and TRIG_IN5 to
      EQDC PHASEB via INPUTMUX0):
        inputmux-connections = <&inputmux0 0 0x37000022>, /* TrigIn10ToQdc0Phasea */
                               <&inputmux0 0 0x36c0001d>; /* TrigIn5ToQdc0Phaseb */
```

## dts/bindings/sensor/nxp,mcux-qdc.yaml
```yaml
# Copyright 2026 NXP
# SPDX-License-Identifier: Apache-2.0

description: NXP MCUX QDC

compatible: "nxp,mcux-qdc"

include: [pinctrl-device.yaml, sensor-device.yaml, mux-consumer.yaml]

properties:
  reg:
    required: true

  counts-per-revolution:
    type: int
    required: true
    description: |
      Number of counts for one full revolution used for converting counter
      positions to rotation degrees.

  single-phase-mode:
    type: boolean
    description: |
      Bypass quadrature decode and count PHASEA transitions only, using PHASEB
      to indicate direction.

  filter-count:
    type: int
    enum: [0, 1, 2, 3, 4, 5, 6, 7]
    description: |
      Number of consecutive samples required before an input transition is
      accepted by the input filter.

  filter-sample-period:
    type: int
    description: |
      Sampling period, in IPBus clock cycles, of the decoder input signals.
      Valid range: 0-255. If value is 0, then the input filter is bypassed.

  mux-states:
    required: true
    description: |
      Routing entries to apply at QDC init time, one per QDC input
      signal. Each entry references a mux controller node (e.g.
      nxp,inputmux on MCXN family, nxp,mcux-xbar on i.MX RT, ...) and
      carries the cells that controller's binding requires. The driver
      applies each entry via mux_state_apply() and is agnostic to the
      underlying mux hardware; refer to the corresponding mux-controller
      binding for the meaning of the cells.
```

## dts/bindings/sensor/nxp,mcux-qdec.yaml
```yaml
# Copyright (c) 2022, Prevas A/S
# Copyright 2026 NXP
# SPDX-License-Identifier: Apache-2.0

description: NXP MCUX QDEC

compatible: "nxp,mcux-qdec"

include: [pinctrl-device.yaml, sensor-device.yaml, mux-consumer.yaml]

properties:
  reg:
    required: true

  interrupts:
    required: true

  counts-per-revolution:
    type: int
    required: true
    description: |
      This is a number that is used to determine how many revolutions
      were done based on the current counter's value.

  single-phase-mode:
    type: boolean
    description: |
      Bypass the quadrature decoder. A positive transition of the PHASEA input
      generates a count signal. The PHASEB input and the REV bit control the
      counter direction.

  filter-count:
    type: int
    enum: [0, 1, 2, 3, 4, 5, 6, 7]
    description: |
      The number of consecutive samples that must agree prior to the input
      filter accepting an input transition. A value of 0 represents 3
      samples. A value of 7 represents 10 samples.

  filter-sample-period:
    type: int
    description: |
      The sampling period (in IPBus clock cycles) of the decoder input signals.
      Each input is sampled multiple times at the rate specified by the Filter
      Sample Period. If FILT_PER is 0 (default), then the input filter is
      bypassed. Bypassing the digital filter enables the position/position
      difference counters to operate with count rates up to the IPBus
      frequency. Turning on the input filter introduces a latency of:
      ((FILT_CNT + 3) * FILT_PER) FILT clock cycles + 2 IPBus clock periods.

  mux-states:
    required: true
    description: |
      Routing entries to apply at QDEC init time, one per QDEC input
      signal. Each entry references a mux controller node (e.g.
      nxp,mcux-xbar on i.MX RT, nxp,inputmux on MCXN family, ...) and
      carries the cells that controller's binding requires. The driver
      applies each entry via mux_state_apply() and is agnostic to the
      underlying mux hardware; refer to the corresponding mux-controller
      binding for the meaning of the cells.
```

## dts/bindings/sensor/nxp,mcx-temperature.yaml
```yaml
description: NXP MCX temperature sensor

compatible: "nxp,mcx-temperature"

include: sensor-device.yaml

properties:
  status:
    required: true
```

## dts/bindings/sensor/nxp,mma8451q.yaml
```yaml
#
# Copyright (c) 2018, Lars Knudsen
#
# SPDX-License-Identifier: Apache-2.0
#
---
title: MMA8451Q 3-axis Accelerometer
id: nxp,mma8451q
version: 0.1

description: >
    This is a representation of the MMA8451Q 3-axis Accelerometer
    sensor

inherits:
    !include i2c-device.yaml

properties:
    compatible:
      constraint: "nxp,mma8451q"

...
```

## dts/bindings/sensor/nxp,p3t1755-common.yaml
```yaml
# Copyright 2024 NXP
# SPDX-License-Identifier: Apache-2.0

description: |
    NXP P3T1755 digital temperature sensor.

properties:
  oneshot-mode:
    type: boolean
    description: |
      Oneshot sampling mode, this reduces power consumption. By default the sensor
      is in a continuous conversion state.
```

## dts/bindings/sensor/nxp,p3t1755-i2c.yaml
```yaml
# Copyright 2024 NXP
# SPDX-License-Identifier: Apache-2.0

description: |
    NXP P3T1755 digital temperature sensor connected to I2C bus.

compatible: "nxp,p3t1755"

include: ["i2c-device.yaml", "nxp,p3t1755-common.yaml"]
```

## dts/bindings/sensor/nxp,p3t1755-i3c.yaml
```yaml
# Copyright 2024 NXP
# SPDX-License-Identifier: Apache-2.0

description: |
    NXP P3T1755 digital temperature sensor connected to I3C bus.

compatible: "nxp,p3t1755"

include: ["i3c-device.yaml", "nxp,p3t1755-common.yaml"]
```

## dts/bindings/sensor/nxp,pmc-tmpsns.yaml
```yaml
# Copyright NXP 2025
# SPDX-License-Identifier: Apache-2.0

description: NXP PMC temperature sensor (PMC-TMPSNS)

compatible: "nxp,pmc-tmpsns"

include: sensor-device.yaml

properties:
  io-channels:
    required: true
    description: |
      This should point to an ADC channel (e.g., <&adc0 0>)
      to read from the PMC internal temperature sensor.

  nxp,power-rails:
    type: phandle-array
    specifier-space: power-rail
    description: |
      Power-rail specifiers for rails that must be powered up before the controller
      can be accessed.
```
