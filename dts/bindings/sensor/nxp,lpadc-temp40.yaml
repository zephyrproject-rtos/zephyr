## dts/bindings/sensor/nxp,s32-qdec.yaml
```yaml
# Copyright 2023 NXP
# SPDX-License-Identifier: Apache-2.0

description: |
  Quadrature Decoder driver which processes encoder signals to determine motor revs
  with the cooperation of S32 IP blocks- eMIOS, TRGMUX and LCU.
  The sensor qdec application can be used for testing this driver.
  The following example uses TRGMUX IN2 and IN3 to connect to LCU1 LC0 I0 and I1.
  LCU1 LC0 O2 and O3 connect to eMIOS0 CH6(Clockwise rotation) and
  CH7(Counter Clockwise rotation) via TRGMUX_INT_OUT37 and TRGMUX_INT_OUT38
  micro-ticks-per-rev is set as per vehicle gearbox reduction.
  lcu output filters are set to capture maximum speed sensitivity and avoid channel noise.

   qdec0 {
        compatible = "nxp,qdec-s32";
        pinctrl-0 = <&qdec_s32>;
        pinctrl-names = "default";
        micro-ticks-per-rev = <685440000>;
        status = "okay";
        trgmux = <&trgmux>;
        trgmux-io-config =
            <0 TRGMUX_IP_OUTPUT_EMIOS0_CH5_9_IPP_IND_CH6 TRGMUX_IP_INPUT_LCU1_LC0_OUT_I2>,
            <1 TRGMUX_IP_OUTPUT_EMIOS0_CH5_9_IPP_IND_CH7 TRGMUX_IP_INPUT_LCU1_LC0_OUT_I3>,
            <2 TRGMUX_IP_OUTPUT_LCU1_0_INP_I0            TRGMUX_IP_INPUT_SIUL2_IN2>,
            <3 TRGMUX_IP_OUTPUT_LCU1_0_INP_I1            TRGMUX_IP_INPUT_SIUL2_IN3>;
        lcu = <&lcu1>;
        lcu-input-idx = <1>;
            <LCU_IP_IN_0 LCU_IP_IN_1
            LCU_IP_IN_2 LCU_IP_IN_3>;
        lcu-mux-sel =
            <LCU_IP_MUX_SEL_LU_IN_0 LCU_IP_MUX_SEL_LU_IN_1
            LCU_IP_MUX_SEL_LU_OUT_0 LCU_IP_MUX_SEL_LU_OUT_1>;
        lcu-output-filter-config =
            /* LCU Out HW ID, Rise Filter, Fall Filter */
            <0 5 5>, /* LCU O0 */
            <1 5 5>, /* LCU O1 */
            <2 2 2>, /* LCU O2 */
            <3 2 2>; /* LCU O3 */
        emios = <&emios0>;
        emios-channels = <6 7>;
   };

compatible: "nxp,qdec-s32"

include: [pinctrl-device.yaml, sensor-device.yaml]

properties:
  micro-ticks-per-rev:
    type: int
    description: |
      This is a number that is used to determine how many revolutions * 1000000
      were done based on the current counter's value.

  trgmux:
    type: phandle
    description: |
      phandle to the TRGMUX node.

  trgmux-io-config:
    type: array
    description: |
      This gives the logic triggers configuration of TRGMUX module.
      It contains 3 values for each of the 4 logic triggers used:
        logic trigger number, output, input.
      Hence, it's length should be '12'.
      Ex:
        trgmux-io-config =
          <0 TRGMUX_IP_OUTPUT_EMIOS0_CH5_9_IPP_IND_CH6 TRGMUX_IP_INPUT_LCU1_LC0_OUT_I2>,
          <1 TRGMUX_IP_OUTPUT_EMIOS0_CH5_9_IPP_IND_CH7 TRGMUX_IP_INPUT_LCU1_LC0_OUT_I3>,
          <2 TRGMUX_IP_OUTPUT_LCU1_0_INP_I0            TRGMUX_IP_INPUT_SIUL2_IN2>,
          <3 TRGMUX_IP_OUTPUT_LCU1_0_INP_I1            TRGMUX_IP_INPUT_SIUL2_IN3>;

  lcu:
    type: phandle
    description: |
      phandle to the LCU node.

  emios:
    type: phandle
    description: |
      phandle to the eMIOS node.

  lcu-output-filter-config:
    type: array
    description: |
      This array gives the configuration for each of the four outputs of LCU module.
      It contains the following for each output: hardware output id, rise filter and fall filter.
      The filters specify the delay in terms of CORE_CLK between the input and output line of LC.
        We use this delay to generate short pulses at the rising and falling edges of input pulse.
      It's length should be '12' - 3 entries for each of the four LCU outputs.
      Ex: lcu-output-filter-config =
        /* LCU Out HW ID, Rise Filter, Fall Filter */
        <0 5 5>, /* LCU O0 */
        <1 5 5>, /* LCU O1 */
        <2 2 2>, /* LCU O2 */
        <3 2 2>; /* LCU O3 */

  lcu-mux-sel:
    type: array
    description: |
      This array configures the sources of input to the LCU module by programming the muxsel.

  lcu-input-idx:
    type: array
    description: |
      This array configures the input indices to the LCU module which help to determine the
      Logic Cell number used inside an LCU instance.

  emios-channels:
    type: array
    description: |
      This is the array containing 2 emios channel TypeG numbers used by the qdec.
```

## dts/bindings/sensor/nxp,tempmon.yaml
```yaml
# Copyright (c) 2023 Centralp
# SPDX-License-Identifier: Apache-2.0

description: NXP on-die temperature monitor

compatible: "nxp,tempmon"

include: sensor-device.yaml
```

## dts/bindings/sensor/nxp,tempsense.yaml
```yaml
# Copyright 2025 NXP
# SPDX-License-Identifier: Apache-2.0

description: |
  NXP on-die temperature sensor (TEMPSENSE)

  Note: The temperature value calculation depends on the ADC reference voltage
  and resolution. These must be configured in the ADC node.

compatible: "nxp,tempsense"

include: sensor-device.yaml

properties:
  io-channels:
    required: true
    description: |
      ADC channel used to sample the TEMPSENSE output.
      Example: <&adc_0 0>.

  expose-ground:
    type: boolean
    description: |
      If present, set ETSCTL[GNDSEL] to expose the ETS ground on the ADC
      output (requires ETS_EN=1). This can improve precision when the ADC
      ground and ETS ground differ.

examples:
  - |
    tempsense: tempsense@1234 {
      status = "okay";
      reg = <0x1234 0x100>;
      compatible = "nxp,tempsense";
      io-channels = <&adc_0 0>;
    };

    adc_0: adc@5678 {
      status = "okay";
      compatible = "nxp,sar-adc";
      reg = <0x5678 0x1000>;
      /* ... */
      #address-cells = <1>;
      #size-cells = <0>;

      channel@0 {
        reg = <0>;
        zephyr,gain = "ADC_GAIN_1";
        zephyr,reference = "ADC_REF_VDD_1";
        zephyr,vref-mv = <3300>;
        zephyr,acquisition-time = <ADC_ACQ_TIME_DEFAULT>;
        zephyr,resolution = <15>;
        zephyr,input-positive = <49>;
      };
    };
```

## dts/bindings/sensor/nxp,tmpsns.yaml
```yaml
# Copyright (c) 2024 Polytech A/S
# SPDX-License-Identifier: Apache-2.0

description: NXP TMPSNS

compatible: "nxp,tmpsns"

include: sensor-device.yaml
```

## dts/bindings/sensor/nxp,tpm-qdec.yaml
```yaml
# Copyright (c) 2025 NXP
# SPDX-License-Identifier: Apache-2.0

description: |
  NXP Timer/PWM Module (TPM) Quadrature Decoder Mode driver.
  This driver uses tpm_chn0 (phase A) and tpm_chn1 (phase B) input signals to control the
  TPM counter increment and decrement. The Zephyr Sensor API exposes the rotational position as
  SENSOR_CHAN_ROTATION by dividing the counter by counts-per revolution definition.

  To use the NXP TPM module you've to override the compatible string to use the QDEC mode driver
  with 'nxp,tpm-qdec'

  &tpm4 {
        compatible = "nxp,tpm-qdec";
        status = "okay";
        pinctrl-0 = <&tpm4_pwm2_pwm3>;
        pinctrl-names = "default";
        micro-ticks-per-rev = <685440000>;
   };

  When inherting from an existing TPM instance you might want to remove the prescaler property
  Since the QDEC mode doesn't use the prescaler, you do this using:
  /delete-property/ prescaler;

compatible: "nxp,tpm-qdec"

include: [pinctrl-device.yaml, sensor-device.yaml]

properties:
  reg:
    required: true

  interrupts:
    required: true

  micro-ticks-per-rev:
    type: int
    required: true
    description: |
      This is a number that is used to determine how many revolutions * 1000000
      were done based on the current counter's value.

  pinctrl-0:
    required: true
```

## dts/bindings/sensor/omron,2smpb-02e.yaml
```yaml
# Copyright (c) 2025 CATIE
# SPDX-License-Identifier: Apache-2.0

description: |
    Omron 2SMPB-02E digital barometric pressure sensor.

compatible: "omron,2smpb-02e"

include: [sensor-device.yaml, i2c-device.yaml]
```

## dts/bindings/sensor/omron,2smpp03.yaml
```yaml
# Copyright (c) 2020 Teslabs Engineering S.L.
# SPDX-License-Identifier: Apache-2.0

description: Omron 2SMPP03 Pressure Gauge

compatible: "omron,2smpp03"

include: base.yaml

properties:
  io-channels:
    type: phandle-array
    required: true
    description: IO channel associated with the amplified sensor voltage
  amplifier-gain:
    type: int
    required: true
    description: Sensor amplifier gain.
  amplifier-offset:
    type: int
    required: true
    description: Sensor amplifier offset (mV).
```

## dts/bindings/sensor/omron,d6f-analog.yaml
```yaml
# Copyright (c) 2025, Prevas A/S
# SPDX-License-Identifier: Apache-2.0

title: Omron D6F mass flow rate sensor.

include: sensor-device.yaml

properties:
  io-channels:
    type: phandle-array
    required: true
    description: |
      ADC used to measure the mass flow rate:
      <&adc_node channel>
```

## dts/bindings/sensor/omron,d6f-p0010.yaml
```yaml
# Copyright (c) 2025, Prevas A/S
# SPDX-License-Identifier: Apache-2.0

title: Omron D6F-P0010 1 L/min flow rate sensor.

compatible: "omron,d6f-p0010"

include: omron,d6f-analog.yaml
```

## dts/bindings/sensor/onnn,nct75.yaml
```yaml
# Copyright (c) 2024 Benedikt Schmidt <benediktibk@gmail.com>
# SPDX-License-Identifier: Apache-2.0

description: |
    ON Semiconductor NCT75 temperature sensor with I2C interface

compatible: "onnn,nct75"

include: [sensor-device.yaml, i2c-device.yaml]
```

## dts/bindings/sensor/panasonic,amg88xx.yaml
```yaml
# Copyright (c) 2019, Phytec Messtechnik GmbH
# SPDX-License-Identifier: Apache-2.0

description: Panasonic AMG88XX 8x8 (64) pixel infrared array sensor

compatible: "panasonic,amg88xx"

include: [sensor-device.yaml, i2c-device.yaml]

properties:
  int-gpios:
    type: phandle-array
    required: true
    description: Interrupt pin.

      The interrupt pin of AMG88XX is open-drain, active low.
      If connected directly the MCU pin should be configured
      as pull-up, active low.
```

## dts/bindings/sensor/panasonic,sngcja5.yaml
```yaml
# Copyright (c) 2023, Panasonic Industrial Devices Europe GmbH
# SPDX-License-Identifier: Apache-2.0

description: Panasonic SN-GCJA5 Laser Particle Sensor

compatible: "panasonic,sngcja5"

include: [sensor-device.yaml, i2c-device.yaml]
```

## dts/bindings/sensor/peacefair,pzem004t.yaml
```yaml
# SPDX-License-Identifier: Apache-2.0
description: Peacefair PZEM004T energy meter sensor

compatible: "peacefair,pzem004t"

include: [sensor-device.yaml]
```
