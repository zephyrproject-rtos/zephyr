## dts/bindings/sensor/st,lps22hb-press.yaml
```yaml
# Copyright (c) 2017, Linaro Limited
# SPDX-License-Identifier: Apache-2.0

description: STMicroelectronics LPS22HB pressure sensor

compatible: "st,lps22hb-press"

include: [sensor-device.yaml, i2c-device.yaml]
```

## dts/bindings/sensor/st,lps22hb-spi.yaml
```yaml
# Copyright (c) 2019 STMicroelectronics
# SPDX-License-Identifier: Apache-2.0

description: |
    STMicroelectronics LPS22HB pressure and temperature sensor connected to SPI
    bus

include: ["spi-device.yaml", "st,lps22hb-common.yaml"]
```

## dts/bindings/sensor/st,lps22hh-i2c.yaml
```yaml
# Copyright (c) 2019 STMicroelectronics
# SPDX-License-Identifier: Apache-2.0

description: |
    STMicroelectronics LPS22HH pressure and temperature sensor connected to I2C
    bus

compatible: "st,lps22hh"

include: ["i2c-device.yaml", "st,lps22hh-common.yaml"]
```

## dts/bindings/sensor/st,lps22hh-i3c.yaml
```yaml
# Copyright (c) 2019 STMicroelectronics
# SPDX-License-Identifier: Apache-2.0

description: |
    STMicroelectronics LPS22HH pressure and temperature sensor connected to I3C
    bus

compatible: "st,lps22hh"

include: ["i3c-device.yaml", "st,lps22hh-common.yaml"]
```

## dts/bindings/sensor/st,lps22hh-spi.yaml
```yaml
# Copyright (c) 2019 STMicroelectronics
# SPDX-License-Identifier: Apache-2.0

description: |
    STMicroelectronics LPS22HH pressure and temperature sensor connected to SPI
    bus

compatible: "st,lps22hh"

include: ["spi-device.yaml", "st,lps22hh-common.yaml"]
```

## dts/bindings/sensor/st,lps25hb-press.yaml
```yaml
# Copyright (c) 2018, Linaro Limited
# SPDX-License-Identifier: Apache-2.0

description: STMicroelectronics LPS25HB pressure sensor

compatible: "st,lps25hb-press"

include: [sensor-device.yaml, i2c-device.yaml]
```

## dts/bindings/sensor/st,lps28dfw-common.yaml
```yaml
# Copyright (c) 2023 STMicroelectronics
# Copyright (c) 2023 PHYTEC Messtechnik GmbH
# SPDX-License-Identifier: Apache-2.0

description: |
    STMicroelectronics LPS28DFW pressure and temperature sensor. This is an
    extension of st,lps22df driver binding.

    Example:
    #include <zephyr/dt-bindings/sensor/lps2xdf.h>

    lps28dfw@5d {
      ...

      odr = <LPS2xDF_DT_ODR_10HZ>;
      lpf = <LPS2xDF_DT_LP_FILTER_ODR_4>;
      avg = <LPS2xDF_DT_AVG_128_SAMPLES>;
    };

include: st,lps22df-common.yaml

properties:
  fs:
    type: int
    default: 0
    description: |
        Specify the full-scale mode.
        The default is the power-on reset value.

        - 0 # LPS28DFW_DT_FS_MODE_1_1260
        - 1 # LPS28DFW_DT_FS_MODE_2_4060
    enum: [0, 1]
```

## dts/bindings/sensor/st,lps28dfw-i2c.yaml
```yaml
# Copyright (c) 2023 STMicroelectronics
# Copyright (c) 2023 PHYTEC Messtechnik GmbH
# SPDX-License-Identifier: Apache-2.0

description: |
    STMicroelectronics LPS28DFW pressure and temperature sensor connected to
    I2C bus

compatible: "st,lps28dfw"

include: ["i2c-device.yaml", "st,lps28dfw-common.yaml"]
```

## dts/bindings/sensor/st,lps33hw.yaml
```yaml
# Copyright (c) 2026 RAKwireless Technology Limited
# SPDX-License-Identifier: Apache-2.0

description: STMicroelectronics LPS33HW pressure and temperature sensor

compatible: "st,lps33hw"

include: [sensor-device.yaml, i2c-device.yaml]

properties:
  odr:
    type: int
    default: 25
    enum:
      - 1
      - 10
      - 25
      - 50
      - 75
    description: |
      Sensor output data rate expressed in samples per second.
```

## dts/bindings/sensor/st,lsm303agr-accel-i2c.yaml
```yaml
# Copyright (c) 2019 Grinn
# SPDX-License-Identifier: Apache-2.0

title: STMicroelectronics MEMS sensors LSM303AGR I2C

description: >
    This binding gives a base representation of LSM303AGR 3-axis accelerometer
    accessed through I2C bus

compatible: "st,lsm303agr-accel"

include: ["i2c-device.yaml", "st,lis2dh-common.yaml"]
```

## dts/bindings/sensor/st,lsm303agr-accel-spi.yaml
```yaml
# Copyright (c) 2019 Grinn
# SPDX-License-Identifier: Apache-2.0

description: |
    STMicroelectronics LSM303AGR 3-axis accelerometer accessed through SPI bus

compatible: "st,lsm303agr-accel"

include: ["spi-device.yaml", "st,lis2dh-common.yaml"]
```

## dts/bindings/sensor/st,lsm303dlhc-accel.yaml
```yaml
# Copyright (c) 2018 Philémon Jaermann
# SPDX-License-Identifier: Apache-2.0

description: LSM303DLHC acceleration sensor

compatible: "st,lsm303dlhc-accel"

include: ["i2c-device.yaml", "st,lis2dh-common.yaml"]
```

## dts/bindings/sensor/st,lsm303dlhc-magn.yaml
```yaml
# Copyright (c) 2018 Philémon Jaermann
# SPDX-License-Identifier: Apache-2.0

description: STMicroelectronics LSM303DLHC magnetometer sensor

compatible: "st,lsm303dlhc-magn"

include: i2c-device.yaml
```

## dts/bindings/sensor/st,lsm6ds0.yaml
```yaml
# Copyright (c) 2018, Linaro Limited
# SPDX-License-Identifier: Apache-2.0

description: STMicroelectronics LSM6DS0 6-axis accelerometer and gyrometer

compatible: "st,lsm6ds0"

include: [sensor-device.yaml, i2c-device.yaml]
```

## dts/bindings/sensor/st,lsm6dsl-common.yaml
```yaml
# Copyright (c) 2017, Linaro Limited
# Copyright (c) 2023, Marcin Niestroj
# SPDX-License-Identifier: Apache-2.0

include: sensor-device.yaml

properties:
  irq-gpios:
    # This signal is active high when produced by the sensor
    type: phandle-array
```

## dts/bindings/sensor/st,lsm6dsl-i2c.yaml
```yaml
# Copyright (c) 2017, Linaro Limited
# SPDX-License-Identifier: Apache-2.0

description: |
  STMicroelectronics LSM6DSL 6-axis accelerometer and gyrometer accessed through
  I2C bus

compatible: "st,lsm6dsl"

include: ["i2c-device.yaml", "st,lsm6dsl-common.yaml"]
```

## dts/bindings/sensor/st,lsm6dsl-spi.yaml
```yaml
# Copyright (c) 2018, Linaro Limited
# SPDX-License-Identifier: Apache-2.0

description: |
  STMicroelectronics LSM6DSL 6-axis accelerometer and gyrometer accessed through
  SPI bus

compatible: "st,lsm6dsl"

include: ["spi-device.yaml", "st,lsm6dsl-common.yaml"]
```

## dts/bindings/sensor/st,lsm6dsl.yaml
```yaml
#
# Copyright (c) 2017, Linaro Limited
#
# SPDX-License-Identifier: Apache-2.0
#
---
title: STMicroelectronics MEMS sensors LSM6DSL
id: st,lps22hb-press
version: 0.1

description: >
    This binding gives a base representation of LSM6DSL 6-axis accelerometer
    and gyrometer

inherits:
    !include i2c-device.yaml

properties:
    compatible:
      constraint: "st,lsm6dsl"

...
```

## dts/bindings/sensor/st,lsm6dso-common.yaml
```yaml
# Copyright (c) 2021 STMicroelectronics
# SPDX-License-Identifier: Apache-2.0

description: |
    When setting the accel-pm, accel-range, accel-odr, gyro-pm, gyro-range,
    gyro-odr properties in a .dts or .dtsi file you may include lsm6dso.h
    and use the macros defined there.

    Example:
    #include <zephyr/dt-bindings/sensor/lsm6dso.h>

    lsm6dso: lsm6dso@0 {
      ...

      accel-pm = <LSM6DSO_DT_XL_ULP_MODE>;
      accel-range = <LSM6DSO_DT_FS_8G>;
      accel-odr = <LSM6DSO_DT_ODR_1Hz6>;
      gyro-pm = <LSM6DSO_DT_GY_NORMAL_MODE>;
      gyro-range = <LSM6DSO_DT_FS_2000DPS>;
      gyro-odr = <LSM6DSO_DT_ODR_6667Hz>;
    };

include: sensor-device.yaml

properties:
  irq-gpios:
    type: phandle-array
    description: |
      DRDY pin

      This pin defaults to active high when produced by the sensor.
      The property value should ensure the flags properly describe
      the signal that is presented to the driver.

  int-pin:
    type: int
    default: 1
    enum:
      - 1 # drdy is generated from INT1
      - 2 # drdy is generated from INT2
    description: |
      Select DRDY pin number (1 or 2).

      This number represents which of the two interrupt pins
      (INT1 or INT2) the drdy line is attached to. This property is not
      mandatory and if not present it defaults to 1 which is the
      configuration at power-up.

  accel-pm:
    type: int
    default: 0
    description: |
      Specify the accelerometer power mode.
      Default is power-up configuration.

      - 0 # LSM6DSO_DT_XL_HP_MODE
      - 1 # LSM6DSO_DT_XL_LP_NORMAL_MODE
      - 2 # LSM6DSO_DT_XL_ULP_MODE

    enum: [0, 1, 2]

  accel-range:
    type: int
    default: 0
    description: |
      Range in g. Default is power-up configuration.

      - 0 # LSM6DSO_DT_FS_2G  (0.061 mg/LSB) (LSM6DSO32 will be double these values)
      - 1 # LSM6DSO_DT_FS_16G (0.488 mg/LSB)
      - 2 # LSM6DSO_DT_FS_4G  (0.122 mg/LSB)
      - 3 # LSM6DSO_DT_FS_8G  (0.244 mg/LSB)

    enum: [0, 1, 2, 3]

  accel-odr:
    type: int
    default: 0
    description: |
      Specify the default accelerometer output data rate expressed in samples per second (Hz).
      Default is power-up configuration.

      - 0  # LSM6DSO_DT_ODR_OFF
      - 1  # LSM6DSO_DT_ODR_12Hz5
      - 2  # LSM6DSO_DT_ODR_26H
      - 3  # LSM6DSO_DT_ODR_52Hz
      - 4  # LSM6DSO_DT_ODR_104Hz
      - 5  # LSM6DSO_DT_ODR_208Hz
      - 6  # LSM6DSO_DT_ODR_417Hz
      - 7  # LSM6DSO_DT_ODR_833Hz
      - 8  # LSM6DSO_DT_ODR_1667Hz
      - 9  # LSM6DSO_DT_ODR_3333Hz
      - 10 # LSM6DSO_DT_ODR_6667Hz
      - 11 # LSM6DSO_DT_ODR_1Hz6

    enum: [0, 1, 2, 3, 4, 5, 6, 7, 8, 9, 10, 11]

  gyro-pm:
    type: int
    default: 0
    description: |
      Specify the gyrometer power mode.
      Default is power-up configuration.

      - 0 # LSM6DSO_DT_GY_HP_MODE
      - 1 # LSM6DSO_DT_GY_NORMAL_MODE

    enum: [0, 1]

  gyro-range:
    type: int
    default: 0
    description: |
      Range in dps. Default is power-up configuration.

      - 0 # LSM6DSO_DT_FS_250DPS  (8.75 mdps/LSB)
      - 1 # LSM6DSO_DT_FS_125DPS  (4.375 mdps/LSB)
      - 2 # LSM6DSO_DT_FS_500DPS  (17.50 mdps/LSB)
      - 4 # LSM6DSO_DT_FS_1000DPS (35 mdps/LSB)
      - 6 # LSM6DSO_DT_FS_2000DPS (70 mdps/LSB)

    enum: [0, 1, 2, 4, 6]

  gyro-odr:
    type: int
    default: 0
    description: |
      Specify the default gyro output data rate expressed in samples per second (Hz).
      Default is power-up configuration.

      - 0  # LSM6DSO_DT_ODR_OFF
      - 1  # LSM6DSO_DT_ODR_12Hz5
      - 2  # LSM6DSO_DT_ODR_26H
      - 3  # LSM6DSO_DT_ODR_52Hz
      - 4  # LSM6DSO_DT_ODR_104Hz
      - 5  # LSM6DSO_DT_ODR_208Hz
      - 6  # LSM6DSO_DT_ODR_417Hz
      - 7  # LSM6DSO_DT_ODR_833Hz
      - 8  # LSM6DSO_DT_ODR_1667Hz
      - 9  # LSM6DSO_DT_ODR_3333Hz
      - 10 # LSM6DSO_DT_ODR_6667Hz

    enum: [0, 1, 2, 3, 4, 5, 6, 7, 8, 9, 10]

  drdy-pulsed:
    type: boolean
    description: |
      Selects the pulsed mode for data-ready interrupt when enabled,
      and the latched mode when disabled.

  # tap and tap-tap configuration section
  # All default values are selected to match the power-up values.
  # tap and tap-tap events can be generated on INT1 only.

  tap-mode:
    type: int
    default: 0
    description: |
      Tap mode. Default is power-up configuration.

      - 0 # LSM6DSO_DT_SINGLE_TAP
      - 1 # LSM6DSO_DT_SINGLE_DOUBLE_TAP

    enum: [0, 1]

  tap-threshold:
    type: array
    default: [0, 0, 0]
    description: |
      Tap X/Y/Z axes threshold. Default is power-up configuration.
      (X/Y/Z values range from 0x00 to 0x1F)

      Thresholds to start the tap-event detection procedure on the X/Y/Z axes.
      Threshold values for each axis are unsigned 5-bit corresponding
      to a 2g acceleration full-scale range. A threshold value equal to zero
      corresponds to disable the tap detection on that axis.

      For example, if you want to set the threshold for X to 12, for Z to 14
      and want to disable tap detection on Y, you should specify in Device Tree

          tap-threshold = <12>, <0>, <14>

      which is equivalent to X = 12 * 2g/32 = 750mg and Z = 14 * 2g/32 = 875mg.

  tap-shock:
    type: int
    default: 0x0
    description: |
      Tap shock value. Default is power-up configuration.
      (values range from 0x0 to 0x3)
      This register represents the maximum time of an over-threshold signal
      detection to be recognized as a tap event. Where 0 equals 4*1/ODR and
      1LSB = 8*1/ODR.

  tap-latency:
    type: int
    default: 0x0
    description: |
      Tap latency. Default is power-up configuration.
      (values range from 0x0 to 0xF)
      When double-tap recognition is enabled, this register expresses the
      maximum time between two successive detected taps to determine a
      double-tap event. Where 0 equals 16*1/ODR and 1LSB = 32*1/ODR.

  tap-quiet:
    type: int
    default: 0x0
    description: |
      Expected quiet time after a tap detection. Default is power-up configuration.
      (values range from 0x0 to 0x3)
      This register represents the time after the first detected tap in which
      there must not be any overthreshold event. Where 0 equals 2*1/ODR
      and 1LSB = 4*1/ODR.
```

## dts/bindings/sensor/st,lsm6dso-i2c.yaml
```yaml
# Copyright (c) 2019 STMicroelectronics
# SPDX-License-Identifier: Apache-2.0

description: |
    STMicroelectronics LSM6DSO 6-axis IMU (Inertial Measurement Unit) sensor
    accessed through I2C bus

compatible: "st,lsm6dso"

include: ["i2c-device.yaml", "st,lsm6dso-common.yaml"]
```

## dts/bindings/sensor/st,lsm6dso-spi.yaml
```yaml
# Copyright (c) 2019 STMicroelectronics
# SPDX-License-Identifier: Apache-2.0

description: |
    STMicroelectronics LSM6DSO 6-axis IMU (Inertial Measurement Unit) sensor
    accessed through SPI bus

compatible: "st,lsm6dso"

include: ["spi-device.yaml", "st,lsm6dso-common.yaml"]
```
