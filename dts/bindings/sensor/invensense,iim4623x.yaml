## dts/bindings/sensor/jedec,jc-42.4-temp.yaml
```yaml
# Copyright (c) 2019, Linaro Limited
# Copyright (c) 2024 Vogl Electronic GmbH
# SPDX-License-Identifier: Apache-2.0

description: |
    JEDEC JC42.4 compliant temperature sensor. See
    http://www.jedec.org/sites/default/files/docs/4_01_04R19.pdf.
    Driver based on the Microchip MCP9808 Digital Temperature Sensor. See
    http://ww1.microchip.com/downloads/en/DeviceDoc/25095A.pdf.

compatible: "jedec,jc-42.4-temp"

include: [sensor-device.yaml, i2c-device.yaml]

properties:
  int-gpios:
    type: phandle-array
    description: |
      The alert pin defaults to active low when produced by the
      sensor, and is open-drain.  A pull-up may be appropriate.  The
      property value should ensure the flags properly describe the
      signal that is presented to the driver.

  resolution:
    type: int
    default: 3
    description: |
      Sensor resolution. Default is 0.0625C (0b11),
      which is the power-up default.
      0 = 0.5°C
      1 = 0.25°C
      2 = 0.125°C
      3 = 0.0625°C
    enum:
      - 0 # 0.5C
      - 1 # 0.25C
      - 2 # 0.125C
      - 3 # 0.0625C
```

## dts/bindings/sensor/kionix,kx022.yaml
```yaml
# Copyright (c) 2021 G-Technologies Sdn. Bhd.
# SPDX-License-Identifier: Apache-2.0

description: KX022 16-Bit digital I2C Accelerometer sensor

compatible: "kionix,kx022"

include: i2c-device.yaml
properties:
    int-gpios:
      type: phandle-array
      required: false
      description: |
        The INT1 pin

    int-pin-1-polarity:
      type: int
      required: false
      default: 1
      enum:
        - 0
        - 1
      description: |
        Polarity of Physical Interrupt Pin 1
        0: active low
        1: Active high

    int-pin-1-response:
      type: int
      required: false
      default: 1
      enum:
        - 0
        - 1
      description: |
        Response of Physical Interrupt Pin 1
        0: Cleared by reading INT_REL
        1: One pulse with a period of 50 us

    full-scale:
      type: int
      required: false
      default: 0
      enum:
        - 0
        - 1
        - 2
      description: |
        Specify the default accelerometer full-scale range.
        An X value for the config represents a range of +/- X G. Valid values
        are:
        0:  +/- 2g
        1:  +/- 4g
        2:  +/- 8g

    odr:
      type: int
      required: false
      default: 2
      enum:
        - 0
        - 1
        - 2
        - 3
        - 4
        - 5
        - 6
        - 7
      description: |
        Specify the default accelerometer output data rate expressed in
        samples per second (Hz).
        0: 12.5Hz
        1: 25Hz
        2: 50Hz
        3: 100Hz
        4: 200Hz
        5: 400Hz
        6: 800Hz
        7: 1600Hz

    resolution:
      type: int
      required: false
      default: 1
      enum:
        - 0
        - 1
      description: |
        Related to the power of theKX022, 
        the default setting is 16-bit resolution.
        0: 8-bit
        1: 16-bit    
        
    motion-odr:    
      type: int
      required: false
      default: 5
      enum:
        - 0
        - 1
        - 2
        - 3
        - 4
        - 5
        - 6
        - 7
      description: |
        Specify the default accelerometer motion detect position output data rate
        are:
        0: 0.781Hz
        1: 1.563Hz
        2: 3.125Hz
        3: 6.25Hz
        4: 12.5hz
        5: 25hz
        6: 50hz
        7: 100hz

    motion-threshold:
      type: int
      required: false
      default: 1
      description: |
        The motion threshold is calculated using Formula:
        value/16 = ths in unit g(default : KX022_FS 2g):
        1: 0.0625g
        2: 0.1250g
        3: 0.1875g
        ++
        (values range from 0x0 to 0xFF)

    motion-detection-timer:
      type: int
      required: false
      default: 6
      description: |
        The duration in second for motion,calculated by using this function
        Value/ Motion Wake-up Output data rate(default:KX022_MOTION_ODR 25hz).
        ie:
        1: 0.04s
        2: 0.08s
        3: 0.12s
        ++
        (values range from 0x0 to 0xFF)

    tilt-odr:
      type: int
      required: false
      default: 2
      enum:
        - 0
        - 1
        - 2
        - 3
      description: |
        Specify the default accelerometer tilt position output data rate
        are:
        0: 1.56Hz
        1: 6.25Hz
        2: 12.5Hz
        3: 50Hz

    tilt-timer:
      type: int
      required: false
      default: 3
      description: |      
        The duration in second for tilt, calculated by using this function
        Value/ tilt Wake-up Output data rate(default:KX022_TILT_ODR 12.5hz).
        ie:
        1: 0.08s
        2: 0.16s
        3: 0.24s
        ++        
        (values range from 0x0 to 0xFF)

    tilt-angle-ll:
      type: int
      required: false
      default: 12
      description: | 
        The Tilt Angle High Limit value is calculated by using the formula below
        Angle(count) = sin θ*32.
        (values range from 0x0 to 0xFF)

    tilt-angle-hl:
      type: int
      required: false
      default: 42
      description: | 
        The Tilt Angle High Limit value is calculated by using the formula below
        Angle(count) = sin θ*32.
        (values range from 0x0 to 0xFF)
```

## dts/bindings/sensor/leuze,odsl8.yaml
```yaml
description: |
  Leuze ODSL8 Optical Laser Distance Sensor

compatible: "leuze,odsl8"

include: base.yaml

properties:

  io-channels:
    required: true
    description: ADC channel for analog distance signal

  meas-resistor:
    type: int
    required: true
    description: |
      Sensing resistor value for current driven sensor output
```

## dts/bindings/sensor/liteon,ltr329.yaml
```yaml
# Copyright (c) 2025 Konrad Sikora
# SPDX-License-Identifier: Apache-2.0

description: LiteOn LTR-329 Digital Ambient Light Sensor

compatible: "liteon,ltr329"

include: [sensor-device.yaml, i2c-device.yaml]

properties:
  gain:
    type: int
    deprecated: true
    description: |
      This parameter adjusts the ADC gain factor, impacting the sensor's
      light sensitivity range. The default setting, corresponding to the
      register reset value (1X).
      Possible values are:
      - 0 # Gain 1X (1 lux to 64k lux)
      - 1 # Gain 2X (0.5 lux to 32k lux)
      - 2 # Gain 4X (0.25 lux to 16k lux)
      - 3 # Gain 8X (0.125 lux to 8k lux)
      - 6 # Gain 48X (0.02 lux to 1.3k lux)
      - 7 # Gain 96X (0.01 lux to 600 lux)
    enum: [0, 1, 2, 3, 6, 7]

  integration-time:
    type: int
    deprecated: true
    description: |
      ALS Integration Time is the measurement time for each ALS cycle.
      Default value is a register reset value (100ms).
      Possible values are:
      - 0 # 100ms
      - 1 # 50ms
      - 2 # 200ms
      - 3 # 400ms
      - 4 # 150ms
      - 5 # 250ms
      - 6 # 300ms
      - 7 # 350ms
    enum: [0, 1, 2, 3, 4, 5, 6, 7]

  measurement-rate:
    type: int
    deprecated: true
    description: |
      ALS Measurement Rate is the rate at which the sensor
      takes measurements in the active mode. This is the interval
      between ALS_DATA registers update. ALS Measurement Repeat Rate
      must be set to be equal or larger than the Integration Time.
      If ALS Measurement Repeat Rate  is set to be smaller than
      ALS Integration Time, it will automatically be reset to be
      equal to ALS Integration Time by the IC internally. Default value
      is a register reset value (500ms).
      Possible values are:
      - 0 # 50ms
      - 1 # 100ms
      - 2 # 200ms
      - 3 # 500ms
      - 4 # 1000ms
      - 5 # 2000ms
    enum: [0, 1, 2, 3, 4, 5]

  als-gain:
    type: int
    default: 1
    enum: [1, 2, 4, 8, 48, 96]
    description: |
      This parameter adjusts the ADC gain factor, impacting the sensor's
      light sensitivity range. The default setting, corresponding to the
      register reset value (1X).

  als-integration-time:
    type: int
    default: 100
    enum: [100, 50, 200, 400, 150, 250, 300, 350]
    description: |
      ALS Integration Time is the measurement time for each ALS cycle.
      Default value is a register reset value (100ms).

  als-measurement-rate:
    type: int
    default: 500
    enum: [50, 100, 200, 500, 1000, 2000]
    description: |
      ALS Measurement Rate is the rate at which the sensor
      takes measurements in the active mode. This is the interval
      between ALS_DATA registers update. ALS Measurement Repeat Rate
      must be set to be equal or larger than the Integration Time.
      If ALS Measurement Repeat Rate  is set to be smaller than
      ALS Integration Time, it will automatically be reset to be
      equal to ALS Integration Time by the IC internally. Default value
      is a register reset value (500ms).
```

## dts/bindings/sensor/liteon,ltr390.yaml
```yaml
# Copyright (c) 2022 Luke Holt
# SPDX-License-Identifier: Apache-2.0

description: |
    Liteon LTR390 I2C ambient light sensor and ultraviolet light sensor. See
    https://optoelectronics.liteon.com/upload/download/DS86-2015-0004/LTR-390UV_Final_%20DS_V1%201.pdf

compatible: "liteon,ltr390"

include: i2c-device.yaml

properties:
    int-gpios:
      type: phandle-array
      required: false
      description: |
        The alert pin defaults to active low when produced by the
        sensor, and is open-drain. A pull-up may be appropriate. The
        property value should ensure the flags properly describe the
        signal that is presented to the driver.

    resolution:
      type: int
      required: false
      default: 2
      description: |
        Sensor measurement resolution. Power-up default is 2 (18 Bit).
      enum:
        - 0 # 20 Bit, Conversion time = 400ms
        - 1 # 19 Bit, Conversion time = 200ms
        - 2 # 18 Bit, Conversion time = 100ms (default)
        - 3 # 17 Bit, Conversion time = 50ms
        - 4 # 16 Bit, Conversion time = 25ms
        - 5 # 13 Bit, Conversion time = 12.5ms

    rate:
      type: int
      required: false
      default: 2
      description: |
        Rate (in ms) at which the sensor takes measurements. If the rate is smaller than
        the time it takes to convert the measurement (resolution times), the rate
        will be lower than programmed. It will be the maximum allowed speed
        according to the resolution setting. Power-up default is a 2 (rate of 100ms).
      enum:
        - 0 # 25ms
        - 1 # 50ms
        - 2 # 100ms (default)
        - 3 # 200ms
        - 4 # 500ms
        - 5 # 1000ms
        - 6 # 2000ms

    gain:
      type: int
      required: false
      default: 1
      description: |
        Measurement gain range setting.
        Power-up default is 1 (gain of 3).
      enum:
        - 0 # Gain Range: 1
        - 1 # Gain Range: 3 (default)
        - 2 # Gain Range: 6
        - 3 # Gain Range: 9
        - 4 # Gain Range: 18

    int_persist:
      type: int
      required: false
      default: 1
      description: |
        Number of consecutive measurements taken outside of the set
        threshold before an interrupt is asserted.
        Power-up default is 1. Maximum is 16.
      enum:
        - 1
        - 2
        - 3
        - 4
        - 5
        - 6
        - 7
        - 8
        - 9
        - 10
        - 11
        - 12
        - 13
        - 14
        - 15
        - 16
```

## dts/bindings/sensor/liteon,ltr553.yaml
```yaml
# Copyright (c) 2025 Konrad Sikora
# Copyright (c) 2025 TOKITA Hiroshi
# SPDX-License-Identifier: Apache-2.0

description: LiteOn LTR-553 Digital Ambient Light and proximity sensor

compatible: "liteon,ltr553"

include: [sensor-device.yaml, i2c-device.yaml]

properties:
  als-gain:
    type: int
    default: 1
    enum: [1, 2, 4, 8, 48, 96]
    description: |
      This parameter adjusts the ADC gain factor, impacting the sensor's
      light sensitivity range. The default setting, corresponding to the
      register reset value (1X).

  als-integration-time:
    type: int
    default: 100
    enum: [100, 50, 200, 400, 150, 250, 300, 350]
    description: |
      ALS Integration Time is the measurement time for each ALS cycle.
      Default value is a register reset value (100ms).

  als-measurement-rate:
    type: int
    default: 500
    enum: [50, 100, 200, 500, 1000, 2000]
    description: |
      ALS Measurement Rate is the rate at which the sensor
      takes measurements in the active mode. This is the interval
      between ALS_DATA registers update. ALS Measurement Repeat Rate
      must be set to be equal or larger than the Integration Time.
      If ALS Measurement Repeat Rate is set to be smaller than
      ALS Integration Time, it will automatically be reset to be
      equal to ALS Integration Time by the IC internally. Default value
      is a register reset value (500ms).

  ps-saturation-indicator:
    type: boolean
    description: |
      Enable the PS saturation indicator flag in PS_DATA_1.

  ps-led-pulse-frequency:
    type: int
    default: 60
    enum: [30, 40, 50, 60, 70, 80, 90, 100]
    description: |
      PS LED pulse modulation frequency.

  ps-led-duty-cycle:
    type: int
    default: 100
    enum: [25, 50, 75, 100]
    description: |
      PS LED duty cycle.

  ps-led-current:
    type: int
    default: 100
    enum: [5, 10, 20, 50, 100]
    description: |
      PS LED peak current in milliamperes.

  ps-n-pulses:
    type: int
    default: 1
    enum: [1, 2, 3, 4, 5, 6, 7, 8, 9, 10, 11, 12, 13, 14, 15]
    description: |
      Number of PS LED pulses emitted per measurement.

  ps-measurement-rate:
    type: int
    default: 100
    enum: [50, 70, 100, 200, 500, 1000, 2000, 10]
    description: |
      PS Measurement Repeat Rate is the interval between PS_DATA updates.
```

## dts/bindings/sensor/liteon,ltrf216a.yaml
```yaml
# Copyright (c) 2023, Trridonic
# SPDX-License-Identifier: Apache-2.0

description: LiteOn F216A ambient light sensor

compatible: "liteon,ltrf216a"

include: [sensor-device.yaml, i2c-device.yaml]
```

## dts/bindings/sensor/lm35.yaml
```yaml
# SPDX-License-Identifier: Apache-2.0

description: LM35 Digital Temperature Sensor

compatible: "lm35"

include: sensor-device.yaml

properties:
  io-channels:
    required: true
    description: |
      ADC channel that will perform measurement

  resolution:
    type: int
    default: 12
    description: |
      ADC resolution to be used for the channel. Defaults to 12 bits
      as it's the most common for adc based drivers.
```

## dts/bindings/sensor/lm75.yaml
```yaml
# Copyright (c) 2021 Leica Geosystems AG
# SPDX-License-Identifier: Apache-2.0

description: LM75 Digital Temperature Sensor with 2-Wire Interface.

compatible: "lm75"

include: [sensor-device.yaml, i2c-device.yaml]

properties:
  int-gpios:
    type: phandle-array
    description: |
      Identifies the INT signal, which is active-low open drain by default
      when produced by the sensor.

  int-inverted:
    type: boolean
    description: |
      When present, the polarity on the INT signal is inverted (active-high).
```
