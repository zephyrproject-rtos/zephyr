## dts/bindings/sensor/lm77.yaml
```yaml
# Copyright (c) 2021 Vestas Wind Systems A/S
# SPDX-License-Identifier: Apache-2.0

description: |
  LM77 digital temperature sensor

compatible: "lm77"

include: [sensor-device.yaml, i2c-device.yaml]

properties:
  int-gpios:
    type: phandle-array
    description: |
      Identifies the INT signal, which is active-low open drain by default
      when produced by the sensor.

  int-inverted:
    type: boolean
    description: |
      When present, the polarity on the INT signal is inverted (active-high).

  tcrita-inverted:
    type: boolean
    description: |
      When present, the polarity on the T_CRIT_A signal is inverted
      (active-high).

  enable-fault-queue:
    type: boolean
    description: |
      When present, the fault queue is enabled. The fault queue allows up to 4
      faults to prevent false INT/T_CRIT_A tripping when the LM77 is used in
      noisy environments.
```

## dts/bindings/sensor/ltr,329.yaml
```yaml
# Copyright (c) 2023 Konrad Sikora
# SPDX-License-Identifier: Apache-2.0

description: Lite-on LTR329 Digital Ambient Light Sensor

compatible: "ltr,329"

include: [sensor-device.yaml, i2c-device.yaml]

properties:
  gain:
    type: int
    default: 0
    description: |
      ADC gain factor. There are 6 possible values,
      which correspond to different gain factors:
      - 0 # Gain 1X (1 lux to 64k lux)
      - 1 # Gain 2X (0.5 lux to 32k lux)
      - 2 # Gain 4X (0.25 lux to 16k lux)
      - 3 # Gain 8X (0.125 lux to 8k lux)
      - 6 # Gain 48X (0.02 lux to 1.3k lux)
      - 7 # Gain 96X (0.01 lux to 600 lux)
    enum: [0, 1, 2, 3, 6, 7]

  integration-time:
    type: int
    default: 0
    description: |
      ALS Integration Time is the measurement time for each ALS cycle.
      Possible values are:
      - 0 # 100ms
      - 1 # 50ms
      - 2 # 200ms
      - 3 # 400ms
      - 4 # 150ms
      - 5 # 250ms
      - 6 # 300ms
      - 7 # 350ms
    enum: [0, 1, 2, 3, 4, 5, 6, 7]

  measurement-rate:
    type: int
    default: 3
    description: |
      ALS Measurement Rate is the rate at which the sensor
      takes measurements in the active mode. This is the interval
      between ALS_DATA registers update. ALS Measurement Repeat Rate
      must be set to be equal or larger than the Integration Time.
      If ALS Measurement Repeat Rate  is set to be smaller than
      ALS Integration Time, it will automatically be reset to be
      equal to ALS Integration Time by the IC internally.
      Possible values are:
      - 0 # 50ms
      - 1 # 100ms
      - 2 # 200ms
      - 3 # 500ms
      - 4 # 1000ms
      - 5 # 2000ms
    enum: [0, 1, 2, 3, 4, 5]
```
