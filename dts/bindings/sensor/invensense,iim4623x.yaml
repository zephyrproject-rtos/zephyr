## dts/bindings/sensor/invensense,iim4623x.yaml
```yaml
# Copyright (c) 2025 Sentry Technologies ApS
#
# SPDX-License-Identifier: Apache-2.0

description: |
  IIM-4623x family of 6-axis motion tracking devices. They combine multiple
  3-axis gyroscopes and 3-axis accelerometers packaged in a small module.

  The sensors can connect on either UART or SPI, but currently only SPI is
  supported. It is worth noting that the device datasheet specifies a range
  for the SPI clock frequency: 4 MHz <= f_sclk <= 12 MHz.
  Additionally the device datasheet specifies operation using SPI mode 3:
  CPOL=1, CPHA=1.

  When setting the accel-bw and gyro-bw properties in a .dts or .dtsi file
  you may include iim4623x.h and use the macros defined there.

  Example:
  #include <zephyr/dt-bindings/sensor/iim4623x.h>

  &spi0 {
    ...

    iim4623x@0 {
      ...

      accel-bw = <IIM4623X_DT_ACCEL_BW_4>;
      gyro-bw = <IIM4623X_DT_GYRO_BW_4>;
    };
  };

include: [spi-device.yaml, sensor-device.yaml]

properties:
  int-gpios:
    type: phandle-array
    required: true
    description: Interrupt gpio

  reset-gpios:
    type: phandle-array
    required: true
    description: Reset gpio

  odr:
    type: int
    default: 1000
    description: |
      Specify the IMU output data rate in Hz.
      Default to the power-up default.
    enum:
      - 1000
      - 500
      - 250
      - 200
      - 125
      - 100
      - 50
      - 25
      - 20
      - 10

  accel-bw:
    type: int
    default: 0
    description: |
      Specify the accelerometer bandwidth setting.
      Consult the datasheet for figures regarding 3dB bandwidth,
      noise bandwidth, and RMS noise.
      Default to the power-up default.
    enum:
      - 0 # IIM4623X_DT_ACCEL_BW_4
      - 1 # IIM4623X_DT_ACCEL_BW_5
      - 2 # IIM4623X_DT_ACCEL_BW_6
      - 3 # IIM4623X_DT_ACCEL_BW_7

  gyro-bw:
    type: int
    default: 0
    description: |
      Specify the gyroscope bandwidth setting.
      Consult the datasheet for figures regarding 3dB bandwidth,
      noise bandwidth, and RMS noise.
      Default to the power-up default.
    enum:
      - 0 # IIM4623X_DT_GYRO_BW_4
      - 1 # IIM4623X_DT_GYRO_BW_5
      - 2 # IIM4623X_DT_GYRO_BW_6
      - 3 # IIM4623X_DT_GYRO_BW_7
```

## dts/bindings/sensor/invensense,mpu6050.yaml
```yaml
# Copyright (c) 2019 Nordic Semiconductor ASA
# SPDX-License-Identifier: Apache-2.0

description: MPU-6000 motion tracking device

# MPU-6000 is SPI or I2C.  MPU-6050 is I2C-only.  Driver does not
# support SPI so stick with I2C variant.
compatible: "invensense,mpu6050"

include: [sensor-device.yaml, i2c-device.yaml]

properties:
  int-gpios:
    type: phandle-array
    description: |
      The INT signal default configuration is active-high.  The
      property value should ensure the flags properly describe the
      signal that is presented to the driver.

  accel-fs:
    type: int
    default: 2
    description: |
      Accelerometer full-scale range.
      An X value represents a range of +/- X g.
      The power-on reset state of the sensor matches the default value of 2.
    enum:
      - 2
      - 4
      - 8
      - 16

  gyro-fs:
    type: int
    default: 250
    description: |
      Gyroscope full-scale range.
      An X value represents a range of +/- X deg/s.
      The power-on reset state of the sensor matches the default value of 250.
    enum:
      - 250
      - 500
      - 1000
      - 2000

  smplrt-div:
    type: int
    default: 0
    description: |
      The base sample rate is 8 kHz for the gyroscope and 1 kHz for
      the accelerometer.
      A division factor of X sets the sample rate to: baserate / (1 + X).
      Valid values for X are 0 through 255.
      The power-on reset state of the sensor matches the default value of 0.
```

## dts/bindings/sensor/invensense,mpu9150.yaml
```yaml
# Copyright (c) 2020, Linaro Limited
# SPDX-License-Identifier: Apache-2.0

description: |
    InvenSense MPU-9150 Nine-Axis (Gyro + Accelerometer + Compass). See more
    info at https://www.invensense.com/products/motion-tracking/9-axis/mpu-9150/

compatible: "invensense,mpu9150"

include: i2c-device.yaml

child-binding:
    description: Embedded AK8975 Magnetometer
    compatible: "asahi-kasei,ak8975"
    properties:
       "#address-cells":
           type: int
           required: true
           const: 1
       "#size-cells":
           type: int
           required: true
           const: 0
```

## dts/bindings/sensor/invensense,mpu9250.yaml
```yaml
# Copyright (c) 2021 Nordic Semiconductor
# SPDX-License-Identifier: Apache-2.0

description: |
    InvenSense MPU-9250 Nine-Axis (Gyro + Accelerometer + Compass). See more
    info at https://www.invensense.com/products/motion-tracking/9-axis/mpu-9250/

compatible: "invensense,mpu9250"

include: i2c-device.yaml

properties:
    irq-gpios:
      type: phandle-array
      required: false
      description: |
        The INT signal default configuration is active-high.  The
        property value should ensure the flags properly describe the
        signal that is presented to the driver.
        This property is required when the trigger mode is used.

    gyro-sr-div:
      type: int
      required: true
      description: |
        Default gyrscope sample rate divider. This divider is only effective
        when gyro-dlpf is in range 5-184.
        rate = sample_rate / (1 + gyro-sr-div)
        Valid range: 0 - 255

    gyro-dlpf:
      type: int
      required: true
      description: |
        Default digital low pass filter frequency of gyroscope.
        Maps to DLPF_CFG field in Configuration setting.
      enum:
        - 250
        - 184
        - 92
        - 41
        - 20
        - 10
        - 5
        - 3600

    gyro-fs:
      type: int
      required: true
      description: |
        Default full scale of gyroscope. (Unit - DPS).
        Maps to GYRO_FS_SEL field in Gyroscope Configuration setting.
      enum:
        - 250
        - 500
        - 1000
        - 2000

    accel-fs:
      type: int
      required: true
      description: |
        Default full scale of accelerometer. (Unit - g)
        Maps to ACCEL_FS_SEL field in Accelerometer Configuration setting
      enum:
        - 2
        - 4
        - 8
        - 16

    accel-dlpf:
      type: string
      required: true
      description: |
        Default digital low pass filter frequency of accelerometer.
        Maps to DLPF_CFG field in Accelerometer Configuration 2 setting.
      enum:
        - "218.1"
        - "218.1a"
        - "99"
        - "44.8"
        - "21.2"
        - "10.2"
        - "5.05"
        - "420"
```

## dts/bindings/sensor/invensense,tad2144-i2c.yaml
```yaml
# Copyright (c) 2025 TDK Invensense
# SPDX-License-Identifier: Apache-2.0

description: TAD2144 TMR Angle Sensor IC

compatible: "invensense,tad2144"

include: [i2c-device.yaml, "invensense,tad2144.yaml"]

properties:
  sa1-gpios:
    type: phandle-array
    description: |
      Use for selecting the device address
      
  sa2-gpios:
    type: phandle-array
    description: |
      Use for selecting the device address
 
```

## dts/bindings/sensor/invensense,tad2144-spi.yaml
```yaml
# Copyright (c) 2025 TDK Invensense
# SPDX-License-Identifier: Apache-2.0

description: TAD2144 TMR Angle Sensor IC

compatible: "invensense,tad2144"

include: [spi-device.yaml, "invensense,tad2144.yaml"]
```

## dts/bindings/sensor/invensense,tad2144.yaml
```yaml
# Copyright (c) 2025 TDK Invensense
# SPDX-License-Identifier: Apache-2.0

description: TAD2144 TMR Angle Sensor IC

compatible: "invensense,tad2144"

include: [sensor-device.yaml]

properties:
  int-gpios:
    type: phandle-array
    description: |
      The INT signal default configuration is active-high. The
      property value should ensure the flags properly describe the
      signal that is presented to the driver.

  sa1-gpios:
    type: phandle-array
    description: |
      Use for selecting the device address
      
  sa2-gpios:
    type: phandle-array
    description: |
      Use for selecting the device address

  miso-gpios:
    type: phandle-array
    required: false
    description: GPIO for encoder B signal (miso)

  mosi-gpios:
    type: phandle-array
    required: false
    description: GPIO for encoder A signal (mosi)

  sck-gpios:
    type: phandle-array
    required: false
    description: GPIO for encoder Z signal (sck)

  cs-gpios:
    type: phandle-array
    description: |
      Use for selecting the chip select

  op-mode:
    type: string
    default: mode0
    description: |
      Default mode for sensor.
      Mode selection is a trade-off between measurement time, consumption and noise.
      Operation modes are the following:
      - Mode0: odr=25Hz,  noise=0.5rms, current=211uA
      - Mode1: odr=120Hz, noise=1rms,   current=222uA
      - Mode2: odr=40Hz,  noise=2.5rms, current=49uA
      - Mode3: odr=2Hz,   noise=0.5rms, current=23uA
      - Mode4: odr=25Hz,  noise=0.3rms, current=250uA
      Default set to mode0 which is the sensor default value.
    enum:
      - mode0
      - mode1
      - mode2
      - mode3
      - mode4

  drive-strength:
    type: string
    default: current_12mA_1_8V
    description: |
      IO device strength register value.
      Define max current when switching IO state.
      Default set to current_12mA_1_8V which is the sensor default value.
    enum:
      - current_2mA_1_8V
      - current_4mA_1_8V
      - current_8mA_1_8V
      - current_12mA_1_8V
      - current_2mA_1_2V
      - current_4mA_1_2V
      - current_6mA_1_2V
      - current_8mA_1_2V
```

## dts/bindings/sensor/invensense-chirp-common.yaml
```yaml
# Copyright (c) 2023 Google LLC
# SPDX-License-Identifier: Apache-2.0

description: TDK chirp ToF sensor common properties

include: [sensor-device.yaml, i2c-device.yaml]

properties:
  reset-gpios:
    type: phandle-array
    description: |
      The RESET_N signal default configuration is active-high. The property
      value should ensure the flags properly describe the signal that is
      presented to the driver.
  int-gpios:
    type: phandle-array
    description: |
      The INT signal default configuration is active-high. The property value
      should ensure the flags properly describe the signal that is presented to
      the driver.
  program-gpios:
    type: phandle-array
    description: |
      The PROGRAM signal default configuration is active-high. The property
      value should ensure the flags properly describe the signal that is
      presented to the driver.
  firmware:
    type: string
    description: |
      Default firmware to load onto the chirp device. Custom firmware (not
      bundled with Zephyr) can be loaded at runtime via the appropriate chx01.h
      headers.
    enum:
      - "GPR"
      - "GPR-SR"
```

## dts/bindings/sensor/isil,isl29035.yaml
```yaml
# Copyright (c) 2019, Linaro Limited
# SPDX-License-Identifier: Apache-2.0

description: |
    Intersil ISL29035 Light Sensor. See datasheet at
    https://www.renesas.com/us/en/www/doc/datasheet/isl29035.pdf

compatible: "isil,isl29035"

include: [sensor-device.yaml, i2c-device.yaml]

properties:
  int-gpios:
    type: phandle-array
    description: |
      The INT pin defaults to active low when produced by the sensor.
      The property value should ensure the flags properly describe the
      signal that is presented to the driver.
```

## dts/bindings/sensor/isil,isl29125.yaml
```yaml
# Copyright (c) 2019, Linaro Limited
# SPDX-License-Identifier: Apache-2.0

description: |
    ISL29125 Color Light to Digital Converter datasheet at
    https://www.renesas.com/eu/en/www/doc/datasheet/isl29125.pdf

compatible: "isil,isl29125"

include: i2c-device.yaml

properties:
    int-gpios:
      type: phandle-array
      required: false
```

## dts/bindings/sensor/ist,tsic-xx6.yaml
```yaml
# Copyright (c) 2024, Vitrolife A/S
# SPDX-License-Identifier: Apache-2.0

description: |
  TSic xx6 temperature sensor.
  https://www.ist-ag.com/sites/default/files/downloads/ATTSic_E.pdf

  Example:
    tsic_716: tsic_716 {
      status = "okay";
      compatible = "ist,tsic-xx6";
      pwms = <&pwm2 1 PWM_USEC(5) PWM_POLARITY_NORMAL>;
      data-bits = <14>;
      lower-temperature-limit = <(-10)>;
      higher-temperature-limit = <60>;
    };

compatible: "ist,tsic-xx6"

include: sensor-device.yaml

properties:
  pwms:
    required: true
    type: phandle-array
    description: Reference to a PWM instance with PWM capture support.

  lower-temperature-limit:
    required: true
    type: int
    description: Lowest temperature supported by the device in celsius degrees.

  higher-temperature-limit:
    required: true
    type: int
    description: Highest temperature supported by the device in celsius degrees.

  data-bits:
    required: true
    type: int
    description: Data bits per reading.
    enum: [11, 14]
```

## dts/bindings/sensor/istentek,ist8310.yaml
```yaml
# Copyright (c) 2019, Linaro Limited
# SPDX-License-Identifier: Apache-2.0

description: |
    iSentek ist8310 Geomagnetic sensor.  See more info at:
    https://isentek.com/products_view.php?PID=10&sn=13

compatible: "isentek,ist8310"

include: ["i2c-device.yaml", "sensor-device.yaml"]
```

## dts/bindings/sensor/ite,it51xxx-vcmp.yaml
```yaml
# Copyright (c) 2025 ITE Technology Corporation.
# SPDX-License-Identifier: Apache-2.0

description: ITE, it51xxx Voltage Comparator node

compatible: "ite,it51xxx-vcmp"

include: sensor-device.yaml

properties:
  # reg:
  #   required: true

  # interrupts:
  #   required: true

  vcmp-ch:
    type: int
    required: true
    description: Voltage comparator channel.

  scan-period:
    type: int
    required: true
    description: |
      Select the scan interval for all comparator channel.
      Check include/zephyr/dt-bindings/sensor/it8xxx2_vcmp.h file for
      pre-defined values.

  comparison:
    type: int
    required: true
    description: |
      Determines the condition to be met between ADC data and
      threshold assert value that will trigger comparator interrupt.
      Check include/zephyr/dt-bindings/sensor/it8xxx2_vcmp.h file for
      pre-defined values.

  threshold-mv:
    type: int
    required: true
    description: |
      16-bit value in milli-volts present on ADC data as threshold assert.
      Check include/zephyr/dt-bindings/sensor/it8xxx2_vcmp.h file for
      pre-defined values.

  io-channels:
    type: phandle-array
    required: true
    description: |
      ADC channel that will perform measurement.
```

## dts/bindings/sensor/ite,it8xxx2-vcmp.yaml
```yaml
# Copyright (c) 2022 ITE Technology Corporation.
# SPDX-License-Identifier: Apache-2.0

description: ITE, it8xxx2 Voltage Comparator node

compatible: "ite,it8xxx2-vcmp"

include: sensor-device.yaml

properties:
  reg:
    required: true

  interrupts:
    required: true

  vcmp-ch:
    type: int
    required: true
    description: Voltage comparator channel.

  scan-period:
    type: int
    required: true
    description: |
      Select the scan interval for all comparator channel.
      Check include/zephyr/dt-bindings/sensor/it8xxx2_vcmp.h file for
      pre-defined values.

  comparison:
    type: int
    required: true
    description: |
      Determines the condition to be met between ADC data and
      threshold assert value that will trigger comparator interrupt.
      Check include/zephyr/dt-bindings/sensor/it8xxx2_vcmp.h file for
      pre-defined values.

  threshold-mv:
    type: int
    required: true
    description: |
      16-bit value in milli-volts present on ADC data as threshold assert.
      Check include/zephyr/dt-bindings/sensor/it8xxx2_vcmp.h file for
      pre-defined values.

  io-channels:
    type: phandle-array
    required: true
    description: |
      ADC channel that will perform measurement.
```
