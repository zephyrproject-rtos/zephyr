## dts/bindings/sensor/microchip,mcp9843.yaml
```yaml
# Copyright (c) 2024 Vogl Electronic GmbH
#
# SPDX-License-Identifier: Apache-2.0

description: |
  Microchip MCP9842/98243 I2C Thermocouple EMF to Temperature Converter. See
  https://www.microchip.com/wwwproducts/en/MCP9600.

compatible: "microchip,mcp9843"

include: [sensor-device.yaml, i2c-device.yaml]

properties:
  resolution:
    type: int
    default: 1
    description: |
      Sensor resolution. Default is 0.25°C (0b01),
      which is the power-up default.
      0 = 0.5°C
      1 = 0.25°C
      2 = 0.125°C
      3 = 0.0625°C
    enum:
      - 0
      - 1
      - 2
      - 3
```

## dts/bindings/sensor/microchip,mtch9010.yaml
```yaml
# Copyright (c) 2025 Microchip Technology Inc.
# SPDX-License-Identifier: Apache-2.0

title: MTCH9010 Liquid Detector

description: |
  Microchip MTCH9010 liquid leak detector

  - Detects liquid leaks using capacitance or conductance
  - Interrupt driven or UART output

  - For more information:
  - https://www.microchip.com/en-us/product/mtch9010

compatible: "microchip,mtch9010"

include: [sensor-device.yaml, uart-device.yaml]

properties:
  operating-mode:
    type: string
    required: true
    description: |
      Sets moisture detection mode (capacitive or conductive)
      Keep in sync with dt-bindings/sensor/mtch9010.h
    enum:
      - "MTCH9010_CAPACITIVE"
      - "MTCH9010_CONDUCTIVE"

  sleep-period:
    type: int
    description: |
      Amount of time (in seconds) the sensor will sleep between each check.
      Leave undefined or at 0 to sleep until wake.
    enum:
      - 0
      - 1
      - 2
      - 4
      - 8
      - 16
      - 32
      - 64
      - 128
      - 256

  uart-config-enable:
    type: boolean
    description: |
      If set, the MTCH9010 is configured over the UART Interface.
      To be disabled if the sensor is configured through its
      I/O or a start-up configuration was previously defined.

  extended-output-enable:
    type: boolean
    description: |
      If set, the output format of the MTCH9010 can be changed.
      If not set, the MTCH9010 uses the default formatting.

  extended-output-format:
    type: string
    description: |
      Output data formatting configuration.
    enum:
      - "MTCH9010_OUTPUT_FORMAT_DELTA"
      - "MTCH9010_OUTPUT_FORMAT_CURRENT"
      - "MTCH9010_OUTPUT_FORMAT_BOTH"
      - "MTCH9010_OUTPUT_FORMAT_MPLAB_DATA_VISUALIZER"

  reference-value:
    type: int
    description: |
      Set the reference "dry" value.
      If not defined, the POR value of the sensor is used.
      KConfig symbol MTCH9010_REFERENCE_AVERAGING_COUNT
      can be used to setup averaging of this value.

  detect-value:
    type: int
    required: true
    description: |
      Set the detection threshold value.

  output-gpios:
    type: phandle-array
    description: Output Status Line for the MTCH9010

  system-lock-gpios:
    type: phandle-array
    description: |
      System lock I/O for the MTCH9010
      Unused if SYSTEM LOCK is not used.

  mode-gpios:
    type: phandle-array
    description: |
      Mode select I/O for the MTCH9010
      Unused if device is configured with UART or connected externally.

  reset-gpios:
    type: phandle-array
    description: |
      Reset I/O for MTCH9010
      Pulled low to reset the device.

  wake-gpios:
    type: phandle-array
    description: |
      Wake I/O for the MTCH9010
      Not used if a sleep period is defined.

  uart-en-gpios:
    type: phandle-array
    description: |
      UART enable line for the MTCH9010
      Unused if the UART EN pin is connected externally.

  cfg-en-gpios:
    type: phandle-array
    description: |
      Enhanced configuration enable for the MTCH9010
      Unused if device is configured with UART or connected externally.

  heartbeat-gpios:
    type: phandle-array
    description: |
      Heartbeat output of MTCH9010
```

## dts/bindings/sensor/microchip,pac194x.yaml
```yaml
# Microchip PAC195X power monitor driver
#
# Copyright (c) 2026 Google, LLC
#
# SPDX-License-Identifier: Apache-2.0

description:
  Microchip PAC194X/PAC195X Power Monitor

compatible: "microchip,pac194x"

include: [sensor-device.yaml, i2c-device.yaml]

child-binding:
  description: PAC194X/PAC195X specific channel configuration
  properties:
    reg:
      type: int
      required: true
      description: Channel index (1 to 4)

    friendly-name:
      type: string

    microchip,shunt-resistor-micro-ohms:
      type: int
      required: true
      description: Value of the shunt resistor in micro-ohms

    microchip,vbus-mode:
      type: int
      default: 0
      description: |
        VBUS Voltage sampling mode.
        The default corresponds to the reset value of the register field.
      enum:
        - 0 # PAC_UNIPOLAR_FSR
        - 1 # PAC_BIPOLAR_FSR
        - 2 # PAC_BIPOLAR_HALF_FSR

    microchip,vsense-mode:
      type: int
      default: 0
      description: |
        VSENSE Current sampling mode.
        The default corresponds to the reset value of the register field.
      enum:
        - 0 # PAC_UNIPOLAR_FSR
        - 1 # PAC_BIPOLAR_FSR
        - 2 # PAC_BIPOLAR_HALF_FSR

    microchip,accumulation-mode:
      type: int
      default: 0
      description: |
        Accumulation configuration for this specific channel.
        The default corresponds to the reset value of the register field.
      enum:
        - 0 # PAC_ACCUM_VPOWER
        - 1 # PAC_ACCUM_VSENSE
        - 2 # PAC_ACCUM_VBUS
```

## dts/bindings/sensor/microchip,tcn75a.yaml
```yaml
# Copyright 2023 Daniel DeGrasse <daniel@degrasse.com>
# SPDX-License-Identifier: Apache-2.0

description: TCN75A ambient temperature sensor

compatible: "microchip,tcn75a"

include: [sensor-device.yaml, i2c-device.yaml]

properties:
  alert-gpios:
    type: phandle-array
    description: |
      ALERT pin
      This pin defaults to active low when produced by the sensor.
      The property value should ensure the gpio flags properly describe
      the signal that is presented to the driver. Required in order to use
      triggering support.

  resolution:
    type: string
    default: "9-bit"
    enum:
      - "9-bit"
      - "10-bit"
      - "11-bit"
      - "12-bit"
    description: |
      Sensor resolution. Higher resolutions will result in longer conversion
      times. Note: datasheet's claim about the ambient temperature register:
      > When the 0.5°C, 0.25°C or 0.125°C resolutions are selected,
      > bit 6, bit 7 or bit 8 will remain clear <0>,
      > respectively.
      appears to be incorrect. Only conversion times seem to be affected by
      resolution selection.

  oneshot-mode:
    type: boolean
    description: |
      Oneshot sampling mode. Reduces power consumption, but disables triggering
      feature as well as high resolution sampling. Only supported with 9 bit
      resolution.
```

## dts/bindings/sensor/microcrystal,rv3032-temp.yaml
```yaml
# Copyright (c) 2025 Baylibre SAS
# SPDX-License-Identifier: Apache-2.0

description: RV3032C7 temperature sensor

compatible: "microcrystal,rv3032-temp"

include: sensor-device.yaml

properties:
  low-temp:
    type: int
    default: -40
    description: |
      Low temperature value
      According to datasheet supported value is in range from -128 to 127
      Default value is standard minimum operation temperature -40
  high-temp:
    type: int
    default: 85
    description: |
      High temperature value
      According to datasheet supported value is in range from -128 to 127
      Default value is standard maximum operation temperature +85
```

## dts/bindings/sensor/murata,ncp15wb473.yaml
```yaml
# Copyright (c) 2023 Google LLC
# SPDX-License-Identifier: Apache-2.0

description: MURATA NCP15WB473 thermistor

compatible: "murata,ncp15wb473"

include: ntc-thermistor.yaml
```

## dts/bindings/sensor/murata,ncp15xh103.yaml
```yaml
# Copyright (c) 2024 Silicom Connectivity Solutions Ltd.
# SPDX-License-Identifier: Apache-2.0

description: MURATA NCP15XH103 thermistor

compatible: "murata,ncp15xh103"

include: ntc-thermistor.yaml
```
