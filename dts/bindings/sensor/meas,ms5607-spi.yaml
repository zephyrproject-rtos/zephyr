## dts/bindings/sensor/meas,ms5607-spi.yaml
```yaml
# Copyright (c) 2019, Thomas Schmid <tom@lfence.de>
# SPDX-License-Identifier: Apache-2.0

description: |
    TE Connectivity MS5607 digital pressure and temperature sensor.
    The Datasheet is at https://www.te.com/usa-en/product-CAT-BLPS0035.html

compatible: "meas,ms5607"

include: [sensor-device.yaml, spi-device.yaml]
```

## dts/bindings/sensor/meas,ms5611.yaml
```yaml
# Copyright (c) 2022, Karol Duda
# SPDX-License-Identifier: Apache-2.0

description: Measurement Specialties barometer

compatible: "meas,ms5611"

include: i2c-device.yaml
```

## dts/bindings/sensor/meas,ms5637.yaml
```yaml
# Copyright The Zephyr Project Contributors
# SPDX-License-Identifier: Apache-2.0

description: |
  TE Connectivity MS5637 digital pressure and temperature sensor.
  Communicates via I2C at fixed address 0x76.

compatible: "meas,ms5637"

include: [sensor-device.yaml, i2c-device.yaml]

properties:
  osr-press:
    type: int
    default: 2048
    enum:
      - 256
      - 512
      - 1024
      - 2048
      - 4096
      - 8192
    description: |
      Pressure oversampling ratio. Higher values improve measurement
      resolution at the cost of longer conversion time (datasheet Table 2):
        256  - 1 ms max
        512  - 2 ms max
        1024 - 3 ms max
        2048 - 5 ms max (default; middle of the range)
        4096 - 9 ms max
        8192 - 17 ms max
      The sensor has no built-in default OSR; 2048 is selected as the
      driver default as a balance between conversion time and resolution.

  osr-temp:
    type: int
    default: 2048
    enum:
      - 256
      - 512
      - 1024
      - 2048
      - 4096
      - 8192
    description: |
      Temperature oversampling ratio. Higher values improve measurement
      resolution at the cost of longer conversion time (datasheet Table 2):
        256  - 1 ms max
        512  - 2 ms max
        1024 - 3 ms max
        2048 - 5 ms max (default; middle of the range)
        4096 - 9 ms max
        8192 - 17 ms max
      The sensor has no built-in default OSR; 2048 is selected as the
      driver default as a balance between conversion time and resolution.

examples:
  - |
    i2c {
      #address-cells = <1>;
      #size-cells = <0>;

      ms5637@76 {
        compatible = "meas,ms5637";
        reg = <0x76>;
      };
    };
```

## dts/bindings/sensor/meas,ms56xx-common.yaml
```yaml
# Copyright (c) 2024, Aaron Chan
# SPDX-License-Identifier: Apache-2.0


description: |
    TE Connectivity MS5607 and MS5611 digital pressure and temperature sensors.
    The Datasheet is at https://www.te.com/usa-en/product-CAT-BLPS0035.html

include: sensor-device.yaml

properties:
  chip:
    type: int
    required: true
    description: |
      Specifies which chip is used to determine calculation coefficients
    enum:
      - 7
      - 11
```

## dts/bindings/sensor/meas,ms56xx-i2c.yaml
```yaml
# Copyright (c) 2021, Aurelien Jarno <aurel32@aurel32.net>
# SPDX-License-Identifier: Apache-2.0

description: |
    TE Connectivity MS5607 and MS5611 digital pressure and temperature sensors.
    The Datasheet is at https://www.te.com/usa-en/product-CAT-BLPS0035.html

compatible: "meas,ms56xx"

include: ["i2c-device.yaml", "meas,ms56xx-common.yaml"]
```

## dts/bindings/sensor/meas,ms56xx-spi.yaml
```yaml
# Copyright (c) 2019, Thomas Schmid <tom@lfence.de>
# SPDX-License-Identifier: Apache-2.0

description: |
    TE Connectivity MS5607 and MS5611 digital pressure and temperature sensors.
    The Datasheet is at https://www.te.com/usa-en/product-CAT-BLPS0035.html

compatible: "meas,ms56xx"

include: ["spi-device.yaml", "meas,ms56xx-common.yaml"]
```

## dts/bindings/sensor/meas,ms5837-02ba.yaml
```yaml
# Copyright (c) 2025, Ivan Wagner <ivan.wagner@tecinvent.ch>
# SPDX-License-Identifier: Apache-2.0

description: TE Connectivity MS5837-02BA digital pressure sensor

compatible: "meas,ms5837-02ba"

include: [sensor-device.yaml, i2c-device.yaml]
```

## dts/bindings/sensor/meas,ms5837-30ba.yaml
```yaml
# Copyright (c) 2025, Ivan Wagner <ivan.wagner@tecinvent.ch>
# SPDX-License-Identifier: Apache-2.0

description: TE Connectivity MS5837-30BA digital pressure sensor

compatible: "meas,ms5837-30ba"

include: [sensor-device.yaml, i2c-device.yaml]
```

## dts/bindings/sensor/meas,ms5837.yaml
```yaml
# Copyright (c) 2018, Jan Van Winkel <jan.van_winkel@dxplore.eu>
# SPDX-License-Identifier: Apache-2.0

description: TE Connectivity MS5837 digital pressure sensor

compatible: "meas,ms5837"

include: [sensor-device.yaml, i2c-device.yaml]

properties:
  submodel:
    type: string
    description: Specifies the MS5837 sub-model.
    default: "02ba"
    enum:
     - "02ba"
     - "30ba"
```

## dts/bindings/sensor/melexis,mlx90394.yaml
```yaml
# Copyright (c) Florian Weber <Florian.Weber@live.de>
# SPDX-License-Identifier: Apache-2.0

description: |
    Melexis MLX90394 Magnetometer. See datasheet at
    https://media.melexis.com/-/media/files/documents/datasheets/mlx90394-datasheet-melexis.pdf

compatible: "melexis,mlx90394"

include: [sensor-device.yaml, i2c-device.yaml]
```

## dts/bindings/sensor/melexis,mlx90632.yaml
```yaml
# SPDX-FileCopyrightText: Copyright (c) Michele Tavecchio <tavecchiomichele03@gmail.com>
# SPDX-FileCopyrightText: Copyright (c) Alessandro Sola <alessandrosola03@gmail.com>
# SPDX-License-Identifier: Apache-2.0

description: |
  Melexis MLX90632 Infrared Temperature Sensor. See datasheet at
  https://www.melexis.com/en/documents/documentation/datasheets/datasheet-mlx90632

compatible: "melexis,mlx90632"

include: [sensor-device.yaml, i2c-device.yaml]
```

## dts/bindings/sensor/memsic,mc3419.yaml
```yaml
# SPDX-License-Identifier: Apache-2.0
# Copyright (c) 2023 Linumiz

description: |
    MC3419 3-axis accel sensor

    Example:
    #include <zephyr/dt-bindings/sensor/mc3419.h>

    mc3419: mc3419@0 {
      ...

      lpf-fc-sel = <MC3419_LPF_DISABLE>;
      decimation-rate = <MC3419_DECIMATE_IDR_BY_1>;
    };

compatible: "memsic,mc3419"

include: [sensor-device.yaml, i2c-device.yaml]

properties:
  int-gpios:
    type: phandle-array
    description: |
      This property specifies the connection for INT, this pin
      defaults to active low when sample produce interrupt.

  int-pin2:
    type: boolean
    description: |
      This property is used for interrupt routing.The sensor
      has two interrupt pins.By default the interrupt are routed
      to interrupt pin 1, by enabled this property interrupt are
      routed to interrupt pin 2.

  lpf-fc-sel:
    type: int
    default: 0
    enum: [0, 9, 10, 11, 13]
    description: |
      Enable and select LPF cutoff frequency for a given IDR (Input Data Rate).
      Possible values are listed below. Either use Int value or Macro Name in node definition.
      +-----------+-------------------------------------+
      | int value | Macro Name                          |
      +-----------+-------------------------------------+
      | 0         | MC3419_LPF_DISABLE                  |
      | 9         | MC3419_LPF_EN_WITH_IDR_BY_4p255_FC  |
      | 10        | MC3419_LPF_EN_WITH_IDR_BY_6_FC      |
      | 11        | MC3419_LPF_EN_WITH_IDR_BY_12_FC     |
      | 13        | MC3419_LPF_EN_WITH_IDR_BY_16_FC     |
      +-----------+-------------------------------------+
      Default is LPF disabled (reset value of the register).

  decimation-rate:
    type: int
    default: 0
    enum: [0, 1, 2, 3, 4, 5, 6, 7, 8, 9, 10, 11, 12, 13, 14, 15]
    description: |
      This helps in producing slower Output Data Rate (ODR) from given Input Data Rate (IDR).
      Possible values are listed below. Either use Int value or Macro Name in node definition.
      +-----------+-------------------------------+
      | Int value | Macro Name                    |
      +-----------+-------------------------------+
      | 0         | MC3419_DECIMATE_IDR_BY_1      |
      | 1         | MC3419_DECIMATE_IDR_BY_2      |
      | 2         | MC3419_DECIMATE_IDR_BY_4      |
      | 3         | MC3419_DECIMATE_IDR_BY_5      |
      | 4         | MC3419_DECIMATE_IDR_BY_8      |
      | 5         | MC3419_DECIMATE_IDR_BY_10     |
      | 6         | MC3419_DECIMATE_IDR_BY_16     |
      | 7         | MC3419_DECIMATE_IDR_BY_20     |
      | 8         | MC3419_DECIMATE_IDR_BY_40     |
      | 9         | MC3419_DECIMATE_IDR_BY_67     |
      | 10        | MC3419_DECIMATE_IDR_BY_80     |
      | 11        | MC3419_DECIMATE_IDR_BY_100    |
      | 12        | MC3419_DECIMATE_IDR_BY_200    |
      | 13        | MC3419_DECIMATE_IDR_BY_250    |
      | 14        | MC3419_DECIMATE_IDR_BY_500    |
      | 15        | MC3419_DECIMATE_IDR_BY_1000   |
      +-----------+-------------------------------+
      Default is Decimation 0 (reset value of the register).
```

## dts/bindings/sensor/memsic,mmc56x3.yaml
```yaml
# SPDX-License-Identifier: Apache-2.0
# Copyright (c) 2023 Linumiz

description: MMC56X3 3-axis magnetic and temperature sensor

compatible: "memsic,mmc56x3"

include: [sensor-device.yaml, i2c-device.yaml]

properties:

  magn-odr:
    type: int
    description: |
      Specify the default magnetometer output data rate expressed in
      samples per second (Hz) for continuous mode. Minimum is 0,
      maximum is 1000, though any ODR above 255 will be set to 1000.
      Setting ODR to 0 will turn off continuous mode. Temperature
      cannot be read in continuous mode.

  bandwidth-selection-bits-0:
    type: boolean
    description: |
      Adjust length of decimation filter. Controls duration of each measurement.
      Affects ODR; see datasheet for details.

  bandwidth-selection-bits-1:
    type: boolean
    description: |
      Adjust length of decimation filter. Controls duration of each measurement.
      Affects ODR; see datasheet for details.

  auto-self-reset:
    type: boolean
    description: |
      Enable automatic self-reset function.
      Recommended to be set.
      Affects ODR; see datasheet for details.
```

## dts/bindings/sensor/microchip,mcp3221.yaml
```yaml
# Copyright (c) 2023, Atmosic
#
# SPDX-License-Identifier: Apache-2.0

description: |
  Microchip MCP3221 Low-Power 12-Bit A/D Converter with I2C Interface.  See
  https://www.microchip.com/en-us/product/mcp3221.

compatible: "microchip,mcp3221"

include: [sensor-device.yaml, i2c-device.yaml]
```

## dts/bindings/sensor/microchip,mcp9600.yaml
```yaml
# Copyright (c) 2025, Thomas Schmid <tom@lfence.de>
# Copyright (c) 2022, Maxmillion McLaughlin
# Copyright (c) 2020, SER Consulting LLC / Steven Riedl
#
# SPDX-License-Identifier: Apache-2.0

description: |
  Microchip MCP9600 I2C Thermocouple EMF to Temperature Converter. See
  https://www.microchip.com/wwwproducts/en/MCP9600.

  When setting the DTS properties, make sure to include
  mcp9600.h and use the macros defined there.

  Example:
  #include <zephyr/dt-bindings/sensor/mcp9600.h>

  mcp9600: mcp9600@60 {
    ...

    thermocouple-type = <MCP9600_DT_TYPE_K>;
    adc-resolution = <MCP9600_DT_ADC_RES_18BIT>;
    filter-coefficient = <0>;
    cold-junction-temp-resolution: <MCP9600_DT_COLD_JUNC_TMP_RES_0_0625C>;
  };

compatible: "microchip,mcp9600"

include: [sensor-device.yaml, i2c-device.yaml]

properties:
  thermocouple-type:
    type: int
    default: 0
    description: |
      Thermocouple type. Use MCP9600_DT_TYPE macros for setting the value.
      The default value corresponds to the reset state of the chip.
    enum:
      - 0 # MCP9600_DT_TYPE_K
      - 1 # MCP9600_DT_TYPE_J
      - 2 # MCP9600_DT_TYPE_T
      - 3 # MCP9600_DT_TYPE_N
      - 4 # MCP9600_DT_TYPE_S
      - 5 # MCP9600_DT_TYPE_E
      - 6 # MCP9600_DT_TYPE_B
      - 7 # MCP9600_DT_TYPE_R

  adc-resolution:
    type: int
    default: 0
    description: |
      ADC resolution in bits. Use MCP9600_DT_ADC_RES macros for setting the value.
      The default value corresponds to the reset state of the chip.
    enum:
      - 0 # MCP9600_DT_ADC_RES_18BIT
      - 1 # MCP9600_DT_ADC_RES_16BIT
      - 2 # MCP9600_DT_ADC_RES_14BIT
      - 3 # MCP9600_DT_ADC_RES_12BIT

  filter-coefficient:
    type: int
    default: 0
    description: |
      Filter coefficient:
      - 0: Filter off
      - 1: Minimum filter
      - 2:
      - 3:
      - 4: Mid filter
      - 5:
      - 6:
      - 7: Maximum filter
      The default value corresponds to the reset state of the chip.
    enum:
      - 0
      - 1
      - 2
      - 3
      - 4
      - 5
      - 6
      - 7

  cold-junction-temp-resolution:
    description: |
      Resolution of the cold junction temperature measurement.
      Select from:
      - 0: 0.0625 °C
      - 1: 0.25 °C
      or use MCP9600_DT_COLD_JUNC_TMP_RES_0_0625C or MCP9600_DT_COLD_JUNC_TMP_RES_0_25C Macros.
      The default value corresponds to the reset state of the chip.
    type: int
    default: 0
    enum:
      - 0 # MCP9600_DT_COLD_JUNC_TMP_RES_0_0625C
      - 1 # MCP9600_DT_COLD_JUNC_TMP_RES_0_25C
```

## dts/bindings/sensor/microchip,mcp970x.yaml
```yaml
#
# Copyright (c) 2023 FTP Technologies
#

description: |
    Microchip MCP9700/9700A MCP9701/9701A
    Low-Power Linear Active Thermistor IC

compatible: "microchip,mcp970x"

include: sensor-device.yaml

properties:
  io-channels:
    required: true
    description: |
      Channels available with this divider configuration.

  family:
    type: string
    required: true
    description: |
      Family            Temperature Coefficient
        MCP9700/9700A -   10.0mV
        MCP9701/9701A -   19.5mV
    enum:
      - "MCP9700/9700A"
      - "MCP9701/9701A"
```

## dts/bindings/sensor/microchip,mcp9800.yaml
```yaml
# Copyright (c) 2024, Robert Kowalewski
# SPDX-License-Identifier: Apache-2.0

description: |
    Microchip MCP9800 Digital Temperature Sensor. See
    https://ww1.microchip.com/downloads/en/devicedoc/21909d.pdf

compatible: "microchip,mcp9800"

include: [sensor-device.yaml, i2c-device.yaml]

properties:
  int-gpios:
    type: phandle-array
    description: |
      The alert pin defaults to active low when produced by the
      sensor, and is open-drain. A pull-up may be appropriate. The
      property value should ensure the flags properly describe the
      signal that is presented to the driver.

  resolution:
    type: int
    default: 0
    description: |
      Sensor resolution. Default is 0.5C (0b00),
      which is the power-up default.
    enum:
      - 0 # 0.5C
      - 1 # 0.25C
      - 2 # 0.125C
      - 3 # 0.0625C
```

## dts/bindings/sensor/microchip,mcp9808.yaml
```yaml
# Copyright (c) 2019, Linaro Limited
# SPDX-License-Identifier: Apache-2.0

description: |
    Microchip MCP9808 Digital Temperature Sensor. See
    http://ww1.microchip.com/downloads/en/DeviceDoc/25095A.pdf.

compatible: "microchip,mcp9808"

include: i2c-device.yaml

properties:
    int-gpios:
      type: phandle-array
      required: false
      description: |
        The alert pin defaults to active low when produced by the
        sensor, and is open-drain.  A pull-up may be appropriate.  The
        property value should ensure the flags properly describe the
        signal that is presented to the driver.

    resolution:
      type: int
      required: false
      default: 3
      description: |
        Sensor resolution. Default is 0.0625C (0b11),
        which is the power-up default.
      enum:
        - 0 # 0.5C
        - 1 # 0.25C
        - 2 # 0.125C
        - 3 # 0.0625C
```
