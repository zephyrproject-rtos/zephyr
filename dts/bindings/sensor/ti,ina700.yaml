## dts/bindings/sensor/ti,tmag5170.yaml
```yaml
# Copyright (c) 2023 Michal Morsisko
# SPDX-License-Identifier: Apache-2.0

description: Texas Instruments TMAG5170 high-precision, linear 3D Hall-effect sensor.

compatible: "ti,tmag5170"

include: [sensor-device.yaml, spi-device.yaml]

properties:
  int-gpios:
    type: phandle-array
    description: |
      This property specifies the connection to ALERT sensor pin.
      It will be used by the driver to notify the application about
      data ready event. For this property to take effect, the
      TMAG5170_TRIGGER must be set in project configuration
  operating-mode:
    type: int
    required: true
    description: |
      Operating mode of the device.
      1 - stand-by mode - in this mode the device waits for application to trigger
      the measurement.
      2 - active measure mode - continuous sampling on all enabled channels
      as fast as possible. Recommended for devices that haven't got
      strict power requirements and need frequent sampling.
      3 - active trigger mode - in this mode, similar to stand-by mode, the device
      wait for application to trigger the measurement, but the time needed to finish
      the conversion is shorter than in stand-by mode, on the cost of increased power
      consumption.
      4 - duty-cycled - after each sample the device goes to sleep and then
      automatically wakes up to take another sample. The sleep time is determined
      by `sleep-time` property. Recommended for low-power devices that don't need
      high frequency sampling.
    enum:
      - 1
      - 2
      - 3
      - 4
  magnetic-channels:
    type: string
    default: "XYZ"
    description: |
      Enables data acquisition of the magnetic axis channel(s)
      If axis is enabled more than once, sensor will do pseudo-simultaneous
      sampling. Refer to datasheet for more information, By default all axes
      are enabled (XYZ) to allow the user to check if the sensor work as expected.
      Following options are allowed:
      None (chip reset value)
      X
      Y
      XY
      Z
      ZX
      YZ
      XYZ (default)
      XYX
      YXY
      YZY
      ZYZ
      ZXZ
      XZX
      XYZYX
      XYZZYX
    enum:
      - "None"
      - "X"
      - "Y"
      - "XY"
      - "Z"
      - "ZX"
      - "YZ"
      - "XYZ"
      - "XYX"
      - "YXY"
      - "YZY"
      - "ZYZ"
      - "ZXZ"
      - "XZX"
      - "XYZYX"
      - "XYZZYX"
  x-range:
    type: int
    default: 0
    description: |
      The maximum and minimum values that can be measured on X axis.
      The wider the range, the worse the resolution.
      0 = ±50mT (TMAG5170A1)/ ±150mT(TMAG5170A2) - (default; chip reset value)
      1 = ±25mT (TMAG5170A1)/ ±75mT(TMAG5170A2)
      2 = ±100mT (TMAG5170A1)/ ±300mT(TMAG5170A2)
    enum:
      - 0
      - 1
      - 2
  y-range:
    type: int
    default: 0
    description: |
      The maximum and minimum values that can be measured on Y axis.
      The wider the range, the worse the resolution.
      0 = ±50mT (TMAG5170A1)/ ±150mT(TMAG5170A2) - (default; chip reset value)
      1 = ±25mT (TMAG5170A1)/ ±75mT(TMAG5170A2)
      2 = ±100mT (TMAG5170A1)/ ±300mT(TMAG5170A2)
    enum:
      - 0
      - 1
      - 2
  z-range:
    type: int
    default: 0
    description: |
      The maximum and minimum values that can be measured on Z axis.
      The wider the range, the worse the resolution.
      0 = ±50mT (TMAG5170A1)/ ±150mT(TMAG5170A2) - (default; chip reset value)
      1 = ±25mT (TMAG5170A1)/ ±75mT(TMAG5170A2)
      2 = ±100mT (TMAG5170A1)/ ±300mT(TMAG5170A2)
    enum:
      - 0
      - 1
      - 2
  oversampling:
    type: int
    default: 1
    description: |
      Enables additional sampling of the sensor data to reduce the noise
      effect. If temperature channel is enabled, temperature will be oversampled
      too, unless `disable-temperature-oversampling` property is present.
      Following options are allowed:
      1 (default; chip reset value)
      2
      4
      8
      16
      32
    enum:
      - 1
      - 2
      - 4
      - 8
      - 16
      - 32
  enable-temperature-channel:
    type: boolean
    description: |
      Enables temperature measurement
  magnet-type:
    type: string
    default: "None"
    description: |
      Enables temperature compensation basing on the type of magnet.
      Following options are allowed:
      None (default; chip reset value)
      NdBFe = 0.12%/deg C
      SmCo = 0.03%/deg C
      Ceramic = 0.2%/deg C
    enum:
      - "None"
      - "NdBFe"
      - "SmCo"
      - "Ceramic"
  angle-measurement:
    type: string
    default: "None"
    description: |
      Enable angle calculation using two axis data:
      None (default; chip reset value)
      XY
      YZ
      XZ
    enum:
      - "None"
      - "XY"
      - "YZ"
      - "XZ"
  disable-temperature-oversampling:
    type: boolean
    description: |
      If true, temperature is always sampled once per conversion set
      If false, temperature is oversampled according to `oversampling`
      property.
  sleep-time:
    type: int
    default: 1
    description: |
      The time in miliseconds the sensor will be in sleep during conversions.
      For this property to take effect sensor must be in `duty-cycled` mode.
      Note that to calculate total time between conversions, the conversion time
      itself must be taken into account. The conversion time is dependent
      on the values of `oversampling`, `magnetic-channels`, `temperature-channel-enabled`
      and `disable-temperature-oversampling` properties.
      Following value are allowed:
      1 (default; chip reset value)
      5
      10
      15
      20
      30
      50
      100
      500
      1000
    enum:
      - 1
      - 5
      - 10
      - 15
      - 20
      - 30
      - 50
      - 100
      - 500
      - 1000
```

## dts/bindings/sensor/ti,tmag5273.yaml
```yaml
# Copyright (c) 2023, deveritec GmbH
# SPDX-License-Identifier: Apache-2.0

description: |
  Texas Instruments TMAG5273 Low-Power Linear 3D Hall-Effect Sensor with an I2C interface.

  See the specification for the default I2C address.

  The specification of the sensor can be found at:
    https://www.ti.com/lit/ds/symlink/tmag5273.pdf

    When setting the enum properties in a .dts or .dtsi file you may
    include tmag5273.h and use the macros defined there.

    Example:
    #include <zephyr/dt-bindings/sensor/tmag5273.h>

    tmag5273: tmag5273@0 {
      ...
      axis = <TMAG5273_DT_AXIS_XYZ>;
      range = <TMAG5273_DT_AXIS_RANGE_HIGH>;
    };

compatible: "ti,tmag5273"

include: [sensor-device.yaml, i2c-device.yaml]

properties:
  operation-mode:
    type: int
    default: 0
    enum: [0, 1]
    description: |
      Sensor mode used if set to "active".
      Defaults to continuous sampling (TMAG5273_DT_OPER_MODE_CONTINUOUS).

      - 0 # TMAG5273_DT_OPER_MODE_CONTINUOUS (continuous)
      - 1 # TMAG5273_DT_OPER_MODE_STANDBY    (standby)

  axis:
    type: int
    default: 7
    enum: [0, 1, 2, 3, 4, 5, 6, 7, 8, 9, 10, 11]
    description: |
      Magnet axis channel inputs.
      Defaults to measure all axis (TMAG5273_DT_AXIS_XYZ).

      - 0  # TMAG5273_DT_AXIS_NONE
      - 1  # TMAG5273_DT_AXIS_X
      - 2  # TMAG5273_DT_AXIS_Y
      - 3  # TMAG5273_DT_AXIS_Z
      - 4  # TMAG5273_DT_AXIS_XY
      - 5  # TMAG5273_DT_AXIS_XZ
      - 6  # TMAG5273_DT_AXIS_YZ
      - 7  # TMAG5273_DT_AXIS_XYZ
      - 8  # TMAG5273_DT_AXIS_XYX (pseudo-simultaneous sampling)
      - 9  # TMAG5273_DT_AXIS_YXY (pseudo-simultaneous sampling)
      - 10 # TMAG5273_DT_AXIS_YZY (pseudo-simultaneous sampling)
      - 11 # TMAG5273_DT_AXIS_XZX (pseudo-simultaneous sampling)

  temperature:
    type: boolean
    description: |
      Select for temperature measurement.

  range:
    type: int
    default: 1
    enum: [0, 1, 2]
    description: |
      XYZ-measurement range for magnetic-field value.
      Defaults to lower range (higher resolution; TMAG5273_DT_AXIS_RANGE_LOW).

      - 0 # TMAG5273_DT_AXIS_RANGE_LOW      (+/-40 mT (TMAG5273A1) or +/-133 mT (TMAG5273A2))
      - 1 # TMAG5273_DT_AXIS_RANGE_HIGH     (+/-80 mT (TMAG5273A1) or +/-266 mT (TMAG5273A2))
      - 2 # TMAG5273_DT_AXIS_RANGE_RUNTIME  (@runtime (initial value is: "high"))

  int-gpios:
    type: phandle-array
    description: |
      The INT signal connection.

      The signal is active-low as produced by the sensor.
      Either used for interrupt signaling, or triggering a conversion.

  temperature-coefficient:
    type: int
    default: 0
    enum: [0, 1, 2]
    description: |
      Selects the magnet temperature coefficient.
      Defaults to none (TMAG5273_DT_TEMP_COEFF_NONE).

        - 0 # TMAG5273_DT_TEMP_COEFF_NONE    (none)
        - 1 # TMAG5273_DT_TEMP_COEFF_NDBFE   (0.12 %/deg C (NdBFe))
        - 2 # TMAG5273_DT_TEMP_COEFF_CERAMIC (0.2 %/deg C (Ceramic))

      Ignored if temperature is not measured.

  trigger-conversion-via-int:
    type: boolean
    description: |
      Selects initiation of a single conversion based on a trigger via
      the INT-pin if enabled, and via I2C-command if disabled.

      Used in "standby"-, "wakeup-and-sleep"- and "sleep"-mode.
      Using I2C-conversion trigger may result in (handled) I2C-errors.

  angle-magnitude-axis:
    type: int
    default: 0
    enum: [0, 1, 2, 3, 4]
    description: |
      Enables angle calculation, magnetic gain, and offset corrections
      between two selected magnetic channels.
      Defaults to no additional calculations (TMAG5273_DT_ANGLE_MAG_NONE).

      - 0 # TMAG5273_DT_ANGLE_MAG_NONE    (deactivated)
      - 1 # TMAG5273_DT_ANGLE_MAG_XY      (x/y)
      - 2 # TMAG5273_DT_ANGLE_MAG_YZ      (y/z)
      - 3 # TMAG5273_DT_ANGLE_MAG_XZ      (x/z)
      - 4 # TMAG5273_DT_ANGLE_MAG_RUNTIME (@runtime (initial value is: "deactivated"))

  ch-mag-gain-correction:
    type: int
    default: 0
    enum: [0, 1]
    description: |
      Channel for the magnitude gain correction.
      Defaults to 1st channel.

        - 0 # TMAG5273_DT_CORRECTION_CH_1 (1st channel)
        - 1 # TMAG5273_DT_CORRECTION_CH_2 (2nd channel)

      Only active if angle-magnitude-calculation is active.

  average-mode:
    type: int
    default: 1
    enum: [0, 1, 2, 3, 4, 5]
    description: |
      Enables additional sampling of the sensor data to reduce the noise effect
      (or to increase resolution).

      Note that averaging will influence the output data rate.
      Defaults to 2x averaging (TMAG5273_DT_AVERAGING_2X).

      - 0 # TMAG5273_DT_AVERAGING_NONE  (10.0-kSPS (3-axes) or 20-kSPS   (1 axis))
      - 1 # TMAG5273_DT_AVERAGING_2X    (5.7-kSPS  (3-axes) or 13.3-kSPS (1 axis))
      - 2 # TMAG5273_DT_AVERAGING_4X    (3.1-kSPS  (3-axes) or 8.0-kSPS  (1 axis))
      - 3 # TMAG5273_DT_AVERAGING_8X    (1.6-kSPS  (3-axes) or 4.4-kSPS  (1 axis))
      - 4 # TMAG5273_DT_AVERAGING_16X   (0.8-kSPS  (3-axes) or 2.4-kSPS  (1 axis))
      - 5 # TMAG5273_DT_AVERAGING_32X   (0.4-kSPS  (3-axes) or 1.2-kSPS  (1 axis))

  crc-enabled:
    type: boolean
    description: |
      Activate I2C CRC byte to be sent.

  low-noise:
    type: boolean
    description: |
      Select low-noise mode when enabled, and low-power mode when disabled.

  ignore-diag-fail:
    type: boolean
    description: |
      Ignore detected diagnostic fail.
      According to the manual, this should be done if VCC < 2.3V.
```

## dts/bindings/sensor/ti,tmp007.yaml
```yaml
# Copyright (c) 2019, Linaro Limited
# SPDX-License-Identifier: Apache-2.0

description: |
    TMP007 Digital Temperature Sensor.  See datasheet at
    https://cdn-shop.adafruit.com/datasheets/tmp007.pdf

compatible: "ti,tmp007"

include: i2c-device.yaml

properties:
    int-gpios:
      type: phandle-array
      required: false
      description: |
        Identifies the ALERT signal, which is active-low open drain when
        produced by the sensor.
```

## dts/bindings/sensor/ti,tmp1075.yaml
```yaml
# Copyright (c) 2024 Arrow Electronics.
# SPDX-License-Identifier: Apache-2.0

description: |
  TMP1075 Digital Temperature Sensor.  See more info at
  https://www.ti.com/product/TMP1075

compatible: "ti,tmp1075"

include: [sensor-device.yaml, i2c-device.yaml]

properties:
  conversion-rate:
    description: Conversion rate in us.
    type: int
    enum:
      - 27500 # 27.5ms
      - 55000 # 55ms
      - 110000 # 110ms
      - 220000 # 220ms
  alert-gpios:
    type: phandle-array
    description: |
      Identifies the ALERT signal, which is active-low open drain when
      produced by the sensor.
  one-shot-conversion:
    description: One-shot conversion mode.
    type: boolean
  consecutive-fault-measurements:
    description: Number of consecutive measured faults that will trigger the alert.
    type: int
    enum:
      - 1
      - 2
      - 3
      - 4
  alert-pin-active-high:
    description: Polarity of the alert pin.
    type: boolean
  interrupt-mode:
    description: Selects the function of the ALERT pin.
    type: boolean
  shutdown-mode:
    description: Sets the device in shutdown mode to conserve power.
    type: boolean
  lower-threshold:
    description: Lower threshold for alert interrupt. Expressed in degrees C.
    type: int
  upper-threshold:
    description: Upper threshold for alert interrupt. Expressed in degrees C.
    type: int
```

## dts/bindings/sensor/ti,tmp108.yaml
```yaml
# Copyright (c) 2021 Jimmy Johnson <catch22@fastmail.net>
# Copyright (c) 2022 T-Mobile USA, Inc.
# SPDX-License-Identifier: Apache-2.0

description: |
    TMP108 Digital Temperature Sensor.  See more info at
    https://www.ti.com/product/TMP108

compatible: "ti,tmp108"

include: [sensor-device.yaml, i2c-device.yaml]

properties:
  alert-gpios:
    type: phandle-array
    description: |
      Identifies the ALERT signal, which is active-low open drain when
      produced by the sensor.
```

## dts/bindings/sensor/ti,tmp112.yaml
```yaml
# Copyright (c) 2019, Linaro Limited
# SPDX-License-Identifier: Apache-2.0

description: |
    TMP112 Digital Temperature Sensor.  See more info at
    https://www.ti.com/product/TMP112

compatible: "ti,tmp112"

include: [sensor-device.yaml, i2c-device.yaml]

properties:
  conversion-rate:
    description: Conversion rate in mHz (milli-Hertz)
    type: int
    default: 4000
    enum:
      - 250
      - 1000
      - 4000
      - 8000

  extended-mode:
    description: When true use 13-bit data format allowing measuring temperature up to 150°C
    type: boolean

  t-low-micro-c:
    description: |
      Sets the default tLow threshold in micro-Celsius. The default value is the chip reset
      value.
    type: int
    default: 75000000

  t-high-micro-c:
    description: |
      Sets the default tHigh threshold in micro-Celsius. The default value is the chip reset
      value.
    type: int
    default: 85000000
```

## dts/bindings/sensor/ti,tmp114.yaml
```yaml
# Copyright (c) 2024 Fredrik Gihl
# SPDX-License-Identifier: Apache-2.0

description: Texas Instruments TMP114 temperature sensor

compatible: "ti,tmp114"

include: [sensor-device.yaml, i2c-device.yaml]

properties:
  odr:
    type: int
    default: 4
    enum: [0, 1, 2, 3, 4, 5, 6, 7]
    description: |
      Specify the default temperature output data rate in milliseconds (ms).
      Default is power-up configuration (250ms).

      - 0    # TMP114_DT_ODR_6_4_MS
      - 1    # TMP114_DT_ODR_32_25_MS
      - 2    # TMP114_DT_ODR_62_5_MS
      - 3    # TMP114_DT_ODR_125_MS
      - 4    # TMP114_DT_ODR_250_MS
      - 5    # TMP114_DT_ODR_500_MS
      - 6    # TMP114_DT_ODR_1000_MS
      - 7    # TMP114_DT_ODR_2000_MS

  oversampling:
    type: boolean
    description: |
      Set averaging of samples.
```
