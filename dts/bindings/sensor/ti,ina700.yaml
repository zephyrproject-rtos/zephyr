## dts/bindings/sensor/vishay,veml6046.yaml
```yaml
# Copyright (c) 2025 Andreas Klinger
# SPDX-License-Identifier: Apache-2.0

description: |
    Vishay VEML6046 RGBIR color sensor with I2C interface.
    See: https://www.vishay.com/docs/80173/veml6046x00.pdf

compatible: "vishay,veml6046"

include: [sensor-device.yaml, i2c-device.yaml]
```

## dts/bindings/sensor/vishay,veml7700.yaml
```yaml
# Copyright (c) 2023 Andreas Kilian
# SPDX-License-Identifier: Apache-2.0

description: |
    Vishay VEML7700 High Accuracy Ambient Light Sensor With I2C Interface.
    See: https://www.vishay.com/doc?84286

compatible: "vishay,veml7700"

include: [sensor-device.yaml, i2c-device.yaml]

properties:
  psm-mode:
    type: int
    default: 0x00
    description: |
      Power saving mode as described in the datasheet on page 8.
      The initial power on register value for the PSM register is 0
      (power saving mode is disabled) which is the default value.
      Possible values are:
        0x00 = Disable power saving mode
        0x01 = Mode 1 (0001b)
        0x03 = Mode 2 (0011b)
        0x05 = Mode 3 (0101b)
        0x07 = Mode 4 (0111b)
    enum:
      - 0x00
      - 0x01
      - 0x03
      - 0x05
      - 0x07
```

## dts/bindings/sensor/we,wsen-hids-2525020210001/we,wsen-hids-2525020210001-i2c.yaml
```yaml
# Copyright (c) 2023 Würth Elektronik eiSos GmbH & Co. KG
# SPDX-License-Identifier: Apache-2.0

description: |
    Würth Elektronik WSEN-HIDS-2525020210001 humidity sensor with
    integrated temperature sensor (I2C bus)

compatible: "we,wsen-hids-2525020210001"

include: ["i2c-device.yaml", "we,wsen-hids-2525020210001-common.yaml"]
```
