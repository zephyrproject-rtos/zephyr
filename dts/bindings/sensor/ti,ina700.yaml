## dts/bindings/sensor/ti,ina700.yaml
```yaml
# Original license from ina23x driver:
# 	Copyright 2021 The Chromium OS Authors
# 	Copyright 2021 Grinn
#
# Copyright 2024, Remie Lowik
#
# SPDX-License-Identifier: Apache-2.0

description: |
  TI INA700 Current and Power Monitor.
  The <zephyr/dt-bindings/sensor/ina700.h> file should be included in the
  DeviceTree and it provides macro that can be used for initializing the
  configuration register.

compatible: "ti,ina700"

include: [sensor-device.yaml, i2c-device.yaml]

properties:
  conversion-delay:
    type: int
    default: 0
    description: |
      Initial ADC conversion delay in steps of 2 ms, 0 = 0 ms, 1 = 2 ms, 255 = 510 ms

  adc-mode:
    type: string
    description: |
      ADC channel conversion configuration.
    default: "Continuous temperature, current, and bus voltage"
    enum:
      - "Shutdown"
      - "Triggered bus voltage, single shot"
      - "Reserved"
      - "Reserved"
      - "Triggered temperature, single shot"
      - "Triggered temperature and bus voltage, single shot"
      - "Triggered temperature and current, single shot"
      - "Triggered temperature, current and bus voltage, single shot"
      - "Shutdown"
      - "Continuous bus voltage only"
      - "Reserved"
      - "Reserved"
      - "Continuous temperature only"
      - "Continuous bus voltage and temperature"
      - "Continuous temperature and current"
      - "Continuous temperature, current, and bus voltage"

  vbus-conversion-time-us:
    type: int
    description: |
      Vbus conversion time in microseconds.
    default: 1052
    enum: [50, 84, 150, 280, 540, 1052, 2074, 4120]

  vshunt-conversion-time-us:
    type: int
    description: |
      Vshunt conversion time in microseconds.
    default: 1052
    enum: [50, 84, 150, 280, 540, 1052, 2074, 4120]

  temperature-conversion-time-us:
    type: int
    description: |
      Temperature conversion time in microseconds.
    default: 1052
    enum: [50, 84, 150, 280, 540, 1052, 2074, 4120]

  avg-count:
    type: int
    description: |
      Number of samples to average (applies to all inputs).
    default: 1
    enum: [1, 4, 16, 64, 128, 256, 512, 1024]

  alatch:
    type: string
    default: "Transparant"
    description: |
      When the Alert Latch Enable bit is set to Transparent mode,
        the Alert pin and Flag bit reset to the idle state when the fault has been cleared.
      When the Alert Latch Enable bit is set to Latch mode,
        the Alert pin and Alert Flag bit remain active follow
    enum:
      - "Transparant"
      - "Latched"

  conversion-ready:
    type: string
    default: "Disable conversion ready flag on ALERT pin"
    description: |
      Setting this bit high configures the Alert pin to be asserted when the Conversion Ready Flag (bit 1)
        is asserted, indicating that a conversion cycle is complete
    enum:
      - "Disable conversion ready flag on ALERT pin"
      - "Enables conversion ready flag on ALERT pin"

  slow-alert:
    type: string
    default: "ALERT comparison on non-averaged (ADC) value"
    description: |
      When enabled, ALERT function is asserted on the completed averaged value.
      This gives the flexibility to delay the ALERT until after the averaged value.
    enum:
      - "ALERT comparison on non-averaged (ADC) value"
      - "ALERT comparison on averaged value"

  alert-polarity:
    type: string
    default: "Normal (active-low, open-drain)"
    description: |
      Alert Polarity bit sets the Alert pin polarity.
    enum:
      - "Normal (active-low, open-drain)"
      - "Inverted (active-high, open-drain)"

  current-over-limit-threshold:
    type: int
    default: 0x7FFF
    description: Sets the threshold for comparison of the value to detect overcurrent
      condition (overcurrent protection). 2's-complement value

  current-under-limit-threshold:
    type: int
    default: 0x8000
    description: Sets the threshold for comparison of the value to detect undercurrent
      condition. 2's-complement value

  bus-overvoltage-threshold:
    type: int
    default: 0x7FFF
    description: Sets the threshold for comparison of the value to detect Bus
      Overvoltage (overvoltage protection). Unsigned representation,
      positive value only. Conversion factor = 3.125 mV/LSB

  bus-undervoltage-threshold:
    type: int
    default: 0
    description: Sets the threshold for comparison of the value to detect Bus
      Undervoltage (undervoltage protection). Unsigned representation,
      positive value only. Conversion factor = 3.125 mV/LSB.

  temperature-over-limit-threshold:
    type: int
    default: 0x7FFF
    description: |
      Sets the threshold for comparison of the value to detect
      overtemperature measurements. 2's-complement value.
      The value entered in this field compares directly against the value
      from the DIETEMP register to determine if an overtemperature
      condition exists. Conversion factor = 7.8125 m°C/LSB.

  power-over-limit-threshold:
    type: int
    default: 0xFFFF
    description: |
      Sets the threshold for comparison of the value to detect power overlimit measurements.
      Unsigned representation, positive value only.
      The value entered in this field compares directly against the value
      from the POWER register to determine if an over power condition
      exists. Conversion factor = 24.576 mW/LSB.

  alert-gpios:
    type: phandle-array
    description: Alert pin
```

## dts/bindings/sensor/ti,ina7xx.yaml
```yaml
# Copyright The Zephyr Project Contributors
# SPDX-License-Identifier: Apache-2.0

description: Texas Instruments Bidirectional Current/Power Sensor

compatible: "ti,ina7xx"

include: [sensor-device.yaml, i2c-device.yaml]

properties:
  inatype:
    type: int
    required: true
    description: |
      select type of INA7xx device.
      1 = INA700
      2 = INA745/746
      3 = INA780/781
    enum:
      - 0
      - 1
      - 2

  convdly:
    type: int
    default: 0
    description: |
      Sets the Delay for initial ADC conversion in steps of 2 ms.
      The default is the power-on reset value.
      0h = 0 ms (default)
      1h = 2 ms
      FFh = 510 ms

  mode:
    type: int
    default: 0xf
    description: |
      MODE for continuous or triggered measurement mode.
      The default is the power-on reset value.
      0h = Shutdown
      1h = Triggered bus voltage, single shot
      4h = Triggered temperature, single shot
      5h = Triggered temperature and bus voltage, single shot
      6h = Triggered temperature and current, single shot
      7h = Triggered temperature, current and bus voltage, single shot
      8h = Shutdown
      9h = Continuous bus voltage only
      Ch = Continuous temperature only
      Dh = Continuous bus voltage and temperature
      Eh = Continuous temperature and current
      Fh = Continuous temperature, current, and bus voltage (default)
    enum:
      - 0x0
      - 0x1
      - 0x4
      - 0x5
      - 0x6
      - 0x7
      - 0x8
      - 0x9
      - 0xc
      - 0xd
      - 0xe
      - 0xf

  vbusct:
    type: int
    default: 5
    description: |
      Sets the conversion time of the bus voltage measurement.
      The default is the power-on reset value.
      0h = 50 µs
      1h = 84 µs
      2h = 150 µs
      3h = 280 µs
      4h = 540 µs
      5h = 1052 µs (default)
      6h = 2074 µs
      7h = 4120 µs
    enum:
      - 0
      - 1
      - 2
      - 3
      - 4
      - 5
      - 6
      - 7

  vsenct:
    type: int
    default: 5
    description: |
      Sets the conversion time of the shunt resistor voltage. Works in
      conjunction with the temperature conversion time. Total conversion
      time for a current measurement is the sum of VSENCT and TCT
      selections.
      The default is the power-on reset value.
      0h = 50 µs
      1h = 84 µs
      2h = 150 µs
      3h = 280 µs
      4h = 540 µs
      5h = 1052 µs (default)
      6h = 2074 µs
      7h = 4120 µs
    enum:
      - 0
      - 1
      - 2
      - 3
      - 4
      - 5
      - 6
      - 7

  tct:
    type: int
    default: 5
    description: |
      Sets the conversion time of the temperature measurement. Works
      in conjunction with the shunt voltage conversion time for current
      measurements. Total conversion time for a current measurement is
      the sum of VSENCT and TCT selections.
      The default is the power-on reset value.
      0h = 50 µs
      1h = 84 µs
      2h = 150 µs
      3h = 280 µs
      4h = 540 µs (default)
      5h = 1052 µs
      6h = 2074 µs
      7h = 4120 µs
    enum:
      - 0
      - 1
      - 2
      - 3
      - 4
      - 5
      - 6
      - 7

  avg:
    type: int
    default: 0
    description: |
      Selects ADC sample averaging count. The averaging setting applies
      to all active inputs.
      When >0h, the output registers are updated after the averaging has
      completed.
      The default is the power-on reset value.
      0h = 1 (default)
      1h = 4
      2h = 16
      3h = 64
      4h = 128
      5h = 256
      6h = 512
      7h = 1024
    enum:
      - 0
      - 1
      - 2
      - 3
      - 4
      - 5
      - 6
      - 7
```

## dts/bindings/sensor/ti,lm73c.yaml
```yaml
# Copyright (c) 2021, SER Consulting LLC / Steven Riedl
# SPDX-License-Identifier: Apache-2.0

description: |
    TI lm73c 11- to 14-Bit Digital Temperature Sensor. See
    https://www.ti.com/lit/ds/symlink/lm73.pdf

compatible: "ti,lm73c"

include: i2c-device.yaml

properties:
    temp-prec:
      type: int
      required: false
      default: 14
      # default to 14 bits .03125 deg C
      description: Bits of temperature precision
      enum:
        - 11
        - 12
        - 13
        - 14
```

## dts/bindings/sensor/ti,opt3001.yaml
```yaml
# Copyright (c) 2019, Actinius
# SPDX-License-Identifier: Apache-2.0

description: Texas Instruments OPT3001 ambient light sensor

compatible: "ti,opt3001"

include: [sensor-device.yaml, i2c-device.yaml]

properties:
  int-gpios:
    type: phandle-array
    description: |
      Interrupt pin on the opt3001 where the default polarity is active low.
```

## dts/bindings/sensor/ti,opt3004.yaml
```yaml
# Copyright (c) 2019, Actinius
# SPDX-License-Identifier: Apache-2.0

description: Texas Instruments OPT3004 ambient light sensor

compatible: "ti,opt3004"

include: ti,opt300x.yaml
```

## dts/bindings/sensor/ti,opt300x.yaml
```yaml
# Copyright (c) 2019, Actinius
# SPDX-License-Identifier: Apache-2.0

description: Texas Instruments OPT300X ambient light sensor

include: [sensor-device.yaml, i2c-device.yaml]

properties:
  int-gpios:
    type: phandle-array
    description: |
      Interrupt pin on the opt300x where the default polarity is active low.
```

## dts/bindings/sensor/ti,tmag3001.yaml
```yaml
# SPDX-License-Identifier: Apache-2.0
description: |
  TMAG3001 Low-Power 3D Linear and Angle Hall-Effect Sensor With I2C Interface
  and Wake Up Detection in WCSP.

  See the specification for the default I2C address.

  The specification of the sensor can be found at:
    https://www.ti.com/lit/ds/symlink/tmag3001.pdf

  Currently, this driver shares implementation with tmag5273. When setting the
  enum properties in a .dts or .dtsi file you may include
  `zephyr/dt-bindings/sensor/tmag5273.h` and use the macros defined there.

compatible: "ti,tmag3001"

include: ["ti,tmag5273.yaml"]
```
