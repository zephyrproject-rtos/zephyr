## dts/bindings/sensor/ti,tmp116.yaml
```yaml
# Copyright (c) 2019 Centaur Analytics, Inc
# SPDX-License-Identifier: Apache-2.0

description: Texas Instruments TMP116 temperature sensor

compatible: "ti,tmp116"

bus: tmp116

include: [sensor-device.yaml, i2c-device.yaml]

properties:
  odr:
    type: int
    default: 0x200
    enum: [0, 0x80, 0x100, 0x180, 0x200, 0x280, 0x300, 0x380]
    description: |
      Specify the default temperature output data rate in milliseconds (ms).
      Default is power-up configuration.

      - 0     # TMP116_DT_ODR_15_5_MS
      - 0x80  # TMP116_DT_ODR_125_MS
      - 0x100 # TMP116_DT_ODR_250_MS
      - 0x180 # TMP116_DT_ODR_500_MS
      - 0x200 # TMP116_DT_ODR_1000_MS
      - 0x280 # TMP116_DT_ODR_4000_MS
      - 0x300 # TMP116_DT_ODR_8000_MS
      - 0x380 # TMP116_DT_ODR_16000_MS
  oversampling:
    type: int
    default: 0x20
    enum: [0, 0x20, 0x40, 0x60]
    description: |
      Set number of sample to averaging in one readout.
      Default is power-up configuration (8 samples).

      - 0    # TMP116_DT_OVERSAMPLING_1
      - 0x20 # TMP116_DT_OVERSAMPLING_8
      - 0x40 # TMP116_DT_OVERSAMPLING_32
      - 0x60 # TMP116_DT_OVERSAMPLING_64
```

## dts/bindings/sensor/ti,tmp11x.yaml
```yaml
# Copyright (c) 2019 Centaur Analytics, Inc
# SPDX-License-Identifier: Apache-2.0

description: Texas Instruments TMP11X temperature sensor

compatible: "ti,tmp11x"

bus: tmp11x

include: [sensor-device.yaml, i2c-device.yaml]

properties:
  odr:
    type: int
    default: 0x200
    enum: [0, 0x80, 0x100, 0x180, 0x200, 0x280, 0x300, 0x380]
    description: |
      Specify the default temperature output data rate in milliseconds (ms).
      Default is power-up configuration.

      - 0     # TMP11X_DT_ODR_15_5_MS
      - 0x80  # TMP11X_DT_ODR_125_MS
      - 0x100 # TMP11X_DT_ODR_250_MS
      - 0x180 # TMP11X_DT_ODR_500_MS
      - 0x200 # TMP11X_DT_ODR_1000_MS
      - 0x280 # TMP11X_DT_ODR_4000_MS
      - 0x300 # TMP11X_DT_ODR_8000_MS
      - 0x380 # TMP11X_DT_ODR_16000_MS
  oversampling:
    type: int
    default: 0x20
    enum: [0, 0x20, 0x40, 0x60]
    description: |
      Set number of sample to averaging in one readout.
      Default is power-up configuration (8 samples).
      - 0    # TMP11X_DT_OVERSAMPLING_1
      - 0x20 # TMP11X_DT_OVERSAMPLING_8
      - 0x40 # TMP11X_DT_OVERSAMPLING_32
      - 0x60 # TMP11X_DT_OVERSAMPLING_64
  alert-polarity:
    type: boolean
    description: |
      Set alert polarity to active high (true) or active low (false).
      Default is power-up configuration (active low).
  alert-mode:
    type: boolean
    description: |
      Set alert mode to one of the following:
      - 0: Alert mode (default)
      - 1: Therm mode
  alert-dr-sel:
    type: boolean
    description: |
      Set alert pin mode to one of the following:
      - 0: ALERT pin reflects the status of the alert flags
      - 1: ALERT pin reflects the status of the data ready flag
  alert-gpios:
    type: phandle-array
    description: |
      GPIO pin used for alert/interrupt functionality.
      Supported on TMP116, TMP117, and TMP119 devices.
      Alert pin functionality depends on Therm/alert modus.
  store-attr-values:
    type: boolean
    description: |
      Enable storage of sensor attribute values in EEPROM. On reset, the device
      goes through a POR sequence that loads the values programmed in the
      EEPROM into the respective register map locations.

      The following values are supported by the sensor:
      High limit register, low limit register, conversion cycle time, averaging
      mode, conversion mode (continuous or shutdown mode), alert function mode
      (alert or therm mode), alert polarity, and temperature offset (not
      specified in datasheet).
```

## dts/bindings/sensor/ti,tmp435.yaml
```yaml
#
# Copyright (c) 2024 Bittium Corporation
#
# SPDX-License-Identifier: Apache-2.0
#

description: Texas Instruments TMP435 temperature sensor

compatible: "ti,tmp435"

bus: tmp435

include: [sensor-device.yaml, i2c-device.yaml]

properties:
  external-channel:
    description: External temperature measurement is enabled
    type: boolean
  resistance-correction:
    description: |
      Resistance correction feature for the external
      temperature channel. If not enabled then conversion
      is faster but with lower accuracy.
    type: boolean
  beta-compensation:
    description: |
      Beta Compensation Configuration, see Table 8
      from TMP435 data sheet, some common values.
      0x0f, Automatically selected range 7 (beta > 27.0) or
      Automatically detected diode connected sensor
      0x07, Manually disabled beta correction
      Default is common value for general purpose transistors.
    type: int
    default: 0x0f
    enum: [0x00, 0x01, 0x02, 0x03, 0x04, 0x05, 0x06, 0x07,
           0x08, 0x09, 0x0a, 0x0b, 0x0c, 0x0d, 0x0e, 0x0f]
```

## dts/bindings/sensor/ti,tmp451.yaml
```yaml
# Copyright (c) 2026 Open Device Partnership and Contributors
# SPDX-License-Identifier: Apache-2.0

description: |
  Texas Instruments TMP451 remote and local temperature sensor.
  See https://www.ti.com/product/TMP451

compatible: "ti,tmp451"

include: [sensor-device.yaml, i2c-device.yaml]

properties:
  conversion-rate-microhz:
    description: |
      Conversion rate in micro-Hz. Controls how often the sensor
      performs temperature conversions in continuous mode.
        62500    = 0.0625 Hz (16s)
        125000   = 0.125 Hz (8s)
        250000   = 0.25 Hz (4s)
        500000   = 0.5 Hz (2s)
        1000000  = 1 Hz (1s)
        2000000  = 2 Hz (500ms)
        4000000  = 4 Hz (250ms)
        8000000  = 8 Hz (125ms)
        16000000 = 16 Hz (63ms)
        32000000 = 32 Hz (32ms)
      Defaults to 16000000 (16 Hz), which matches POR value.
    type: int
    enum:
      - 62500
      - 125000
      - 250000
      - 500000
      - 1000000
      - 2000000
      - 4000000
      - 8000000
      - 16000000
      - 32000000
    default: 16000000
  therm-hysteresis:
    description: |
      THERM hysteresis value in deg C. Defines how far below the
      THERM limit the temperature must drop before the THERM output is
      de-asserted.
      Valid range: 0 to 255.
      Defaults to 10, which matches POR value.
    type: int
    default: 10
  ideality-factor:
    description: |
      Ideality factor (eta-factor) correction register value for the remote diode.
      See Table 27 in the TMP451 datasheet for the mapping between
      register value and effective ideality factor.
      Valid range: -128 to 127.
      Defaults to 0 (eta = 1.008), which matches POR value.
    type: int
    default: 0
  digital-filter:
    description: |
      Digital filter control register value. Enables the on-chip digital
      filter on the remote temperature channel.
        0 = filter disabled
        1 = filter level 1 enabled (averages last 4 samples)
        2 = filter level 2 enabled (averages last 8 samples)
      Defaults to 0 (disabled), which matches POR value.
    type: int
    enum:
      - 0
      - 1
      - 2
    default: 0
  remote-offset-millicelsius:
    description: |
      Remote temperature offset in milli-deg C. This value is
      added to the remote ADC result to compensate for system-level
      calibration errors. The TMP451 offset register has 0.0625 deg C
      resolution.
      Valid range: -128000 to 127937.
      Defaults to 0, which matches POR value.
    type: int
    default: 0
  local-therm-limit:
    description: |
      Local temperature THERM limit in deg C.
      When the local temperature exceeds this value, the THERM output (pin 4) is asserted.
      Valid range: -64 to 191.
      Defaults to 85, which matches POR value (but raw value adjusted for extended range).
    type: int
    default: 85
  remote-therm-limit:
    description: |
      Remote temperature THERM limit in deg C.
      When the remote temperature exceeds this value, the THERM output (pin 4) is asserted.
      Valid range: -64 to 191.
      Defaults to 108, which matches POR value (but raw value adjusted for extended range).
    type: int
    default: 108
  pin6-mode:
    description: |
      Configures the function of pin 6 (ALERT/THERM2).
      Note: Software triggers only support the ALERT configuration; the driver assumes
      if this pin is configured for THERM2 it will not be used as an interrupt.
        "alert" = latching; triggers on any limit violation or remote diode open
        "therm2" = non-latching; triggers on high limit exceeded only, self-clears with hysteresis
      Defaults to "alert", which matches POR value.
    type: string
    enum:
      - "alert"
      - "therm2"
    default: "alert"
  consecutive-alerts:
    description: |
      Number of consecutive out-of-limit measurements required before the ALERT pin is asserted.
      Note: Only applies when pin6-mode is configured as ALERT.
      Defaults to 1, which matches POR value.
    type: int
    enum:
      - 1
      - 2
      - 3
      - 4
    default: 1
  alert-gpios:
    type: phandle-array
    description: |
      GPIO connected to the ALERT pin (pin 6).
      Active-low, open-drain output.
      Note: The driver only supports this if pin6-mode is configured as ALERT.
```

## dts/bindings/sensor/ti,vtm.yaml
```yaml
# SPDX-License-Identifier: Apache-2.0
# SPDX-FileCopyrightText: Copyright (c) 2026 Texas Instruments

description: |
  TI Voltage and Thermal Management driver

  The VTM module provides thermal management capabilities including:
  - Multiple temperature sensors (up to 8)
  - Configurable temperature thresholds with interrupt support
  - Thermal shutdown capabilities

compatible: "ti,vtm"

include: [base.yaml, power-domain.yaml]

properties:
  reg:
    required: true

  reg-names:
    required: true
    enum:
      - "cfg1"
      - "cfg2"

  interrupts:
    required: true

  interrupt-names:
    required: true
    enum:
      - "th0"
      - "th1"
      - "th2"

  ti,maxt-outrg-thresh:
    type: int
    required: true
    description: |
      Maximum outrange alert trigger threshold in millidegree Celsius.
      When any enabled sensor exceeds this value, outrange alert is
      asserted causing a warm reset.

  ti,maxt-outrg-thresh0:
    type: int
    required: true
    description: |
      Maximum outrange alert recovery threshold in millidegree Celsius.
      Alert deasserts when temperature drops below this value.

child-binding:
  description: |
    VTM temperature sensor instances. Each child node represents an individual
    temperature sensor with its own thresholds and semantic meaning.

  properties:
    reg:
      type: int
      required: true
      description: |
        Sensor ID within the VTM controller (0-7).
        Must be within the range of sensors available on the SoC.
      enum: [0, 1, 2, 3, 4, 5, 6, 7]

    ti,voltage-domain:
      type: int
      required: true
      description: |
        Voltage domain index this sensor belongs to (0-7).
        Used for VD interrupts.
      enum: [0, 1, 2, 3, 4, 5, 6, 7]
```

## dts/bindings/sensor/vishay,vcnl36825t.yaml
```yaml
# Copyright (c) 2024 Juliane Schulze, deveritec GmbH
# SPDX-License-Identifier: Apache-2.0

description: |
  VCNL36825T proximity and ambient light sensor.  See datasheet at
  https://www.vishay.com/docs/84274/vcnl36825t.pdf

compatible: "vishay,vcnl36825t"

include: [sensor-device.yaml, i2c-device.yaml]

properties:
  operation-mode:
    type: string
    default: "auto"
    enum: ["auto", "force"]
    description: |
      Mode of operation.
      - "auto": the sensor performs sampling continuously,
      - "force": the sampling is performed on every fetch command.

      Defaults to sensor reset value.

  measurement-period:
    type: int
    default: 40
    enum: [10, 20, 40, 80, 160, 320]
    description: |
      Measurement period of the sensors in ms.
      Higher values yield lower power consumption.
      Note:
        - [10, 80] ms only if low power mode is inactive
        - [80, 320] ms only in low power mode

      Defaults to 40 ms which is supported in both normal and low-power mode.

  proximity-it:
    type: string
    default: "1"
    enum: ["1", "1.5", "2", "2.5", "3", "3.5", "4", "8"]
    description: |
      Proximity integration time in T.
      Defaults to sensor reset value.

  proximity-itb:
    type: int
    default: 25
    enum: [25, 50]
    description: |
      Duration of the proximity integration time T in us.
      Defaults to sensor reset value.

  multi-pulse:
    type: int
    default: 1
    enum: [1, 2, 4, 8]
    description: |
      Number of pulses per single measurement.
      Higher values increase accuracy and power consumption.
      Defaults to sensor reset value.

  laser-current:
    type: int
    default: 10
    enum: [10, 12, 14, 16, 18, 20]
    description: |
      Current used by the laser during measurement periods.
      Defaults to minimum allowed value.

  low-power:
    type: boolean
    description: |
      Activate low power mode.
      This allows to increase the measurement period up to 320 ms.

  high-gain:
    type: boolean
    description: |
      Activate the high gain mode.

  sunlight-cancellation:
    type: boolean
    description: |
      Activate sunlight cancellation.

  high-dynamic-output:
    type: boolean
    description: |
      Activate 16bit high dynamic output mode.
      Cannot be used with threshold interrupt.
```

## dts/bindings/sensor/vishay,vcnl4040.yaml
```yaml
# Copyright (c) 2020 Richard Osterloh
# SPDX-License-Identifier: Apache-2.0

description: |
    VCNL4040 proximity and ambient light sensor.  See datasheet at
    https://www.vishay.com/docs/84274/vcnl4040.pdf

compatible: "vishay,vcnl4040"

include: [sensor-device.yaml, i2c-device.yaml]

properties:
  int-gpios:
    type: phandle-array
    description: |
      The INT pin signals that a programmable interrupt function
      for ALS and PS with upper and lower thresholds has been
      triggered. The sensor generates an active-low level signal
      which remains asserted until the data is read.

  led-current:
    type: int
    default: 50
    # default of 50 mA is POR (0b000) for PS_MS[LED_I] register
    description: LED current in mA
    enum:
      - 50
      - 75
      - 100
      - 120
      - 140
      - 160
      - 180
      - 200

  led-duty-cycle:
    type: int
    default: 40
    # default of 40 Hz is POR (0b00) for PS_CONF1[PS_Duty] register
    description: LED duty cycle in Hz
    enum:
      - 40
      - 80
      - 160
      - 320

  proximity-it:
    type: string
    default: "1"
    # default of 1 is POR (0b000) for PS_CONF2[PS_IT] register
    description: Proximity integration time in T
    enum:
      - "1"
      - "1.5"
      - "2"
      - "2.5"
      - "3"
      - "3.5"
      - "4"
      - "8"

  proximity-trigger:
    type: string
    default: "disabled"
    # default of "disabled" is POR (0b00) for PS_CONF2[PS_INT] register
    description: Proximity trigger type
    enum:
      - "disabled"
      - "close"
      - "away"
      - "close-away"

  als-it:
    type: int
    default: 80
    # default of 80 is POR (0b00) for ALS_CONF[ALS_IT] register
    description: ALS integration time in ms
    enum:
      - 80
      - 160
      - 320
      - 640
```

## dts/bindings/sensor/vishay,veml6031.yaml
```yaml
# Copyright (c) 2025 Andreas Klinger
# SPDX-License-Identifier: Apache-2.0

description: |
    Vishay VEML6031 High Accuracy Ambient Light Sensor With I2C Interface.
    See: https://www.vishay.com/docs/80007/veml6031x00.pdf

compatible: "vishay,veml6031"

include: [sensor-device.yaml, i2c-device.yaml]
```
