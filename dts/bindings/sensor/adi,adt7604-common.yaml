## dts/bindings/sensor/bosch,bmi260.yaml
```yaml
# Copyright (c) 2026 Shreyas Acharya
# SPDX-License-Identifier: Apache-2.0

description: |
    The BMI260 is a 6-axis inertial measurement unit combining a 16-bit
    accelerometer and a 16-bit gyroscope, and reporting its own die
    temperature. See more info at:
    https://www.bosch-sensortec.com/products/motion-sensors/imus/bmi260.html

include: sensor-device.yaml

compatible: "bosch,bmi260"

properties:
  irq-gpios:
    type: phandle-array
    description: |
      The INT1 and, optionally, INT2 signal connections. Index 0 is INT1 and
      index 1 is INT2. Without this property the sensor can only be polled
      and sensor_trigger_set() reports -ENOTSUP.

  accel-odr:
    type: int
    default: 100
    description: |
      Accelerometer output data rate in Hz, applied at initialization.
      Defaults to 100 Hz, the reset value of ACC_CONF.acc_odr.
    enum: [25, 50, 100, 200, 400, 800, 1600]

  accel-range:
    type: int
    default: 2
    description: |
      Accelerometer full-scale range in g, applied at initialization.
      Defaults to 2 g, which is less than the reset value of 8 g but is the
      most commonly useful setting and the one with the finest resolution.
    enum: [2, 4, 8, 16]

  gyro-odr:
    type: int
    default: 100
    description: |
      Gyroscope output data rate in Hz, applied at initialization. Defaults
      to 100 Hz, below the reset value of 200 Hz, to match accel-odr so that
      both sensors produce a sample per data-ready interrupt.
    enum: [25, 50, 100, 200, 400, 800, 1600, 3200]

  gyro-range:
    type: int
    default: 2000
    description: |
      Gyroscope full-scale range in degrees per second, applied at
      initialization. Defaults to 2000 dps, the reset value of
      GYR_RANGE.gyr_range.
    enum: [125, 250, 500, 1000, 2000]
```

## dts/bindings/sensor/bosch,bmp280.yaml
```yaml
# Copyright (c) 2026 NBuiLe
# SPDX-License-Identifier: Apache-2.0

description: |
    Bosch BMP280 pressure and temperature sensor accessed through I2C bus

compatible: "bosch,bmp280"

include: [i2c-device.yaml, sensor-device.yaml]

properties:
  osrs-temp:
    type: int
    default: 1
    description: |
      Temperature oversampling rate:
        0: Skipped
        1: x1 (16-bit / 0.0050 °C)
        2: x2 (17-bit / 0.0025 °C)
        3: x4 (18-bit / 0.0012 °C)
        4: x8 (19-bit / 0.0006 °C)
        5: x16 (20-bit / 0.0003 °C)
    enum: [0, 1, 2, 3, 4, 5]

  osrs-press:
    type: int
    default: 3
    description: |
      Pressure oversampling rate:
        0: Skipped
        1: x1 (Ultra low power)
        2: x2 (Low power)
        3: x4 (Standard resolution)
        4: x8 (High resolution)
        5: x16 (Ultra high resolution)
    enum: [0, 1, 2, 3, 4, 5]

  mode:
    type: int
    default: 3
    description: |
      Sensor power mode:
        0: Sleep mode
        1: Forced mode
        3: Normal mode
    enum: [0, 1, 3]

  t-sb:
    type: int
    default: 5
    description: |
      Standby duration in normal mode:
        0: 0.5 ms
        1: 62.5 ms
        2: 125 ms
        3: 250 ms
        4: 500 ms
        5: 1000 ms
        6: 2000 ms
        7: 4000 ms
    enum: [0, 1, 2, 3, 4, 5, 6, 7]

  filter:
    type: int
    default: 0
    description: |
      IIR filter time constant coefficient:
        0: Filter off
        1: 2
        2: 4
        3: 8
        4: 16
    enum: [0, 1, 2, 3, 4]
```

## dts/bindings/sensor/bosch,bmp384-spi.yaml
```yaml
# Copyright (c) 2026 Embeint Holdings Pty Ltd
# SPDX-License-Identifier: Apache-2.0

description: |
    Bosch BMP384 pressure sensor accessed through SPI bus

    Variant of the BMP388 with a gel-filled package for robustness against
    liquids, at slightly lower accuracy.

compatible: "bosch,bmp384"

include: [spi-device.yaml, "bosch,bmp388.yaml"]
```

## dts/bindings/sensor/dfrobot,sen0466.yaml
```yaml
# Copyright (c) 2026, Iomico
# SPDX-License-Identifier: Apache-2.0

description: |
  DFRobot SEN0466 electrochemical carbon monoxide sensor.
  Provides CO concentration and on-board temperature readings via I2C.

compatible: "dfrobot,sen0466"

include: [sensor-device.yaml, i2c-device.yaml]
```

## dts/bindings/sensor/invensense,itg3200.yaml.yaml
```yaml
# Copyright (c) 2026 NBuiLe
# SPDX-License-Identifier: Apache-2.0

description: InvenSense ITG-3200 3-Axis Digital Gyroscope

compatible: "invensense,itg3200"

include: [sensor-device.yaml, i2c-device.yaml]

properties:
  smplrt-div:
    type: int
    default: 9
    description: |
      Sample Rate Divider (SMPLRT_DIV register 0x15).
      Sample Rate = Internal_Sample_Rate / (1 + SMPLRT_DIV).
      Default is 9 (1kHz / 10 = 100 Hz).

  fs-sel:
    type: int
    default: 3
    enum:
      - 3
    description: |
      Full-Scale Range selection (DLPF_FS bits [4:3]).
      Must be set to 3 (+/- 2000 deg/sec) for proper operation per datasheet.

  dlpf-cfg:
    type: int
    default: 3
    enum:
      - 0
      - 1
      - 2
      - 3
      - 4
      - 5
      - 6
    description: |
      Digital Low-Pass Filter bandwidth configuration (DLPF_FS bits [2:0]):
      - 0: 256 Hz (8 kHz Internal_Sample_Rate)
      - 1: 188 Hz (1 kHz Internal_Sample_Rate)
      - 2: 98 Hz (1 kHz Internal_Sample_Rate)
      - 3: 42 Hz (1 kHz Internal_Sample_Rate, default)
      - 4: 20 Hz (1 kHz Internal_Sample_Rate)
      - 5: 10 Hz (1 kHz Internal_Sample_Rate)
      - 6: 5 Hz (1 kHz Internal_Sample_Rate)
      Note: Value 7 is reserved by datasheet and excluded.

  int-cfg:
    type: int
    default: 0
    description: |
      Interrupt configuration register value (INT_CFG register 0x17).
      Default is 0x00 (interrupts disabled, polling mode).

  pwr-mgm:
    type: int
    default: 1
    description: |
      Power Management register value (PWR_MGM register 0x3E).
      Default is 0x01 (PLL with X Gyro reference, recommended by datasheet).
```

## dts/bindings/sensor/liteon,ltr329.yaml
```yaml
# Copyright (c) 2025 Konrad Sikora
# SPDX-License-Identifier: Apache-2.0

description: LiteOn LTR-329 Digital Ambient Light Sensor

compatible: "liteon,ltr329"

include: [sensor-device.yaml, i2c-device.yaml]

properties:
  als-gain:
    type: int
    default: 1
    enum: [1, 2, 4, 8, 48, 96]
    description: |
      This parameter adjusts the ADC gain factor, impacting the sensor's
      light sensitivity range. The default setting, corresponding to the
      register reset value (1X).

  als-integration-time:
    type: int
    default: 100
    enum: [100, 50, 200, 400, 150, 250, 300, 350]
    description: |
      ALS Integration Time is the measurement time for each ALS cycle.
      Default value is a register reset value (100ms).

  als-measurement-rate:
    type: int
    default: 500
    enum: [50, 100, 200, 500, 1000, 2000]
    description: |
      ALS Measurement Rate is the rate at which the sensor
      takes measurements in the active mode. This is the interval
      between ALS_DATA registers update. ALS Measurement Repeat Rate
      must be set to be equal or larger than the Integration Time.
      If ALS Measurement Repeat Rate  is set to be smaller than
      ALS Integration Time, it will automatically be reset to be
      equal to ALS Integration Time by the IC internally. Default value
      is a register reset value (500ms).
```

## dts/bindings/sensor/maxim,max30003.yaml
```yaml
# Copyright (c) 2026 Nainaiu Rakhaine
# SPDX-License-Identifier: Apache-2.0

description: |
  Maxim (Analog Devices) MAX30003 single-lead ECG analog front end with
  R-to-R (heart beat) detection and a 32-sample FIFO, on SPI (mode 0,
  up to 12 MHz).

  The chip needs a 32.768 kHz clock on its FCLK pin. Either feed it from a
  crystal oscillator, or let the driver generate it with a PWM channel
  (pwms property).

  If the application starts FCLK itself after boot, add
  zephyr,deferred-init to the node and call device_init() once the clock
  runs: the driver waits for the PLL to lock during init.

  Example:

    &spi1 {
        cs-gpios = <&gpio0 28 GPIO_ACTIVE_LOW>;

        ecg: max30003@0 {
            compatible = "maxim,max30003";
            reg = <0>;
            spi-max-frequency = <4000000>;
            int-gpios = <&gpio0 17 (GPIO_ACTIVE_LOW | GPIO_PULL_UP)>;
            sample-rate = <256>;
            gain = <160>;
            digital-high-pass;
            rtor-enable;
        };
    };

compatible: "maxim,max30003"

include: [sensor-device.yaml, spi-device.yaml]

properties:
  int-gpios:
    type: phandle-array
    description: |
      INTB pin (active low; the driver enables the chip's internal pull-up).
      Required for triggers.

  pwms:
    type: phandle-array
    description: |
      Optional PWM channel wired to FCLK. The driver starts it at
      fclk-frequency with 50 % duty before talking to the chip.

  fclk-frequency:
    type: int
    default: 32768
    min: 1
    description: |
      Actual FCLK frequency in Hz. Used to scale R-to-R intervals and the
      PWM period. If the PWM cannot hit 32768 Hz exactly, put the frequency
      it really produces here.

  sample-rate:
    type: int
    default: 256
    enum: [125, 128, 200, 250, 256, 500, 512]
    description: |
      ECG samples per second (with a 32768 Hz FCLK). 128/256/512 use
      FMSTR = 32768 Hz; 125/250/500 and 200 use the internal 32000 Hz
      master clock.

  gain:
    type: int
    default: 160
    enum: [20, 40, 80, 160]
    description: ECG channel gain in V/V. Input range is +/-1 V / gain.

  digital-high-pass:
    type: boolean
    description: Enable the 0.5 Hz digital high-pass filter (removes baseline wander).

  low-pass-filter:
    type: string
    default: "40hz"
    enum: ["bypass", "40hz", "100hz", "150hz"]
    description: |
      Digital low-pass filter (DLPF). Corners are nominal for 512/256 sps;
      see the CNFG_ECG table in the datasheet for the other rates.

  input-bias:
    type: string
    default: "100mohm"
    enum: ["none", "50mohm", "100mohm", "200mohm"]
    description: |
      Resistive bias of ECGP/ECGN to VMID. Needed unless the electrodes are
      biased externally (for example by a right-leg drive).

  input-bias-inputs:
    type: string
    default: "both"
    enum: ["both", "positive", "negative"]
    description: Which inputs input-bias is applied to (RBIASP, RBIASN).

  dc-lead-off-current-na:
    type: int
    default: 0
    enum: [0, 5, 10, 20, 50, 100]
    description: |
      DC lead-off detection current in nA. 0 disables lead-off detection.
      Results are reported on SENSOR_CHAN_MAX30003_LEAD_OFF.

  dc-lead-off-threshold-mv:
    type: int
    default: 300
    enum: [300, 400, 450, 500]
    description: Lead-off comparator threshold, VMID +/- this value.

  dc-lead-off-reverse-polarity:
    type: boolean
    description: |
      Reverse the lead-off current direction (DCLOFF_IPOL): ECGP pulled
      down and ECGN pulled up. Default is ECGP up, ECGN down.

  invert-polarity:
    type: boolean
    description: Swap ECGP and ECGN (inverts the waveform).

  rtor-enable:
    type: boolean
    description: Enable the on-chip R-to-R (QRS) detector.

  rtor-window:
    type: int
    default: 12
    description: |
      R-to-R averaging window (WNDW), in R-to-R periods of 256 master clock
      cycles (about 7.8 ms): 6 to 28, even. Default 12 (about 94 ms).

  rtor-gain:
    type: int
    default: 0
    description: |
      R-to-R detector gain (RTOR GAIN): 0 for automatic, or a power of two
      from 1 to 16384.

  rtor-peak-average:
    type: int
    default: 8
    enum: [2, 4, 8, 16]
    description: Number of beats in the peak average (PAVG).

  rtor-peak-threshold:
    type: int
    default: 4
    description: |
      R-wave detection threshold as a fraction of the running peak
      average, in sixteenths (1 to 16). Use 1 for small R waves.

  rtor-holdoff:
    type: int
    default: 32
    description: |
      Minimum hold-off after a detected beat (HOFF), in R-to-R periods
      (about 7.8 ms): 0 to 63. Default 32 (250 ms).

  rtor-interval-average:
    type: int
    default: 8
    enum: [2, 4, 8, 16]
    description: Number of intervals averaged for the adaptive hold-off (RAVG).

  rtor-holdoff-scale:
    type: int
    default: 4
    description: |
      Adaptive hold-off as eighths of the average interval (RHSF): 0 to 7.
      0 uses only rtor-holdoff.

  fast-recovery:
    type: string
    default: "off"
    enum: ["off", "manual", "auto"]
    description: |
      Fast recovery after input saturation (MNGR_DYN FAST). "auto" starts
      it when the output stays beyond fast-recovery-threshold; "manual"
      keeps it on until changed. Samples taken during recovery carry
      MAX30003_FLAG_FAST.

  fast-recovery-threshold:
    type: int
    default: 63
    description: Automatic fast recovery threshold, in units of 2048 ADC counts (0 to 63).

  data-ready-interval:
    type: int
    default: 1
    enum: [1, 2, 4, 16]
    description: SENSOR_TRIG_DATA_READY fires every this many samples (SAMP_IT).

  fifo-watermark:
    type: int
    default: 8
    description: |
      Unread samples (1 to 32) that raise SENSOR_TRIG_FIFO_WATERMARK.
      The handler must read the FIFO (max30003_fifo_read()): INTB stays low
      until the FIFO drops below the watermark.
```

## dts/bindings/sensor/melexis,mlx90632.yaml
```yaml
# SPDX-FileCopyrightText: Copyright (c) Michele Tavecchio <tavecchiomichele03@gmail.com>
# SPDX-FileCopyrightText: Copyright (c) Alessandro Sola <alessandrosola03@gmail.com>
# SPDX-License-Identifier: Apache-2.0

description: |
  Melexis MLX90632 Infrared Temperature Sensor. See datasheet at
  https://www.melexis.com/en/documents/documentation/datasheets/datasheet-mlx90632

compatible: "melexis,mlx90632"

include: [sensor-device.yaml, i2c-device.yaml]
properties:
  power-mode:
    type: string
    default: continuous
    enum:
      - continuous
      - step
      - sleeping-step
    description: |
      Measurement power mode. Continuous mode runs measurements automatically;
      step mode waits for a conversion command, and sleeping-step mode sleeps
      between measurements.

  refresh-rate:
    type: int
    default: 2
    enum: [0, 1, 2, 3, 4, 5, 6, 7]
    description: |
      EEPROM refresh-rate selection code, rather than a frequency in Hz.
      In medical mode, codes 0 through 7 select 0.5, 1, 2, 4, 8, 16, 32 and 64 Hz.
      In extended mode, they select approximately 0.16, 0.32, 0.65, 1.3, 2.6, 5,
      10 and 20 Hz. The default selects 2 Hz in medical mode.

  extended-mode:
    type: boolean
    description: |
      Enable the extended temperature range measurement sequence and calculations.
      If absent, the sensor uses the medical measurement sequence.
```

## dts/bindings/sensor/murata,scl3300.yaml
```yaml
# Copyright (c) 2026 Sacra Systems Private Limited
# SPDX-License-Identifier: Apache-2.0

description: Murata SCL3300 inclinometer sensor

compatible: "murata,scl3300"

include: spi-device.yaml

properties:
  init:
    type: boolean
    description: Enable sensor initialization sequence
```
