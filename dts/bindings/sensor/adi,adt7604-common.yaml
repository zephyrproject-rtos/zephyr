## dts/bindings/sensor/nxp,emios-qdec.yaml
```yaml
# SPDX-FileCopyrightText: Copyright 2026 NXP
# SPDX-License-Identifier: Apache-2.0

description: |
  Quadrature decoder using one NXP LCU cell and two externally clocked
  eMIOS MCB counters. The decoder exclusively owns its eMIOS instance;
  that instance cannot also enable a PWM device or another decoder.
  Configure input pad selection and eMIOS input daisy selection with pinctrl,
  and signal routing with mux-states. MCB period interrupts extend the counters
  between application fetches.

compatible: "nxp,emios-qdec"

include: [sensor-device.yaml, pinctrl-device.yaml, mux-consumer.yaml]

properties:
  lcu:
    type: phandle
    required: true
    description: LCU controller.

  lcu-cell:
    type: int
    required: true
    enum: [0, 1, 2]
    description: Exclusively reserved LCU logic cell.

  lcu-inputs:
    type: array
    required: true
    min-len: 2
    max-len: 2
    min: 0
    max: 11
    description: |
      Two LCU instance input indices (0..11), for A and B respectively.
      The cell's other two inputs use internal delayed output feedback.

  emios:
    type: phandle
    required: true
    description: Exclusively owned eMIOS instance.

  emios-channels:
    type: array
    required: true
    min-len: 2
    max-len: 2
    min: 1
    max: 7
    description: |
      Two distinct UC indices for CW and CCW, respectively. Both channels
      must implement MCB with an internal counter and must take their counter
      input from the internal TRGMUX/LCU path, such as  eMIOS_0 UC1..UC7 on MCXE.

  counts-per-revolution:
    type: int
    required: true
    min: 1
    max: 2147483647
    description: |
      Decoded counts per mechanical revolution. Calculate this value from the
      encoder's specifications; it must match the actual counts generated by
      one mechanical revolution. This driver uses x4 quadrature decoding, so
      multiply per-channel pulses per revolution (PPR) by four: 1000 PPR
      requires 4000 counts. If the specification already gives counts after
      x4 decoding, use that value directly without multiplying again.

  feedback-filter:
    type: int
    default: 5
    min: 1
    max: 65535
    description: Rising and falling delay of A/B feedback outputs, in LCU clock cycles.

  pulse-filter:
    type: int
    default: 4
    min: 0
    max: 65535
    description: |
      Rising and falling filter of direction pulse outputs, in LCU clock cycles.
      Must be smaller than feedback-filter so direction pulses are not suppressed.

  reverse-direction:
    type: boolean
    description: Reverse the decoded counting direction.

  pinctrl-0:
    required: true

  pinctrl-names:
    required: true

  mux-states:
    required: true
```

## dts/bindings/sensor/rakwireless,rak12035.yaml
```yaml
# Copyright (c) 2026 RAKwireless Technology Limited
# SPDX-License-Identifier: Apache-2.0

title: RAKwireless RAK12035 capacitive soil moisture and temperature sensor.

description: |
  RAKwireless RAK12035 capacitive soil moisture and temperature sensor.

  The probe is an ATtiny441 with RAKwireless firmware, accessed over I2C.
  Default 7-bit address is 0x20 (programmable). See the datasheet at
  https://docs.rakwireless.com/product-categories/wisblock/rak12035/datasheet/

  The sensor reports an unscaled capacitance value, probe temperature, and a
  two-point calibrated soil moisture percentage. The percentage is relative
  to the stored dry and wet calibration points; it is not air relative
  humidity or volumetric water content.

compatible: "rakwireless,rak12035"

include: [sensor-device.yaml, i2c-device.yaml, power.yaml]

properties:
  reset-gpios:
    type: phandle-array
    description: |
      Optional active-low reset signal. The driver pulses it once before any
      probe is initialized and leaves it deasserted afterwards. On a carrier
      such as the RAK12023 the signal reaches every socket, so all probes on
      one carrier name the same line and are reset together.
```

## dts/bindings/sensor/sensirion,scd30.yaml
```yaml
# Copyright (c) 2026 RAKwireless Technology Limited
# SPDX-License-Identifier: Apache-2.0

description: |
  Sensirion SCD30 NDIR CO2, humidity and temperature sensor module.

  The I2C address is 0x61. The bus runs at 100 kHz or slower and the
  controller must support clock stretching. Sensirion recommends 50 kHz
  or less. The RDY pin is high when a new measurement can be read.

compatible: "sensirion,scd30"

include: [sensor-device.yaml, i2c-device.yaml]

properties:
  measurement-interval:
    type: int
    default: 2
    min: 2
    max: 1800
    description: |
      Continuous measurement interval in seconds. The interface manual
      allows 2 to 1800. The initial value is 2 seconds and is kept in
      non-volatile memory across power cycles.

  ready-gpios:
    type: phandle-array
    description: |
      Optional data-ready (RDY) output. Active high when a new measurement is
      available. When present, sample_fetch uses this pin instead of the I2C
      get-data-ready command. Without this property, readiness is polled over
      I2C.
```

## dts/bindings/sensor/sensirion,sgp41.yaml
```yaml
# Copyright (c) 2026 Dotcom IoT LLP
# SPDX-License-Identifier: Apache-2.0

description: Sensirion SGP41 VOC and NOx gas sensor
compatible: "sensirion,sgp41"
include: [sensor-device.yaml, i2c-device.yaml]
properties:
  enable-selftest:
    type: boolean
    description: |
      Run the on-chip self-test during driver initialisation.
      The self-test takes approximately 320 ms to complete.
```

## dts/bindings/sensor/st,sths34pf80-common.yaml
```yaml
# Copyright (c) 2026 Dotcom IoT LLP
# SPDX-License-Identifier: Apache-2.0

description: ST STHS34PF80 infrared presence and motion detection sensor

include: sensor-device.yaml

properties:
  odr:
    type: int
    default: 3
    description: |
      Output data rate selection. Valid values are:
      0 = power-down, 1 = 0.25 Hz, 2 = 0.5 Hz, 3 = 1 Hz,
      4 = 2 Hz, 5 = 4 Hz, 6 = 8 Hz, 7 = 15 Hz, 8 = 30 Hz.
      Default is 3 (1 Hz), a safe power-up rate.
      Please note that the values are defined in
      include/zephyr/dt-bindings/sensor/sths34pf80.h
    enum:
      - 0 # STHS34PF80_DT_ODR_POWER_DOWN
      - 1 # STHS34PF80_DT_ODR_0HZ25
      - 2 # STHS34PF80_DT_ODR_0HZ50
      - 3 # STHS34PF80_DT_ODR_1HZ
      - 4 # STHS34PF80_DT_ODR_2HZ
      - 5 # STHS34PF80_DT_ODR_4HZ
      - 6 # STHS34PF80_DT_ODR_8HZ
      - 7 # STHS34PF80_DT_ODR_15HZ
      - 8 # STHS34PF80_DT_ODR_30HZ
```

## dts/bindings/sensor/st,sths34pf80-spi.yaml
```yaml
# Copyright (c) 2026 Dotcom IoT LLP
# SPDX-License-Identifier: Apache-2.0

description: ST STHS34PF80 infrared presence and motion detection sensor (SPI)

compatible: "st,sths34pf80"

include: ["st,sths34pf80-common.yaml", spi-device.yaml]
```

## dts/bindings/sensor/st,vl53l0x.yaml
```yaml
# Copyright (c) 2017, Linaro Limited
# SPDX-License-Identifier: Apache-2.0

description: STMicroelectronics VL53L0X Time of Flight sensor

compatible: "st,vl53l0x"

include: [sensor-device.yaml, i2c-device.yaml]

properties:
  xshut-gpios:
    type: phandle-array
    description: |
      Xshutdown pin, Active LOW.

  int-gpios:
    type: phandle-array
    description: |
      An interrupt is raised when a distance measurement is ready.
      GPIO1 is the interrupt pin on the VL53L0X (active low). It is an
      open drain output, so the driver enables a pull-up on the input.
      Leave it out to have the driver poll for the result instead.
```
