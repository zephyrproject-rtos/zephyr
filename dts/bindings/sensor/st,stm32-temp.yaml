## dts/bindings/sensor/ti,bq274xx.yaml
```yaml
#
# Copyright (c) 2020 Linumiz
#
# SPDX-License-Identifier: Apache-2.0
#

description: Texas Instruments BQ274xx Fuel Gauge

compatible: "ti,bq274xx"

include: [sensor-device.yaml, i2c-device.yaml]

properties:
  design-voltage:
    type: int
    required: true
    description: Battery Design Voltage in mV (3300 - 4400)

  design-capacity:
    type: int
    required: true
    description: Battery Design Capacity in mAh

  taper-current:
    type: int
    required: true
    description: |
      Current in mA slightly higher than the taper current threshold at which
      point the charger cuts off charging.

  terminate-voltage:
    type: int
    required: true
    description: |
      Minimum operating voltage of your system. This is the target where the
      gauge typically reports 0% capacity. In mV.

  chemistry-id:
    type: int
    description: |
      The value of the Chem ID register. When zero, the driver will not check the register.
      See the reference manual for the specific BQ274xx variant for values.

  int-gpios:
    type: phandle-array
    description: |
      The INT signal defaults to active low open drain, so requires a
      pull-up on the board. By default it acts as an output and signals
      specific events happening (e.g. change in State of Charge).
      Note this pin is required for this sensor's power management APIs: in
      shutdown mode it acts as an input and toggling it will make the sensor
      exit the mode.

  zephyr,lazy-load:
    type: boolean
    description: |
      Configuring the sensor can take a long time, using lazy loading we can delay
      until the first sample request and keep the boot time as short as possible.
```

## dts/bindings/sensor/ti,bq34110.yaml
```yaml
#
# Copyright (c) 2021 Linumiz
#
# SPDX-License-Identifier: Apache-2.0
#

description: Texas Instruments BQ34110 Fuel Gauge

compatible: "ti,bq34110"

include: i2c-device.yaml

properties:
    design-voltage:
      type: int
      required: true
      description: Battery Design Voltage in mV

    design-capacity:
      type: int
      required: true
      description: Battery Design Capacity in mAh

    taper-current:
      type: int
      required: true
      description: Battery Taper Current in mAh

    taper-voltage:
      type: int
      required: true
      description: Battery Taper Voltage in mV
```

## dts/bindings/sensor/ti,bq35100.yaml
```yaml
# Copyright (c) 2021 arithmetics.io
# SPDX-License-Identifier: Apache-2.0

description: Texas Instruments BQ35100 lithium primary battery fuel gauge
compatible: "ti,bq35100"

include: i2c-device.yaml

properties:
    ge-gpios:
      type: phandle-array
      required: false
      description: |
        The Gauge Enable (GE) pin defaults to active high when consumed by the sensor.
        The property value should ensure the flags properly describe
        the signal that is presented to the driver.

    alert-gpios:
      type: phandle-array
      required: false
      description: |
        The ALERT pin defaults to active low when produced by the sensor.
        The property value should ensure the flags properly describe
        the signal that is presented to the driver.
```

## dts/bindings/sensor/ti,bq40zxx.yaml
```yaml
#
# Copyright (c) 2020 ZedBlox
#
# SPDX-License-Identifier: Apache-2.0
#

description: Texas Instruments BQ40Zxx Fuel Gauge

compatible: "ti,bq40zxx"

include: i2c-device.yaml

properties:
    design-voltage:
      type: int
      required: false
      description: Battery Design Volatge in (3300 - 4400)mV
      default: 3700

    design-capacity:
      type: int
      required: false
      description: Battery Design Capacity in mAh
      default: 4400

    taper-current:
      type: int
      required: false
      description: Battery Taper current in mAh
      default: 45

    terminate-voltage:
      type: int
      required: false
      description: Battery Terminate Voltage in mV
      default: 3000
```
