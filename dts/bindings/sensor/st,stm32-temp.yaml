## dts/bindings/sensor/st,stm32-temp.yaml
```yaml
# Copyright (c) 2021, Eug Krashtan
# SPDX-License-Identifier: Apache-2.0

description: STM32 family TEMP node

compatible: "st,stm32-temp"

include: [base.yaml, "st,stm32-temp-common.yaml"]

properties:
  v25:
    type: int
    required: true
    description: |
      Voltage of temperature sensor at 25°C (in mV), found in MCU datasheet
      chapters "Electrical characteristics" or "Operating conditions"
```

## dts/bindings/sensor/st,stm32-vbat.yaml
```yaml
# Copyright (c) 2022 STMicroelectronics
# SPDX-License-Identifier: Apache-2.0

description: STM32 family VBAT node

include: base.yaml

compatible: "st,stm32-vbat"

properties:
    io-channels:
      required: true
      description: ADC channel for Vbat sensor

    ratio:
      type: int
      required: true
      description: fraction of VBat to be connected to the ADC input
```

## dts/bindings/sensor/st,stm32-vddcore.yaml
```yaml
# Copyright (c) 2026 CodeWrights GmbH
# SPDX-License-Identifier: Apache-2.0

title: STM32 Vddcore
description: |
  Voltage sensor for the internal digital core supply voltage (Vddcore)
  on STM32 devices. This sensor uses an internal ADC channel to measure
  the core supply voltage.

include: sensor-device.yaml

compatible: "st,stm32-vddcore"

properties:
  io-channels:
    required: true
    description: ADC channel for Vddcore sensor
```

## dts/bindings/sensor/st,stm32-vref.yaml
```yaml
# Copyright (c) 2023 Kenneth J. Miller <ken@miller.ec>
# SPDX-License-Identifier: Apache-2.0

description: STM32 VREF+.

compatible: "st,stm32-vref"

include: [nvmem-consumer.yaml, sensor-device.yaml]

properties:
  nvmem-cells:
    required: true
    description: |
      One entry corresponding to the VREFINT_CAL calibration parameter
      (factory-measured calibration bandgap voltage) must be provided.

  vrefint-cal-mv:
    type: int
    required: true
    description: |
      VDDA/VREF+ voltage in millivolts applied during manufacturing to determine
      the internal bandgap voltage reference VREFINT.

  vrefint-cal-resolution:
    type: int
    description: |
      ADC resolution used for measuring calibration data

      This is usually equal to the ADC's native resolution.

      Most series have a 12-bit ADC, but 14-bit and 16-bit
      also exists on e.g., STM32U5 and STM32H7 series.
    default: 12
    enum:
      - 12
      - 14
      - 16
```

## dts/bindings/sensor/st,stm32c0-temp-cal.yaml
```yaml
# Copyright (c) 2023, Benjamin Björnsson <benjamin.bjornsson@gmail.com>
# SPDX-License-Identifier: Apache-2.0

description: |
  STM32 TEMP for production calibrated sensors with a single calibration temperature.

compatible: "st,stm32c0-temp-cal"

include: "st,stm32-temp-cal-common.yaml"

properties:
  nvmem-cell-names:
    description: |
      One NVMEM cell must be provided: TS_CAL1

      This cell corresponds to the eponymous calibration parameter.
    enum: ["TS_CAL1"]
```

## dts/bindings/sensor/st,stts22h-i2c.yaml
```yaml
# Copyright (c) 2024 STMicroelectronics
# SPDX-License-Identifier: Apache-2.0

description: |
    STMicroelectronics STTS22H temperature sensor connected to I2C bus
    When setting the sampling-rate property in a .dts or .dtsi file you
    may include stts22h.h and use the macros defined there.

    Example:
    #include <zephyr/dt-bindings/sensor/stts22h.h>

    stts22h: stts22h@0 {
      ...

      sampling-rate = <STTS22H_100Hz>;
    };

compatible: "st,stts22h"

include: [sensor-device.yaml, i2c-device.yaml]

properties:
  int-gpios:
    type: phandle-array
    description: interrupt pin

      This pin defaults to active high when produced by the sensor.
      The property value should ensure the flags properly describe
      the signal that is presented to the driver.

  temperature-hi-threshold:
    type: int
    default: 0
    description: |
      HIGH temperature threshold above which an alarm is triggered.
      Valid range is 0 to 255. It defaults to 0 (alarm off) which is
      the configuration at power-up. This threshold must be calculated
      from a temperature T in Celsius using the formula
      temperature-hi-threshold = 63 + T/0.64 C.


  temperature-lo-threshold:
    type: int
    default: 0
    description: |
      LOW temperature threshold below which an alarm is triggered.
      Valid range is 0 to 255. It defaults to 0 (alarm off) which is
      the configuration at power-up. This threshold must be calculated
      from a temperature T in Celsius using the formula
      temperature-lo-threshold = 63 + T/0.64 C.

  sampling-rate:
    type: int
    default: 0x0
    description: |
      Specify the default output data rate expressed in samples per second (Hz).
      The values are taken in accordance to stts22h_odr_temp_t enumerative in hal/st
      module. Default 0x0 (power down) matches the power-up configuration.

      - 0x00 # STTS22H_POWER_DOWN
      - 0x01 # STTS22H_ONE_SHOT
      - 0x04 # STTS22H_1Hz
      - 0x02 # STTS22H_25Hz
      - 0x12 # STTS22H_50Hz
      - 0x22 # STTS22H_100Hz
      - 0x32 # STTS22H_200Hz

    enum: [0x00, 0x01, 0x02, 0x04, 0x12, 0x22, 0x32]
```

## dts/bindings/sensor/st,stts751-i2c.yaml
```yaml
# Copyright (c) 2019 STMicroelectronics
# SPDX-License-Identifier: Apache-2.0

description: |
    STMicroelectronics STTS751 temperature sensor connected to I2C bus

compatible: "st,stts751"

include: i2c-device.yaml

properties:
    drdy-gpios:
      type: phandle-array
      required: false
      description: DRDY pin

        This pin defaults to active high when produced by the sensor.
        The property value should ensure the flags properly describe
        the signal that is presented to the driver.
```

## dts/bindings/sensor/st,vl53l0x.yaml
```yaml
# Copyright (c) 2017, Linaro Limited
# SPDX-License-Identifier: Apache-2.0

description: |
  STMicroelectronics VL53L0X Time of Flight sensor
  See: https://www.st.com/en/imaging-and-photonics-solutions/vl53l0x.html#documentation
  Example API range profiles
  1. High accuracy 1.2m (white target)  precise measurement
    signal limit ratio: 250
    sigma limit ratio: 18000
    max time for ranging: 200000
  2. Long range  2m (white target) long ranging, only for dark conditions
    signal limit ratio: 100
    sigma limit ratio: 60000
    max time for ranging: 33000
  3. High speed  1.2m (white target) high speed where accuracy is not priority
    signal limit ratio: 250
    sigma limit ratio: 32000
    max time for ranging: 20000

compatible: "st,vl53l0x"

include: [sensor-device.yaml, i2c-device.yaml]

properties:
  xshut-gpios:
    type: phandle-array
    description: |
      Xshutdown pin, Active LOW.

  max-time-for-ranging:
    type: int
    default: 33000
    description: |
      Set max time for ranging in μs
      default value 33000 is 33ms
      The timing budget is the time allocated by the user to perform one range measurement.
      The API takes care of splitting this timing budget into dedicated sub steps in the
      ranging process.
      The user only has to set the overall timing budget in micro seconds, and the
      function allocates the timings internally. A check is performed to know which
      part of the scheduler is enabled or disabled, in order to maximize Final Range
      timing budget.
      VL53L0X_SetMeasurementTimingBudgetMicroSeconds() and
      VL53L0X_GetMeasurementTimingBudgetMicroSeconds()
      The default timing budget value is 33ms, while the minimum is 20ms.

  signal-limit-ratio:
    type: int
    default: 100
    description: |
      Specify a floating point value multiplied by 1000.
      For example, a value of 1 represents 0.001 in real value.
      default value 100 is set VL53L0X_SETUP_SIGNAL_LIMIT (0.1 * 65536)
      This represents the amplitude of the signal reflected from the
      target and detected by the device.

  sigma-limit-ratio:
    type: int
    default: 60000
    description: |
      Specify a floating point value multiplied by 1000.
      For example, a value of 1 represents 0.001 in real value.
      default value 60000 is set VL53L0X_SETUP_SIGMA_LIMIT (60 * 65536)
      Sigma is the time difference (shift) between the reference and
      return SPAD arrays.
      As Sigma represents time of flight and this translates to distance
```

## dts/bindings/sensor/st,vl53l1x.yaml
```yaml
# Copyright (c) 2023 Prosaris Solutions Inc.
# SPDX-License-Identifier: Apache-2.0

description: STMicroelectronics VL53L1X Time of Flight sensor

compatible: "st,vl53l1x"

include: [sensor-device.yaml, i2c-device.yaml]

properties:
  xshut-gpios:
    type: phandle-array
    description: |
      Driving the XSHUT pin low puts the VL53L1X into hardware
      standby (if VDD is present) or complete power off (if
      VDD is not present). Additionally, if XSHUT is connected
      directly to VDD, the sensor will go into boot mode on a
      transition from LOW to HIGH.

  int-gpios:
    type: phandle-array
    description: |
      An interrupt is raised when a distance measurement is ready.
      GPIO1 is the interrupt pin on the VL53L1X (active low). This
      can be disabled if the user prefers to use polling instead.
```

## dts/bindings/sensor/st,vl6180x.yaml
```yaml
# Copyright (c) 2017, Linaro Limited
# SPDX-License-Identifier: Apache-2.0

description: STMicroelectronics VL6180X Time of Flight sensor

compatible: "st,vl6180x"

include: i2c-device.yaml

properties:
    xshut-gpios:
      type: phandle-array
      required: false
```

## dts/bindings/sensor/tdk,icm20948-i2c.yaml
```yaml
#
# Copyright (c) 2018 TDK Invensense.
#
# SPDX-License-Identifier: Apache-2.0
#
---
title: ICM-20948 Nine Axis I2C/SPI MEMS
version: 0.1

description: >
    This is a representation of the ICM-20948 Three Axis High-g I2C/SPI accelerometer

inherits:
    !include i2c-device.yaml

properties:
    compatible:
      constraint: "tdk,icm20948"

...
```

## dts/bindings/sensor/tdk,ntcg163jf103ft1.yaml
```yaml
# Copyright (c) 2023 Urban Sky LLC.
# SPDX-License-Identifier: Apache-2.0

description: TDK NTCG163JF103FT1 thermistor

compatible: "tdk,ntcg163jf103ft1"

include: ntc-thermistor.yaml
```

## dts/bindings/sensor/tdk,ntcgxx3jx103x.yaml
```yaml
# Copyright (c) 2023 Urban Sky LLC.
# SPDX-License-Identifier: Apache-2.0

description: TDK NTCGXX3JX103X thermistor

compatible: "tdk,ntcgxx3jx103x"

include: ntc-thermistor.yaml
```

## dts/bindings/sensor/ti,adcxx1c.yaml
```yaml
#
# Copyright (c) 2024 Bert Outtier
#
# SPDX-License-Identifier: Apache-2.0
#

description: Texas Instruments ADCXX1C I2C Voltage sensor

compatible: "ti,adcxx1c"

include: [sensor-device.yaml, i2c-device.yaml]

properties:
  alert-gpios:
    type: phandle-array
    description: |
      ALERT pin.

      This pin signals active high when produced by the sensor. The
      property value should ensure the flags properly describe the
      signal that is presented to the driver.

  resolution:
    type: int
    description: |
      ADC resolution. This property takes precedence over the
      variant property.
    enum:
      - 8
      - 10
      - 12

  variant:
    type: string
    description: |
      Variant of the ADC.

      This property should be set to one of the following values:

      - "ADC081C"
      - "ADC101C"
      - "ADC121C"
    enum:
      - "ADC081C"
      - "ADC101C"
      - "ADC121C"

  cycle:
    type: int
    default: 0
    description: |
      Conversion interval configuration value
    enum:
      - 0
      - 32
      - 64
      - 128
      - 256
      - 512
      - 1024
      - 2048
```

## dts/bindings/sensor/ti,bq24155.yaml
```yaml
description: Texas Instruments BQ24155 One-Cell Li-Ion Charger

compatible: "ti,bq24155"

include: i2c-device.yaml

properties:
    input-current:
      type: int
      required: true
      description: maximum current charger can pull
                   from power supply in mA.

    weak-voltage:
      type: int
      required: true
      description: weak battery voltage threshold in mV.
                   The chip will use slow precharge if
                   battery voltage is below this value.

    regulation-voltage:
      type: int
      required: true
      description: maximum charging voltage in mV.

    charge-current:
      type: int
      required: true
      description: maximum charging current in mA.

    termination-current:
      type: int
      required: true
      description: charge will be terminated when current in
                   constant-voltage phase drops below this value (in mA).

    resistor-sense:
      type: int
      required: true
      description: value of sensing resistor in milliohm.
```

## dts/bindings/sensor/ti,bq2415x.yaml
```yaml
description: Texas Instruments BQ2415x One-Cell Li-Ion Charger

compatible: "ti,bq2415x"

include: i2c-device.yaml

properties:
    current-limit:
      type: int
      required: true
      description: initial maximum current charger can pull
                   from power supply in mA.

    weak-voltage:
      type: int
      required: true
      description: weak battery voltage threshold in mV.
                   The chip will use slow precharge if
                   battery voltage is below this value.

    regulation-voltage:
      type: int
      required: true
      description: maximum charging voltage in mV.

    charge-current:
      type: int
      required: true
      description: maximum charging current in mA.

    termination-current:
      type: int
      required: true
      description: charge will be terminated when current in
                   constant-voltage phase drops below this value (in mA).

    resistor-sense:
      type: int
      required: true
      description: value of sensing resistor in milliohm.
```

## dts/bindings/sensor/ti,bq27411.yaml
```yaml
# SPDX-License-Identifier: Apache-2.0

description: TI BQ27411 Fuel Gauge

compatible: "ti,bq27411"

include: ti,bq274xx-common.yaml
```

## dts/bindings/sensor/ti,bq27421.yaml
```yaml
# SPDX-License-Identifier: Apache-2.0

description: TI BQ27421 Fuel Gauge

compatible: "ti,bq27421"

include: ti,bq274xx-common.yaml
```

## dts/bindings/sensor/ti,bq27425.yaml
```yaml
# SPDX-License-Identifier: Apache-2.0

description: TI BQ27425 Fuel Gauge

compatible: "ti,bq27425"

include: ti,bq274xx-common.yaml
```

## dts/bindings/sensor/ti,bq27426.yaml
```yaml
# SPDX-License-Identifier: Apache-2.0

description: TI BQ27426 Fuel Gauge

compatible: "ti,bq27426"

include: ti,bq274xx-common.yaml

properties:
    chemistry:
      type: string
      required: false
      description: |
        Chemistry type to use for devices that support programmable chemistry.
      enum:
         - "CHEM_A"
         - "CHEM_B"
         - "CHEM_C"
```

## dts/bindings/sensor/ti,bq27441.yaml
```yaml
# SPDX-License-Identifier: Apache-2.0

description: TI BQ27441 Fuel Gauge

compatible: "ti,bq27441"

include: ti,bq274xx-common.yaml
```
