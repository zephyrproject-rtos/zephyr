## dts/bindings/sensor/sensirion,sht21.yaml
```yaml
# Copyright (c) 2023, Trent Piepho <tpiepho@gmail.com>
# SPDX-License-Identifier: Apache-2.0

description: |
  Sensirion SHT21 Humidity and Temperature Sensor

  This is compatible with the Measurement Specialties HUT21D, "meas,htu21d".

  For the Silicon Labs Si7006/13/20/21 series, use the "silabs,si7006"
  compatible for slightly altered operation.

compatible: "sensirion,sht21"

include: [sensor-device.yaml, i2c-device.yaml]
```

## dts/bindings/sensor/sensirion,sht2x.yaml
```yaml
#
# Copyright (c) 2022 Amarula Solutions B.V.
#
# SPDX-License-Identifier: Apache-2.0

description: Sensirion SHT2x humidity and temperature sensor

compatible: "sensirion,sht2x"

include: i2c-device.yaml
```

## dts/bindings/sensor/sensirion,sht3xd.yaml
```yaml
# Copyright (c) 2018, Peter Bigot Consulting, LLC
# SPDX-License-Identifier: Apache-2.0

description: Sensirion Humidity SHT3x-DIS humidity and temperature sensor

compatible: "sensirion,sht3xd"

include: [sensor-device.yaml, i2c-device.yaml]

properties:
  alert-gpios:
    type: phandle-array
    description: |
      ALERT pin.

      This pin signals active high when produced by the sensor.  The
      property value should ensure the flags properly describe the
      signal that is presented to the driver.
```

## dts/bindings/sensor/sensirion,sht4x.yaml
```yaml
#
# Copyright (c) 2021, Leonard Pollak
#
# SPDX-License-Identifier: Apache-2.0

description: Sensirion SHT4x humidity and temperature sensor

compatible: "sensirion,sht4x"

include: [sensor-device.yaml, i2c-device.yaml]

properties:
  repeatability:
    type: int
    required: true
    description: |
      Repeatability of the T/RH Measurement
      0 = low -> 1.7 ms
      1 = med -> 4.5 ms
      2 = high -> 8.2 ms
    enum:
      - 0
      - 1
      - 2
```

## dts/bindings/sensor/sensirion,shtcx.yaml
```yaml
# Copyright (c) 2021, Thomas Stranger
# SPDX-License-Identifier: Apache-2.0

description: |
  Sensirion SHTCx humidity and temperature sensor

  Additionally use "sensirion,shtc1" or "sensirion,shtc3" compatibles
  such that a generic driver can consider chip specific behaviour.

  Example device tree node describing a Sensirion SHTC3 Sensor on the i2c0 bus:

   &i2c0 {
      status = "okay";
      clock-frequency = <I2C_BITRATE_FAST>;
      shtc3@70 {
        compatible = "sensirion,shtc3", "sensirion,shtcx";
        reg = <0x70>;
        measure-mode = "normal";
        clock-stretching;
     };
   };

compatible: "sensirion,shtcx"

include: [sensor-device.yaml, i2c-device.yaml]

properties:
  measure-mode:
    type: string
    required: true
    description: |
      Specifies which measurement mode is used.
      SHTC1 sensor only supports the normal measuremnt mode.
    enum:
      - "normal"
      - "low-power"

  clock-stretching:
    type: boolean
    description: |
      Specifies that the driver should clock stretching i2c communication to
      read the sensor values.
```

## dts/bindings/sensor/sensirion,sps30-i2c.yaml
```yaml
# Copyright (c) 2026 Shi Weizhi
# SPDX-License-Identifier: Apache-2.0

description: Sensirion SPS30 Particulate Matter Sensor

compatible: "sensirion,sps30"

include: [sensor-device.yaml, i2c-device.yaml]
```

## dts/bindings/sensor/sensirion,stc31.yaml
```yaml
# Copyright (c) 2026 RAKwireless Technology Limited
# SPDX-License-Identifier: Apache-2.0

description: |
  Sensirion STC31 thermal conductivity CO2 sensor IC.

  Measures high-range CO2 concentration (vol%) and temperature over I2C.
  A binary gas model must be selected before measurements.

compatible: "sensirion,stc31"

include: [sensor-device.yaml, i2c-device.yaml]

properties:
  binary-gas:
    type: int
    default: 0x0001
    description: |
      Measurement mode and binary gas argument for command 0x3615.
      See include/zephyr/dt-bindings/sensor/stc31.h. Default is CO2 in air,
      0...100 vol%, low-noise mode (0x0001), compatible with STC31 and STC31-C.
    enum:
      - 0x0000 # STC31_DT_BINARY_GAS_CO2_IN_N2_100_LN
      - 0x0001 # STC31_DT_BINARY_GAS_CO2_IN_AIR_100_LN
      - 0x0002 # STC31_DT_BINARY_GAS_CO2_IN_N2_25_LN
      - 0x0003 # STC31_DT_BINARY_GAS_CO2_IN_AIR_25_LN
      - 0x0010 # STC31_DT_BINARY_GAS_CO2_IN_N2_100
      - 0x0011 # STC31_DT_BINARY_GAS_CO2_IN_AIR_100
      - 0x0012 # STC31_DT_BINARY_GAS_CO2_IN_N2_40
      - 0x0013 # STC31_DT_BINARY_GAS_CO2_IN_AIR_40

examples:
  - |
    #include <zephyr/dt-bindings/sensor/stc31.h>

    stc31@29 {
      compatible = "sensirion,stc31";
      reg = <0x29>;
      binary-gas = <STC31_DT_BINARY_GAS_CO2_IN_AIR_100_LN>;
    };
```

## dts/bindings/sensor/sensirion,stcc4.yaml
```yaml
# Copyright The Zephyr Project Contributors
# SPDX-License-Identifier: Apache-2.0

description: |
  Sensirion STCC4 miniature CO2 sensor based on thermal conductivity.
  Provides CO2, temperature, and humidity readings via I2C.

compatible: "sensirion,stcc4"

include: [sensor-device.yaml, i2c-device.yaml]

properties:
  measurement-mode:
    type: int
    required: true
    description: |
      Measurement mode.
      Continuous mode measures at ~1 Hz. Single-shot mode measures
      on demand with a 500ms conversion time per fetch.
    enum:
      - 0 # STCC4_DT_MODE_CONTINUOUS
      - 1 # STCC4_DT_MODE_SINGLE_SHOT

examples:
  - |
    #include <zephyr/dt-bindings/sensor/stcc4.h>

    stcc4@64 {
      compatible = "sensirion,stcc4";
      reg = <0x64>;
      measurement-mode = <STCC4_DT_MODE_CONTINUOUS>;
    };
```

## dts/bindings/sensor/sensirion,sts4x.yaml
```yaml
# Copyright (c) 2026, Sensirion AG
# SPDX-License-Identifier: Apache-2.0

compatible: "sensirion,sts4x"

include: [sensor-device.yaml, i2c-device.yaml]

description: |
  The STS4x is a 4th generation, high-accuracy, ultra-low-power, fully digital
  temperature sensor platform with a 16-bit I2C interface.
  Learn more: https://sensirion.com/products/product-categories/
  Supported I2C addresses: 0x44(default), 0x45, 0x46

properties:
  repeatability:
    type: int
    default: 0
    description: |
      Set the repeatability. Default is 0.
      - 0 -> low repeatability
      - 1 -> medium repeatability
      - 2 -> high repeatability
```

## dts/bindings/sensor/sensor-adc.yaml
```yaml
# Copyright (c) 2026 Nordic Semiconductor ASA
# SPDX-License-Identifier: Apache-2.0

description: |
  Virtual sensor device converting an ADC device's channels to sensor voltage channels.

compatible: "sensor-adc"

include: sensor-device.yaml

properties:
  io-channels:
    required: true
    description: ADC device's IO channels to expose as sensor voltage channels.

  fifo-watermark:
    type: int
    min: 0
    max: 65534
    default: 0
    description: |
      ADC device's initial sampling FIFO watermark in number of samplings. Watermark is disabled by
      default.

  fifo-depth:
    type: int
    required: true
    min: 1
    max: 65535
    description: |
      ADC device's sampling FIFO depth in number of samplings. The fifo-width is determined from
      the number of io-channels.

  calibrate:
    type: boolean
    description: Calibrate ADC device before each ADC sampling.

examples:
  - |
    / {
              vsense {
                      compatible = "sensor-adc";
                      io-channels = <&adc0 0>, <&adc1 3>;
                      fifo-depth = <12>;
                      calibrate;
              };
    };

    &adc0 {
            status = "okay";

            channel@0 {
                    reg = <0>;
                    zephyr,gain = "ADC_GAIN_1_4";
                    zephyr,resolution = <12>;
                    zephyr,reference = "ADC_REF_INTERNAL";
                    zephyr,oversampling = <2>;
                    zephyr,acquisition-time = <ADC_ACQ_TIME_DEFAULT>;
                    zephyr,input-positive = <0>;
            };

            channel@3 {
                    reg = <3>;
                    zephyr,gain = "ADC_GAIN_1_4";
                    zephyr,reference = "ADC_REF_INTERNAL";
                    zephyr,input-positive = <0>;
            };
    };
```

## dts/bindings/sensor/sensor-axis-align.yaml
```yaml
# Copyright 2025 CogniPilot Foundation
# SPDX-License-Identifier: Apache-2.0

description: |
    Axis alignment specification for sensors
    that require orientation. This can be used for
    sensors that have more than one axis. It is used by
    assigning the hardware's internal axes to an external
    reference frame axes of choice (IE, orientation of sensor
    on a board or overall system mounting).

    Consider a sensor (sensor-top-90) that follows right hand rule,
    and when mounted to the board was rotated clockwise around it's Z axis
    90 degrees from another identical directional sensor (sensor-bottom)
    that was mounted on the bottom side of the board.

    To have the sensors all in the same board reference frame a simple
    axis change can be performed by changing the axis output of
    sensor-top-90 as follows:
    x -> +y
    y -> -x
    z -> +z

    To align the sensor that is on the bottom side of the board an
    axis output change for sensor-bottom would be as followed:
    x -> +x
    y -> -y
    z -> -z

    Example of how to encode that into DTS:
    #include <zephyr/dt-bindings/sensor/sensor_axis_align.h>

    sensor-top-90: sensor-top-90@0 {
      ...
      axis-align-x = <SENSOR_AXIS_ALIGN_DT_Y>
      axis-align-y = <SENSOR_AXIS_ALIGN_DT_X>
      axis-align-y-sign = <SENSOR_AXIS_ALIGN_DT_NEG>
      axis-align-z = <SENSOR_AXIS_ALIGN_DT_Z>
    };

    sensor-bottom: sensor-bottom@1 {
      ...
      axis-align-x = <SENSOR_AXIS_ALIGN_DT_X>
      axis-align-y = <SENSOR_AXIS_ALIGN_DT_Y>
      axis-align-y-sign = <SENSOR_AXIS_ALIGN_DT_NEG>
      axis-align-z = <SENSOR_AXIS_ALIGN_DT_Z>
      axis-align-z-sign = <SENSOR_AXIS_ALIGN_DT_NEG>
    };

include: base.yaml
properties:
  axis-align-x:
    type: int
    default: 0
    description: |
      Align sensor chanel x output with hardware orientation axis.
      Defaults to x.
    enum:
      - 0 # SENSOR_AXIS_ALIGN_DT_X
      - 1 # SENSOR_AXIS_ALIGN_DT_Y
      - 2 # SENSOR_AXIS_ALIGN_DT_Z

  axis-align-x-sign:
    type: int
    default: 2
    description: |
      Align sensor chanel x output with hardware orientation axis sign component.
      Defaults to positive.
    enum:
      - 0 # SENSOR_AXIS_ALIGN_DT_NEG
      - 2 # SENSOR_AXIS_ALIGN_DT_POS

  axis-align-y:
    type: int
    default: 1
    description: |
      Align sensor chanel y output with hardware orientation axis.
      Defaults to y.
    enum:
      - 0 # SENSOR_AXIS_ALIGN_DT_X
      - 1 # SENSOR_AXIS_ALIGN_DT_Y
      - 2 # SENSOR_AXIS_ALIGN_DT_Z

  axis-align-y-sign:
    type: int
    default: 2
    description: |
      Align sensor chanel y output with hardware orientation axis sign component.
      Defaults to positive.
    enum:
      - 0 # SENSOR_AXIS_ALIGN_DT_NEG
      - 2 # SENSOR_AXIS_ALIGN_DT_POS

  axis-align-z:
    type: int
    default: 2
    description: |
      Align sensor chanel z output with hardware orientation axis.
      Defaults to z.
    enum:
      - 0 # SENSOR_AXIS_ALIGN_DT_X
      - 1 # SENSOR_AXIS_ALIGN_DT_Y
      - 2 # SENSOR_AXIS_ALIGN_DT_Z

  axis-align-z-sign:
    type: int
    default: 2
    description: |
      Align sensor chanel z output with hardware orientation axis sign component.
      Defaults to positive.
    enum:
      - 0 # SENSOR_AXIS_ALIGN_DT_NEG
      - 2 # SENSOR_AXIS_ALIGN_DT_POS
```

## dts/bindings/sensor/sensor-channel.yaml
```yaml
# Copyright (c) 2022 Intel Corporation
#
# SPDX-License-Identifier: Apache-2.0

# Properties for sensor channels, where a sensor channel is considered a grouping
# of sensor fields, and a sensor field is a scalar measurement of a physical
# phenomenom. A channel then is a vector of fields. A sensor a vector of channels.
#
# A channel might also be a channel from a sensor hub like device and optionally
# enable with additional configuration options for a particular device.

description: Sensor Channel

include: base.yaml

properties:
  channel-index:
    type: int
    required: true
    description: |
      The numerical index in an array of channels the sensor provides. For
      example the 0th channel may be the accelerometer channel, the 1st may be
      a gyro, and 3rd may be a magnetometer. Some devices may group several
      channels together and in Zephyr those would be fields in a channel rather
      than individual channels. Each channel might typically come with its own ability
      to set sensitivity, odr, and so on.

  channel-type:
    type: int
    required: true
    description: |
      The type of physical sensing information provided by this channel. It
      can be used to identify a channel of data from a sensor that provides
      for example acceleration, rotational velocity, magnetic field strength,
      light intensity, and more.

      The channel type identifiers are defined in C and are extensible.

  channel-fields:
    type: array
    description: |
      A sensor channel may itself be representative of a multi-dimensional
      array containing relative data about a particular physical measurement.
      This may be the filtered frequencies of light in a spectrometer, the
      euclidean alignment of mems sensors for x, y, z, or a simple array of
      values for things like ToF sensors with 1 or 2 dimensional arrays readings.

      Each field is given by a pair (Field Descriptor, Length) to signify the channel
      produces fields with a particular meaning and N of them.

      Example fields usages

      channel-fields: <SENSOR_FIELD_XYZ 1>
```

## dts/bindings/sensor/sensor-device.yaml
```yaml
# Copyright (c) 2022 Intel Corporation
#
# SPDX-License-Identifier: Apache-2.0

description: Sensor Device

include: base.yaml

properties:
  friendly-name:
    type: string
    description: |
      Human readable string describing the sensor. It can be used to
      distinguish multiple instances of the same model (e.g., lid accelerometer
      vs. base accelerometer in a laptop) to a host operating system.

      This property is defined in the Generic Sensor Property Usages of the HID
      Usage Tables specification
      (https://usb.org/sites/default/files/hut1_3_0.pdf, section 22.5).
```

## dts/bindings/sensor/senss,hinge-angle.yaml
```yaml
# Copyright (c) 2022, Intel Corporation
# SPDX-License-Identifier: Apache-2.0
#

description: Sensor subsystem (senss) hinge angle sensor bindings.

compatible: "senss,hinge-angle"

# Common senss sensor properties.
include: zephyr,senss-sensor.yaml

# Sensor specific properties can be added below.
#properties:
```

## dts/bindings/sensor/senss,motion-detector.yaml
```yaml
# Copyright (c) 2022, Intel Corporation
# SPDX-License-Identifier: Apache-2.0
#

description: Sensor subsystem (senss) motion detector sensor bindings.

compatible: "senss,motion-detector"

# Common senss sensor properties.
include: zephyr,senss-sensor.yaml

# Sensor specific properties can be added below.
#properties:
```

## dts/bindings/sensor/senss,phy-accel.yaml
```yaml
# Copyright (c) 2022, Intel Corporation
# SPDX-License-Identifier: Apache-2.0
#

description: Sensor subsystem (senss) physical accelerometer sensor bindings.

compatible: "senss,phy-accel"

# Common senss sensor properties.
include: zephyr,senss-sensor.yaml

# Sensor specific properties.
properties:
    underlying-device:
       type: phandle
       required: false
       description: underlying sensor device for physical sensor
```
