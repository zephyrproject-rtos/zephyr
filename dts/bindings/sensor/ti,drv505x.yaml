## dts/bindings/spi/infineon,spi.yaml
```yaml
# Copyright (c) 2022 Cypress Semiconductor Corporation (an Infineon company) or
# an affiliate of Cypress Semiconductor Corporation
#
# SPDX-License-Identifier: Apache-2.0

description: Infineon CAT1 SPI

compatible: "infineon,spi"

include: [spi-controller.yaml, pinctrl-device.yaml, mux-consumer.yaml, "infineon,scb.yaml"]

properties:
  reg:
    required: true

  interrupts:
    required: true

  pinctrl-0:
    required: true

  sub-mode:
    type: int
    default: 0
    enum: [0, 1, 2, 5]
    description: |
      SPI frame format:
        0: Motorola
        1: Texas Instruments, slave select coincides with the first data bit
        2: National Semiconductor Microwire
        5: Texas Instruments, slave select precedes the first data bit
      SPI_FRAME_FORMAT_TI selects 5 when this property is 0.

  enable-free-run-sclk:
    type: boolean
    description: Drive SCLK continuously in controller mode, also between transfers.

  enable-input-filter:
    type: boolean
    description: Enable the median filter on the SPI inputs.

  disable-miso-late-sample:
    type: boolean
    description: |
      Sample MISO on the SCLK edge defined by the SPI mode instead of half an
      SCLK period later.

  enable-transfer-separation:
    type: boolean
    description: Deassert the slave select between data frames in controller mode.

  ss-setup-delay:
    type: boolean
    description: |
      Extend the slave select setup time by one SCLK period in Motorola
      controller mode.

  ss-hold-delay:
    type: boolean
    description: |
      Extend the slave select hold time by one SCLK period in Motorola
      controller mode.

  ss-inter-frame-delay:
    type: boolean
    description: |
      Extend the slave select deassertion between data frames by one SCLK
      period in Motorola controller mode.
```

## dts/bindings/spi/microchip,qspi-g1-spi.yaml
```yaml
# SPDX-FileCopyrightText: Copyright The Zephyr Project Contributors
# SPDX-License-Identifier: Apache-2.0

description: |
  Microchip G1 QSPI controller in SPI mode

  Group G1 QSPI includes the following hardware peripherals:
    - module name="QSPI" id="U2008"

  The driver runs the controller in SPI mode (CTRLB.MODE = 0), as a
  single-line SPI controller with 8-bit words. The chip select is the
  hardware CS line unless cs-gpios is set. The serial memory mode (dual
  and quad I/O, memory-mapped reads) is not used.

  Transfers are polled, or use two DMAC channels when dmas is set.

  The serial clock is CLK_QSPI_AHB (the CPU clock) divided by 1 to 256.
  Keep spi-max-frequency within the QSPI electrical specifications of the
  SoC data sheet.

examples:
  - |
    &qspi {
      pinctrl-0 = <&qspi_default>;
      pinctrl-names = "default";
      dmas = <&dmac 0 84>, <&dmac 1 83>;
      dma-names = "tx", "rx";
      status = "okay";

      flash@0 {
        compatible = "jedec,spi-nor";
        reg = <0>;
        spi-max-frequency = <24000000>;
      };
    };

compatible: "microchip,qspi-g1-spi"

include:
  - name: spi-controller.yaml
  - name: pinctrl-device.yaml

properties:
  reg:
    required: true

  interrupts:
    required: true

  clocks:
    required: true

  clock-names:
    required: true
    description: |
      "mclk-apb" for the APB bus clock, "mclk-ahb" for the AHB clock that
      also drives the baud rate generator.

  dmas:
    description: |
      Optional TX and RX DMA specifiers: the DMAC phandle, the channel
      number and the peripheral trigger source (QSPI TX is 84, QSPI RX is
      83 on PIC32CX SG).

  dma-names:
    description: |
      Required if dmas is set: "tx" and "rx", matching dmas.
```

## dts/bindings/spi/renesas,rx-spi-b.yaml
```yaml
# Copyright (c) 2026 Renesas Electronics Corporation
# SPDX-License-Identifier: Apache-2.0

description: Renesas RX SPI_B controller

compatible: "renesas,rx-spi-b"

include: [spi-controller.yaml, pinctrl-device.yaml]

properties:
  channel:
    type: int
    required: true

  reg:
    required: true

  clocks:
    required: true

  pinctrl-0:
    required: true

  pinctrl-names:
    required: true
```

## dts/bindings/spi/ti,unicomm-spi.yaml
```yaml
# Copyright (c) 2026 Texas Instruments Incorporated
# SPDX-License-Identifier: Apache-2.0

description: TI Unicomm SPI controller

compatible: "ti,unicomm-spi"

include: [spi-controller.yaml, pinctrl-device.yaml, base.yaml]

properties:
  reg:
    required: true

  interrupts:
    required: true

  clocks:
    required: true

  pinctrl-0:
    required: true

  pinctrl-names:
    required: true

  fifo-depth:
    type: int
    default: 16
    description: |
      Depth of the UNICOMM SPI TX and RX FIFOs in bytes.

  tx-fifo-threshold:
    type: int
    default: 4
    description: |
      TX FIFO interrupt threshold encoding (IFLS.TXIFLSEL field, bits [2:0]).
      This value doesn't correspond to the number of bytes in the FIFO. Check TRM
      for the actual encoding. The default value of 4 causes an interrupt to fire
      when the FIFO is not full.

  rx-fifo-threshold:
    type: int
    default: 4
    description: |
      RX FIFO interrupt threshold encoding (IFLS.RXIFLSEL field, bits [6:4]).
      This value doesn't correspond to the number of bytes in the FIFO. Check TRM
      for the actual encoding. The default value of 4 causes an interrupt to fire
      when the FIFO is not empty.

  dmas:
    description: |
      Optional DMA specifiers, used for asynchronous controller-mode transfers when
      CONFIG_SPI_TI_UNICOMM_DMA is enabled. Both channels must be given, TX first then RX
      (the channel cell is the DMA channel, the trigger cell is the SPI TX/RX DMA trigger).
      Without it, transfers use interrupts.

  dma-names:
    description: DMA channel names, must be "tx" then "rx" when dmas is set.
```

## dts/bindings/stepper/adi/adi,tmc2241-uart.yaml
```yaml
# SPDX-FileCopyrightText: Copyright (c) 2026 Analog Devices, Inc.
# SPDX-License-Identifier: Apache-2.0

description: |
  ADI/Trinamic TMC2241 Stepper Motor Driver, driver-only (no ramp generator),
  single-wire UART mode

compatible: "adi,tmc2241"

include: [uart-device.yaml, "adi,tmc2241-base.yaml"]

properties:
  uart-en-gpios:
    type: phandle-array
    description: |
      GPIO connected to the UART_EN pin of TMC2241. Driven high at init to
      select the single-wire UART interface (low selects SPI).
      If not provided, it's assumed UART_EN is hardwired high.

  uart-device-addr:
    type: int
    description: |
      UART device address for TMC2241 in UART mode.
    min: 0
    max: 253

examples:
  - |
    &uart2 {
        current-speed = <115200>;
        status = "okay";

        tmc2241: tmc2241 {
            compatible = "adi,tmc2241";
            uart-en-gpios = <&gpiob 0x01 GPIO_ACTIVE_HIGH>;

            /* Common settings from base binding */
            clock-frequency = <DT_FREQ_M(12)>;
            en-pwm-mode;
            shaft;

            tmc2241_stepper_driver: stepper-driver {
                compatible = "adi,tmc5241-stepper-driver";
                micro-step-res = <256>;

                /* ADI TMC stallguard settings specific to TMC2241 */
                stallguard2-threshold = <9>;
            };
        };
    };
```

## dts/bindings/stepper/adi/adi,tmc5241-uart.yaml
```yaml
# SPDX-FileCopyrightText: Copyright (c) 2026 Analog Devices, Inc.
# SPDX-License-Identifier: Apache-2.0

description: |
  ADI/Trinamic TMC5241 Stepper Motor Controller (UART single-wire mode)

  This binding supports the single-wire UART mode where:
  - DIAG1/SW is connected to the MCU's UART TX/RX pin (TX through a series
    resistor, as on the TMC5241-EVKIT, so the host can read back its own bytes)
  - UART_EN must be HIGH (either via GPIO control or hardwired)

compatible: "adi,tmc5241"

include: [uart-device.yaml, "adi,tmc5241-base.yaml"]

properties:
  uart-en-gpios:
    type: phandle-array
    description: |
      GPIO connected to the UART_EN pin of TMC5241. Driven high at init to
      select the single-wire UART interface (low selects SPI).
      If not provided, it's assumed UART_EN is hardwired high.

  uart-device-addr:
    type: int
    description: |
      UART device address for TMC5241 in UART mode.
    min: 0
    max: 253

examples:
  - |
    &uart2 {
        current-speed = <115200>;
        status = "okay";

        tmc5241: tmc5241 {
            compatible = "adi,tmc5241";
            uart-en-gpios = <&gpiob 0x01 GPIO_ACTIVE_HIGH>;

            /* Common settings from base binding */
            clock-frequency = <DT_FREQ_M(12)>;
            en-pwm-mode;
            shaft;

            tmc5241_stepper_driver: stepper-driver {
                compatible = "adi,tmc5241-stepper-driver";
                micro-step-res = <256>;

                /* ADI TMC stallguard settings specific to TMC5241 */
                stallguard2-threshold = <9>;
            };

            tmc5241_stepper_ctrl: stepper-ctrl {
              compatible = "adi,tmc5241-stepper-ctrl";

              /* ADI TMC ramp generator as well as current settings */
              vstart = <10>;
              a1 = <20>;
              v1 = <30>;
              d1 = <40>;
              vmax = <50>;
              amax = <60>;
              dmax = <70>;
              tzerowait = <80>;
              thigh = <90>;
              tcoolthrs = <100>;
              tpwmthrs = <110>;
              tpowerdown = <120>;
              ihold = <1>;
              irun = <2>;
              iholddelay = <3>;
            };
        };
    };
```

## dts/bindings/test/vnd,aic3104-test-clock.yaml
```yaml
# SPDX-FileCopyrightText: Copyright The Zephyr Project Contributors
# SPDX-License-Identifier: Apache-2.0

description: |
  Clock provider for the TLV320AIC3104 tests. It counts clock_control_on()
  calls and reports a fixed rate. It has no clock-frequency property, so the
  codec driver reads it through the clock control API, not at build time.

compatible: "vnd,aic3104-test-clock"

include: [clock-controller.yaml, base.yaml]

properties:
  output-rate:
    type: int
    required: true
    description: Rate in Hz that clock_control_get_rate() reports.

  "#clock-cells":
    const: 1

clock-cells:
  - name
```

## dts/bindings/test/vnd,counter.yaml
```yaml
# Copyright (c) 2026 Meta Platforms
# SPDX-License-Identifier: Apache-2.0

description: VND counter controller

compatible: "vnd,counter"

include: [base.yaml]

properties:
  reg:
    required: true

  "#counter-alarm-cells":
    type: int
    const: 1

  "#counter-capture-cells":
    type: int
    const: 2

counter-alarm-cells:
  - channel

counter-capture-cells:
  - channel
  - flags
```

## dts/bindings/timer/riscv,machine-timer.yaml
```yaml
# Copyright (c) 2025 MASSDRIVER EI (massdriver.space)
# SPDX-License-Identifier: Apache-2.0

description: RISC-V Machine Timer.

compatible: "riscv,machine-timer"

include: base.yaml

properties:
  reg:
    required: true
  reg-names:
    required: true
  interrupts-extended:
    required: true
  clock-frequency:
    type: int
    description: Clock frequency in Hz
  no-64bit-mmio:
    type: boolean
    description: |
      Set when the machine timer MMIO registers do not support 64-bit accesses
      (for example, T-Head C9xx CLINT implementations). On 64-bit targets,
      mtimecmp is written using 32-bit accesses and mtime is read via the time
      CSR when Zicntr is available, or via 32-bit MMIO reads otherwise.
```

## dts/bindings/timer/wch,systick-ch32v10x.yaml
```yaml
# SPDX-FileCopyrightText: Copyright (c) 2026 BayLibre SAS
# SPDX-License-Identifier: Apache-2.0

description: |
  WCH CH32V10x SysTick. Its counter and compare value are eight byte-wide
  registers, unlike the SysTick of the other QingKe cores.

compatible: "wch,systick-ch32v10x"

include: base.yaml

properties:
  reg:
    required: true

  interrupts:
    required: true
```

## dts/bindings/usb/atmel,sam0-usb.yaml
```yaml
description: |
    Atmel SAM0 USB in device mode.

    This binding also covers SAM0-compatible USB controllers used by
    Microchip devices.

compatible: "atmel,sam0-usb"

include:
  - name: usb-ep.yaml
  - name: pinctrl-device.yaml

properties:
  reg:
    required: true

  interrupts:
    required: true

  clocks:
    description: |
      Clock phandles used to drive the USB controller.

  clock-names:
    description: |
      Clock names corresponding to the clocks property.

  nvm-calib:
    type: phandle
    description: |
      NVM area that holds the USB pad calibration values. The bit offsets in
      calib-mapping are counted from the start of this area.

  calib-mapping:
    type: array
    description: |
      Location of the USB pad calibration values in the area given by
      nvm-calib. Three entries in the order TRANSN, TRANSP and TRIM, each
      <nvm_bit default>.

      nvm_bit is the bit offset of the value and must not cross a 32-bit word
      boundary. default is used when all bits of the value are set, which
      means the fuse is unprogrammed.
```

## dts/bindings/usb/mentor,musb-host.yaml
```yaml
# SPDX-FileCopyrightText: Copyright (c) 2026 Microchip Technology Inc.
# SPDX-License-Identifier: Apache-2.0

description: |
  Mentor Graphics MUSB host controller.

  The MUSB core is a dual-role controller. The device role uses the
  "mentor,musb" compatible; this binding selects the host role. Only one role
  can be active for a given controller instance.

compatible: "mentor,musb-host"

include: usb-ep.yaml

properties:
  reg:
    required: true

  interrupts:
    required: true

  num-bidir-endpoints:
    description: |
      Number of hardware endpoints available for host channels, including
      EP0. At most 16.

  vbus-gpios:
    description: |
      GPIO that controls VBUS power to the downstream port. The active level of
      the GPIO (as encoded in the flags cell) is driven to enable VBUS. If this
      property is omitted, the driver assumes VBUS is supplied externally and
      performs no VBUS switching.
```

## dts/bindings/usb/microchip,usbhs-g1-host.yaml
```yaml
# SPDX-FileCopyrightText: Copyright (c) 2026 Microchip Technology Inc.
# SPDX-License-Identifier: Apache-2.0

title: Microchip USBHS G1 host controller

description: |
  Microchip USBHS G1 host-role bindings.

  Group usbhs-g1 USB driver supports following hardware peripherals:
    - module name="USBHS" id="03787" version="2a0"

  The same USBHS hardware block is used as a device controller through the
  "microchip,usbhs-g1", "mentor,musb" compatibles (drivers/usb/udc/udc_musb.c).
  To use the host role (drivers/usb/uhc/uhc_musb.c), override the compatible
  of the SoC USBHS node in the board or application overlay:

    compatible = "microchip,usbhs-g1-host", "mentor,musb-host";

compatible: "microchip,usbhs-g1-host"

include: mentor,musb-host.yaml

properties:
  reg:
    required: true
    description: |
      USBHS wrapper and MUSB core register regions.

  reg-names:
    required: true
    description: |
      Must be "wrapper", "core".

  clocks:
    required: true
    description: |
      Clock configuration for the USB controller. At minimum the AHB module
      clock must be provided.

  clock-names:
    description: |
      Names of the clock inputs, e.g. "ahb".

  nvm-phy-calib:
    type: phandle
    description: |
      Phandle to the NVM PHY calibration fuse area. Inherited from the SoC
      USBHS node (see microchip,usbhs-g1). The host role programs fixed PHY
      calibration values and does not read this fuse.
```
