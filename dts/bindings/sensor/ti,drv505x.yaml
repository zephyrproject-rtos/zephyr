## dts/bindings/sensor/ti,drv505x.yaml
```yaml
# SPDX-FileCopyrightText: Copyright RAKwireless Technology Limited
# SPDX-License-Identifier: Apache-2.0

title: Texas Instruments DRV505x Hall-effect sensor read through an ADC.

description: |
  A DRV505x answers a magnetic field with an analog voltage, which an ADC
  reads. The field is reported on SENSOR_CHAN_MAGN_Z, the axis being the one
  normal to the top of the package.

  Datasheets SBAS596, SBAS788 and SBAS644, equation 1, without the
  temperature term:

    VOUT = VQ + B * sensitivity

  One compatible covers the series, because what sets its parts apart is
  that pair of numbers, and both of them belong to the board: the quiescent
  voltage of a DRV5055 is half of whatever supply it runs from, and the
  sensitivity of a ratiometric part scales with that supply too.

  A DRV5056 is unipolar and answers a south pole only, so the field it
  reports never falls below zero by more than the tolerance on its quiescent
  voltage.

compatible: "ti,drv505x"

include: sensor-device.yaml

properties:
  io-channels:
    type: phandle-array
    required: true
    description: |
      ADC that reads the output voltage: <&adc_node channel>

  sensitivity-microvolts-per-millitesla:
    type: int
    required: true
    description: |
      Output change per millitesla, at the supply the part runs from. It is
      negative on the DRV5053 versions whose output falls as a south pole
      approaches.

  quiescent-microvolts:
    type: int
    required: true
    description: |
      Output with no field present. The datasheets give 1020000 for the
      DRV5053, half the supply for the DRV5055 and 600000 for the DRV5056.
```

## dts/bindings/sensor/ti,mspm0-temp.yaml
```yaml
# SPDX-FileCopyrightText: Copyright The Zephyr Project Contributors
# SPDX-License-Identifier: Apache-2.0

title: TI MSPM0 internal die temperature sensor

description: |
  The temperature sensor is an internal input of the ADC12. Each device stores a
  single-point factory trim, TEMP_SENSE0: the 12-bit ADC code of the sensor at
  ts-trim-temp, measured against a ts-trim-vref reference. The driver samples the
  sensor on the ADC internal reference and computes

    T = ts-trim-temp + (V_sample - V_trim) / ts-coefficient

  The trim conditions and the coefficient come from the device datasheet and are
  set in the SoC devicetree.

  The referenced ADC channel must use the internal reference
  (zephyr,reference = "ADC_REF_INTERNAL", with the vref property set on the ADC
  node) and sample for at least 12.5 us.

compatible: "ti,mspm0-temp"

include: sensor-device.yaml

properties:
  io-channels:
    required: true
    description: ADC channel connected to the temperature sensor.

  ts-trim-temp:
    type: int
    required: true
    description: Temperature of the factory trim (TSTRIM), in degrees Celsius.

  ts-trim-vref:
    type: int
    required: true
    description: |
      Reference voltage of the factory trim measurement, in millivolts: 1400 for
      the internal reference, or the supply voltage when the trim was taken against
      VDD.

  ts-coefficient:
    type: int
    required: true
    description: Temperature coefficient of the sensor (TSc), in microvolts per degree Celsius.

examples:
  - |
    #include <zephyr/dt-bindings/adc/adc.h>

    &adc0 {
        vref = <&vref0>;
        #address-cells = <1>;
        #size-cells = <0>;

        channel@b {
            reg = <11>;
            zephyr,gain = "ADC_GAIN_1";
            zephyr,reference = "ADC_REF_INTERNAL";
            zephyr,acquisition-time = <ADC_ACQ_TIME(ADC_ACQ_TIME_TICKS, 800)>;
            zephyr,resolution = <12>;
        };
    };

    &die_temp {
        status = "okay";
    };
```

## dts/bindings/sensor/ti,opt4048.yaml
```yaml
# Copyright (c) 2026 Darshan Maru <darshanmaru1411@gmail.com>
# SPDX-License-Identifier: Apache-2.0

description: |
  TI OPT4048 high speed, high precision tristimulus XYZ color sensor.

compatible: "ti,opt4048"

include: [sensor-device.yaml, i2c-device.yaml]

properties:
  conversion-time:
    type: int
    default: 8
    enum: [0, 1, 2, 3, 4, 5, 6, 7, 8, 9, 10, 11]
    description: |
      Conversion time per channel. The default of 100 ms provides a
      practical balance between measurement speed and noise performance
      for general-purpose ambient light sensing. Applications requiring
      faster response should select a shorter conversion time.

      0: 600 us, 1: 1 ms, 2: 1.8 ms, 3: 3.4 ms,
      4: 6.5 ms, 5: 12.7 ms, 6: 25 ms, 7: 50 ms,
      8: 100 ms, 9: 200 ms, 10: 400 ms, 11: 800 ms.

  range:
    type: int
    default: 12
    enum: [0, 1, 2, 3, 4, 5, 6, 12]
    description: |
      Full-scale measurement range. The default enables automatic
      ranging, allowing the sensor to adapt to changing illumination
      without board-specific tuning. A fixed range should be selected
      when the illumination level is known.

      0: 2.2 klux, 1: 4.5 klux, 2: 9 klux, 3: 18 klux,
      4: 36 klux, 5: 72 klux, 6: 144 klux, 12: automatic range.

  operating-mode:
    type: int
    default: 3
    enum: [0, 1, 2, 3]
    description: |
      Operating mode. The default enables continuous conversion, which
      matches the most common use case of periodically polling ambient
      light. One-shot modes should be selected when measurements are
      needed only on demand or when reducing power consumption is a
      priority.

      0: power-down, 1: forced auto-range one-shot,
      2: one-shot, 3: continuous.

      In one-shot modes, each sample_fetch() call must trigger a
      new measurement and wait for its completion.
```

## dts/bindings/sensor/winsen,mq.yaml
```yaml
# SPDX-FileCopyrightText: Copyright RAKwireless Technology Limited
# SPDX-License-Identifier: Apache-2.0

title: Winsen MQ series gas sensor read through an ADC.

description: |
  The sensing element of an MQ sensor is a heated resistor whose value falls
  as the gas it is sensitive to grows denser. It sits in series with a load
  resistor across the heater supply, and an ADC reads the voltage across that
  load resistor.

  The sensor resistance follows from that voltage and is reported on
  SENSOR_CHAN_GAS_RES. One compatible covers the series, because what sets
  the parts apart is the sensitivity curve, and a part sensitive to several
  gases has one curve per gas, so the curve is a property of the board and
  the gas it watches rather than of the part alone.

  Turning the resistance into a concentration also needs the resistance the
  part shows in clean air, which differs from part to part and drifts, so
  SENSOR_CHAN_MQ_PPM is reported only once r0-ohms is known. It can be given
  here or measured at runtime with SENSOR_ATTR_MQ_R0.

compatible: "winsen,mq"

include: sensor-device.yaml

properties:
  io-channels:
    type: phandle-array
    required: true
    description: |
      ADC that reads the voltage across the load resistor:
      <&adc_node channel>

  load-resistance-ohms:
    type: int
    required: true
    description: |
      Resistance in series with the sensing element, in ohms. Boards that
      trim it with a potentiometer state the value it was set to.

  r0-ohms:
    type: int
    description: |
      Resistance the sensing element shows in clean air, in ohms. Without it
      SENSOR_CHAN_MQ_PPM returns -ENODATA until SENSOR_ATTR_MQ_R0 is set.

  curve-scale-milli:
    type: int
    description: |
      Factor a of ppm = a * (Rs / R0) ^ b, scaled by 1000. Read off the
      sensitivity curve of the part for the gas being measured.

  curve-exponent-milli:
    type: int
    description: |
      Exponent b of ppm = a * (Rs / R0) ^ b, scaled by 1000. It is negative,
      as the resistance falls while the concentration rises. Without both
      curve properties SENSOR_CHAN_MQ_PPM returns -ENOTSUP.
```

## dts/bindings/sensor/zephyr,generic-emul-sensor.yaml
```yaml
# Copyright (c) 2026 Embeint Holdings Pty Ltd
# SPDX-License-Identifier: Apache-2.0

description: |
  Generic emulated sensor for use in testing other libraries

compatible: "zephyr,generic-emul-sensor"

include: [sensor-device.yaml]

properties:
  negated-init-rc:
    type: int
    default: 0
    description:
      Value to return in init function (negated due to devicetree limitation
      to unsigned integers).

  sampling-frequency:
    type: int
    description:
      Rate in Hz at which the FIFO gains a sample, rounded to whole kernel
      ticks. Samples arrive fifo-watermark at a time. Setting it enables
      streaming. Pending stream reads, multishot or plain, are served in
      submission order, from the sampling timer. A plain read's buffer must
      hold fifo-watermark samples; the samples that do not fit stay in the
      FIFO. A full RTIO memory pool ends the read with -ENOMEM. Sampling
      continues while no read is pending, until a cancel leaves none.

  fifo-watermark:
    type: int
    default: 1
    description:
      Samples held before a streaming read completes, from 1 to fifo-depth.

  fifo-depth:
    type: int
    default: 32
    description:
      Samples the FIFO holds. Once it is full, each new sample replaces the
      oldest, which counts as an overrun.
```

## dts/bindings/serial/espressif,esp32-uart.yaml
```yaml
description: ESP32 UART

compatible: "espressif,esp32-uart"

include: [uart-controller.yaml, uart-controller-pin-inversion.yaml, pinctrl-device.yaml]

properties:
  reg:
    required: true

  pinctrl-0:
    required: true

  pinctrl-names:
    required: true

  stop-bits:
    description: |
      Sets the number of stop bits. Defaults to standard of 1 if not specified.
    default: "1"

  data-bits:
    description: |
      Sets the number of data bits. Defaults to standard of 8 if not specified.
    default: 8

  hw-rs485-hd-mode:
    type: boolean
    description: |
      Enable the hardware RS485 half duplex mode.
      Overrides hw-flow-control if both are set.
      Using this mode, the pin assigned to DTR
      is asserted during transmission.

  rx-fifo-threshold:
    type: int
    min: 1
    max: 127
    description: |
      Number of bytes in the RX FIFO that raises the RX FIFO full interrupt.
      A low value reports received bytes to the interrupt-driven API without
      waiting for the RX timeout, at the cost of more interrupts.
      When not set, the deprecated CONFIG_UART_ESP32_RX_FIFO_THRESH value is
      used.

  tx-fifo-threshold:
    type: int
    min: 1
    max: 127
    description: |
      Number of bytes in the TX FIFO at or below which the TX FIFO empty
      interrupt is raised.
      When not set, the deprecated CONFIG_UART_ESP32_TX_FIFO_THRESH value is
      used.

  rx-timeout:
    type: int
    default: 22
    min: 1
    max: 255
    description: |
      RX line idle time, in character times, after which the bytes held in the
      RX FIFO are reported to the interrupt-driven API even when fewer than
      rx-fifo-threshold bytes were received. The default keeps RX interrupts
      infrequent on ports that receive continuous data. Protocols that end a
      frame on line idle time, such as Modbus RTU, need a value below their
      inter-frame gap. Values above the hardware limit for the current frame
      format are clamped to that limit.

  uhci-slip-tx:
    type: boolean
    description: |
      Enable SLIP encoding on TX when using UART with DMA (async API).
      When enabled, the UHCI hardware automatically encodes transmitted data
      using SLIP framing (0xC0 -> 0xDB 0xDC, 0xDB -> 0xDB 0xDD).
      Disabled by default to prevent unintended data corruption.

  uhci-slip-rx:
    type: boolean
    description: |
      Enable SLIP decoding on RX when using UART with DMA (async API).
      When enabled, the UHCI hardware automatically decodes received data
      using SLIP framing (0xDB 0xDC -> 0xC0, 0xDB 0xDD -> 0xDB).
      Disabled by default to prevent unintended data corruption.
```

## dts/bindings/serial/ti,unicomm-uart.yaml
```yaml
# Copyright (c) 2026 Texas Instruments Incorporated
# SPDX-License-Identifier: Apache-2.0

description: TI UNICOMM UART

compatible: "ti,unicomm-uart"

include: "ti,mspm0-uart.yaml"
```

## dts/bindings/spi/atmel,sam-qspi.yaml
```yaml
# SPDX-FileCopyrightText: Copyright The Zephyr Project Contributors
# SPDX-License-Identifier: Apache-2.0

description: |
  Atmel SAM QSPI controller, as found on SAM E70/S70/V70/V71 and
  PIC32CZ CA70/MC70.

  The driver runs the controller in SPI mode, as a single-line SPI
  controller. The chip select is the hardware QCS line unless cs-gpios
  is set.

examples:
  - |
    &qspi {
      pinctrl-0 = <&qspi_default>;
      pinctrl-names = "default";
      status = "okay";

      flash@0 {
        compatible = "jedec,spi-nor";
        reg = <0>;
        spi-max-frequency = <50000000>;
      };
    };

compatible: "atmel,sam-qspi"

include:
  - name: spi-controller.yaml
  - name: pinctrl-device.yaml

properties:
  reg:
    required: true

  reg-names:
    required: true
    description: |
      "qspi" for the registers, "qspi_mm" for the serial memory window.

  interrupts:
    required: true

  clocks:
    required: true
```

## dts/bindings/spi/brcm,bcm2835-spi.yaml
```yaml
# Copyright (c) 2026 Jonathan Elliot Peace <jep@alphabetiq.com>
# SPDX-License-Identifier: Apache-2.0

title: Broadcom BCM283x SPI Controller

description: |
  Chip select is driven through cs-gpios; the native CE0/CE1 lines of the
  controller are not used.

compatible: "brcm,bcm2835-spi"

include: [spi-controller.yaml, pinctrl-device.yaml]

properties:
  reg:
    required: true

  interrupts:
    required: true

  clocks:
    required: true

  pinctrl-0:
    required: true

  pinctrl-names:
    required: true
```

## dts/bindings/spi/infineon,spi-m0s8.yaml
```yaml
# SPDX-FileCopyrightText: Copyright (c) 2026 Linumiz
#
# SPDX-License-Identifier: Apache-2.0

description: |
  Infineon SCB in SPI mode on the M0S8 SCB generation (PSOC 4 HVMS)

  The M0S8 SCB selects the FIFO element width with CTRL.BYTE_MODE instead of
  CTRL.MEM_WIDTH, and has no slave select delay or SPI_TX_CTRL/SPI_RX_CTRL
  registers. List "infineon,spi" as the fallback compatible.

compatible: "infineon,spi-m0s8"

include: "infineon,spi.yaml"
```
