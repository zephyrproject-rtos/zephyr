## dts/bindings/sensor/avia,hx711-spi.yaml
```yaml
# Copyright (c) 2026 Zephyr Project Developers
# SPDX-License-Identifier: Apache-2.0

description: |
    Avia Semiconductor HX711 24-bit ADC Specialized for Load Cells / Strain Gauges on SPI bus

compatible: "avia,hx711-spi"

include: ["spi-device.yaml", "sensor-device.yaml", "pinctrl-device.yaml"]

properties:
  gain:
    type: int
    required: true
    enum:
      - 64
      - 128
    description: |
      PGA gain for channel A

  avdd:
    type: int
    required: true
    description: |
      AVDD value in milivolts, for converting samples to voltage

  dout-trig-gpios:
    type: phandle-array
    description: |
      GPIO for DOUT and trigger signal indicating a sample is ready
```

## dts/bindings/sensor/avia,hx711.yaml
```yaml
# Copyright (c) 2020 George Gkinis
# Copyright (c) 2021 Jan Gnip
# SPDX-License-Identifier: Apache-2.0

description: |
  Avia HX711 sensor

compatible: "avia,hx711"

include: base.yaml

properties:
  sample-fetch-timeout-ms:
    type: int
    required: false
    default: 700
    description: |
      Time until sample-fetch will wait before returning an error.
      Most module implementations have a wake-up time after power up of about 600ms.
      Default set to 700ms to ensure most implementations will work.
      Increase if necessary.

  gain:
    type: int
    required: false
    default: 1
    description: |
      Gain of the sensor. 1 = 128x, 2 = 32x, 3 = 64x.
      Default set to 1(128x) as this is the sensors default setting after power-up.
    enum:
      - 1
      - 2
      - 3

  rate-hz:
    type: int
    required: true
    description: |
      Sensor sample rate. 0 = 10Hz, 1 = 80Hz
      User should provide initial value depending on HW implementation.
      If CONFIG_PM_DEVICE_RUNTIME = y rate will not be higher
      than 2~3Hz due to the long wake-up time needed for HX711.
    enum:
      - 0
      - 1

  dout-gpios:
    type: phandle-array
    required: true
    description: |
      Pin on which sensor data will be read from.

  sck-gpios:
    type: phandle-array
    required: true
    description: |
      Pin on which data fetch triggering occurs.

  rate-gpios:
    type: phandle-array
    required: false
    description: |
      Pin on which sampling rate is chosen.
```

## dts/bindings/sensor/avia,hx717.yaml
```yaml
# Copyright (c) 2020 George Gkinis
# Copyright (c) 2021 Jan Gnip
# SPDX-License-Identifier: Apache-2.0

description: |
  Avia HX711 sensor

compatible: "avia,hx717"

include: avia,hx7xx-common.yaml

properties:
  gain:
    type: int
    description: |
      Gain of the sensor.
      Default set to 128x as this is the sensors default setting after power-up.
    default: 128
    enum: [128, 64, 8]

  rate-hz:
    type: int
    description: |
      Sensor sample rate.
      User should provide initial value depending on HW implementation.
      If CONFIG_PM_DEVICE_RUNTIME = y rate will not be higher
      than 2~3Hz due to the long wake-up time needed for HX717.
    default: 10
    enum: [10, 20, 80, 320]

  rate-gpios:
    type: phandle-array
    description: |
      Pin on which sampling rate is chosen.
```

## dts/bindings/sensor/avia,hx71708.yaml
```yaml
# Copyright (c) 2020 George Gkinis
# Copyright (c) 2021 Jan Gnip
# SPDX-License-Identifier: Apache-2.0

description: |
  Avia HX71708 sensor

compatible: "avia,hx71708"

include: avia,hx7xx-common.yaml

properties:
  rate-hz:
    type: int
    description: |
      Sensor sample rate.
      User should provide initial value depending on HW implementation.
      If CONFIG_PM_DEVICE_RUNTIME = y rate will not be higher
      than 2~3Hz due to the long wake-up time needed for HX71708.
    default: 10
    enum: [10, 20, 80, 320]
```

## dts/bindings/sensor/avia,hx7xx-common.yaml
```yaml
# Copyright (c) 2020 George Gkinis
# Copyright (c) 2021 Jan Gnip
# SPDX-License-Identifier: Apache-2.0

include: base.yaml

properties:
  sample-fetch-timeout-ms:
    type: int
    default: 700
    description: |
      Time until sample-fetch will wait before returning an error.
      Most module implementations have a wake-up time after power up of about 600ms.
      Default set to 700ms to ensure most implementations will work.
      Increase if necessary.

  dout-gpios:
    type: phandle-array
    required: true
    description: |
      Pin on which sensor data will be read from.

  sck-gpios:
    type: phandle-array
    required: true
    description: |
      Pin on which data fetch triggering occurs.
```

## dts/bindings/sensor/bflb,tsen.yaml
```yaml
# Copyright The Zephyr Project Contributors
#
# SPDX-License-Identifier: Apache-2.0

title: Bouffalo Lab internal die temperature sensor (TSEN)

description: |
  TSEN is an internal input of the GPADC. It has no external pins: the
  analog front-end is shared with the general-purpose ADC and is switched
  into temperature-sense mode by the BFLB ADC driver when a channel is
  configured with zephyr,input-positive = 14.

  Integration requirements:

    * The parent ADC controller node (e.g. &adc0) must be enabled.
    * The referenced ADC channel must use:
        - zephyr,input-positive = 14
        - zephyr,resolution = 16
        - zephyr,gain = "ADC_GAIN_1"
        - zephyr,reference = "ADC_REF_INTERNAL"
        - zephyr,acquisition-time = <ADC_ACQ_TIME_DEFAULT>
    * No pinctrl pins are required; an empty pinctrl state on the ADC is
      sufficient.
    * The sensor driver reads a factory calibration offset from the SoC
      efuse when available and falls back to a built-in default otherwise.

compatible: "bflb,tsen"

include: sensor-device.yaml

properties:
  io-channels:
    required: true
    description: |
      Reference to the ADC controller and the channel node configured for
      the internal TSEN input. The channel must have
      zephyr,input-positive = 14.

examples:
  - |
    #include <zephyr/dt-bindings/adc/adc.h>

    &adc0 {
        status = "okay";
        pinctrl-0 = <&adc0_default>;
        pinctrl-names = "default";

        channel@0 {
            reg = <0>;
            zephyr,gain = "ADC_GAIN_1";
            zephyr,reference = "ADC_REF_INTERNAL";
            zephyr,acquisition-time = <ADC_ACQ_TIME_DEFAULT>;
            zephyr,resolution = <16>;
            zephyr,input-positive = <14>;
        };
    };

    &tsen {
        status = "okay";
    };
```

## dts/bindings/sensor/bosch,bhi2xy.yaml
```yaml
description: |
  Bosch BHI260AP/BHI260AB ultra-low power smart sensor with integrated accelerometer and gyroscope.

  The BHI260AP/BHI260AB is an ultra-low power, customizable smart sensor consisting of Bosch
  Sensortec's programmable 32-bit microcontroller (Fuser2), a state-of-the-art 6-axis IMU
  (3-Axis Accelerometer + 3-Axis Gyroscope) and a powerful Event-driven Software Framework
  containing pre-installed sensor fusion and other sensor data processing software.

compatible: "bosch,bhi2xy"

include: sensor-device.yaml

properties:
  variant:
    type: string
    required: true
    description: Sensor variant (BHI260AP or BHI260AB)
    enum:
      - "BHI260AB"
      - "BHI260AP"

  reset-gpios:
    type: phandle-array
    description: |
      The RESET signal connection.

  supply-gpios:
    type: phandle-array
    description: |
      GPIO specifier that controls power to the device.

  vin-supply:
    type: phandle
    description: |
      Reference to the regulator that controls power to the device.
```

## dts/bindings/sensor/bosch,bma280.yaml
```yaml
# Copyright (c) 2020 Nordic Semiconductor ASA
# SPDX-License-Identifier: Apache-2.0

description: |
  Bosch BMA280 triaxial acceleration sensor.  See more info at:
  https://www.bosch-sensortec.com/products/motion-sensors/accelerometers/bma280.html

compatible: "bosch,bma280"

include: i2c-device.yaml

properties:
  int1-gpios:
    type: phandle-array
    required: false
    description: |
      Identifies pin for the INT1 signal on the sensor.  The sensor
      INT2 signal is not supported by the driver.

  is-bmc150:
    type: boolean
    required: false
    description: |
      Specifies that the driver should adapt to the accelerometer
      capability provided by the BMC150 6-axis eCompass.  This affects
      the chip ID and the resolution of the measurements.
```

## dts/bindings/sensor/bosch,bma400-i2c.yaml
```yaml
# Copyright (c) 2020, Bosch Sensortec GmbH
# SPDX-License-Identifier: Apache-2.0

description: |
    The BMA400 is an ultra-low power accelerometer. See more info at:
    https://www.bosch-sensortec.com/products/motion-sensors/accelerometers/bma400.html

compatible: "bosch,bma400"

include: i2c-device.yaml
```

## dts/bindings/sensor/bosch,bma400-spi.yaml
```yaml
# Copyright (c) 2025 Luca Gessi
# SPDX-License-Identifier: Apache-2.0

description: |
  Bosch BMA400 3-axis acceleration sensors in SPI mode.  See more info at:
  https://www.bosch-sensortec.com/products/motion-sensors/accelerometers/

compatible: "bosch,bma400"

include: [spi-device.yaml, "bosch,bma400-common.yaml"]
```

## dts/bindings/sensor/bosch,bma400.yaml
```yaml
# Copyright (c) 2020 Nordic Semiconductor ASA
# SPDX-License-Identifier: Apache-2.0

description: |
  Bosch BMA400 triaxial acceleration sensor.  See more info at:
  https://www.bosch-sensortec.com/products/motion-sensors/accelerometers/bma400.html

compatible: "bosch,bma400"

include: i2c-device.yaml

properties:
  int1-gpios:
    type: phandle-array
    required: false
    description: |
      Mapping for INT1 pin.

  int2-gpios:
    type: phandle-array
    required: false
    description: |
      Mapping for INT2 pin.
```

## dts/bindings/sensor/bosch,bma4xx-common.yaml
```yaml
# Copyright (c) 2023 Google LLC
# SPDX-License-Identifier: Apache-2.0

properties:
  int1-gpios:
    type: phandle-array
    description: |
      Identifies pin for the INT1 signal on the sensor.  The sensor
      INT2,3,4 signals are not supported by the driver.
```

## dts/bindings/sensor/bosch,bma4xx-i2c.yaml
```yaml
# Copyright (c) 2023 Google LLC
# SPDX-License-Identifier: Apache-2.0

description: |
  Bosch BMA4xx 3-axis acceleration sensors in I2C mode.  See more info at:
  https://www.bosch-sensortec.com/products/motion-sensors/accelerometers/

compatible: "bosch,bma4xx"

include: [sensor-device.yaml, i2c-device.yaml, "bosch,bma4xx-common.yaml"]
```

## dts/bindings/sensor/bosch,bma4xx-spi.yaml
```yaml
# Copyright (c) 2023 Google LLC
# SPDX-License-Identifier: Apache-2.0

description: |
  Bosch BMA4xx 3-axis acceleration sensors in SPI mode.  See more info at:
  https://www.bosch-sensortec.com/products/motion-sensors/accelerometers/

  SPI mode is currently NOT supported in the driver but is specified in the
  bindings for ease of future expansion.

compatible: "bosch,bma4xx"

include: [sensor-device.yaml, spi-device.yaml, "bosch,bma4xx-common.yaml"]
```

## dts/bindings/sensor/bosch,bma530-common.yaml
```yaml
# Copyright (c) 2024 Arrow Electronics.
# SPDX-License-Identifier: Apache-2.0

properties:
  sampling-frequency-hz:
    description: |
      Sampling frequency of accelerometer [Hz]. Only the listed values are allowed.
      The position in enum is already the value to write to register (with a proper offset).
      The default chip reset frequency is 200 Hz.
    type: string
    default: "200"
    enum:
      - "1.5625"
      - "3.125"
      - "6.25"
      - "12.5"
      - "25"
      - "50"
      - "100"
      - "200"
      - "400"
      - "800"
      - "1600"
      - "3200"
      - "6400"

  full-scale-range-g:
    description: Full scale range in [g].
      The position in enum is already the value to write to register (with a proper offset).
      The default chip reset range is 8 g.
    type: int
    default: 8
    enum:
      - 2
      - 4
      - 8
      - 16

  power-mode:
    description: |
      Accelerometer power mode.
      The position in enum is already the value to write to register (with a proper offset).
      The default chip reset mode is HPM.
      "LPM" - Low power mode (Duty Cycling mode)
      "HPM" - High performance mode (Continuous mode)
    type: string
    default: "HPM"
    enum:
      - "LPM"
      - "HPM"
```

## dts/bindings/sensor/bosch,bma530-i2c.yaml
```yaml
# Copyright (c) 2024 Arrow Electronics.
# SPDX-License-Identifier: Apache-2.0

description: |
  Bosch BMA530 3-axis acceleration sensor in I2C mode. See more info at:
  https://www.bosch-sensortec.com/products/motion-sensors/accelerometers/

compatible: "bosch,bma530"

include: [sensor-device.yaml, i2c-device.yaml, "bosch,bma530-common.yaml"]
```

## dts/bindings/sensor/bosch,bma530-spi.yaml
```yaml
# Copyright (c) 2024 Arrow Electronics.
# SPDX-License-Identifier: Apache-2.0

description: |
  Bosch BMA530 3-axis acceleration sensor in SPI mode. See more info at:
  https://www.bosch-sensortec.com/products/motion-sensors/accelerometers/

  SPI mode is currently NOT supported in the driver but is specified in the
  bindings for ease of future expansion.

compatible: "bosch,bma530"

include: [sensor-device.yaml, spi-device.yaml, "bosch,bma530-common.yaml"]
```

## dts/bindings/sensor/bosch,bmc150_magn.yaml
```yaml
# Copyright (c) 2019, Linaro Limited
# SPDX-License-Identifier: Apache-2.0

description: |
    Bosch BMC150 Magnetometer.  See more info at:
    https://www.bosch-sensortec.com/bst/products/all_products/bmc150

compatible: "bosch,bmc150_magn"

include: [sensor-device.yaml, i2c-device.yaml]

properties:
  drdy-gpios:
    type: phandle-array
```

## dts/bindings/sensor/bosch,bme280-i2c.yaml
```yaml
#
# Copyright (c) 2019, Linaro Limited
#
# SPDX-License-Identifier: Apache-2.0
#
---
title: BME280 Integrated environmental sensor
version: 0.1

description: >
    This is a representation of the BME280 Integrated environmental sensor

inherits:
    !include i2c-device.yaml

properties:
    compatible:
      constraint: "bosch,bme280"

...
```

## dts/bindings/sensor/bosch,bme280-spi.yaml
```yaml
# Copyright (c) 2019, Linaro Limited
# SPDX-License-Identifier: Apache-2.0

description: BME280 integrated environmental sensor

compatible: "bosch,bme280"

include: spi-device.yaml
```

## dts/bindings/sensor/bosch,bmg160.yaml
```yaml
# Copyright (c) 2019, Linaro Limited
# SPDX-License-Identifier: Apache-2.0

description: |
    Bosch BMG160 gyroscope.  See more info at:
    https://www.bosch-sensortec.com/bst/products/all_products/bmg160

compatible: "bosch,bmg160"

include: [sensor-device.yaml, i2c-device.yaml]

properties:
  int-gpios:
    type: phandle-array
```

## dts/bindings/sensor/bosch,bmi088-acc.yaml
```yaml
# Copyright (c) 2018, Linaro Limited
# SPDX-License-Identifier: Apache-2.0

description: BMI088 inertial measurement unit

compatible: "bosch,bmi088-acc"

include: spi-device.yaml

properties:
  osr:
    type: int
    required: false
    default: 0x0A
    description: Oversampling ratio, influences bandwidth of internal low-pass filter. See value "acc_bwp" in datasheet
  odr:
    type: int
    required: false
    default: 0x08
    description: Bandwidth of the internal low-pass filter
```

## dts/bindings/sensor/bosch,bmi088-gyr.yaml
```yaml
# Copyright (c) 2018, Linaro Limited
# SPDX-License-Identifier: Apache-2.0

description: BMI088 inertial measurement unit

compatible: "bosch,bmi088-gyr"

include: spi-device.yaml

properties:
  bandwidth:
    type: int
    required: false
    default: 0x04
    description: Bandwidth of the internal low-pass filter, see value "gyro_bw" in datasheet
```
