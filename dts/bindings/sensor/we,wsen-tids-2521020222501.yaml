## dts/bindings/sent/sent-controller.yaml
```yaml
# Copyright 2025 NXP
#
# SPDX-License-Identifier: Apache-2.0

description: SENT (Single Edge Nibble Transmission) Controller

include: base.yaml

properties:
  reg:
    required: true

child-binding:
  description: |
    Each child node defines the configuration of a SENT channel

  properties:
    reg:
      type: int
      required: true
      description: Channel identifier.

    num-data-nibbles:
      type: int
      enum:
        - 1
        - 2
        - 3
        - 4
        - 5
        - 6
        - 7
        - 8
      required: true
      description: |
        Specifies the number of data nibbles. A nibble is a four-bit aggregation.
        This property defines how many such nibbles are used in the data transmission.

    clock-tick-length-us:
      type: int
      required: true
      description: |
        Specifies the clock tick length in microseconds (us). This value determines the
        base time unit for the system's timing operations, effectively setting the resolution
        of the timer.

    successive-calib-pulse-method:
      type: int
      required: true
      enum:
        - 1
        - 2
      description: |
        Specifies the successive calibration pulse check method options.
        Option 1 is the preferred high-latency method, while option 2 provides
        a low-latency alternative.

    calib-pulse-tolerance-percent:
      type: int
      required: true
      enum:
        - 20
        - 25
      description: |
        Specifies the acceptable calibration pulse tolerance. The available options are
        20% and 25%.

    pause-pulse-detect:
      type: boolean
      description: |
        Indicates whether the channel is enabled to detect a pause pulse.

    fast-crc:
      type: int
      required: true
      description: |
        Specifies the fast message CRC configurations is applied when calculating the CRC.
        Allowed value combinations are defined in dt-bindings/sent/sent.h:
        - FAST_CRC_DISABLE
        - FAST_CRC_RECOMMENDED_IMPLEMENTATION
        - FAST_CRC_LEGACY_IMPLEMENTATION
        - FAST_CRC_RECOMMENDED_IMPLEMENTATION | FAST_CRC_STATUS_INCLUDE
        - FAST_CRC_LEGACY_IMPLEMENTATION | FAST_CRC_STATUS_INCLUDE

    short-serial-crc:
      type: int
      required: true
      description: |
        Specifies the short serial message CRC configurations is applied when calculating the CRC.
        Allowed values are defined in dt-bindings/sent/sent.h:
        - SHORT_CRC_RECOMMENDED_IMPLEMENTATION
        - SHORT_CRC_LEGACY_IMPLEMENTATION
```

## dts/bindings/serial/acts,uart.yaml
```yaml
# Copyright (c) 2019, Manivannan Sadhasivam
# SPDX-License-Identifier: Apache-2.0

description: |
    This binding gives a base representation of the ACTIONS UART

compatible: "acts,uart"

include: uart-controller.yaml

properties:
    reg:
      required: true

    interrupts:
      required: true

    clocks:
      required: true
```

## dts/bindings/serial/adi,max32-uart.yaml
```yaml
# Copyright (c) 2023-2024 Analog Devices, Inc.
# SPDX-License-Identifier: Apache-2.0

description: MAX32 UART

include: [uart-controller.yaml, pinctrl-device.yaml]

compatible: "adi,max32-uart"

properties:
  reg:
    required: true

  clocks:
    required: true

  interrupts:
    required: true

  pinctrl:
    type: phandles

  clock-source:
    type: int
    enum: [0, 1, 2, 3, 4, 5]
    description: |
      Clock source to be used by the UART peripheral. The following options
      are available:
      - 0: "ADI_MAX32_PRPH_CLK_SRC_PCLK" Peripheral clock
      - 1: "ADI_MAX32_PRPH_CLK_SRC_EXTCLK" External Clock
      - 2: "ADI_MAX32_PRPH_CLK_SRC_IBRO" Internal Baud Rate Oscillator
      - 3: "ADI_MAX32_PRPH_CLK_SRC_ERFO" External Radio Frequency Oscillator
      - 4: "ADI_MAX32_PRPH_CLK_SRC_ERTCO" External Real-Time Clock Oscillator
      - 5: "ADI_MAX32_PRPH_CLK_SRC_INRO" Internal Ring Oscillator
      The target device might not support all option please take a look on
      target device user guide

  current-speed:
    description: |
      Initial baud rate setting for UART. Defaults to standard baudrate of 115200 if not specified.
    default: 115200

  stop-bits:
    description: |
      Sets the number of stop bits. Defaults to standard of 1 if not specified.
    default: "1"

  data-bits:
    description: |
      Sets the number of data bits. Defaults to standard of 8 if not specified.
    default: 8

  dmas:
    description: |
      DMA configuration used by asynchronous UART. Consists of a DMA instance,
      channel number and a matching DMA slot.

      For example dmas for TX, RX on UART2
         dmas = <&dma0 1 MAX32_DMA_SLOT_UART2_TX>, <&dma0 2 MAX32_DMA_SLOT_UART2_RX>;

  dma-names:
    description: |
      Required if the dmas property exists.  This should be "tx" and "rx"
      to match the dmas property.

      For example
         dma-names = "tx", "rx";
```

## dts/bindings/serial/aesc,uart.yaml
```yaml
#
# Copyright (c) 2025 Aesc Silicon
#
# SPDX-License-Identifier: Apache-2.0
#

title: Aesc Silicon UART (Universal Synchronous/Asynchronous Receiver/Transmitter)

description: |
  The UART (Universal Asynchronous Receiver-Transmitter) IP Core is a configurable serial
  communication interface designed to handle data transmission and reception. The core includes
  an internal clock divider and supports flexible frame configurations, allowing for variable data
  length, parity, and stop bit settings.

compatible: "aesc,uart"

include: uart-controller.yaml

properties:
  reg:
    required: true
```

## dts/bindings/serial/altera,jtag-uart.yaml
```yaml
description: Altera JTAG UART

compatible: "altera,jtag-uart"

include: uart-controller.yaml

properties:
    reg:
      required: true
```
