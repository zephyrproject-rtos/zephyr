## dts/bindings/sensor/we,wsen-tids-2521020222501.yaml
```yaml
# Copyright (c) 2025 Würth Elektronik eiSos GmbH & Co. KG
# SPDX-License-Identifier: Apache-2.0

description: |
    Würth Elektronik WSEN-TIDS-2521020222501 temperature sensor

compatible: "we,wsen-tids-2521020222501"

include: [sensor-device.yaml, i2c-device.yaml]

properties:
  interrupt-gpios:
    type: phandle-array
    description: Threshold interrupt pin.
      Interrupt is active low by default.

  odr:
    type: int
    required: true
    enum:
      - 0
      - 25
      - 50
      - 100
      - 200
    description: |
      Sensor output data rate expressed in samples per second.
      Data rates supported by the chip are 0 (power down), 25, 50, 100 and 200.

  temp-high-threshold:
    type: int
    default: -40320
    description: |
      Threshold for temperature high limit interrupt event in millidegree Celsius.
      Defaults to -40320, which is the configuration at power-up.

  temp-low-threshold:
    type: int
    default: -40320
    description: |
      Threshold for temperature low limit interrupt event in millidegree Celsius.
      Defaults to -40320, which is the configuration at power-up.
```

## dts/bindings/sensor/we,wsen-tids.yaml
```yaml
# Copyright (c) 2022 Würth Elektronik eiSos GmbH & Co. KG
# SPDX-License-Identifier: Apache-2.0

description: |
    Würth Elektronik WSEN-TIDS temperature sensor

compatible: "we,wsen-tids"

include: [sensor-device.yaml, i2c-device.yaml]

properties:
  int-gpios:
    type: phandle-array
    description: Threshold interrupt pin.
      Interrupt is active low by default.

  odr:
    type: int
    required: true
    enum:
      - 25
      - 50
      - 100
      - 200
    description: |
      Sensor output data rate expressed in samples per second.
      Data rates supported by the chip are 25, 50, 100 and 200.

  temp-high-threshold:
    type: int
    description: |
      Threshold for temperature high limit interrupt event.

  temp-low-threshold:
    type: int
    description: |
      Threshold for temperature low limit interrupt event.
```

## dts/bindings/sensor/winsen,mhz19b.yaml
```yaml
# Copyright (c) 2021 G-Technologies Sdn. Bhd.
# SPDX-License-Identifier: Apache-2.0

description: Winsen MHZ-19B CO2 Sensor

compatible: "winsen,mhz19b"

include: uart-device.yaml

properties:
  maximum-range:
    type: int
    required: true
    description: CO2 detection range.
    enum:
      - 2000
      - 5000
      - 10000

  abc-on:
    type: boolean
    required: false
    description: |
      Enable ABC self-calibration function
```

## dts/bindings/sensor/xlnx,versal-sysmon.yaml
```yaml
# Copyright (c) 2026 Advanced Micro Devices, Inc.
# SPDX-License-Identifier: Apache-2.0

description: AMD/Xilinx Versal System Monitor

compatible: "xlnx,versal-sysmon"

include: [base.yaml]

properties:
  xlnx,numchannels:
    type: int
    required: true
    description: |
      Number of supply channels enabled in the design.
      Range: 0 - 62

child-binding:
  description: SysMon supply channel node

  properties:
    xlnx,register:
      type: int
      required: true
      description: Internal SysMon channel index

    xlnx,name:
      type: string
      required: true
      description: Name of the supply channel
```

## dts/bindings/sensor/zephyr,adc-thermistor.yaml
```yaml
# Copyright (c) 2023, Basalte bv
# SPDX-License-Identifier: Apache-2.0

compatible: "zephyr,adc-thermistor"

include: sensor-device.yaml

description: |
  General Purpose ADC based thermistor sensor with an optional lookup table.

  Example:
    ntc: ntc {
      compatible = "zephyr,adc-thermistor";
      io-channels = <&adc0 1>;
      temperature-lookup-table = <
        0      3086
        10000  2951
        20000  2761
        30000  2512
        40000  2214
        50000  1887
        60000  1558
        70000  1251
        80000  985
        90000  763
        100000 585
        110000 449
        120000 347
        125000 305
      >;
    };

properties:
  io-channels:
    required: true
    description: ADC channel for temperature sensor.

  temperature-lookup-table:
    type: array
    description: |
      Lookup table to map the relation between ADC value and temperature.
      When ADC is read, the value is looked up in the table to get the
      equivalent temperature.

      The table has to have pairs of values where the first value of each
      is the temperature in milliCelsius and the second value is the ADC
      read value. The ADC values have to be in descending order.

      If not specified, the driver assumes the ADC channel gives milliCelsius
      directly.
```

## dts/bindings/sensor/zephyr,flow-meter.yaml
```yaml
# Copyright (c) 2026 Nicolas Belin <nbelin@baylibre.com>
# SPDX-License-Identifier: Apache-2.0

description: |
  Hall-effect pulse-output flow meter.

  The sensor outputs one pulse per fixed volume increment on pulse-gpios.
  The driver counts pulses and converts to volume using pulses-per-liter.
  Volume is reported on SENSOR_CHAN_VOLUME (liters, val1 = whole liters,
  val2 = microliters), flow rate on SENSOR_CHAN_FLOW_RATE (L/min).
  Runtime calibration is available via SENSOR_ATTR_CALIBRATION
  (val1 = pulses/liter, val2 = 0). Volume threshold triggers use
  SENSOR_TRIG_THRESHOLD on SENSOR_CHAN_VOLUME with SENSOR_ATTR_UPPER_THRESH
  (one-shot, disarms after firing or on NULL handler).

compatible: "zephyr,flow-meter"

include: sensor-device.yaml

properties:
  pulse-gpios:
    type: phandle-array
    required: true
    description: |
      Input GPIO connected to the Hall-effect sensor output.
      Each active edge represents one pulse (volume increment).

  power-gpios:
    type: phandle-array
    description: |
      Optional GPIO used to power the flow meter module.
      Driven active during initialization and held throughout operation.

  pulses-per-liter:
    type: int
    required: true
    min: 1
    description: |
      Number of pulses produced per liter of flow.
      This is the factory calibration value for the specific sensor and
      can be overridden at runtime via SENSOR_ATTR_CALIBRATION.
```

## dts/bindings/sensor/zephyr,ntc-thermistor-rt-table.yaml
```yaml
# Copyright 2023 Google LLC
#
# SPDX-License-Identifier: Apache-2.0

description: |
  Common properties for NTC thermistors
  For more information: https://www.electronics-tutorials.ws/io/thermistors.html

compatible: "zephyr,ntc-thermistor-rt-table"

properties:
  tr-table:
    required: true
    type: array
    description: |
      NTC Thermistor Temp/Resistance Table formatted as an array like follows
      <temp0 resistance0 temp1 resistance1 ...>
      See `scripts/utils/ntc_thermistor_table.py` to help generate node.
```

## dts/bindings/sensor/zephyr,ntc-thermistor.yaml
```yaml
# Copyright (c) 2022 Google LLC
# SPDX-License-Identifier: Apache-2.0

description: Generic NTC Thermistor

compatible: "zephyr,ntc-thermistor"

include: [sensor-device.yaml]

properties:
  io-channels:
    required: true
    description: |
      ADC IO channel connected to this NTC thermistor.

  zephyr,rt-table:
    type: phandle
    required: true
    description: R/T table for NTC thermistor.

  r25-ohm:
    type: int
    description: |
      The resistance value of the thermistor at 25 C.

  pullup-uv:
    type: int
    description: |
      The pullup voltage microvoltage in the circuit.

  pullup-ohm:
    type: int
    description: |
      The pullup resistance in the circuit.

  pulldown-ohm:
    type: int
    description: |
      The pulldown resistance in the circuit.

  connected-positive:
    type: boolean
    description: |
      Indicates how the thermistor is connected in series with a pull-up and/or
      a pull-down resistor. If this flag is NOT specified, the thermistor is
      assumed to be connected-ground, which usually means a pull-down resistance
      of zero but complex arrangements are possible.
```

## dts/bindings/sensor/zephyr,sensing-hinge-angle.yaml
```yaml
# Copyright (c) 2023, Intel Corporation
# SPDX-License-Identifier: Apache-2.0
#

description: Sensing subsystem hinge angle sensor bindings.

compatible: "zephyr,sensing-hinge-angle"

# Common sensor subsystem sensor properties.
include: ["zephyr,sensing-sensor.yaml"]
```

## dts/bindings/sensor/zephyr,sensing-phy-3d-sensor.yaml
```yaml
# Copyright (c) 2023, Intel Corporation
# SPDX-License-Identifier: Apache-2.0
#

description: Sensing subsystem physical 3d sensors(accel, gyro, mag) bindings.

compatible: "zephyr,sensing-phy-3d-sensor"

include: zephyr,sensing-phy-sensor.yaml
```

## dts/bindings/sensor/zephyr,sensing-phy-sensor.yaml
```yaml
# Copyright (c) 2023, Intel Corporation
# SPDX-License-Identifier: Apache-2.0
#

description: Sensing subsystem physical sensor properties bindings.

include: zephyr,sensing-sensor.yaml

properties:
  underlying-device:
    type: phandle
    required: true
    description: underlying sensor device for physical sensor
```

## dts/bindings/sensor/zephyr,sensing-sensor.yaml
```yaml
# Copyright (c) 2023, Intel Corporation
# SPDX-License-Identifier: Apache-2.0
#

description: Sensing subsystem sensor common properties bindings.

include: sensor-device.yaml

properties:
  sensor-types:
    type: array
    required: true
    description: sensor type id (follow HID spec definition)

  friendly-name:
    required: true

  minimal-interval:
    type: int
    required: true
    description: sensor minimal report interval

  reporters:
    type: phandles
    description: sensor reporters

  reporters-index:
    type: array
    description: the index in sensor-types of reporter if the reporter support multiple sensor-types

  stream-mode:
    type: boolean
    description: sensor works on stream mode or poll mode
```

## dts/bindings/sensor/zephyr,sensing.yaml
```yaml
# Copyright (c) 2023, Intel Corporation
# SPDX-License-Identifier: Apache-2.0
#

description: Sensing Subsystem

compatible: "zephyr,sensing"

# To add sensor subsystem related common feature
```

## dts/bindings/sensor/zephyr,sensor-channel.yaml
```yaml
# Copyright (c) 2023 Intel Corporation
#
# SPDX-License-Identifier: Apache-2.0

description: Zephyr Sensor Device

compatible: "zephyr,sensor-channel"

include: sensor-channel.yaml
```

## dts/bindings/sensor/zephyr,sensor-sim-async.yaml
```yaml
# Copyright (c) 2025 COGNID Telematik GmbH
# SPDX-License-Identifier: Apache-2.0

description: |
  Sensor simulator with async API and internal sensor FIFO.
  Can be fed with test data which then can be queried with both Fetch + Get and Read + Decode APIs.
  Also capable of sensor streaming.

compatible: "zephyr,sensor-sim-async"

include: [sensor-device.yaml, base.yaml]

properties:
  fifo_wm:
    type: int
    default: 16
    description: |
      Watermark of FIFO that triggers the FIFO_WM callback.
      Default is half the default fifo capacity.

  fifo_capacity:
    type: int
    default: 32
    description: |
      Capacity of simulated sensor FIFO. Default is 32 as this is enough for a simple test.
```

## dts/bindings/sensor/zephyr,senss-sensor.yaml
```yaml
# Copyright (c) 2022, Intel Corporation
# SPDX-License-Identifier: Apache-2.0
#

description: Sensor subsystem (senss) sensor common properties bindings.

properties:
    label:
      type: string
      required: true
      description: sensor device tree node label name

    sensor-type:
      type: int
      required: true
      description: sensor type id (follow HID spec definition)

    sensor-index:
      type: int
      required: true
      description: sensor instance index for same sensor type

    vendor:
      type: string
      required: true
      description: sensor vendor name

    model:
      type: string
      required: true
      description: sensor model name

    friendly-name:
      type: string
      required: true
      description: sensor friendly name

    minimal-interval:
      type: int
      required: true
      description: sensor minimal report interval

    rotation-matrix:
      type: array
      required: false
      description: sensor rotation matrix

    reporters:
      type: phandles
      required: false
      description: sensor reporters
```

## dts/bindings/sensor/zephyr,senss.yaml
```yaml
# Copyright (c) 2022, Intel Corporation
# SPDX-License-Identifier: Apache-2.0
#

description: Sensor Subsystem (senss)

compatible: "zephyr,senss"

properties:
    label:
      type: string
      required: true
      description: sensor device tree node label name
```

## dts/bindings/sent/nxp,s32-sent-channel.yaml
```yaml
# Copyright 2024 NXP
#
# SPDX-License-Identifier: Apache-2.0

description: Properties for  Single Edge Nibble Transmission (SENT) Receiver channel

compatible: "nxp,s32-sent-channel"

include: base.yaml

properties:
  num-data-nibbles:
    type: int
    required: true
    description: |
      The number of data nibbles.

  tick-time-prescaler-us:
    type: int
    required: true
    description: |
      The tick time prescaler in us.

  bus-timeout-cycles:
    type: int
    required: true
    enum:
      - 0
      - 256
      - 512
      - 1024
      - 2048
    description: |
      The bus timeout cycles.

  calib-method-low-latency:
    type: boolean
    description: |
      The successive calibration pulse check method with low latency.

  slow-crc-no-data-nibble-xor:
    type: boolean
    description: |
      The slow message CRC implementation does not use the zero data nibble XOR method.

  fast-crc-no-data-nibble-xor:
    type: boolean
    description: |
      The fast message CRC implementation does not use the zero data nibble XOR method.
```

## dts/bindings/sent/nxp,s32-sent-controller.yaml
```yaml
# Copyright 2024 NXP
#
# SPDX-License-Identifier: Apache-2.0

description: Properties for Single Edge Nibble Transmission (SENT) Receiver

compatible: "nxp,s32-sent-controller"

include: [base.yaml, pinctrl-device.yaml]
```

## dts/bindings/sent/nxp,s32-sent.yaml
```yaml
# Copyright 2025 NXP
#
# SPDX-License-Identifier: Apache-2.0

description: NXP S32 SENT (Single Edge Nibble Transmission) Receiver Controller

compatible: "nxp,s32-sent"

include: [sent-controller.yaml, pinctrl-device.yaml]

properties:
  interrupts:
    required: true

  clocks:
    required: true

  pinctrl-0:
    required: true

  pinctrl-names:
    required: true

child-binding:

  properties:
    bus-timeout-cycles:
      type: int
      enum:
        - 0
        - 256
        - 512
        - 1024
        - 2048
      default: 0
      description: |
        Specifies the number of bus timeout cycles. This value determines the maximum number
        of cycles the bus will wait before timing out. The default value is 0, which disables
        the bus timeout.
```
