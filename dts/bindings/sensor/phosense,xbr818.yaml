## dts/bindings/sensor/qst,qmi8658a.yaml
```yaml
# SPDX-FileCopyrightText: Copyright The Zephyr Project Contributors
# SPDX-License-Identifier: Apache-2.0

description: QST QMI8658A 6-axis IMU

compatible: "qst,qmi8658a"

include: [sensor-device.yaml, i2c-device.yaml]

properties:
  int-gpios:
    type: phandle-array
    description: |
      Data-ready interrupt line connected to the sensor INT1 or INT2 pin.
      Configure flags to match the signal level presented to the MCU.

  int-pin:
    type: int
    default: 2
    description: |
      Sensor interrupt pin to use for data-ready: 1 for INT1, 2 for INT2.
      The default is 2 because QMI8658A DRDY is routed to INT2 in the standard
      configuration described by the datasheet interrupt mapping. Set this to 1
      only when using a configuration that explicitly routes data-ready to INT1.
    enum:
      - 1
      - 2

  accel-fs:
    type: int
    default: 4
    description: |
      Accelerometer full-scale range in g.
      The default is a general-purpose range that balances resolution with
      headroom for typical handheld and board-level motion. Use 2 for highest
      sensitivity at low acceleration, or 8/16 when higher acceleration is
      expected.
    enum:
      - 2
      - 4
      - 8
      - 16

  gyro-fs:
    type: int
    default: 512
    description: |
      Gyroscope full-scale range in degrees per second (dps).
      The default provides a practical balance between sensitivity and headroom
      for common motion-tracking use. Use lower ranges for finer low-rate
      motion, or higher ranges for faster rotational movement.
    enum:
      - 16
      - 32
      - 64
      - 128
      - 256
      - 512
      - 1024
      - 2048

  accel-odr:
    type: int
    default: 896
    description: |
      Requested accelerometer output data rate in Hz.
      The default targets low-latency 6-DoF streaming and is paired with the
      gyroscope default to keep both sensors at the same nominal rate. Use
      lower values to reduce power and bandwidth, or higher values when maximum
      update rate is needed.

  gyro-odr:
    type: int
    default: 896
    description: |
      Requested gyroscope output data rate in Hz.
      The default matches the accelerometer default to keep sampling rates
      aligned for fused 6-DoF data. Use lower values to reduce power and
      bandwidth, or higher values when faster gyro updates are required.

examples:
  - |
    #include <zephyr/dt-bindings/gpio.h>

    qmi8658a@6b {
      compatible = "qst,qmi8658a";
      reg = <0x6b>;
      accel-fs = <4>;
      gyro-fs = <512>;
      accel-odr = <896>;
      gyro-odr = <896>;
      int-gpios = <&gpio0 10 GPIO_ACTIVE_HIGH>;
      int-pin = <2>;
    };
```

## dts/bindings/sensor/qstcorp,qmc5883l.yaml
```yaml
# Copyright (c) 2025 LCKFB
# SPDX-License-Identifier: Apache-2.0

description: QSTCORP QMC5883L magnetometer sensor.

compatible: "qstcorp,qmc5883l"

include: [sensor-device.yaml, i2c-device.yaml]
```

## dts/bindings/sensor/qstcorp,qmi8658c.yaml
```yaml
# Copyright (c) 2025 LCKFB
# SPDX-License-Identifier: Apache-2.0

description: |
  QSTCORP QMI8658C 6-axis IMU sensor (accelerometer + gyroscope).
  
  This sensor provides 3-axis accelerometer and 3-axis gyroscope data via I2C interface.
  I2C address: 0x6A (7-bit)

compatible: "qstcorp,qmi8658c"

include: [sensor-device.yaml, i2c-device.yaml]
```

## dts/bindings/sensor/rapidsi,pvt.yaml
```yaml
# Copyright (c) 2024, Rapid Silicon
# SPDX-License-Identifier: Apache-2.0

description: Power Voltage and Temperature Monitoring Module

compatible: "rapidsi,pvt"

include: [base.yaml]

properties:

  io-channels:
    required: false
    description: |
      ADC channel that will perform measurement

  resolution:
    type: int
    required: false
    description: |
      ADC resolution to be used for the channel.

  clock-frequency:
    type: int
    required: false
    description:
      Clock frequency of the ADC channel for PVT.
```

## dts/bindings/sensor/raspberrypi,bcm283x-vc-thermal.yaml
```yaml
# Copyright (c) 2026 Jonathan Elliot Peace <jep@alphabetiq.com>
# SPDX-License-Identifier: Apache-2.0

description: |
  Raspberry Pi BCM283x SoC die-temperature sensor.

  The SoC temperature is read through the VideoCore firmware
  GET_TEMPERATURE property tag -- the same source as `vcgencmd
  measure_temp`. The sensor owns no registers of its own, so it is
  modelled as a child of the raspberrypi,bcm283x-firmware node.
  Exposes SENSOR_CHAN_DIE_TEMP.

compatible: "raspberrypi,bcm283x-vc-thermal"

include: base.yaml
```

## dts/bindings/sensor/raspberrypi,pico-temp.yaml
```yaml
# Copyright (c) 2023 TOKITA Hiroshi
# SPDX-License-Identifier: Apache-2.0

description: Raspberry Pi Pico family temperature sensor node

compatible: "raspberrypi,pico-temp"

include: sensor-device.yaml

properties:
  io-channels:
    required: true
    description: ADC channel for CPU temperature sensor

  vbe:
    type: int
    default: 706000
    description: |
      Vbe voltage in microvolts at 27 degrees C. Vbe = 0.706V typically.
      The temperature sensor measures the Vbe voltage of a biased bipolar diode.
      The temperature calculates from the Vbe voltage measured by the sensor
      using the following equation typical case.

        T = 27 - (ADC_Voltage - 0.706)/0.001721

      See also the vbe-slope section.

  vbe-slope:
    type: int
    default: -1721
    description: |
      The slope of Vbe voltage in microvolts per degree C.
      Typically, a slope of -1.721mV per degree.

      See also the vbe section.
```

## dts/bindings/sensor/realtek,bee-aon-qdec.yaml
```yaml
# Copyright (c) 2026, Realtek Semiconductor Corporation
# SPDX-License-Identifier: Apache-2.0

description: |
  Bee AON_QDEC.
  This QDEC only supports the X-axis.

compatible: "realtek,bee-aon-qdec"

include: [sensor-device.yaml, pinctrl-device.yaml, "realtek,bee-qdec.yaml"]
```

## dts/bindings/sensor/realtek,bee-basic-qdec.yaml
```yaml
# Copyright (c) 2026, Realtek Semiconductor Corporation
# SPDX-License-Identifier: Apache-2.0

description: |
  Bee basic QDEC.
  This QDEC supports the X, Y, Z axes.

compatible: "realtek,bee-basic-qdec"

include: [sensor-device.yaml, pinctrl-device.yaml, "realtek,bee-qdec.yaml"]

properties:
  y-enable:
    type: boolean
    description: Enable Y axis.

  y-counts-per-revolution:
    type: int
    default: 4
    description: |
      Counts per revolution for the Y axis.
      This specifies the hardware decoding mode, determining whether the
      internal counter increments after 2 or 4 external waveform edge
      transitions. The default represents the X4 decoding mode, which
      provides the highest resolution. It could be changed to 2 if a
      lower resolution is desired by the application.
    enum:
      - 2
      - 4

  y-debounce-time-ms:
    type: int
    description: |
      Debounce time of the Y axis in milliseconds.

  z-enable:
    type: boolean
    description: Enable Z axis.

  z-counts-per-revolution:
    type: int
    default: 4
    description: |
      Counts per revolution for the Z axis.
      This specifies the hardware decoding mode, determining whether the
      internal counter increments after 2 or 4 external waveform edge
      transitions. The default represents the X4 decoding mode, which
      provides the highest resolution. It could be changed to 2 if a
      lower resolution is desired by the application.
    enum:
      - 2
      - 4

  z-debounce-time-ms:
    type: int
    description: |
      Debounce time of the Z axis in milliseconds.
```

## dts/bindings/sensor/realtek,bee-qdec.yaml
```yaml
# Copyright (c) 2026, Realtek Semiconductor Corporation
# SPDX-License-Identifier: Apache-2.0

description: |
  Common properties for Realtek Bee QDEC.

compatible: "realtek,bee-qdec"

include: [sensor-device.yaml, pinctrl-device.yaml]

properties:
  reg:
    required: true

  interrupts:
    required: true

  pinctrl-0:
    required: true

  x-enable:
    type: boolean
    description: Enable X axis.

  x-counts-per-revolution:
    type: int
    default: 4
    description: |
      Counts per revolution for the X axis.
      This specifies the hardware decoding mode, determining whether the
      internal counter increments after 2 or 4 external waveform edge
      transitions. The default represents the X4 decoding mode, which
      provides the highest resolution. It could be changed to 2 if a
      lower resolution is desired by the application.
    enum:
      - 2
      - 4

  x-debounce-time-ms:
    type: int
    description: |
      Debounce time of the X axis in milliseconds.
```

## dts/bindings/sensor/refsoc,sensor-i2c.yaml
```yaml
#
# Copyright (c) 2018, Linaro Limited
#
# SPDX-License-Identifier: Apache-2.0
#
---
title: REFSOC I2C sensor
type: sensor
version: 0.1

description: >
    This binding gives a base representation Reference SoC I2C device sensor

inherits:
    !include i2c-device.yaml

properties:
    compatible:
      constraint: "refsoc,sensor-i2c"

...
```

## dts/bindings/sensor/refsoc,sensor-spi.yaml
```yaml
#
# Copyright (c) 2018, Linaro Limited
#
# SPDX-License-Identifier: Apache-2.0
#
---
title: REFSOC I2C sensor
type: sensor
version: 0.1

description: >
    This binding gives a base representation Reference SoC I2C device sensor

inherits:
    !include spi-device.yaml

properties:
    compatible:
        constraint: "refsoc,sensor-spi"

    irq-gpios:
      type: compound
      category: required
      generation: define, use-prop-name
...
```

## dts/bindings/sensor/renesas,hs300x.yaml
```yaml
#
# Copyright (c) 2023 Ian Morris
#
# SPDX-License-Identifier: Apache-2.0

description: Renesas HS300x humidity and temperature sensor

compatible: "renesas,hs300x"

include: [sensor-device.yaml, i2c-device.yaml]
```

## dts/bindings/sensor/renesas,hs400x.yaml
```yaml
#
# Copyright (c) 2024 Renesas Electronics Corporation
#
# SPDX-License-Identifier: Apache-2.0

description: Renesas HS400x humidity and temperature sensor

compatible: "renesas,hs400x"

include: [sensor-device.yaml, i2c-device.yaml]
```
