## dts/bindings/sensor/phosense,xbr818.yaml
```yaml
# Copyright (c) 2024 MASSDRIVER EI (massdriver.space)
# SPDX-License-Identifier: Apache-2.0

description: |
    Phosense XBR818 I2C-capable 10 GHz Radar Sensor

compatible: "phosense,xbr818"

include: [sensor-device.yaml, i2c-device.yaml]

properties:
  int-gpios:
    type: phandle-array
    required: true
    description: GPIO pin connected to IO pin (IO_VAL)

  i2c-en-gpios:
    type: phandle-array
    description: GPIO pin connected to I2C enable (I2C_EN)
```

## dts/bindings/sensor/photosensor.yaml
```yaml
# Copyright (c) 2026 Nordic Semiconductor ASA
# SPDX-License-Identifier: Apache-2.0

description: |
  Analog photosensor circuit converting illuminance driven current into a voltage
  across a load resistor, measured using an ADC channel and converted to lux.

  Example components follow:

    - Osram SFH 5701 A01
    - Vishay TEMT6000

  A typical circuit using a photodiode follows:

    enable-gpio -------+
                       |
                      ---
           light  -->  ^   photodiode
                  --> / \
                      ---
                       |
      io-channel ------+
                       |
                      ---
                      | |  load resistor
                      | |
                      ---
                       |
                      GND

  A typical circuit using a phototransistor follows:

    enable-gpio -------+
                       |
                       /
          light  --> |/    phototransistor
                 --> |
                     |\
                       \
                       |
      io-channel ------+
                       |
                      ---
                      | |  load resistor
                      | |
                      ---
                       |
                      GND

  A typical variation of a circuit using a phototransistor follows:

                      VDD
                       |
                       /
          light  --> |/    phototransistor
                 --> |
                     |\
                       \
                       |
      io-channel ------+
                       |
                      ---
                      | |  load resistor
                      | |
                      ---
                       |
                   ||--+   mosfet
     enable-gpio --||
                   ||--+
                       |
                      GND

  With this above variation, the on resistance of the mosfet must be added to the
  load resistor resistance.

  The enable-gpio pin may be excluded if the circuit is always enabled.

compatible: "photosensor"

include: sensor-device.yaml

properties:
  enable-gpios:
    type: phandle-array
    description: Optional GPIO used to enable the circuit.

  no-disconnect:
    type: boolean
    description: Do not disconnect the enable GPIO when disabling the circuit.

  io-channels:
    required: true
    description: ADC IO channel measuring the voltage across the load resistor.

  settle-time-ns:
    type: int
    description: Settling time of the output after enabling the circuit in nanoseconds.

  photocurrent-na:
    type: int
    required: true
    description: The photocurrent at 100 lux in nanoamps.

  load-resistance-ohm:
    type: int
    required: true
    description: |
      The resistance of the load in ohms. This includes every component between the ADC IO
      channel node and GND.

examples:
  - |
    / {
              photosensor {
                      compatible = "photosensor";
                      enable-gpios = <&gpio0 0 GPIO_ACTIVE_HIGH>;
                      io-channels = <&adc 0>;
                      /* Osram SFH 5701 A01 */
                      settle-time-ns = <14000000>;
                      photocurrent-na = <135000>;
                      load-resistance-ohm = <10000>;
              };
    };

    &adc0 {
            status = "okay";

            channel@0 {
                    reg = <0>;
                    zephyr,gain = "ADC_GAIN_1_4";
                    zephyr,resolution = <12>;
                    zephyr,reference = "ADC_REF_INTERNAL";
                    zephyr,oversampling = <2>;
                    zephyr,acquisition-time = <ADC_ACQ_TIME_DEFAULT>;
                    zephyr,input-positive = <0>;
            };
    };
  - |
    / {
              photosensor {
                      compatible = "photosensor";
                      power-domains = <&pd0>;
                      io-channels = <&adc 0>;
                      /* Vishay TEMPT6000 */
                      settle-time-ns = <14000000>;
                      photocurrent-na = <50000>;
                      load-resistance-ohm = <30000>;
              };
    };
  - |
    / {
              photosensor {
                      compatible = "photosensor";
                      io-channels = <&adc 0>;
                      /* Vishay TEMP6000 */
                      photocurrent-na = <50000>;
                      load-resistance-ohm = <30000>;
              };
    };
```

## dts/bindings/sensor/pixart,paa3905.yaml
```yaml
# Copyright (c) 2025 Croxel Inc.
# Copyright (c) 2025 CogniPilot Foundation
# SPDX-License-Identifier: Apache-2.0

description: PA3905 optical flow sensor

compatible: "pixart,paa3905"

include: [sensor-device.yaml, spi-device.yaml]

properties:
  resolution:
    type: int
    default: 42
    description: |
      The resolution of the sensor, which affects the counts per inch detected
      by the sensor.
      Default is power-on reset value.

  led-control:
    type: boolean
    default:
    description: |
      Enable or disable the LED control feature, which allows the optical flow
      sensor to drive an external LED in order to provide illuminance when needed.

  int-gpios:
    type: phandle-array
    description: |
      The INT signal default configuration is active-low. The
      property value should ensure the flags properly describe the
      signal that is presented to the driver.

  backup-timer-ms:
    type: int
    default: 80
    description: |
      The back-up timer in milliseconds used to ensure sensor interaction
      even if no motion is present, when Data-Ready streaming trigger is
      configured. If erratic behavior is detected, a sensor recovery
      sequence is performed.
      Default is 10X the fastest frame rate (126 fps).
```

## dts/bindings/sensor/pixart,paj7620.yaml
```yaml
# Copyright (c) 2025 Paul Timke <ptimkec@live.com>
# SPDX-License-Identifier: Apache-2.0

description: Pixart PAJ7620 gesture sensor

compatible: "pixart,paj7620"

include: [sensor-device.yaml, i2c-device.yaml]

properties:
  int-gpios:
    type: phandle-array
    description: |
      INT pin
      This pin defaults to active low when produced by the sensor.
      The property value should ensure the flags properly describe
      the signal that is presented to the driver.
```

## dts/bindings/sensor/pixart,pat9136.yaml
```yaml
# Copyright (c) 2025 Croxel Inc.
# Copyright (c) 2025 CogniPilot Foundation
# SPDX-License-Identifier: Apache-2.0

description: PAT9136 optical flow sensor

compatible: "pixart,pat9136"

include: [sensor-device.yaml, spi-device.yaml]

properties:
  resolution:
    type: int
    default: 19
    description: |
      The resolution of the sensor which indirectly results in counts per inch
      (CPI), following the formula CPI = (1 + resolution) * 100.
      Valid range is 0 to 199.
      Default is value set during Performance Optimization Settings.

  int-gpios:
    type: phandle-array
    description: |
      The INT signal default configuration is active-low. The
      property value should ensure the flags properly describe the
      signal that is presented to the driver.

  backup-timer-ms:
    type: int
    default: 50
    description: |
      The back-up timer in milliseconds used to ensure sensor interaction
      even if no motion is present, when Data-Ready streaming trigger is
      configured.
      Default is 1000X the fastest frame rate (20,000 fps).

  cooldown-timer-ms:
    type: int
    default: 10
    description: |
      The cooldown timer in milliseconds used to prevent flooding the system
      with interrupts (potentially at max 20,000 fps) while Data-Ready
      streaming trigger is configured.
      Default is 200X the fastest frame rate (20,000 fps).
      Must be less than backup-timer-ms.
```

## dts/bindings/sensor/plantower,pms7003.yaml
```yaml
# Copyright (c) 2020, Linaro Limited
# SPDX-License-Identifier: Apache-2.0

description: |
  Plantower PMS7003 air pollution sensor.
  Air pollution sensor capable of measuring mass concentration of dust.  See
  more info at:
  https://www.espruino.com/datasheets/PMS7003.pdf

compatible: "plantower,pms7003"

include: uart-device.yaml
```

## dts/bindings/sensor/plantower,pmsX003.yaml
```yaml
# Copyright (c) 2020, Linaro Limited
# SPDX-License-Identifier: Apache-2.0

description: |
  Plantower PMSX003 air pollution sensor.
  Air pollution sensor capable of measuring mass concentration of dust.
  The 'X' in PMSX003 stands for any sensor in the series, such as PMS6003, PMS7003, or PMS5003.
  See more info at:
  https://www.espruino.com/datasheets/PMS7003.pdf
  https://www.digikey.com/en/htmldatasheets/production/2903006/0/0/1/pms5003-series-manual
  https://evelta.com/content/datasheets/203-PMS6003.pdf


compatible: "plantower,pmsX003"

include: [sensor-device.yaml, uart-device.yaml]
```

## dts/bindings/sensor/pni,rm3100-common.yaml
```yaml
# Copyright (c) 2025 Croxel, Inc.
# Copyright (c) 2025 CogniPilot Foundation
# SPDX-License-Identifier: Apache-2.0

description: PNI RM3100 3-axis Magnetometer.

compatible: "pni,rm3100"

include: sensor-device.yaml

properties:
  int-gpios:
    type: phandle-array
    description: |
      The INT signal default configuration is active-high. The
      property value should ensure the flags properly describe the
      signal that is presented to the driver.

  odr:
    type: int
    default: 0x96
    description: |
      The output data rate (ODR) of the sensor in Hz.
      Default is power-on setting.
    enum:
      - 0x92 # RM3100_DT_ODR_600
      - 0x93 # RM3100_DT_ODR_300
      - 0x94 # RM3100_DT_ODR_150
      - 0x95 # RM3100_DT_ODR_75
      - 0x96 # RM3100_DT_ODR_37_5
      - 0x97 # RM3100_DT_ODR_18
      - 0x98 # RM3100_DT_ODR_9
      - 0x99 # RM3100_DT_ODR_4_5
      - 0x9A # RM3100_DT_ODR_2_3
      - 0x9B # RM3100_DT_ODR_1_2
      - 0x9C # RM3100_DT_ODR_0_6
      - 0x9D # RM3100_DT_ODR_0_3
      - 0x9E # RM3100_DT_ODR_0_015
      - 0x9F # RM3100_DT_ODR_0_0075
```

## dts/bindings/sensor/pni,rm3100-i2c.yaml
```yaml
# Copyright (c) 2025 Anthony Williams <anthony289478@gmail.com>
# SPDX-License-Identifier: Apache-2.0

description: |
    PNI RM3100 3-axis Magnetometer.

    The RM3100 can use either I2C or SPI as a communication bus.
    When setting the odr property in a .dts or .dtsi file you may include rm3100.h
    and use the macros defined there.

    Example:
    #include <zephyr/dt-bindings/sensor/rm3100.h>

    &i2c0 {
        rm3100@20 {
            compatible = "pni,rm3100";
            reg = <0x20>;
            odr = <RM3100_DT_ODR_600>;
        };
    };

compatible: "pni,rm3100"

include: ["i2c-device.yaml", "pni,rm3100-common.yaml"]
```

## dts/bindings/sensor/pni,rm3100-spi.yaml
```yaml
# Copyright (c) 2025 Anthony Williams <anthony289478@gmail.com>
# SPDX-License-Identifier: Apache-2.0

description: |
    PNI RM3100 3-axis Magnetometer.

    The RM3100 can use either I2C or SPI as a communication bus.
    When using SPI, the device only supports SPI mode 0 or 3.
    When setting the odr property in a .dts or .dtsi file you may include rm3100.h
    and use the macros defined there.

    Example:
    #include <zephyr/dt-bindings/sensor/rm3100.h>

    &spi0 {
        cs-gpios = <&arduino_header 10 GPIO_ACTIVE_LOW>;
        rm3100@0 {
            compatible = "pni,rm3100";
            reg = <0x0>;
            spi-max-frequency = <8000000>;

            // Enable SPI mode 3. Remove to use mode 0.
            spi-cpol;
            spi-pha;

            odr = <RM3100_DT_ODR_600>;
        };
    };

compatible: "pni,rm3100"

include: ["spi-device.yaml", "pni,rm3100-common.yaml"]
```

## dts/bindings/sensor/pni,rm3100.yaml
```yaml
# Copyright (c) 2025 Croxel, Inc.
# Copyright (c) 2025 CogniPilot Foundation
# SPDX-License-Identifier: Apache-2.0

description: |
    PNI RM3100 3-axis Magnetometer.

    The RM3100 can use either I2C or SPI as a communication bus.
    This driver currently supports I2C only.
    When setting the odr property in a .dts or .dtsi file you may include rm3100.h
    and use the macros defined there.

    Example:
    #include <zephyr/dt-bindings/sensor/rm3100.h>

    &i2c0 {
        rm3100@20 {
            compatible = "pni,rm3100";
            reg = <0x20>;
            odr = <RM3100_DT_ODR_600>;
        };
    };

compatible: "pni,rm3100"

include: [sensor-device.yaml, i2c-device.yaml]

properties:
  int-gpios:
    type: phandle-array
    description: |
      The INT signal default configuration is active-high. The
      property value should ensure the flags properly describe the
      signal that is presented to the driver.

  odr:
    type: int
    default: 0x96
    description: |
      The output data rate (ODR) of the sensor in Hz.
      Default is power-on setting.
    enum:
      - 0x92 # RM33100_DT_ODR_600
      - 0x93 # RM33100_DT_ODR_300
      - 0x94 # RM33100_DT_ODR_150
      - 0x95 # RM33100_DT_ODR_75
      - 0x96 # RM33100_DT_ODR_37_5
      - 0x97 # RM33100_DT_ODR_18
      - 0x98 # RM33100_DT_ODR_9
      - 0x99 # RM33100_DT_ODR_4_5
      - 0x9A # RM33100_DT_ODR_2_3
      - 0x9B # RM33100_DT_ODR_1_2
      - 0x9C # RM33100_DT_ODR_0_6
      - 0x9D # RM33100_DT_ODR_0_3
      - 0x9E # RM33100_DT_ODR_0_015
      - 0x9F # RM33100_DT_ODR_0_0075
```

## dts/bindings/sensor/qorvo,cmd170p4.yaml
```yaml
# Copyright (c) 2026 HawkEye 360
# SPDX-License-Identifier: Apache-2.0

description: |
  Qorvo CMD170P4 7.5-9 GHz driver amplifier with integrated power detector.

  The CMD170P4 has an on-chip power detector that outputs a voltage (0-5V)
  proportional to the RF output power (0-30 dBm) according to a non-linear
  power law. The driver uses a pre-computed compensation table and linear
  interpolation to convert detector voltage to RF power.

compatible: "qorvo,cmd170p4"

include: sensor-device.yaml

properties:
  io-channels:
    required: true
    description: |
      ADC channel connected to the CMD170P4 Vdet pin.
      The detector outputs 0-5V corresponding to 0-30 dBm RF power.

examples:
  - |
    rf_power_detector: rf-power-detector {
      compatible = "qorvo,cmd170p4";
      io-channels = <&adc 5>;
    };
```
