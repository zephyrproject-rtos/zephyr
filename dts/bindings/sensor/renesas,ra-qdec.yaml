## dts/bindings/sensor/renesas,ra-qdec.yaml
```yaml
# Copyright (c) 2025, Pivot International
# SPDX-License-Identifier: Apache-2.0
description: |
  Renesas RA quadrature decoder

compatible: "renesas,ra-qdec"

include:
  - name: base.yaml
  - name: pinctrl-device.yaml
  - name: sensor-device.yaml

properties:
  micro-ticks-per-rev:
    type: int
    required: true
    description: |
      This is a number that is used to determine how many revolutions * 1000000
      were done based on the current counter's value.
```

## dts/bindings/sensor/renesas,rrh46410-common.yaml
```yaml
#
# Copyright (c) 2024 Renesas Electronics Corporation
#
# SPDX-License-Identifier: Apache-2.0

description: Renesas RRH46410 TVOC sensor

compatible: "renesas,rrh46410"

include: sensor-device.yaml

properties:
  reset-gpios:
    type: phandle-array
    description: |
      The RESET pin is asserted to disable the sensor causing a hard
      reset.  The sensor receives this as an active-low signal.
```

## dts/bindings/sensor/renesas,rrh46410-uart.yaml
```yaml
#
# Copyright (c) 2024 Renesas Electronics Corporation
#
# SPDX-License-Identifier: Apache-2.0

description: Renesas RRH46410 TVOC sensor

compatible: "renesas,rrh46410"

include: [uart-device.yaml, "renesas,rrh46410-common.yaml"]
```

## dts/bindings/sensor/rohm,bd8lb600fs-diagnostics.yaml
```yaml
# Copyright (c) 2024 SILA Embedded Solutions GmbH
# SPDX-License-Identifier: Apache-2.0

description: |
  Open load detection, over current protection and thermal shutdown
  sensor of the low side switch BD8LB600FS

compatible: "rohm,bd8lb600fs-diagnostics"

include: sensor-device.yaml

on-bus: bd8lb600fs

properties:
  "#sensor-cells":
    type: int
    const: 0
```

## dts/bindings/sensor/rohm,bh1730.yaml
```yaml
# Copyright (c) 2025, Borislav Kereziev
# SPDX-License-Identifier: Apache-2.0

description: Rohm BH1730 ambient light sensor.

compatible: "rohm,bh1730"

include: [sensor-device.yaml, i2c-device.yaml]

properties:
  gain:
    type: int
    default: 0
    description: |
      ADC resolution setting
      0 = x1 gain mode
      1 = x2 gain mode
      2 = x64 gain mode
      3 = x128 gain mode
      Lower gain values (x1 and x2) reduce sensitivity and prevent
      saturation in brighter environments.
      Higher gain values (x64 and x128) result in higher sensitivity,
      which are useful in low-light environments.
      The default corresponds to the reset value of the GAIN register.
    enum:
      - 0
      - 1
      - 2
      - 3
  itime:
    type: int
    default: 0xDA
    description: |
      ITIME value in TIMING register determines integration time.
      Higher values result in longer integration time and
      increased accuracy.
      The default corresponds to the reset value of the TIMING register.
```

## dts/bindings/sensor/rohm,bh1745.yaml
```yaml
#
# Copyright (c) 2019 Nordic Semiconductor ASA
# Copyright (c) 2022 Grzegorz Blach
#
# SPDX-License-Identifier: Apache-2.0
#

description: |
    This is a representation of the BH1745 sensor

compatible: "rohm,bh1745"

include: i2c-device.yaml

properties:
    int-gpios:
      type: phandle-array
      required: true
```

## dts/bindings/sensor/rohm,bh1749.yaml
```yaml
description: Roah semiconductor BH1749 color sensor

compatible: "rohm,bh1749"

include: [sensor-device.yaml, i2c-device.yaml]
```

## dts/bindings/sensor/rohm,bh1750-i2c.yaml
```yaml
# SPDX-License-Identifier: Apache-2.0

description: ROHM integrated light sensor

compatible: "rohm,bh1750"

include: [sensor-device.yaml, i2c-device.yaml]
```

## dts/bindings/sensor/rohm,bh1750.yaml
```yaml
# Copyright (c) 2022, Michal Morsisko
# SPDX-License-Identifier: Apache-2.0

description: Rohm BH1750 ambient light sensor.

compatible: "rohm,bh1750"

include: [sensor-device.yaml, i2c-device.yaml]

properties:
  resolution:
    type: int
    default: 1
    description: |
      Resolution of the measurement result
      0 = low resolution
      1 = high resolution
      2 = high resolution 2
      The default mode number 1 is mentioned
      in the datasheet as recommended by the
      sensor manufacturer. One should pick
      other mode, if higher or lower resolution
      is desired.
    enum:
      - 0
      - 1
      - 2
  mtreg:
    type: int
    default: 69
    description: |
      Duration of single measurement process.
      The greater the value, the longer the duration
      and greater accuracy. After sensor power-on
      mtreg register is set to default value of
      this property (chosen by sensor manufacturer): 69.
      Valid values are in range 31-254 (inclusive).
```

## dts/bindings/sensor/rohm,bh1790.yaml
```yaml
# Copyright (c) 2025, Magpie Embedded
# SPDX-License-Identifier: Apache-2.0

description: Rohm BH1790 Optical Sensor for Heart Rate Monitor IC.

compatible: "rohm,bh1790"

include: [sensor-device.yaml, i2c-device.yaml]
```

## dts/bindings/sensor/sbs,sbs-gauge.yaml
```yaml
description: SBS 1.1 compliant fuel gauge (http://www.sbs-forum.org/specs)

compatible: "sbs,sbs-gauge"

include: [sensor-device.yaml, i2c-device.yaml]
```

## dts/bindings/sensor/sciosense,ens160-common.yaml
```yaml
# Copyright (c) 2024 Gustavo Silva
# SPDX-License-Identifier: Apache-2.0

description: ScioSense ENS160 Digital Metal Oxide Multi-Gas Sensor

include: sensor-device.yaml

properties:
  int-gpios:
    type: phandle-array
    description: |
      The interrupt pin of ENS160.
```

## dts/bindings/sensor/sciosense,ens160-i2c.yaml
```yaml
# Copyright (c) 2024 Gustavo Silva
# SPDX-License-Identifier: Apache-2.0

description: |
    ScioSense ENS160 Digital Metal Oxide Multi-Gas Sensor on I2C bus

compatible: "sciosense,ens160"

include: ["i2c-device.yaml", "sciosense,ens160-common.yaml"]
```

## dts/bindings/sensor/sciosense,ens160-spi.yaml
```yaml
# Copyright (c) 2024 Gustavo Silva
# SPDX-License-Identifier: Apache-2.0

description: |
    ScioSense ENS160 Digital Metal Oxide Multi-Gas Sensor on SPI bus

compatible: "sciosense,ens160"

include: ["spi-device.yaml", "sciosense,ens160-common.yaml"]
```

## dts/bindings/sensor/seeed,grove-light.yaml
```yaml
# Copyright (c) 2019 Nordic Semiconductor ASA
# SPDX-License-Identifier: Apache-2.0

description: Grove Photo-Resistor Light Sensor

compatible: "seeed,grove-light"

include: sensor-device.yaml

properties:
  io-channels:
    required: true
    description: |
      IO channel associated with the resistor voltage divider.
```

## dts/bindings/sensor/seeed,grove-temperature.yaml
```yaml
# Copyright (c) 2019 Nordic Semiconductor ASA
# SPDX-License-Identifier: Apache-2.0

description: Grove NTC Temperature Sensor

compatible: "seeed,grove-temperature"

include: base.yaml

properties:
  io-channels:
    required: true
    description: |
      IO channel associated with the NTC voltage

  v1p0:
    type: boolean
    description: |
      Set to indicate a v1.0 sensor.  Leave unset for v1.1 or v1.2.
```

## dts/bindings/sensor/seeed,hm330x.yaml
```yaml
# Copyright (c) 2023 benjamin@zephyrproject.org
# SPDX-License-Identifier: Apache-2.0

description: |
    Seeed Studio HM330x dust particle sensor

compatible: "seeed,hm330x"

include: [sensor-device.yaml, i2c-device.yaml]
```

## dts/bindings/sensor/semtech,sx9500.yaml
```yaml
# Copyright (c) 2019, Linaro Limited
# SPDX-License-Identifier: Apache-2.0

description: |
    Semtech SX9500 capacitive proximity/button. See more info at
    https://www.semtech.com/products/smart-sensing/touch-proximity-devices/sx9500

compatible: "semtech,sx9500"

include: [sensor-device.yaml, i2c-device.yaml]

properties:
  int-gpios:
    type: phandle-array
    description: |
      Connection for the NIRQ signal.  This signal is active-low when
      produced by the sensor.
```

## dts/bindings/sensor/sensirion,scd40.yaml
```yaml
# Copyright (c) 2024, Jan Fäh
# SPDX-License-Identifier: Apache-2.0

description: Sensirion SCD4x temperature sensor

compatible: "sensirion,scd40"

include: [sensor-device.yaml, i2c-device.yaml]
```

## dts/bindings/sensor/sensirion,scd41.yaml
```yaml
# Copyright (c) 2024, Jan Fäh
# SPDX-License-Identifier: Apache-2.0

description: Sensirion SCD4x temperature sensor

compatible: "sensirion,scd41"

include: [sensor-device.yaml, i2c-device.yaml]

properties:
  mode:
    type: int
    required: true
    description: |
      - 0: Normal periodic measurement. Default interval of 5sec
      - 1: Low power periodic measurement. Interval of 30sec
      - 2: Singleshot measurement for low power usage.
    enum:
      - 0
      - 1
      - 2
```

## dts/bindings/sensor/sensirion,scd4x.yaml
```yaml
#
# Copyright (c) 2022, Stephen Oliver
#
# SPDX-License-Identifier: Apache-2.0

description: Sensirion SCD4x co2, humidity, and temperature sensor

compatible: "sensirion,scd4x"

include: i2c-device.yaml

properties:
  model:
    type: string
    required: true
    description: |
      The sensor model in use
    enum:
        - "scd40"
        - "scd41"
  measure-mode:
    type: string
    required: true
    description: |
      Normal: Background measurement produces a new sample every 5 seconds

      Low power mode (SCD41 only): Similar to normal mode, sensor uses 3mA
      rather than 13-18mA. Produces a new sample every 30 seconds.

      Single-shot mode (SCD41 only): Similar to low-power mode but samples immediately
      after sensor_sample_fetch() is called. See scd4x driver Kconfig options to
      put sensor to sleep between samples.
    enum:
        - "normal"
        - "low-power"
        - "single-shot"
  auto-calibration:
    type: boolean
    required: false
    description: |
       Recalibrates the sensor's 400ppm reference level to match lowest CO2 level seen in
       past 7 days (assumed to be outdoor air). Disable if the sensor is never exposed to
       outdoor air to avoid severe accuracy drift.
  temperature-offset:
    type: int
    required: true
    default: 4
    description: |
      Degrees centigrade. Sensor subtracts this from temperature before calculating
      humidity. Does not affect CO2 sample. Use when sensor is inside a device that
      is hotter than ambient temperature.
  altitude:
    type: int
    required: false
    default: 0
    description: |
      Meters above sea level, improves CO2 accuracy. Sensor uses it to calculate
      ambient pressure.
      
      The scd4x_set_ambient_pressure() function in the driver can be called at any
      time to update the sensor calculations, which will override the altitude setting.
```

## dts/bindings/sensor/sensirion,sdp3x.yaml
```yaml
#
# Copyright (c) 2021, Leonard Pollak
#
# SPDX-License-Identifier: Apache-2.0

description: Sensirion SDP3x differential pressure

compatible: "sensirion,sdp3x"

include: [sensor-device.yaml, i2c-device.yaml]

properties:
  mesure-mode:
    type: int
    required: true
    description: |
      Repeatability of the T/RH Measurement
      0 -> Mass flow | Average till read (periodic)
      1 -> Mass flow | None - Update rate 0.5ms (periodic) | Clock streching (One shot)
      2 -> Differential pressure | Average till read (periodic)
      3 -> Differential pressure | None - Update rate 0.5ms (periodic) | Clock streching (One shot)
    enum:
      - 0
      - 1
      - 2
      - 3
```

## dts/bindings/sensor/sensirion,sen6x.yaml
```yaml
# Copyright (c) 2025 sevenlab engineering GmbH
# SPDX-License-Identifier: Apache-2.0

title: Sensirion SEN6x sensor driver.
description: |
    3rd Generation Environmental Sensor Node for Air Quality Applications.

    Example:

    &i2c0 {
      ...

      sen6x: sen6x@6b {
        ...

        model = SEN6X_MODEL_SEN66;
        auto-clear-device-status;
        start-measurement-on-init;
      };
    };

compatible: "sensirion,sen6x"

include: ["i2c-device.yaml", "sensor-device.yaml"]

properties:
  model:
    type: string
    required: true
    description: |
      The model of the connected sensor.
    enum:
      - "SEN60"
      - "SEN63C"
      - "SEN65"
      - "SEN66"
      - "SEN68"

  auto-clear-device-status:
    type: boolean
    description: |
      Automatically clear device status after reading it. Not supported on SEN60.

  start-measurement-on-init:
    type: boolean
    description: |
      Start continuous measurement after successful initialization.
```

## dts/bindings/sensor/sensirion,sgp30.yaml
```yaml
# Copyright (c) 2021, Advanced Climate Systems
# SPDX-License-Identifier: Apache-2.0

description: Sensirion SGP30 VOC Sensor

compatible: "sensirion,sgp30"

include: i2c-device.yaml

properties:
    label:
      required: true
```

## dts/bindings/sensor/sensirion,sgp40.yaml
```yaml
#
# Copyright (c) 2021, Leonard Pollak
#
# SPDX-License-Identifier: Apache-2.0

description: Sensirion SGP40 Multipixel Gas Sensor

compatible: "sensirion,sgp40"

include: i2c-device.yaml

properties:
    enable-selftest:
      type: boolean
      description: |
        Enabling this will run a selftest when the driver initializes.
        The selftest takes ~250ms.
```
