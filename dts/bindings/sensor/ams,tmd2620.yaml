## dts/bindings/sensor/avago,apds9253.yaml
```yaml
# Copyright(c) 2018, Phytec Messtechnik GmbH
# SPDX-License-Identifier: Apache-2.0

description: APDS9253 ambient light, RGB

compatible: "avago,apds9253"

include: [sensor-device.yaml, i2c-device.yaml]

properties:
  int-gpios:
    type: phandle-array
    description: Interrupt pin.

      The interrupt pin of APDS9253 is open-drain, active low.
      If connected directly the MCU pin should be configured
      as pull-up, active low.

  rate:
    type: int
    required: true
    description: |
      Select the rate interval (ms) for all comparator channel.
      Default value is chosen from the official documentation.
      - <APDS9253_MEASUREMENT_RATE_2000MS>: 6
      - <APDS9253_MEASUREMENT_RATE_1000MS>: 5
      - <APDS9253_MEASUREMENT_RATE_500MS>:  4
      - <APDS9253_MEASUREMENT_RATE_200MS>:  3
      - <APDS9253_MEASUREMENT_RATE_100MS>:  2
      - <APDS9253_MEASUREMENT_RATE_50MS>    1
      - <APDS9253_MEASUREMENT_RATE_25MS>    0
    default: 2
    enum:
      - 6
      - 5
      - 4
      - 3
      - 2
      - 1
      - 0

  gain:
    type: int
    required: true
    description: |
      Select the gain value for all comparator channel.
      Default value is chosen from the official documentation.
      - <APDS9253_GAIN_RANGE_18>: 4
      - <APDS9253_GAIN_RANGE_9>:  3
      - <APDS9253_GAIN_RANGE_6>:  2
      - <APDS9253_GAIN_RANGE_3>:  1
      - <APDS9253_GAIN_RANGE_1>:  0
    default: 1
    enum:
      - 4
      - 3
      - 2
      - 1
      - 0

  resolution:
    type: int
    required: true
    description: |
      Select the resolution value for all comparator channel.
      Default value is chosen from the official documentation.
      - <APDS9253_RESOLUTION_20BIT_400MS>:  0
      - <APDS9253_RESOLUTION_19BIT_200MS>   16
      - <APDS9253_RESOLUTION_18BIT_100MS>:  32
      - <APDS9253_RESOLUTION_17BIT_50MS>:   48
      - <APDS9253_RESOLUTION_16BIT_25MS>:   64
      - <APDS9253_RESOLUTION_13BIT_3MS>:    80
    default: 32
    enum:
      - 0
      - 16
      - 32
      - 48
      - 64
      - 80
```

## dts/bindings/sensor/avago,apds9306.yaml
```yaml
# SPDX-License-Identifier: Apache-2.0
# Copyright (c) 2024 Daniel Kampert
# Author: Daniel Kampert <DanielKampert@kampis-elektroecke.de>

description: APDS9306 miniature Surface-Mount Digital Ambient Light Sensor.

compatible: "avago,apds9306"

include:
  - sensor-device.yaml
  - i2c-device.yaml

properties:
  gain:
    type: int
    default: 3
    enum:
      - 1
      - 3
      - 6
      - 9
      - 18
    description:
      ALS Gain range.
      The default corresponds to the reset value of the register field.

  resolution:
    type: int
    default: 18
    enum:
      - 20
      - 19
      - 18
      - 17
      - 16
      - 13
    description:
      ALS Resolution / Bit width.
      The default corresponds to the reset value of the register field.

  measurement-period:
    type: int
    default: 100
    enum:
      - 25
      - 50
      - 100
      - 200
      - 500
      - 1000
      - 2000
    description:
      ALS Measurement period in milliseconds.
      The default corresponds to the reset value of the register field.
```

## dts/bindings/sensor/avia,hx710.yaml
```yaml
# Copyright (c) 2020 George Gkinis
# Copyright (c) 2021 Jan Gnip
# SPDX-License-Identifier: Apache-2.0

description: |
  Avia HX710/HX712/HX720 sensor

compatible: "avia,hx710"

include: avia,hx7xx-common.yaml

properties:
  rate-hz:
    type: int
    description: |
      Sensor sample rate.
      User should provide initial value depending on HW implementation.
      If CONFIG_PM_DEVICE_RUNTIME = y rate will not be higher
      than 2~3Hz due to the long wake-up time needed for HX710.
    default: 10
    enum: [10, 40]
```
