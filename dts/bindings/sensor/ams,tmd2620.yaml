## dts/bindings/sensor/ams,tmd2620.yaml
```yaml
# Copyright (c) 2023 Phytec Messtechnik GmbH
# SPDX-License-Identifier: Apache-2.0

description: OSRAM ams TMD2620 Proximity Sensor

compatible: "ams,tmd2620"

include: ams,tmd26xx-base.yaml
```

## dts/bindings/sensor/ams,tmd2635.yaml
```yaml
# SPDX-FileCopyrightText: Copyright (c) 2023 Carl Zeiss Meditec AG
# SPDX-License-Identifier: Apache-2.0

description: |
    OSRAM ams TMD2635 Proximity Sensor

compatible: "ams,tmd2635"

include: ams,tmd26xx-base.yaml

properties:
  proximity-sample-duration:
    type: int
    required: true
    description: |
      This register defines the duration of 1 proximity sample,
      which is (PRATE + 1)*88µs. default: 0x1F
```

## dts/bindings/sensor/ams,tmd26xx.yaml
```yaml
# SPDX-FileCopyrightText: Copyright (c) 2023 Carl Zeiss Meditec AG
# SPDX-License-Identifier: Apache-2.0

description: |
    OSRAM ams TMD26XX Proximity Sensor

compatible: "ams,tmd26xx"

include: [sensor-device.yaml, i2c-device.yaml]

properties:
  timeout:
    type: int
    required: false
  int-gpios:
    type: phandle-array
    required: true
    description: |
      Identifies pin for the INT signal on the module. Tristate
      interrupt output based on ramp generator flags RAMP_STAT
      bits 4, 5, 6 & 7. Outputs positive active interrupt signal.

  proximity-gain:
    type: int
    required: true
    description: |
      Proximity detection gain of the sensor
      Legal values: 1, 2, 4, 8

  proximity-pulse-length:
    type: int
    required: true
    description: |
      IR led pulse length in us
      Legal values: 1, 2, 4, 8, 12, 16, 24, 32

  proximity-pulse-count:
    type: int
    required: true
    description: |
      count of IR led pulses (min. 1; max. 64)

  proximity-high-threshold:
    type: int
    required: true
    description: |
      high threshold for interrupt.

  proximity-low-threshold:
    type: int
    required: true
    description: |
      low threshold for interrupt.

  proximity-led-drive-strength:
    type: int
    required: true
    description: |
      This field sets the drive strength of the IR VCSEL current.
      Values are approximate; actual current through VCSEL is
      factory trimmed to normalize IR intensity. For lowest part
      to part variation, 7mA is recommended.

  proximity-interrupt-filter:
    type: int
    required: true
    description: |
      This register sets the proximity persistence filter. (min. 0; max. 15)
      0-> every cycle fires an interrupt
      1-> 1 Any value outside proximity thresholds
      2-> 2 consecutive proximity values out of range
      ...
      15-> 15 consecutive proximity values out of range

  enable-wait-mode:
    type: boolean
    description: Enables wait mode

  wait-time-factor:
    type: int
    required: true
    description: |
      Value that specifies the wait time in 2.78ms increments.
      value: 0x00 Increment: 1 Wait Time 2.78ms
      value: 0x01 Increment: 2 Wait Time 5.56ms
      value: 0x11 Increment: 18 Wait Time 50.0ms
      value: 0x23 Increment: 36 Wait Time 100ms
      value: 0x3f Increment: 64 Wait Time 178ms
      value: 0xff Increment: 256 Wait Time 712ms

  wait-long:
    type: boolean
    description: |
      When PWLONG (PROX Wait Long) is asserted the wait,
      period as set by PWTIME is increased by a factor of 12.

  proximity-sample-duration:
    type: int
    required: true
    description: |
      This register defines the duration of 1 proximity sample,
      which is (PRATE + 1)*88µs. default: 0x1F
```

## dts/bindings/sensor/ams,tsl2520.yaml
```yaml
# SPDX-FileCopyrightText: Copyright (c) 2023 Carl Zeiss Meditec AG
# SPDX-License-Identifier: Apache-2.0

description: |
    TSL2520 series Highly Sensitive ambient light sensor.  See datasheet at
    https://ams.com/documents/20143/4410897/TSL2520_DS001068_3-00.pdf

compatible: "ams,tsl2520"

include: [sensor-device.yaml, i2c-device.yaml]

properties:
  int-gpios:
    type: phandle-array
    description: |
      Identifies the interrupt pin

  sample-time:
    type: int
    default: 179
    description: |
      ALS measurement time step. Sets the time in steps of 1.388889μs
      modulator clock. The modulator clock can be divided with MOD_DIVIDER_SELECT
      in register CFG7. Please observe that SAMPLE_TIME needs to be set in
      register 0x83 and 0x84 (11-bit wide). It counts from 0-2047 (2048 counts).
      SAMPLE_TIME =(1/SamplingFreq/1.388889μs)-1
      Default: 179+1 = 1/4000Hz / 1.388889μs
      (180 counts as counted 0-179)
      ALSIntegrationTimeStep = (SAMPLE_TIME+1) x 1.388889μs
      Default: 250μs = (179+1) x 1.388889μs.

  als-nr-samples:
    type: int
    default: 0
    description: |
      ALS_NR_OF_SAMPLES defines the total measurement time for ALS
      atime = (ALS_NR_SAMPLES+1) x (SAMPLE_TIME+1) x 1.388889μs.

  agc-nr-samples:
    type: int
    default: 0
    description: |
      AGC Number of Samples Sets the time for every AGC measurement
      and is calculated as: agc_atime = (AGC_NR_SAMPLES+1) x
      (SAMPLE_TIME+1) x 1.388889μs.

  als-gains:
    type: int
    default: 0x88
    description: |
      Defines the gain of modulator for the measurement
      sequencer steps.
      Gain of modulator0 and modulator1 for sequencer
      step1,step2,step3 and step4.
      The gain is also updated by the AGC, if activated.
      0x00: 1/2x
      0x01: 1x
      0x02: 2x
      0x03: 4x
      0x04: 8x
      0x05: 16x
      0x06: 32x
      0x07: 64x
      0x08: 128x
      0x09: 256x
      0x0A: 512x
      0x0B:1024x
      0x0C:2048x
      0x0D:4096x
```

## dts/bindings/sensor/ams,tsl2540.yaml
```yaml
# Copyright (c) 2022 T-Mobile USA, Inc.
# SPDX-License-Identifier: Apache-2.0

description: |
    TSL2540 series ambient light sensor.  See datasheet at
    https://ams.com/documents/20143/36005/TSL2540_DS000564_4-00.pdf/39728ac4-098c-9eca-b5ca-61d9c6f3a588

compatible: "ams,tsl2540"

include: [sensor-device.yaml, i2c-device.yaml]

properties:
  int-gpios:
    type: phandle-array
    description: |
      Identifies the interrupt pin

  glass-attenuation:
    type: int
    default: 100000
    description: |
      Visible light attenuation.
      Integer value for a represenation with 5 decimal points.
      This default value (1.00000) is chosen for free open space (no glass).
      Example: 1.2 would be 120000

  glass-ir-attenuation:
    type: int
    default: 100000
    description: |
      Infa-red light attenuation.
      Integer value for a represenation with 5 decimal points.
      This default value (1.00000) is chosen for free open space (no glass).
      Example: 1.2 would be 120000
```

## dts/bindings/sensor/ams,tsl2561.yaml
```yaml
# Copyright (c) 2023, Gustavo Silva
# SPDX-License-Identifier: Apache-2.0

description: |
    OSRAM ams TSL2561 light sensor.

compatible: "ams,tsl2561"

include: [sensor-device.yaml, i2c-device.yaml]

properties:
  integration-time:
    type: int
    default: 402
    description: |
      ADC integration time in ms. The default value matches Timing Register's value at power on.
    enum:
      - 13
      - 101
      - 402
  gain:
    type: int
    default: 16
    description: |
      ADC gain factor. The default value matches Timing Register's value at power on.
    enum:
      - 1
      - 16
```

## dts/bindings/sensor/ams,tsl2591.yaml
```yaml
# Copyright (c) 2023 Kurtis Dinelle
# SPDX-License-Identifier: Apache-2.0

description: |
    OSRAM ams TSL2591 ambient light sensor.

compatible: "ams,tsl2591"

include: [sensor-device.yaml, i2c-device.yaml]

properties:
  int-gpios:
    type: phandle-array
    description: |
      The interrupt pin of the TSL2591 is open-drain, active low.
      If connected directly, the MCU pin should be configured
      as pull-up, active low.
```

## dts/bindings/sensor/anamicro,ams5915.yaml
```yaml
# Copyright (c) 2024 BoRob Engineering
# SPDX-License-Identifier: Apache-2.0

description: AMS5915 pressure and temperature sensor

compatible: "anamicro,ams5915"

include: [sensor-device.yaml, i2c-device.yaml]

properties:
  lower-limit-press:
    required: true
    type: int
    description: |
      The lower pressure limit in kilopascal of the attached AMS5915 sensor
      variant according datasheet. 

  upper-limit-press:
    required: true
    type: int
    description: |
      The upper pressure limit in kilopascal of the attached AMS5915 sensor
      variant according datasheet. 
```

## dts/bindings/sensor/andar,at581x.yaml
```yaml
# Copyright (c) 2026 NotioNext Ltd.
# SPDX-License-Identifier: Apache-2.0

description: Andar AT581X radar sensor

compatible: "andar,at581x"

include: [sensor-device.yaml, i2c-device.yaml]

properties:
  threshold:
    type: int
    default: 200
    description: |
      Detection threshold value (0-1023).
      Lower values increase sensitivity.
      Default value of 200 provides balanced sensitivity for typical indoor
      motion detection applications while minimizing false positives from
      environmental noise. Adjust lower (100-150) for higher sensitivity
      in quiet environments or higher (300-400) to reduce false triggers
      in noisy environments.

  gain:
    type: int
    default: 27
    description: |
      Gain setting (0-255).
      Default value 27 (0x1B) is the manufacturer-recommended setting
      that provides optimal signal amplification for most applications.
      Lower values reduce sensitivity, higher values may introduce noise.

  base-time-ms:
    type: int
    default: 500
    description: |
      Base detection time in milliseconds.
      Time before detection signal is asserted.
      Default 500ms provides good balance between responsiveness and
      stability, reducing false triggers from brief movements while
      maintaining quick detection of sustained motion.

  keep-time-ms:
    type: int
    default: 1500
    description: |
      Keep detection time in milliseconds.
      Time to maintain detection signal after motion stops.
      Default 1500ms ensures detection remains active long enough for
      typical applications while avoiding excessive power consumption.
      Increase for applications requiring longer detection persistence.
```

## dts/bindings/sensor/aosong,ags10.yaml
```yaml
# Copyright (c) 2023 Balthazar Deliers
# SPDX-License-Identifier: Apache-2.0

description: |
    AOSONG AGS10 a high-performance TVOC Sensor With I2C Interface.
    See: http://www.aosong.com/en/products-86.html

compatible: "aosong,ags10"

include: [sensor-device.yaml, i2c-device.yaml]
```

## dts/bindings/sensor/aosong,aht20.yaml
```yaml
#
# Copyright (c) 2024 Nathan Olff
#
# SPDX-License-Identifier: Apache-2.0

description: |
    Aosong AHT20 (Digital-output Humidity and Temperature Sensor)

    The Asosong AHT20 sensor provides temperature and humidity
    measurements through an I2C bus.

compatible: "aosong,aht20"

include: [sensor-device.yaml, i2c-device.yaml]
```

## dts/bindings/sensor/aosong,aht30.yaml
```yaml
#
# Copyright (c) 2026 NotioNext Ltd.
#
# SPDX-License-Identifier: Apache-2.0

description: |
    Aosong AHT30 (Digital-output Humidity and Temperature Sensor)

    The Aosong AHT30 sensor provides temperature and humidity
    measurements through an I2C bus.

compatible: "aosong,aht30"

include: [sensor-device.yaml, i2c-device.yaml]
```

## dts/bindings/sensor/aosong,am2301b.yaml
```yaml
#
# Copyright (c) 2024 Nathan Olff
#
# SPDX-License-Identifier: Apache-2.0

description: |
    Aosong AM2301B (Digital-output Humidity and Temperature Sensor)

    The Asosong AM2301B sensor provides temperature and humidity
    measurements through an I2C bus.

compatible: "aosong,am2301b"

include: [sensor-device.yaml, i2c-device.yaml]
```

## dts/bindings/sensor/aosong,dht.yaml
```yaml
# Copyright (c) 2019 Nordic Semiconductor ASA
# SPDX-License-Identifier: Apache-2.0

description: |
    Aosong DHT (Digital-output Humidity and Temperature Sensor)

    The Aosong DHT family of sensors provide temperature and humidity
    measurements through a bidirectional serial digital signal.  The
    DHT11 uses a polymer humidity capacitor with NTC thermistor; the
    DHT22 replaces the thermistor with a DS18B20 1-wire thermometer.

    The DHT22 is also known as an AM2303.

compatible: "aosong,dht"

include: sensor-device.yaml

properties:
  dio-gpios:
    type: phandle-array
    required: true
    description: |
      Pin on which sensor communication will be performed.

      Control and data are encoded by the duration of active low
      signals.  A pull up may be appropriate.

  dht22:
    type: boolean
    description: |
      Set to identify sensor as a DHT22/AM2303.  Leave unset to identify
      sensor as a DHT11.
```

## dts/bindings/sensor/aosong,dht20.yaml
```yaml
#
# Copyright (c) 2024 Nathan Olff
#
# SPDX-License-Identifier: Apache-2.0

description: |
    Aosong DHT20 (Digital-output Humidity and Temperature Sensor)

    The Asosong DHT20 sensor provides temperature and humidity
    measurements through an I2C bus.

compatible: "aosong,dht20"

include: [sensor-device.yaml, i2c-device.yaml]
```

## dts/bindings/sensor/ap,fcx-mldx5.yaml
```yaml
# Copyright (c) 2024, Vitrolife A/S
# SPDX-License-Identifier: Apache-2.0

description: Angst+Pfister O2 sensor

compatible: "ap,fcx-mldx5"

include: [sensor-device.yaml, uart-device.yaml]
```

## dts/bindings/sensor/asahi-kasei,ak8975.yaml
```yaml
# Copyright (c) 2020, Linaro Limited
# SPDX-License-Identifier: Apache-2.0

description: |
    Asahi Kasei AK8975 Magnetometer. See datasheet at
    https://www.akm.com/akm/en/file/datasheet/AK8975.pdf

compatible: "asahi-kasei,ak8975"

include: [sensor-device.yaml, i2c-device.yaml]
```

## dts/bindings/sensor/asahi-kasei,akm09918c.yaml
```yaml
# Copyright (c) 2023 Google LLC
# SPDX-License-Identifier: Apache-2.0

description: |
    Asahi Kasei AKM09918C Magnetometer. See datasheet at
    https://www.akm.com/content/dam/documents/products/electronic-compass/ak09918c/ak09918c-en-datasheet.pdf

compatible: "asahi-kasei,akm09918c"

include: [sensor-device.yaml, i2c-device.yaml]
```

## dts/bindings/sensor/atmel,m90e26-spi.yaml
```yaml
# Copyright (c) 2025 Atmel Corporation
# SPDX-License-Identifier: Apache-2.0

description: |
  ATM90E26 Energy Metering IC
  Single-Phase High-Performance Wide-Span
  Smart Energy Meter

compatible: "atmel,m90e26"

include: ["sensor-device.yaml", "spi-device.yaml", "atmel,m90exx-common.yaml"]
```

## dts/bindings/sensor/atmel,m90e32as.yaml
```yaml
# Copyright (c) 2025 Atmel Corporation
# SPDX-License-Identifier: Apache-2.0

description: |
  ATM90E32AS Energy Metering IC
  Enhanced Poly-Phase High-Performance Wide-Span
  3-Phase Smart Energy Meter

compatible: "atmel,m90e32as"

include: ["sensor-device.yaml", "spi-device.yaml", "atmel,m90exx-common.yaml"]

properties:
  cf3-gpios:
    type: phandle-array
    description: "Active Fundamental Energy Pulse Output"

  cf4-gpios:
    type: phandle-array
    description: "Active Harmonic Energy Pulse Output"

  irq1-gpios:
    type: phandle-array
    description: "Interrupt Output 1"

  pm0-gpios:
    type: phandle-array
    description: "Power Mode Configuration 0"

  pm1-gpios:
    type: phandle-array
    description: "Power Mode Configuration 1"
```

## dts/bindings/sensor/atmel,m90exx-common.yaml
```yaml
# Copyright (c) 2025 Atmel Corporation
# SPDX-License-Identifier: Apache-2.0

properties:
  cf1-gpios:
    type: phandle-array
    description: "Active Energy Pulse Output"

  cf2-gpios:
    type: phandle-array
    description: "Reactive/Apparent Energy Pulse Output"

  wrn-out-gpios:
    type: phandle-array
    description: "Fatal Error Warning"

  irq0-gpios:
    type: phandle-array
    description: "Interrupt Output 0"
```

## dts/bindings/sensor/atmel,sam-tc-qdec.yaml
```yaml
# SPDX-License-Identifier: Apache-2.0

description: Atmel SAM Timer Counter (TC) QDEC mode

compatible: "atmel,sam-tc-qdec"

include:
  - name: sensor-device.yaml
  - name: pinctrl-device.yaml
```
