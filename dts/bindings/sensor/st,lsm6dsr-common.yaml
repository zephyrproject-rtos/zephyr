## dts/bindings/sensor/st,stm32-icap-freq-meter.yaml
```yaml
# Copyright (c) 2024 Freedom Veiculos Eletricos
# SPDX-License-Identifier: Apache-2.0

description: STM32 Input Capture Frequency Meter Sensor

compatible: "st,stm32-icap-freq-meter"

include:
  - name: sensor-device.yaml
  - name: pinctrl-device.yaml

properties:
  pinctrl-0:
    required: true

  pinctrl-names:
    required: true

  channel:
    type: int
    description: |
      The timer channel selected to be used to count the frequency.
    default: 1
    enum:
    - 1
    - 2
    - 3
    - 4
```

## dts/bindings/sensor/st,stm32-qdec.yaml
```yaml
# Copyright (c) 2022, Valerio Setti <vsetti@baylibre.com
# SPDX-License-Identifier: Apache-2.0

description: STM32 quadrature decoder

compatible: "st,stm32-qdec"

include:
  - name: base.yaml
  - name: pinctrl-device.yaml

properties:
  pinctrl-0:
    required: true

  pinctrl-names:
    required: true

  st,input-polarity-inverted:
    type: boolean
    description: Encoder is triggered by a falling edge on the input pin

  st,input-filter-level:
    type: int
    description: |
      Intensity of the filter applied to the input signal. This is
      implemented by scaling the sampling frequency and adding a counter
      in which N consecutive samples with same value are needed to validate
      a transition.
      Mapping is as follows (F_clk is the timer's clock):
      0: No filter, sampling is done at F_dts (default value)
      1: Fs = F_clk, N=2
      2: Fs = F_clk, N=4
      3: Fs = F_clk, N=8
      4: Fs = F_clk/2, N=6
      5: Fs = F_clk/2, N=8
      6: Fs = F_clk/4, N=6
      7: Fs = F_clk/4, N=8
      8: Fs = F_clk/8, N=6
      9: Fs = F_clk/8, N=8
      10: Fs = F_clk/16, N=5
      11: Fs = F_clk/16, N=6
      12: Fs = F_clk/16, N=8
      13: Fs = F_clk/32, N=5
      14: Fs = F_clk/32, N=6
      15: Fs = F_clk/32, N=8
      Default value is set by hardware at reset
    default: 0
    enum:
      - 0  # No filter
      - 1  # FDIV1_N2
      - 2  # FDIV1_N4
      - 3  # FDIV1_N8
      - 4  # FDIV2_N6
      - 5  # FDIV2_N8
      - 6  # FDIV4_N6
      - 7  # FDIV4_N8
      - 8  # FDIV8_N6
      - 9  # FDIV8_N8
      - 10 # FDIV16_N5
      - 11 # FDIV16_N6
      - 12 # FDIV16_N8
      - 13 # FDIV32_N5
      - 14 # FDIV32_N6
      - 15 # FDIV32_N8

  st,counts-per-revolution:
    type: int
    required: true
    description: |
      This is a number >= 1 that is used to determine how many revolutions
      were done based on the current counter's value.

  st,encoder-mode:
    type: int
    description: |
      Encoder counting mode
      MODE_X2_TI1 Counter counts up/down on TI2FP2 edge depending on TI1FP1 level
      MODE_X2_TI2  Counter counts up/down on TI1FP1 edge depending on TI2FP2 level
      MODE_X4_TI12 Counter counts up/down on both TI1FP1 and TI2FP2 edges
      depending on the level of the other input
    required: true
    enum:
      - 0 # MODE_X2_TI1
      - 1 # MODE_X2_TI2
      - 2 # MODE_X4_TI1
```

## dts/bindings/sensor/st,stm32-temp-cal-common.yaml
```yaml
# Copyright (c) 2022, Wouter Cappelle
# SPDX-License-Identifier: Apache-2.0

description: Common fields for STM32 family TEMP production calibrated sensors

include: [base.yaml, "st,stm32-temp-common.yaml"]

properties:
  ts-cal1-addr:
    type: int
    required: true
    description: Address of TS_CAL1 calibration parameter

  ts-cal1-temp:
    type: int
    required: true
    description: Temperature at which TS_CAL1 has been measured (TS_CAL2_TEMP)

  ts-cal-vrefanalog:
    type: int
    required: true
    description: |
      Analog voltage reference (Vref+) voltage with which
      temperature sensor calibration parameters have been
      measured

  ts-cal-resolution:
    type: int
    description: |
      ADC resolution used for measuring calibration data

      This is usually equal to the ADC's native resolution.

      Most series have a 12-bit ADC, but 14-bit and 16-bit
      also exists on e.g., STM32U5 and STM32H7 (16) series.
    default: 12
    enum:
    - 12
    - 14
    - 16
```

## dts/bindings/sensor/st,stm32-temp-cal.yaml
```yaml
# Copyright (c) 2022, Wouter Cappelle
# SPDX-License-Identifier: Apache-2.0

description: |
    STM32 family TEMP node for production calibrated sensors with two calibration temperatures.

compatible: "st,stm32-temp-cal"

include:
  - name: st,stm32-temp-cal-common.yaml
    property-blocklist:
      - avgslope
      - ntc

properties:
  nvmem-cell-names:
    description: |
      Two NVMEM cells must be provided:
        - TS_CAL1
        - TS_CAL2

      Each cell corresponds to the eponymous calibration parameter.
    enum: ["TS_CAL1", "TS_CAL2"]

  ts-cal2-temp:
    type: int
    required: true
    description: Temperature at which TS_CAL2 has been measured (TS_CAL2_TEMP)
```

## dts/bindings/sensor/st,stm32-temp-common.yaml
```yaml
# Copyright (c) 2022, Wouter Cappelle
# SPDX-License-Identifier: Apache-2.0

include: sensor-device.yaml

properties:
  io-channels:
    required: true
    description: ADC channel for temperature sensor

  avgslope:
    type: string
    required: true
    description: |
      Average slope of T-V chart (in mV/°C), found in MCU datasheet
      chapters "Electrical characteristics" or "Operating conditions"

  ntc:
    type: boolean
    description: |
      Negative Temperature Coefficient

      Set when the sensor's value is inversely proportional to temperature
      (i.e., the sensor's value decreases as the temperature increases).

      This is visible in the formula used for temperature calculation, which has the
      form "Calibration_Value - ADC_Value" rather than "ADC_Value - Calibration_Value".
```
