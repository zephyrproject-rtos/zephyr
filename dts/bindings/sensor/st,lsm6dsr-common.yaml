## dts/bindings/sensor/st,lsm6dsr-common.yaml
```yaml
# Copyright (c) 2025, Helbling Technik AG
# SPDX-License-Identifier: Apache-2.0

include: sensor-device.yaml

properties:
  irq-gpios:
    # This signal is active high when produced by the sensor
    type: phandle-array
```

## dts/bindings/sensor/st,lsm6dsr-i2c.yaml
```yaml
# Copyright (c) 2025, Helbling Technik AG
# SPDX-License-Identifier: Apache-2.0

description: |
  STMicroelectronics LSM6DSR 6-axis accelerometer and gyrometer accessed through
  I2C bus

compatible: "st,lsm6dsr"

include: ["i2c-device.yaml", "st,lsm6dsr-common.yaml"]
```

## dts/bindings/sensor/st,lsm6dsr-spi.yaml
```yaml
# Copyright (c) 2025, Helbling Technik AG
# SPDX-License-Identifier: Apache-2.0

description: |
  STMicroelectronics LSM6DSR 6-axis accelerometer and gyrometer accessed through
  SPI bus

compatible: "st,lsm6dsr"

include: ["spi-device.yaml", "st,lsm6dsr-common.yaml"]
```

## dts/bindings/sensor/st,lsm6dsv16x-common.yaml
```yaml
# Copyright (c) 2023 STMicroelectronics
# SPDX-License-Identifier: Apache-2.0

include: st,lsm6dsvxxx-common.yaml

properties:
  accel-range:
    type: int
    default: 2
    description: |
      Range in g. Default is power-up configuration.

      - 2  # LSM6DSV16X_DT_FS_2G  (0.061 mg/LSB)
      - 4  # LSM6DSV16X_DT_FS_4G  (0.122 mg/LSB)
      - 8  # LSM6DSV16X_DT_FS_8G  (0.244 mg/LSB)
      - 16 # LSM6DSV16X_DT_FS_16G (0.488 mg/LSB)

    enum: [2, 4, 8, 16]
```

## dts/bindings/sensor/st,lsm6dsv16x-i2c.yaml
```yaml
# Copyright (c) 2023 STMicroelectronics
# SPDX-License-Identifier: Apache-2.0

description: |
    STMicroelectronics LSM6DSV16X 6-axis IMU (Inertial Measurement Unit) sensor
    accessed through I2C bus

compatible: "st,lsm6dsv16x"

include: ["i2c-device.yaml", "st,lsm6dsv16x-common.yaml"]
```

## dts/bindings/sensor/st,lsm6dsv16x-i3c.yaml
```yaml
# Copyright (c) 2024 Meta Platforms
# SPDX-License-Identifier: Apache-2.0

description: |
    STMicroelectronics LSM6DSV16X 6-axis IMU (Inertial Measurement Unit) sensor
    accessed through I3C bus

compatible: "st,lsm6dsv16x"

include: ["i3c-device.yaml", "st,lsm6dsv16x-common.yaml"]
```

## dts/bindings/sensor/st,lsm6dsv16x-spi.yaml
```yaml
# Copyright (c) 2023 STMicroelectronics
# SPDX-License-Identifier: Apache-2.0

description: |
    STMicroelectronics LSM6DSV16X 6-axis IMU (Inertial Measurement Unit) sensor
    accessed through SPI bus

compatible: "st,lsm6dsv16x"

include: ["spi-device.yaml", "st,lsm6dsv16x-common.yaml"]
```

## dts/bindings/sensor/st,lsm6dsv320x-common.yaml
```yaml
# Copyright (c) 2025 STMicroelectronics
# SPDX-License-Identifier: Apache-2.0

description: |
    When setting the accel-range, accel-odr, gyro-range, gyro-odr properties in
    a .dts or .dtsi file you may include lsm6dsv320x.h and use the macros
    defined there.

    Example:
    #include <zephyr/dt-bindings/sensor/lsm6dsv320x.h>

    lsm6dsv320x: lsm6dsv320x@0 {
      ...

      accel-range = <LSM6DSV320X_DT_FS_8G>;
      accel-odr = <LSM6DSVXXX_DT_ODR_AT_60Hz>;
      gyro-range = <LSM6DSV320X_DT_FS_4000DPS>;
      gyro-odr = <LSM6DSVXXX_DT_ODR_AT_60Hz>;
    };

include: st,lsm6dsvxxx-common.yaml

properties:
  accel-hg-odr:
    type: int
    default: 0x0
    description: |
      Specify the default accelerometer High-g output data rate expressed in samples per
      second (Hz).
      The values are taken in accordance to lsm6dsv320x_hg_xl_data_rate_t enumerative in hal/st
      module. Please note that this values will not change the operating mode, which will remain
      High Performance (device default)
      Default is power-up configuration.

      - 0x0 # LSM6DSV320X_HG_XL_ODR_OFF
      - 0x3 # LSM6DSV320X_HG_XL_ODR_AT_480Hz
      - 0x4 # LSM6DSV320X_HG_XL_ODR_AT_960Hz
      - 0x5 # LSM6DSV320X_HG_XL_ODR_AT_1920Hz
      - 0x6 # LSM6DSV320X_HG_XL_ODR_AT_3840Hz
      - 0x7 # LSM6DSV320X_HG_XL_ODR_AT_7680Hz

    enum: [0x0, 0x3, 0x4, 0x5, 0x6, 0x7]

  accel-range:
    type: int
    default: 2
    description: |
      Range in g. Default is power-up configuration.
      Ranges from 32g and above requires the High-g sensor to be turned on (see accel-hg-odr).

      - 2   # LSM6DSV320X_DT_FS_2G  (0.061 mg/LSB)
      - 4   # LSM6DSV320X_DT_FS_4G  (0.122 mg/LSB)
      - 8   # LSM6DSV320X_DT_FS_8G  (0.244 mg/LSB)
      - 16  # LSM6DSV320X_DT_FS_16G (0.488 mg/LSB)
      - 32  # LSM6DSV320X_DT_FS_32G (0.976 mg/LSB)
      - 64  # LSM6DSV320X_DT_FS_64G (1.952 mg/LSB)
      - 128 # LSM6DSV320X_DT_FS_128G (3.904 mg/LSB)
      - 256 # LSM6DSV320X_DT_FS_256G (7.808 mg/LSB)
      - 320 # LSM6DSV320X_DT_FS_320G (10.417 mg/LSB)

    enum: [2, 4, 8, 16, 32, 64, 128, 256, 320]

  gyro-range:
    type: int
    default: 0
    description: |
      Range in dps. Default is power-up configuration.

      - 0x0 # power-up configuration
      - 0x1 # LSM6DSV320X_DT_FS_250DPS  (8.75 mdps/LSB)
      - 0x2 # LSM6DSV320X_DT_FS_500DPS  (17.50 mdps/LSB)
      - 0x3 # LSM6DSV320X_DT_FS_1000DPS (35 mdps/LSB)
      - 0x4 # LSM6DSV320X_DT_FS_2000DPS (70 mdps/LSB)
      - 0x5 # LSM6DSV320X_DT_FS_4000DPS (140 mdps/LSB)

    enum: [0x0, 0x1, 0x2, 0x3, 0x4, 0x5]
```

## dts/bindings/sensor/st,lsm6dsv320x-i2c.yaml
```yaml
# Copyright (c) 2025 STMicroelectronics
# SPDX-License-Identifier: Apache-2.0

description: |
    STMicroelectronics LSM6DSV320X 6-axis IMU (Inertial Measurement Unit) sensor
    accessed through I2C bus

compatible: "st,lsm6dsv320x"

include: ["i2c-device.yaml", "st,lsm6dsv320x-common.yaml"]
```

## dts/bindings/sensor/st,lsm6dsv32x-common.yaml
```yaml
# Copyright (c) 2025 Meta Platforms
# SPDX-License-Identifier: Apache-2.0

description: |
    When setting the accel-range, accel-odr, gyro-range, gyro-odr properties in
    a .dts or .dtsi file you may include lsm6dsv32x.h and use the macros
    defined there.

    Example:
    #include <zephyr/dt-bindings/sensor/lsm6dsv32x.h>

    lsm6dsv32x: lsm6dsv32x@0 {
      ...

      accel-range = <LSM6DSV32X_DT_FS_8G>;
      accel-odr = <LSM6DSVXXX_DT_ODR_AT_60Hz>;
      gyro-range = <LSM6DSV32X_DT_FS_4000DPS>;
      gyro-odr = <LSM6DSVXXX_DT_ODR_AT_60Hz>;
    };

include: st,lsm6dsvxxx-common.yaml

properties:
  accel-range:
    type: int
    default: 4
    description: |
      Range in g. Default is power-up configuration.

      - 4  # LSM6DSV32X_DT_FS_4G  (0.122 mg/LSB)
      - 8  # LSM6DSV32X_DT_FS_8G  (0.244 mg/LSB)
      - 16 # LSM6DSV32X_DT_FS_16G (0.488 mg/LSB)
      - 32 # LSM6DSV32X_DT_FS_32G (0.976 mg/LSB)

    enum: [4, 8, 16, 32]

  gyro-range:
    type: int
    default: 0
    description: |
      Range in dps. Default is power-up configuration.

      - 0x0 # LSM6DSV32X_DT_FS_125DPS  (4.375 mdps/LSB)
      - 0x1 # LSM6DSV32X_DT_FS_250DPS  (8.75 mdps/LSB)
      - 0x2 # LSM6DSV32X_DT_FS_500DPS  (17.50 mdps/LSB)
      - 0x3 # LSM6DSV32X_DT_FS_1000DPS (35 mdps/LSB)
      - 0x4 # LSM6DSV32X_DT_FS_2000DPS (70 mdps/LSB)
      - 0xc # LSM6DSV32X_DT_FS_4000DPS (140 mdps/LSB)

    enum: [0x0, 0x1, 0x2, 0x3, 0x4, 0xc]
```

## dts/bindings/sensor/st,lsm6dsv32x-i3c.yaml
```yaml
# Copyright (c) 2025 Meta Platforms
# SPDX-License-Identifier: Apache-2.0

description: |
    STMicroelectronics LSM6DSV32X 6-axis IMU (Inertial Measurement Unit) sensor
    accessed through I3C bus

compatible: "st,lsm6dsv32x"

include: ["i3c-device.yaml", "st,lsm6dsv32x-common.yaml"]

properties:
  int-en-i3c:
    type: boolean
    description: |
      Enables INT pin when I3C is enabled

  bus-act-sel-us:
    type: int
    default: 50
    description: |
      Bus available time for I3C IBI in microseconds

    enum: [50, 2, 1000, 25000]
```

## dts/bindings/sensor/st,lsm6dsv32x-spi.yaml
```yaml
# Copyright (c) 2025 Meta Platforms
# SPDX-License-Identifier: Apache-2.0

description: |
    STMicroelectronics LSM6DSV32X 6-axis IMU (Inertial Measurement Unit) sensor
    accessed through SPI bus

compatible: "st,lsm6dsv32x"

include: ["spi-device.yaml", "st,lsm6dsv32x-common.yaml"]
```

## dts/bindings/sensor/st,lsm6dsv80x-i2c.yaml
```yaml
# Copyright (c) 2025 STMicroelectronics
# SPDX-License-Identifier: Apache-2.0

description: |
    STMicroelectronics LSM6DSV80X 6-axis IMU (Inertial Measurement Unit) sensor
    accessed through I2C bus

compatible: "st,lsm6dsv80x"

include: ["i2c-device.yaml", "st,lsm6dsv80x-common.yaml"]
```

## dts/bindings/sensor/st,lsm6dsv80x-spi.yaml
```yaml
# Copyright (c) 2025 STMicroelectronics
# SPDX-License-Identifier: Apache-2.0

description: |
    STMicroelectronics LSM6DSV80X 6-axis IMU (Inertial Measurement Unit) sensor
    accessed through SPI bus

compatible: "st,lsm6dsv80x"

include: ["spi-device.yaml", "st,lsm6dsv80x-common.yaml"]
```

## dts/bindings/sensor/st,lsm9ds0-gyro-i2c.yaml
```yaml
# Copyright (c) 2018 STMicroelectronics
# SPDX-License-Identifier: Apache-2.0

description: STMicroelectronics LSM9DS0-GYRO 3-axis gyro

compatible: "st,lsm9ds0-gyro"

include: i2c-device.yaml

properties:
    irq-gpios:
      type: phandle-array
      required: false
```

## dts/bindings/sensor/st,lsm9ds0-mfd-i2c.yaml
```yaml
# Copyright (c) 2018 STMicroelectronics
# SPDX-License-Identifier: Apache-2.0

description: STMicroelectronics LSM9DS0 3-axis accelerometer + magnetometer

compatible: "st,lsm9ds0-mfd"

include: i2c-device.yaml

properties:
    irq-gpios:
      type: phandle-array
      required: false
```

## dts/bindings/sensor/st,lsm9ds1.yaml
```yaml
# Copyright (c) 2024 Bootlin
# SPDX-License-Identifier: Apache-2.0

description: |
    STMicroelectronics LSM9DS1 3-axis accelerometer + gyroscope accessed
    through I2C bus.

    This binding describe only the inertial part : accelerometer and gyroscope.

    When setting the accel-range, gyro-range, imu-odr properties in
    a .dts or .dtsi file you may include lsm9ds1.h and use the macros
    defined there.

    Example:
    #include <zephyr/dt-bindings/sensor/lsm9ds1.h>

    lsm9ds1: lsm9ds1@0 {
      ...

      accel-range = <LSM9DS1_DT_FS_4G>;
      imu-odr   =  <LSM9DS1_IMU_14Hz9>;
      gyro-range = <LSM9DS1_DT_FS_2000DPS>;
    };

compatible: "st,lsm9ds1"

include: [sensor-device.yaml, i2c-device.yaml]

properties:
  accel-range:
    type: int
    default: 0
    description: |
      Range of the accelerometer. Unit : g. Default is power-up configuration.

      - 0 # LSM9DS1_DT_FS_2G  (0.061 mg/LSB)
      - 1 # LSM9DS1_DT_FS_16G (0.732 mg/LSB)
      - 2 # LSM9DS1_DT_FS_4G  (0.122 mg/LSB)
      - 3 # LSM9DS1_DT_FS_8G  (0.244 mg/LSB)

    enum: [0, 1, 2, 3]

  gyro-range:
    type: int
    default: 0
    description: |
      Range in dps. Default is power-up configuration.

      - 0 # LSM9DS1_DT_FS_245DPS  (8.75  mdps/LSB)
      - 1 # LSM9DS1_DT_FS_500DPS  (17.50 mdps/LSB)
      - 3 # LSM9DS1_DT_FS_2000DPS (70    mdps/LSB)

    enum: [0, 1, 3]

  imu-odr:
    type: int
    default: 0
    description: |
      Specify the default accelerometer and gyroscope output data rate expressed in samples
      per second (Hz).
      Default is power-up configuration.

      - 0x00 # LSM9DS1_IMU_OFF
      - 0x10 # LSM9DS1_GY_OFF_XL_10Hz
      - 0x20 # LSM9DS1_GY_OFF_XL_50Hz
      - 0x30 # LSM9DS1_GY_OFF_XL_119Hz
      - 0x40 # LSM9DS1_GY_OFF_XL_238Hz
      - 0x50 # LSM9DS1_GY_OFF_XL_476Hz
      - 0x60 # LSM9DS1_GY_OFF_XL_952Hz
      - 0x01 # LSM9DS1_XL_OFF_GY_14Hz9
      - 0x02 # LSM9DS1_XL_OFF_GY_59Hz5
      - 0x03 # LSM9DS1_XL_OFF_GY_119Hz
      - 0x04 # LSM9DS1_XL_OFF_GY_238Hz
      - 0x05 # LSM9DS1_XL_OFF_GY_476Hz
      - 0x06 # LSM9DS1_XL_OFF_GY_952Hz
      - 0x11 # LSM9DS1_IMU_14Hz9
      - 0x22 # LSM9DS1_IMU_59Hz5
      - 0x33 # LSM9DS1_IMU_119Hz
      - 0x44 # LSM9DS1_IMU_238Hz
      - 0x55 # LSM9DS1_IMU_476Hz
      - 0x66 # LSM9DS1_IMU_952Hz
      - 0x81 # LSM9DS1_XL_OFF_GY_14Hz9_LP
      - 0x82 # LSM9DS1_XL_OFF_GY_59Hz5_LP
      - 0x83 # LSM9DS1_XL_OFF_GY_119Hz_LP
      - 0x91 # LSM9DS1_IMU_14Hz9_LP
      - 0xA2 # LSM9DS1_IMU_59Hz5_LP
      - 0xB3 # LSM9DS1_IMU_119Hz_LP

    enum: [0x00, 0x10, 0x20, 0x30, 0x40, 0x50, 0x60, 0x01, 0x02, 0x03, 0x04, 0x05, 0x06, 0x11,
           0x22, 0x33, 0x44, 0x55, 0x66, 0x81, 0x82, 0x83, 0x91, 0xA2, 0xB3]
```

## dts/bindings/sensor/st,lsm9ds1_mag.yaml
```yaml
# Copyright (c) 2024 Bootlin
# SPDX-License-Identifier: Apache-2.0

description: |
    STMicroelectronics LSM9DS1-MAG 3-axis magnetometer accessed
    through I2C bus.

    This binding describes only the magnetometer.

    When setting the mag-range and mag-odr properties in
    a .dts or .dtsi file you may include lsm9ds1.h and use the macros
    defined here.

    Example:
    #include <zephyr/dt-bindings/sensor/lsm9ds1.h>

    lsm9ds1_mag: lsm9ds1_mag@0 {
      ...

      mag-range = <LSM9DS1_DT_FS_4Ga>;
      mag-odr = <LSM9DS1_MAG_MP_40Hz>;
    };

compatible: "st,lsm9ds1_mag"

include: [sensor-device.yaml, i2c-device.yaml]

properties:
  mag-range:
    type: int
    default: 0
    description: |
      Range of the magnetometer in gauss. Default is power-up configuration.

      - 0 # LSM9DS1_DT_FS_4Ga   (0.14  mgauss/LSB)
      - 1 # LSM9DS1_DT_FS_8Ga   (0.29  mgauss/LSB)
      - 2 # LSM9DS1_DT_FS_12Ga  (0.43  mgauss/LSB)
      - 3 # LSM9DS1_DT_FS_16Ga  (0.58  mgauss/LSB)

    enum: [0, 1, 2, 3]

  mag-odr:
    type: int
    default: 0
    description: |
      Specify the default output data rate of the magnetometer (samples/second).
      Default is power-up configuration.
      - 0xC0 # LSM9DS1_MAG_POWER_DOWN
      - 0x00 # LSM9DS1_MAG_LP_0Hz625
      - 0x01 # LSM9DS1_MAG_LP_1Hz25
      - 0x02 # LSM9DS1_MAG_LP_2Hz5
      - 0x03 # LSM9DS1_MAG_LP_5Hz
      - 0x04 # LSM9DS1_MAG_LP_10Hz
      - 0x05 # LSM9DS1_MAG_LP_20Hz
      - 0x06 # LSM9DS1_MAG_LP_40Hz
      - 0x07 # LSM9DS1_MAG_LP_80Hz
      - 0x10 # LSM9DS1_MAG_MP_0Hz625
      - 0x11 # LSM9DS1_MAG_MP_1Hz25
      - 0x12 # LSM9DS1_MAG_MP_2Hz5
      - 0x13 # LSM9DS1_MAG_MP_5Hz
      - 0x14 # LSM9DS1_MAG_MP_10Hz
      - 0x15 # LSM9DS1_MAG_MP_20Hz
      - 0x16 # LSM9DS1_MAG_MP_40Hz
      - 0x17 # LSM9DS1_MAG_MP_80Hz
      - 0x20 # LSM9DS1_MAG_HP_0Hz625
      - 0x21 # LSM9DS1_MAG_HP_1Hz25
      - 0x22 # LSM9DS1_MAG_HP_2Hz5
      - 0x23 # LSM9DS1_MAG_HP_5Hz
      - 0x24 # LSM9DS1_MAG_HP_10Hz
      - 0x25 # LSM9DS1_MAG_HP_20Hz
      - 0x26 # LSM9DS1_MAG_HP_40Hz
      - 0x27 # LSM9DS1_MAG_HP_80Hz
      - 0x30 # LSM9DS1_MAG_UHP_0Hz625
      - 0x31 # LSM9DS1_MAG_UHP_1Hz25
      - 0x32 # LSM9DS1_MAG_UHP_2Hz5
      - 0x33 # LSM9DS1_MAG_UHP_5Hz
      - 0x34 # LSM9DS1_MAG_UHP_10Hz
      - 0x35 # LSM9DS1_MAG_UHP_20Hz
      - 0x36 # LSM9DS1_MAG_UHP_40Hz
      - 0x37 # LSM9DS1_MAG_UHP_80Hz
      - 0x38 # LSM9DS1_MAG_UHP_155Hz
      - 0x28 # LSM9DS1_MAG_HP_300Hz
      - 0x18 # LSM9DS1_MAG_MP_560Hz
      - 0x08 # LSM9DS1_MAG_LP_1000Hz
      - 0x70 # LSM9DS1_MAG_ONE_SHOT

    enum: [0xC0, 0x00, 0x01, 0x02, 0x03, 0x04, 0x05, 0x06, 0x07, 0x10, 0x11, 0x12, 0x13,
           0x14, 0x15, 0x16, 0x17, 0x20, 0x21, 0x22, 0x23, 0x24, 0x25, 0x26, 0x27, 0x30, 0x31,
           0x32, 0x33, 0x34, 0x35, 0x36, 0x37, 0x38, 0x28, 0x18, 0x08, 0x70]
```

## dts/bindings/sensor/st,stc3100.yaml
```yaml
# Copyright (c) 2024 Benedikt Schmidt <benediktibk@gmail.com>
# SPDX-License-Identifier: Apache-2.0

description: STMicroelectronics STC3100 battery monitor

compatible: "st,stc3100"

include: [sensor-device.yaml, i2c-device.yaml]

properties:
  sense-resistor:
    type: int
    required: true
    description: |
      External sense resistor in mOhm.

  nominal-capacity:
    type: int
    required: true
    description: |
      Nominal capacity in mAh.
```

## dts/bindings/sensor/st,stm32-digi-temp.yaml
```yaml
# Copyright (c) 2024, Aurelien Jarno
# SPDX-License-Identifier: Apache-2.0

description: STM32 family Digital Temperature Sensor node

compatible: "st,stm32-digi-temp"

include: base.yaml

properties:
  reg:
    required: true

  interrupts:
    required: true

  clocks:
    required: true
```
