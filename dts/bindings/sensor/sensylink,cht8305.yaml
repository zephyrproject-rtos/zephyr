## dts/bindings/sensor/ti,ldc1x1x.yaml
```yaml
# Copyright (c) 2026 RAKwireless Technology Limited
# SPDX-License-Identifier: Apache-2.0

title: Texas Instruments LDC1X1X Inductance-to-Digital Converter

description: |
  Texas Instruments LDC1312, LDC1314, LDC1612, and LDC1614
  inductance-to-digital converters.

  The family provides 2-channel or 4-channel inductive sensing over I2C.
  LDC131x devices report the 12 MSBs of an internal 16-bit conversion result
  and support output gain. LDC161x devices report a 28-bit conversion result.

compatible: "ti,ldc1x1x"

include: [sensor-device.yaml, i2c-device.yaml]

properties:
  sd-gpios:
    type: phandle-array
    description: |
      The SD pin defaults to active high when consumed by the sensor.
      The property value should ensure the flags properly describe
      the signal that is presented to the driver.

  intb-gpios:
    type: phandle-array
    description: |
      The INTB pin defaults to active low when produced by the sensor.
      The property value should ensure the flags properly describe
      the signal that is presented to the driver.

  ldc1x14:
    type: boolean
    description: |
      Set to identify the sensor as LDC1314 or LDC1614
      (4-channel version).

  autoscan:
    type: boolean
    description: |
      Set the Auto-Scan mode.

      false = Continuous conversion on the single channel selected by
      "active-channel" (single-channel mode).

      true = Auto-Scan conversions as selected by "rr-sequence"
      (multichannel mode).

  fref:
    type: int
    required: true
    description: |
      Reference frequency of the selected clock source in kHz.

      The internal oscillator is nominally around 43 MHz.
      A common external clock source is 40 MHz on CLKIN.

  rr-sequence:
    type: int
    default: 0
    description: |
      Auto-Scan sequence configuration.
      The LDC will perform a single conversion on each channel
      in the sequence selected, and then restart the sequence continuously.

      The sensor performs conversion on Channel 0 to 1 by default after
      power-on reset. This setting only applies if autoscan=true
      (multichannel mode).

      0 = Ch0, Ch1
      1 = Ch0, Ch1, Ch2 (LDC1314, LDC1614 only)
      2 = Ch0, Ch1, Ch2, Ch3 (LDC1314, LDC1614 only)
    enum:
      - 0
      - 1
      - 2

  active-channel:
    type: int
    default: 0
    description: |
      Selects the channel for continuous conversions.

      The sensor performs continuous conversion on Channel 0 by default after
      power-on reset. This setting only applies if autoscan=false
      (single-channel mode).

      0 = Perform continuous conversions on Channel 0
      1 = Perform continuous conversions on Channel 1
      2 = Perform continuous conversions on Channel 2 (LDC1314, LDC1614 only)
      3 = Perform continuous conversions on Channel 3 (LDC1314, LDC1614 only)
    enum:
      - 0
      - 1
      - 2
      - 3

  deglitch:
    type: int
    required: true
    description: |
      Input deglitch filter bandwidth. Select the lowest setting that exceeds
      the maximum sensor oscillation frequency.

      1 = 1.0 MHz
      4 = 3.3 MHz
      5 = 10 MHz
      7 = 33 MHz
    enum:
      - 1
      - 4
      - 5
      - 7

  rp-override:
    type: boolean
    description: |
      Drive the sensor with the fixed current programmed by "idrive" instead
      of letting the sensor pick one.

      The sensor determines the drive current automatically after power-on
      reset, which is meant for prototyping an unknown sensor. Set this once
      a suitable "idrive" is known, which is what TI recommends for
      consistent measurement performance.

  auto-amplitude-correction-disable:
    type: boolean
    description: |
      Disable the automatic amplitude correction algorithm and stop the
      sensor from updating its internal drive current estimate.

      Set this together with "rp-override" to keep the drive current fully
      under the control of "idrive".

  sensor-activate-sel:
    type: string
    default: "low-power"
    description: |
      Sensor activation mode selection.

      The sensor uses low-power activation mode by default after
      power-on reset.

      full-current = The LDC drives maximum sensor current for a shorter
      sensor activation time.

      low-power = The LDC uses the value programmed by "idrive" during
      sensor activation to minimize power consumption.
    enum:
      - "full-current"
      - "low-power"

  ref-clk-src:
    type: string
    default: "internal"
    description: |
      Select reference frequency source.

      The sensor uses the internal clock by default after power-on reset.

      internal = Use internal oscillator as reference frequency.
      external = Reference frequency is provided from CLKIN pin.
    enum:
      - "internal"
      - "external"

  current-drive:
    type: string
    default: "normal"
    description: |
      Select sensor current drive mode.

      The sensor uses normal current drive by default after power-on reset.
      High current drive only applies to Channel 0, and is only supported
      when autoscan=false.

      normal = The LDC drives all channels with normal sensor current
      (1.5 mA max).

      high = The LDC drives Channel 0 with current >1.5 mA.
    enum:
      - "normal"
      - "high"

  output-gain:
    type: int
    default: 0
    description: |
      Output gain control (LDC1312 and LDC1314 only).

      The default output gain is 0 after power-on reset.
      This property is ignored by LDC1612 and LDC1614.

      0 = Gain = 1   | Effective resolution 12 bits | 100% full scale
      1 = Gain = 4   | Effective resolution 14 bits | 25% full scale
      2 = Gain = 8   | Effective resolution 15 bits | 12.5% full scale
      3 = Gain = 16  | Effective resolution 16 bits | 6.25% full scale
    enum:
      - 0
      - 1
      - 2
      - 3

child-binding:
  description: |
    Settings for one enabled sensor channel.

    Exactly the channels the sensor converts must have a node. In Auto-Scan
    that is channel 0 up to the channel selected by "rr-sequence", and in
    single-channel mode it is the channel selected by "active-channel".

  properties:
    reg:
      type: int
      required: true
      description: |
        Channel number.
        Channels 0-1 are available on LDC1312 and LDC1612.
        Channels 0-3 are available on LDC1314 and LDC1614.
      enum:
        - 0
        - 1
        - 2
        - 3

    rcount:
      type: int
      required: true
      description: |
        Channel X reference count conversion interval time.
      min: 5
      max: 65535

    offset:
      type: int
      default: 0
      description: |
        Channel X conversion offset.
        The default offset value after power-on reset is 0.
      min: 0
      max: 65535

    settlecount:
      type: int
      required: true
      description: |
        Channel X conversion settling time.

        The LDC uses this settling time to allow the LC sensor to
        stabilize before initiating a conversion on Channel X.
      min: 2
      max: 65535

    fref-divider:
      type: int
      required: true
      description: |
        Channel X reference divider.

        Sets the divider for the channel reference clock.
      min: 1
      max: 1023

    idrive:
      type: int
      required: true
      description: |
        Channel X sensor drive current.

        This field defines the drive current used during the settling
        and conversion time of the Channel X sensor clock.
      min: 0
      max: 31

    fin-divider:
      type: int
      required: true
      description: |
        Channel X sensor input divider.

        Sets FIN_DIVIDERx so that the effective sensor input frequency stays
        within the allowed operating range.
      min: 1
      max: 15

examples:
  - |
    #include <zephyr/dt-bindings/gpio/gpio.h>

    &i2c0 {
      ldc1614: ldc1614@2a {
        compatible = "ti,ldc1x1x";
        reg = <0x2a>;
        #address-cells = <1>;
        #size-cells = <0>;
        ldc1x14;
        fref = <40000>;
        autoscan;
        rr-sequence = <2>;
        deglitch = <4>;
        sensor-activate-sel = "full-current";
        ref-clk-src = "external";
        sd-gpios = <&gpio0 5 GPIO_ACTIVE_HIGH>;
        intb-gpios = <&gpio0 6 GPIO_ACTIVE_LOW>;

        channel@0 {
          reg = <0>;
          rcount = <0x04d6>;
          settlecount = <0x000a>;
          fref-divider = <2>;
          fin-divider = <1>;
          idrive = <0x10>;
        };

        channel@1 {
          reg = <1>;
          rcount = <0x04d6>;
          settlecount = <0x000a>;
          fref-divider = <2>;
          fin-divider = <1>;
          idrive = <0x10>;
        };

        channel@2 {
          reg = <2>;
          rcount = <0x04d6>;
          settlecount = <0x000a>;
          fref-divider = <2>;
          fin-divider = <1>;
          idrive = <0x10>;
        };

        channel@3 {
          reg = <3>;
          rcount = <0x04d6>;
          settlecount = <0x000a>;
          fref-divider = <2>;
          fin-divider = <1>;
          idrive = <0x10>;
        };
      };
    };
```

## dts/bindings/sensor/ti,opt4048.yaml
```yaml
# Copyright (c) 2026 Darshan Maru <darshanmaru1411@gmail.com>
# SPDX-License-Identifier: Apache-2.0

description: |
  TI OPT4048 high speed, high precision tristimulus XYZ color sensor.

compatible: "ti,opt4048"

include: [sensor-device.yaml, i2c-device.yaml]

properties:
  conversion-time:
    type: int
    default: 8
    enum: [0, 1, 2, 3, 4, 5, 6, 7, 8, 9, 10, 11]
    description: |
      The default selects 100 ms per channel, providing a practical
      balance between measurement response time and noise performance
      for general-purpose ambient light sensing. Applications requiring
      faster measurements or lower measurement noise can select a
      different conversion time.

      0: 600 us, 1: 1 ms, 2: 1.8 ms, 3: 3.4 ms,
      4: 6.5 ms, 5: 12.7 ms, 6: 25 ms, 7: 50 ms,
      8: 100 ms, 9: 200 ms, 10: 400 ms, 11: 800 ms.

  range:
    type: int
    default: 12
    enum: [0, 1, 2, 3, 4, 5, 6, 12]
    description: |
      The default selects automatic ranging so that the sensor can
      adapt its measurement range to changing illumination without
      requiring an application-specific fixed range. Applications
      requiring a fixed measurement range can select one of the
      supported manual range settings.

      0: 2.2 klux, 1: 4.5 klux, 2: 9 klux, 3: 18 klux,
      4: 36 klux, 5: 72 klux, 6: 144 klux, 12: automatic range.

  operating-mode:
    type: int
    default: 3
    enum: [0, 1, 2, 3]
    description: |
      The default selects continuous conversion, which is suitable
      for applications that periodically read ambient light
      measurements without explicitly triggering each conversion.
      Applications that need measurements only on demand or need
      to reduce measurement activity can select a one-shot mode.

      0: power-down, 1: forced auto-range one-shot,
      2: one-shot, 3: continuous.

      In one-shot modes, each sample_fetch() call must trigger a
      new measurement and wait for its completion.
```

## dts/bindings/sensor/vishay,veml3328.yaml
```yaml
# Copyright (c) 2026 Christopher Ruehl
# SPDX-License-Identifier: Apache-2.0

description: |
    Vishay VEML3328 RGBC,IR Sensor With I2C Interface.
    See: https://www.vishay.com/en/product/84968/

compatible: "vishay,veml3328"

include: [sensor-device.yaml, i2c-device.yaml]

properties:
  dg:
    type: int
    default: 0x00
    description: |
      DG setting as described in the datasheet on page 7.
      The DG is set with Bit 13,12 at Register 0x00
      Possible values are:
        0x00 = DG x1  (0b00)
        0x01 = DG x2  (0b01)
        0x02 = DG x4  (0b10)
        0x03 = Reserved, do not use
    enum:
      - 0x00
      - 0x01
      - 0x02

  gain:
    type: int
    default: 0x00
    description: |
      Gain setting as described in the datasheet on page 7.
      The gain is set with Bit 11,10 at Register 0x00
      Possible values are:
        0x00 = Gain x1  (0b00)
        0x01 = Gain x2  (0b01)
        0x02 = Gain x4  (0b10)
        0x03 = Gain 1/2 (0b11)
    enum:
      - 0x00
      - 0x01
      - 0x02
      - 0x03

  it:
    type: int
    default: 0x00
    description: |
      Integration Time (IT), described in the datasheet on page 7.
      IT is set with Bit 5,4 at Register 0x00
      Possible values are:
        0x00 = 50ms  (0b00)
        0x01 = 100ms (0b01)
        0x02 = 200ms (0b10)
        0x03 = 400ms (0b11)
    enum:
      - 0x00
      - 0x01
      - 0x02
      - 0x03

  active-force-mode:
    type: boolean
    description: |
      Active Force Mode, described in the datasheet on page 7.
      The mode is set with Bit 3 at Register 0x00

  sd-als-only:
    type: boolean
    description: |
      Sense Ambiente Light only described in the datasheet on page 7.
      SD_ALS_ONLY is set with Bit 14 at Register 0x00

  sens:
    type: boolean
    description: |
      Low Sensetivity, described in the datasheet on page 7.
      Low Sensetivity (1/3) set with Bit 6 at Register 0x00
```

## dts/bindings/sensor/zephyr,generic-sim-sensor.yaml
```yaml
# Copyright (c) 2026 Embeint Holdings Pty Ltd
# SPDX-License-Identifier: Apache-2.0

description: |
  Generic simulated sensor for use in testing other libraries

compatible: "zephyr,generic-sim-sensor"

include: [sensor-device.yaml]

properties:
  negated-init-rc:
    type: int
    default: 0
    description:
      Value to return in init function (negated due to devicetree limitation
      to unsigned integers).
```

## dts/bindings/sensor/zephyr,native-linux-temp.yaml
```yaml
# Copyright 2026 Bayrem Gharsellaoui
# SPDX-License-Identifier: Apache-2.0

description: Native Linux host temperature sensor.

compatible: "zephyr,native-linux-temp"

include: sensor-device.yaml

properties:
  path:
    type: string
    required: true
    description: Path to the Linux temperature input file
```

## dts/bindings/sensor/zephyr,pmbus.yaml
```yaml
# SPDX-FileCopyrightText: Copyright (c) 2026 Linumiz
#
# SPDX-License-Identifier: Apache-2.0

description: |
  Generic PMBus device read through the sensor API.

  READ_VOUT, READ_IOUT, READ_POUT and READ_TEMPERATURE_1 of page 0 are
  exposed as the voltage, current, power and ambient temperature channels,
  when the device supports them. Support is detected at initialization.
  READ_VOUT requires the ULINEAR16 output voltage mode, the other commands
  the LINEAR11 format.

  Example:

    &smbus0 {
      pmbus@40 {
        compatible = "zephyr,pmbus";
        reg = <0x40>;
      };
    };

compatible: "zephyr,pmbus"

include: [sensor-device.yaml, smbus-device.yaml]
```

## dts/bindings/serial/abov,abov32-usart.yaml
```yaml
# Copyright (c) 2026 ABOV Semiconductor Co., Ltd.
# SPDX-License-Identifier: Apache-2.0

description: |
  ABOV32 USART controller. The IP block supports asynchronous (UART),
  synchronous, and SPI communication modes.

compatible: "abov,abov32-usart"

include: [uart-controller.yaml, pinctrl-device.yaml, base.yaml]

properties:
  reg:
    required: true

  interrupts:
    required: true

  clocks:
    required: true
```
