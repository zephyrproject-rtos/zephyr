## dts/bindings/serial/aifoundry,shakti-uart-v1.yaml
```yaml
# SPDX-License-Identifier: Apache-2.0

description: |
  Original Erbium integration of the Nekko Shakti UART, with 32-bit accesses
  at eight-byte intervals, InterruptEn at 0x30 and Rx_Threshold at 0x40.
  This layout is also implemented by the et-platform functional simulator.
  It differs from the later Erbium UART with separate interrupt raw, enable
  and status registers at 0x48, 0x50 and 0x58.

  Register documentation for this revision:
  https://github.com/openhwfoundation/core-et-erbium/blob/325b32b7efaa2c2ab9c91001c89d3f49a4740826/doc/uart.md

compatible: "aifoundry,shakti-uart-v1"

include: uart-controller.yaml

properties:
  reg:
    required: true

  clock-frequency:
    required: true

  current-speed:
    required: true

  parity:
    const: "none"

  stop-bits:
    const: "1"

  data-bits:
    const: 8
```

## dts/bindings/serial/atmel,sam-usart.yaml
```yaml
description: Atmel SAM family USART

compatible: "atmel,sam-usart"

include:
  - name: uart-controller.yaml
  - name: pinctrl-device.yaml

properties:
  reg:
    required: true

  interrupts:
    required: true

  clocks:
    required: true

  atmel,rs485-mode:
    type: boolean
    description: |
      RS-485 mode: RTS is driven high while the USART transmits, to enable the
      driver of an external RS-485 transceiver. RTS has to be assigned in
      pinctrl. Must not be combined with hw-flow-control.
```

## dts/bindings/serial/beken,bk7258-uart.yaml
```yaml
# Copyright The Zephyr Project Contributors
# SPDX-License-Identifier: Apache-2.0

description: Beken BK7258 UART

compatible: "beken,bk7258-uart"

include: [uart-controller.yaml, pinctrl-device.yaml]

properties:
  reg:
    required: true

  interrupts:
    required: true

  clocks:
    required: true

  current-speed:
    required: true

  pinctrl-0:
    required: true

  pinctrl-names:
    required: true
```
