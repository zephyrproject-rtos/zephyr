## dts/bindings/sensor/sensylink,cht8305.yaml
```yaml
# Copyright (c) 2026 MASSDRIVER EI (massdriver.space)
# SPDX-License-Identifier: Apache-2.0

title: Sensylink CHT8305 Temperature and Humidity Sensor

description: |
  The Sensylink CHT8305 is a Digital Humidity and Temperature Sensor with
  ±3.0%RH Accuracy for humidity and ±0.5°C Accuracy for temperature.
  Its possible addresses are 0x40, 0x41, 0x42 and 0x43.

compatible: "sensylink,cht8305"

include: [sensor-device.yaml, i2c-device.yaml]

properties:
  heater:
    type: boolean
    description: |
      Use the heater. Consumption is 7mA when measuring.

  disable-clock-stretching:
    type: boolean
    description: |
      Disable using I2C clock stretching to fetch the conversion, sleep instead.
```

## dts/bindings/sensor/silabs,emu-temp.yaml
```yaml
# Copyright (c) 2026 Martin Moya
# SPDX-License-Identifier: Apache-2.0

description: |
  Silicon Labs Series 2 EMU internal die temperature sensor.

  The Energy Management Unit (EMU) periodically samples the die temperature
  (every ~250 ms) and stores the result in EMU_TEMP. The value is exposed
  through the SENSOR_CHAN_DIE_TEMP channel in degrees Celsius. The sensor runs
  autonomously in all energy modes except EM4.

compatible: "silabs,emu-temp"

include: sensor-device.yaml
```

## dts/bindings/sensor/st,lps22hh-common.yaml
```yaml
# Copyright (c) 2021 STMicroelectronics
# SPDX-License-Identifier: Apache-2.0

description: |
    When setting the odr property in a .dts or .dtsi file you may include
    lps22hh.h and use the macros defined there.

include: sensor-device.yaml

properties:
  drdy-gpios:
    type: phandle-array
    description: |
      DRDY pin

      This pin defaults to active high when produced by the sensor.
      The property value should ensure the flags properly describe
      the signal that is presented to the driver.

  odr:
    type: int
    default: 0
    description: |
        Select the default output data rate and noise mode using the values below.
        This value is ignored in favor of one-shot mode unless trigger mode is enabled.
        The default is the power-on reset value.
        Low-noise mode reduces RMS noise at the cost of higher supply current
        and is available at 1, 10, 25, 50 and 75 Hz. Setting the sampling
        frequency at runtime selects low-current mode and overrides this default.

        - 0  # LPS22HH_DT_ODR_POWER_DOWN
        - 1  # LPS22HH_DT_ODR_1HZ
        - 2  # LPS22HH_DT_ODR_10HZ
        - 3  # LPS22HH_DT_ODR_25HZ
        - 4  # LPS22HH_DT_ODR_50HZ
        - 5  # LPS22HH_DT_ODR_75HZ
        - 6  # LPS22HH_DT_ODR_100HZ
        - 7  # LPS22HH_DT_ODR_200HZ
        - 17 # LPS22HH_DT_ODR_1HZ_LOW_NOISE
        - 18 # LPS22HH_DT_ODR_10HZ_LOW_NOISE
        - 19 # LPS22HH_DT_ODR_25HZ_LOW_NOISE
        - 20 # LPS22HH_DT_ODR_50HZ_LOW_NOISE
        - 21 # LPS22HH_DT_ODR_75HZ_LOW_NOISE

    enum: [0, 1, 2, 3, 4, 5, 6, 7, 17, 18, 19, 20, 21]

  lpfp-bandwidth:
    type: int
    default: 0
    description: |
        Internal low-pass filter bandwidth selection (CTRL_REG1 lpfp_cfg).
        Value 0 disables the filter; 2 and 3 select ODR/9 and ODR/20
        bandwidths respectively. The default matches the reset state.

        - 0  # LPS22HH_DT_LPF_DISABLED
        - 2  # LPS22HH_DT_LPF_ODR_DIV_9
        - 3  # LPS22HH_DT_LPF_ODR_DIV_20

    enum: [0, 2, 3]

examples:
  - |
    #include <zephyr/dt-bindings/sensor/lps22hh.h>

    lps22hh: lps22hh@0 {
      /* ... */

      odr = <LPS22HH_DT_ODR_25HZ_LOW_NOISE>;
      lpfp-bandwidth = <LPS22HH_DT_LPF_ODR_DIV_20>;
    };
```

## dts/bindings/sensor/st,lps22hx-i2c.yaml
```yaml
# Copyright (c) 2019 STMicroelectronics
# SPDX-License-Identifier: Apache-2.0

description: |
    STMicroelectronics LPS22HH/LPS22HB pressure and temperature sensor connected
    to I2C bus

compatible: "st,lps22hx"

include: ["i2c-device.yaml", "st,lps22hh-common.yaml"]
```

## dts/bindings/sensor/st,lps22hx-spi.yaml
```yaml
# Copyright (c) 2019 STMicroelectronics
# SPDX-License-Identifier: Apache-2.0

description: |
    STMicroelectronics LPS22HH/LPS22HB pressure and temperature sensor connected
    to SPI bus

compatible: "st,lps22hx"

include: ["spi-device.yaml", "st,lps22hh-common.yaml"]
```

## dts/bindings/sensor/st,lsm9ds1-i2c.yaml
```yaml
description: |
  STMicroelectronics LSM9DS1 3-axis accelerometer + gyroscope accessed
  through I2C bus.

compatible: "st,lsm9ds1"

include: ["i2c-device.yaml", "st,lsm9ds1-common.yaml"]
```

## dts/bindings/sensor/st,lsm9ds1-spi.yaml
```yaml
# SPDX-FileCopyrightText: Copyright The Zephyr Project Contributors
# SPDX-License-Identifier: Apache-2.0

description: |
  STMicroelectronics LSM9DS1 3-axis accelerometer + gyroscope accessed
  through SPI bus.

compatible: "st,lsm9ds1"

include: ["spi-device.yaml", "st,lsm9ds1-common.yaml"]
```

## dts/bindings/sensor/st,lsm9ds1_mag-i2c.yaml
```yaml
description: |
  STMicroelectronics LSM9DS1-MAG 3-axis magnetometer accessed
  through I2C bus.

compatible: "st,lsm9ds1_mag"

include: ["i2c-device.yaml", "st,lsm9ds1_mag-common.yaml"]
```

## dts/bindings/sensor/st,lsm9ds1_mag-spi.yaml
```yaml
# SPDX-FileCopyrightText: Copyright The Zephyr Project Contributors
# SPDX-License-Identifier: Apache-2.0

description: |
  STMicroelectronics LSM9DS1-MAG 3-axis magnetometer accessed
  through SPI bus.

compatible: "st,lsm9ds1_mag"

include: ["spi-device.yaml", "st,lsm9ds1_mag-common.yaml"]
```

## dts/bindings/sensor/st,mis2du12-i2c.yaml
```yaml
# Copyright (c) 2026 Dotcom IoT LLP
# SPDX-License-Identifier: Apache-2.0

description: STMicroelectronics MIS2DU12 3-axis accelerometer accessed through I2C bus

compatible: "st,mis2du12"

include: ["st,lis2du12-common.yaml", "i2c-device.yaml"]

on-bus: i2c
```

## dts/bindings/sensor/st,mis2du12-spi.yaml
```yaml
# Copyright (c) 2026 Dotcom IoT LLP
# SPDX-License-Identifier: Apache-2.0

description: STMicroelectronics MIS2DU12 3-axis accelerometer accessed through SPI bus

compatible: "st,mis2du12"

include: ["st,lis2du12-common.yaml", "spi-device.yaml"]

on-bus: spi
```

## dts/bindings/sensor/st,sths34pf80.yaml
```yaml
# Copyright (c) 2026 Dotcom IoT LLP
# SPDX-License-Identifier: Apache-2.0

description: ST STHS34PF80 infrared presence and motion detection sensor

compatible: "st,sths34pf80"

include: [sensor-device.yaml, i2c-device.yaml]

properties:
  odr:
    type: int
    default: 3
    description: |
      Output data rate selection. Valid values are:
      0 = power-down, 1 = 0.25 Hz, 2 = 0.5 Hz, 3 = 1 Hz,
      4 = 2 Hz, 5 = 4 Hz, 6 = 8 Hz, 7 = 15 Hz, 8 = 30 Hz.
      Default is 3 (1 Hz), a safe power-up rate.
    enum: [0, 1, 2, 3, 4, 5, 6, 7, 8]
```

## dts/bindings/sensor/st,vl53l4cd.yaml
```yaml
# Copyright (c) 2026 Dotcom IoT LLP
# SPDX-License-Identifier: Apache-2.0

description: |
  ST VL53L4CD time-of-flight distance sensor (I2C).

compatible: "st,vl53l4cd"

include: [sensor-device.yaml, i2c-device.yaml]

properties:
  xshut-gpios:
    type: phandle-array
    description: |
      XSHUT pin (hardware standby, active low on the sensor). Optional.
      Must be described with GPIO_ACTIVE_HIGH: the driver drives it to the
      logical inactive level (pin low = standby) and then to the logical
      active level (pin high = running). AVDD must be on before XSHUT is
      raised.

  io-1v8:
    type: boolean
    description: |
      Set when the I2C bus and GPIO are pulled up at 1.8 V. When not set, the
      driver configures the sensor for pull-ups at AVDD (2.8 V), which is the
      reference driver default.

  fast-mode-plus:
    type: boolean
    description: |
      Set to enable the sensor's I2C fast mode plus (1 MHz) support. Only
      needed when the I2C bus runs at 1 MHz.

  timing-budget-ms:
    type: int
    default: 50
    description: |
      Ranging timing budget in milliseconds (10 to 200). The default of 50 ms
      is the value the reference driver uses after init: a balance between
      accuracy and measurement rate.

  inter-measurement-ms:
    type: int
    default: 0
    description: |
      Inter-measurement period in milliseconds. Must be 0 or greater than
      timing-budget-ms. The default of 0 selects continuous ranging, which is
      the reference driver default and gives the highest measurement rate.
      Any other value selects autonomous low power mode.
```

## dts/bindings/sensor/st,vl53l5cx.yaml
```yaml
# Copyright (c) 2024 Fabian Blatz <fabianblatz@gmail.com>
# Copyright (c) 2026 STMicroelectronics
# SPDX-License-Identifier: Apache-2.0

title: STMicroelectronics VL53L5CX Time of Flight sensor

description: |
    The VL53L5CX is a Time-of-Flight (TOF), multizone ranging sensor,
    ranging up to 400 cm and can work at speed up to 60Hz. Multizone
    distance measurements are possible up to 8x8 zones with a wide 65°
    diagonal FoV.

compatible: "st,vl53l5cx"

include: [sensor-device.yaml, i2c-device.yaml]
```
