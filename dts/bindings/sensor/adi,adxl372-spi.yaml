## dts/bindings/sensor/adi,max30009-i2c.yaml
```yaml
# Copyright (c) 2026 Analog Devices Inc.
# SPDX-License-Identifier: Apache-2.0

description: MAX30009 Bio-Impedance AFE with I2C connection

compatible: "adi,max30009"

include: ["i2c-device.yaml", "adi,max30009-common.yaml"]
```

## dts/bindings/sensor/adi,max30009-spi.yaml
```yaml
# Copyright (c) 2026 Analog Devices Inc.
# SPDX-License-Identifier: Apache-2.0

description: MAX30009 Bio-Impedance AFE with SPI connection

compatible: "adi,max30009"

include: ["spi-device.yaml", "adi,max30009-common.yaml"]
```

## dts/bindings/sensor/adi,max30210.yaml
```yaml
# Copyright (c) 2025 Analog Devices Inc.
# SPDX-License-Identifier: Apache-2.0
#

description: MAX30210, a high-accuracy digital temperature sensor from Analog Devices.

compatible: "adi,max30210"

include: [sensor-device.yaml, i2c-device.yaml]

properties:
  reg:
    required: true

  interrupt-gpios:
    type: phandle-array
    description: |
      The INT1 pin defaults to active low when produced by the sensor. The property value should
      ensure the flags properly describe the signal that is presented to the driver.

  sampling-rate:
    type: int
    description: |
      The sampling rate of the sensor in Hz. This value is used to configure the sensor's internal
      sampling rate. If not specified, the driver will use a default value of 0.015625 Hz
      which is also the reset value.
    default: 0x00
    enum:
      - 0x0  # 0.015625 Hz
      - 0x1  # 0.03125 Hz
      - 0x2  # 0.0625 Hz
      - 0x3  # 0.125 Hz
      - 0x4  # 0.25 Hz
      - 0x5  # 0.5 Hz
      - 0x6  # 1 Hz
      - 0x7  # 2 Hz
      - 0x8  # 4 Hz
      - 0x9  # 8 Hz

  alarm-high-setup:
    type: int
    description: |
      The high temperature threshold for the sensor in degrees Celsius. When the temperature
      exceeds this threshold, the INT1 pin will be asserted. The value is represented as a
      signed 16-bit integer in two's complement format, with a resolution of 0.005 degrees Celsius.
      Usage: input a temperature in millidegrees Celsius (e.g., 25000 for 25.000°C), and the driver
      will convert it to the appropriate register value. Default value is equivalent is 163.835°C
      which is equivalent to the reset value (0x7FFF) for ALARM_HI register.
    default: 163835 # 163.835°C

  alarm-low-setup:
    type: int
    description: |
      The low temperature threshold for the sensor in degrees Celsius. When the temperature
      falls below this threshold, the INT1 pin will be asserted. The value is represented as a
      signed 16-bit integer in two's complement format, with a resolution of 0.005 degrees Celsius.
      Usage: input a temperature in millidegrees Celsius (e.g., 25000 for 25.000°C), and the driver
      will convert it to the appropriate register value. Default value is equivalent is -163.840°C
      which is equivalent to the reset value (0x8000) for ALARM_LO register.
    default: -163840 # -163.840°C

  inc-fast-thresh:
    type: int
    description: |
      The increment threshold between samples. If the temperature increments
      by more than N x 5 m°C between samples, the INT1 pin will be asserted
      when interrupts are enabled. The default value is 0, which represents 0 m°C
      and corresponds to the device register reset value.
    default: 0

  dec-fast-thresh:
    type: int
    description: |
      The decrement threshold between samples. If the temperature decrements
      by more than N x 5 m°C between samples, the INT1 pin will be asserted
      when interrupts are enabled. The default value is 0, which represents 0 m°C
      and corresponds to the device register reset value.
    default: 0

  hi-trip-count:
    type: int
    description: |
      The number of trip counts exceeding the high temperature threshold that must occur
      to assert required to assert the TEMP_HI alarm on the INT1 pin. Default value is 1
      which equates to a single sample exceeding the high temperature threshold and corresponds
      to the device register reset value.
    default: 1
    enum:
      - 1
      - 2
      - 3
      - 4

  lo-trip-count:
    type: int
    description: |
      The number of trip counts below the low temperature threshold that must occur
      to assert required to assert the TEMP_LO alarm on the INT1 pin. Default value is 1
      which equates to a single sample below the low temperature threshold and corresponds
      to the device register reset value.
    default: 1
    enum:
      - 1
      - 2
      - 3
      - 4

  hi-trip-non-consecutive:
    type: boolean
    description: |
      If true, the high temperature threshold trip count is non-consecutive.

  lo-trip-non-consecutive:
    type: boolean
    description: |
      If true, the low temperature threshold trip count is non-consecutive.

  start-continuous-conversion:
    type: boolean
    description: |
      If true, the sensor will start temperature conversions immediately after initialization.
      If false, the sensor will remain in standby mode until explicitly started by the driver.
```

## dts/bindings/sensor/adi,max31825.yaml
```yaml
# Copyright (c) 2024 Analog Devices, Inc.
# SPDX-License-Identifier: Apache-2.0

description: Analog Devices 1-Wire temperature sensor

compatible: "adi,max31825"

include: [sensor-device.yaml, w1-slave.yaml]

properties:
  resolution:
    type: int
    enum:
      - 8
      - 9
      - 10
      - 12
    default: 12
    description: |
      Resolution of the temperature reading in bit.

  extended-mode:
    type: boolean
    description: |
      Normal format produces temperature data up to 128C 1LSB, and
      Extended format produces data up to and beyond the 145C operating limit.

  conversions-per-second:
    type: string
    enum:
      - "0"     # shudwonw
      - "1/64"  # 1/64 (conv./sec.) = 0.015625
      - "1/32"  # 1/32 (conv./sec.) = 0.03125
      - "1/16"  # 1/16 (conv./sec.) = 0.0625
      - "1/4"   # 1/4  (conv./sec.) = 0.25
      - "1"     # 1/1  (conv./sec.)
      - "4"     # 4/1  (conv./sec.)
      - "8"     # 8/1  (conv./sec.)
    description: |
      Number of temperature conversion per second.

  alarm-output-mode:
    type: string
    enum:
      - "Comparator"
      - "Interrupt"
    description: |
      Select compare or interrupt mode selection.

      0: Comparator mode. In Comparator mode, the ALARM output asserts and the
      Status bit is set to 1 when the temperature rises above the TH value or
      falls below the TL value. The ALARM output de-asserts and the Status bits
      return to 0 when the measured temperature returns to a value ranging from TH to TL.

      1: Interrupt mode. In interrupt mode, exceeding TH or going below TL also asserts
      the ALARM output and sets the Status bits to 1. ALARM remains asserted
      and the Status bits remain set to 1 until a read operation is performed on
      any of the registers, at which point ALARM is de-asserted and the Status bits return to 0.
      Note that if the result of the next conversion is greater than TH or less than TL,
      the ALARM output will assert and the Status bit(s) will set.

  rom:
    type: uint8-array
    description: |
      Each 1-Wire component contains a unique 64-bit code stored in ROM.
      The ROM address will be used to address device incase of there are multiple slave on the bus.
      Format: FamilyCode(1 byte) + Serial(6 bytes) + CRC(1 byte)
```

## dts/bindings/sensor/allegro,als31300.yaml
```yaml
# ALS31300 Device Tree Binding

description: Allegro ALS31300 3D Linear Hall Effect Sensor

compatible: "allegro,als31300"

include: [sensor-device.yaml, i2c-device.yaml]
```

## dts/bindings/sensor/amd,sb-tsi.yaml
```yaml
# Copyright (c) 2023 Google LLC
# SPDX-License-Identifier: Apache-2.0

description: AMD SB Temperature Sensor Interface.

compatible: "amd,sb-tsi"

include: [sensor-device.yaml, i2c-device.yaml]
```

## dts/bindings/sensor/ams,as5048.yaml
```yaml
# SPDX-License-Identifier: Apache-2.0

description: |
  AMS AS5048 magnetic rotary sensor

    &spi3 {
    status = "okay";

    as5048@0 {
      compatible = "ams,as5048";
      reg = <0>;
      spi-max-frequency = <4000000>;
    };
  };


compatible: "ams,as5048"

include: [sensor-device.yaml, spi-device.yaml]

properties:
  reg:
    required: true

  spi-max-frequency:
    required: true
```

## dts/bindings/sensor/ams,as5600.yaml
```yaml
# Copyright (c) 2022, Felipe Neves
# SPDX-License-Identifier: Apache-2.0

description: |
    AMS (Austria Mikro Systeme) AS5600 Angular position sensor

compatible: "ams,as5600"

include: [sensor-device.yaml, i2c-device.yaml]
```

## dts/bindings/sensor/ams,as5601-qdec.yaml
```yaml
# SPDX-License-Identifier: Apache-2.0

description: ams as5601 magnetic rotary position sensor

compatible: "ams,as5601-qdec"

include: i2c-device.yaml
```

## dts/bindings/sensor/ams,as5x47.yaml
```yaml
description: |
  AMS AS5x47 rotary position sensor, compatible with AS5047P, AS5047D, AS5147, AS5147P, AS5247

compatible: "ams,as5x47"

include: spi-device.yaml

properties:

  output-interface:
    type: string
    required: true
    description: Enables ABI or UVW output (UVW_ABI field).
    enum:
      - "abi"
      - "uvw"

  uvw-polepairs:
    type: int
    required: true
    description: Sets pole pairs for UVW output (1 to 7)
```

## dts/bindings/sensor/ams,as6212.yaml
```yaml
# Copyright (c) 2022 T-Mobile USA, Inc.
# SPDX-License-Identifier: Apache-2.0

description: |
    AMS AS6212 Digital Temperature Sensor.  See more info at
    https://ams.com/en/as621x

compatible: "ams,as6212"

include: i2c-device.yaml

properties:
    alert-gpios:
      type: phandle-array
      required: false
      description: |
        Identifies the ALERT signal, which is active-low open drain when
        produced by the sensor.
```

## dts/bindings/sensor/ams,as6221.yaml
```yaml
# Copyright (c) 2025 Byteflies NV
# Copyright (c) 2022 T-Mobile USA, Inc.
# SPDX-License-Identifier: Apache-2.0

description: |
    AMS AS6221 Digital Temperature Sensor.  See more info at
    https://ams.com/en/as6221

compatible: "ams,as6221"

include: [sensor-device.yaml, i2c-device.yaml]

properties:
  alert-gpios:
    type: phandle-array
    description: |
      Identifies the ALERT signal, which is active-low open drain when
      produced by the sensor.
```

## dts/bindings/sensor/ams,ccs811.yaml
```yaml
# Copyright (c) 2018, Linaro Limited
# SPDX-License-Identifier: Apache-2.0

description: CCS811 digital air quality sensor

compatible: "ams,ccs811"

include: [sensor-device.yaml, i2c-device.yaml]

properties:
  wake-gpios:
    type: phandle-array
    description: |
      The WAKEn pin is asserted to communicate with the sensor.  The
      sensor receives this as an active-low signal.

  reset-gpios:
    type: phandle-array
    description: |
      The RESETn pin is asserted to disable the sensor causing a hard
      reset.  The sensor receives this as an active-low signal.

  irq-gpios:
    type: phandle-array
    description: |
      The INTn pin signals that a new reading is available.  The
      sensor generates an active-low level signal which remains
      asserted until the data is read.
```

## dts/bindings/sensor/ams,ens210.yaml
```yaml
# Copyright (c) 2018, Alexander Wachter
# SPDX-License-Identifier: Apache-2.0

description: |
    AMS (Austria Mikro Systeme) ens210 Relative Humidity and Temperature Sensor

compatible: "ams,ens210"

include: [sensor-device.yaml, i2c-device.yaml]
```

## dts/bindings/sensor/ams,iaqcore.yaml
```yaml
# Copyright (c) 2018, Alexander Wachter
# SPDX-License-Identifier: Apache-2.0

description: iAQ-core indoor air quality sensor

compatible: "ams,iaqcore"

include: [sensor-device.yaml, i2c-device.yaml]
```

## dts/bindings/sensor/ams,tcs3400.yaml
```yaml
# Copyright 2023 Google LLC
# SPDX-License-Identifier: Apache-2.0

description: AMS TCS3400 Color Light-to-Digital Converter

compatible: "ams,tcs3400"

include: [sensor-device.yaml, i2c-device.yaml]

properties:
  int-gpios:
    type: phandle-array
    required: true
    description: |
      INT pin GPIO identifier, open-drain, active low.
```

## dts/bindings/sensor/ams,tcs3472x.yaml
```yaml
# Copyright (c) 2023, Thomas Kiss <thokis@gmail.com>
# SPDX-License-Identifier: Apache-2.0

description: TCS3472X color sensor

compatible: "ams,tcs3472x"

include: [sensor-device.yaml, i2c-device.yaml]

properties:
  again:
    type: int
    enum:
      - 1
      - 4
      - 16
      - 60
    default: 1
    description: ADC gain.

  int-time:
    type: int
    default: 100000
    description: ADC Integration time.

      The integration time of TCS3472X is possible in the
      range of 2.4ms to 614ms.
```
