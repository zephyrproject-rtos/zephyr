## dts/bindings/sensor/st,ilps22qs-i2c.yaml
```yaml
# Copyright (c) 2024 STMicroelectronics
# SPDX-License-Identifier: Apache-2.0

description: |
    STMicroelectronics LPS22DF pressure and temperature sensor connected to I2C
    bus

compatible: "st,ilps22qs"

include: ["i2c-device.yaml", "st,ilps22qs-common.yaml"]
```

## dts/bindings/sensor/st,ilps22qs-i3c.yaml
```yaml
# Copyright (c) 2024 STMicroelectronics
# SPDX-License-Identifier: Apache-2.0

description: |
    STMicroelectronics ILPS22QS pressure and temperature sensor connected to I3C
    bus

compatible: "st,ilps22qs"

include: ["i3c-device.yaml", "st,ilps22qs-common.yaml"]
```

## dts/bindings/sensor/st,ilps22qs-spi.yaml
```yaml
# Copyright (c) 2024 STMicroelectronics
# SPDX-License-Identifier: Apache-2.0

description: |
    STMicroelectronics ILPS22QS pressure and temperature sensor connected to SPI
    bus

compatible: "st,ilps22qs"

include: ["spi-device.yaml", "st,ilps22qs-common.yaml"]
```

## dts/bindings/sensor/st,ism330dhcx-common.yaml
```yaml
# Copyright (c) 2021 STMicroelectronics
# SPDX-License-Identifier: Apache-2.0

description: |
    When setting the accel-odr and gyro-odr properties in a .dts or .dtsi file you may include
    ism330dhcx.h and use the macros defined there.

    Example:
    #include <zephyr/dt-bindings/sensor/ism330dhcx.h>

    ism330dhcx: ism330dhcx@0 {
      ...

      accel-odr = <ISM330DHCX_DT_ODR_104Hz>;
      gyro-odr = <ISM330DHCX_DT_ODR_104Hz>;
    };

include: sensor-device.yaml

properties:
  drdy-gpios:
    type: phandle-array
    description: |
      DRDY gpio pin

      This pin defaults to active high when produced by the sensor.
      The property value should ensure the flags properly describe
      the signal that is presented to the driver.

  int-pin:
    type: int
    default: 1
    description: |
      Select DRDY pin number (1 or 2).

        Selection
          1  drdy is generated from INT1
          2  drdy is generated from INT2

      This number represents which of the two interrupt pins
      (INT1 or INT2) the drdy line is attached to. This property is not
      mandatory and if not present it defaults to 1 which is the
      configuration at power-up.
    enum: [1, 2]

  accel-odr:
    type: int
    default: 0
    description: |
      Specify the default accelerometer output data rate expressed in samples per second (Hz).
      Default is power-up configuration.

      - 0 # ISM330DHCX_DT_ODR_OFF
      - 1 # ISM330DHCX_DT_ODR_12Hz5
      - 2 # ISM330DHCX_DT_ODR_26H
      - 3 # ISM330DHCX_DT_ODR_52Hz
      - 4 # ISM330DHCX_DT_ODR_104Hz
      - 5 # ISM330DHCX_DT_ODR_208Hz
      - 6 # ISM330DHCX_DT_ODR_416Hz
      - 7 # ISM330DHCX_DT_ODR_833Hz
      - 8 # ISM330DHCX_DT_ODR_1666Hz
      - 9 # ISM330DHCX_DT_ODR_3332Hz
      - 10 # ISM330DHCX_DT_ODR_6667Hz
      - 11 # ISM330DHCX_DT_ODR_1Hz6

    enum: [0, 1, 2, 3, 4, 5, 6, 7, 8, 9, 10, 11]

  accel-range:
    type: int
    default: 2
    description: |
      Range in g. Default is power-up configuration.

      - 16 # 16g (0.488 mg/LSB)
      - 8  # 8g (0.244 mg/LSB)
      - 4  # 4g (0.122 mg/LSB)
      - 2  # 2g (0.061 mg/LSB)

    enum: [16, 8, 4, 2]

  gyro-odr:
    type: int
    default: 0
    description: |
      Specify the default gyro output data rate expressed in samples per second (Hz).
      Default is power-up configuration.

      - 0 # ISM330DHCX_DT_ODR_OFF
      - 1 # ISM330DHCX_DT_ODR_12Hz5
      - 2 # ISM330DHCX_DT_ODR_26H
      - 3 # ISM330DHCX_DT_ODR_52Hz
      - 4 # ISM330DHCX_DT_ODR_104Hz
      - 5 # ISM330DHCX_DT_ODR_208Hz
      - 6 # ISM330DHCX_DT_ODR_416Hz
      - 7 # ISM330DHCX_DT_ODR_833Hz
      - 8 # ISM330DHCX_DT_ODR_1666Hz
      - 9 # ISM330DHCX_DT_ODR_3332Hz
      - 10 # ISM330DHCX_DT_ODR_6667Hz

    enum: [0, 1, 2, 3, 4, 5, 6, 7, 8, 9, 10]

  gyro-range:
    type: int
    default: 125
    description: |
      Range in dps. Default is power-up configuration.

      - 125  # +/- 125dps
      - 250  # +/- 250dps
      - 500  # +/- 500dps
      - 1000 # +/- 1000dps
      - 2000 # +/- 2000dps

    enum: [125, 250, 500, 1000, 2000]
```

## dts/bindings/sensor/st,ism330dhcx-i2c.yaml
```yaml
# Copyright (c) 2020 STMicroelectronics
# SPDX-License-Identifier: Apache-2.0

description: |
    STMicroelectronics ISM330DHCX 6-axis IMU (Inertial Measurement Unit) sensor
    accessed through I2C bus

compatible: "st,ism330dhcx"

include: ["i2c-device.yaml", "st,ism330dhcx-common.yaml"]
```

## dts/bindings/sensor/st,ism330dhcx-spi.yaml
```yaml
# Copyright (c) 2020 STMicroelectronics
# SPDX-License-Identifier: Apache-2.0

description: |
    STMicroelectronics ISM330DHCX 6-axis IMU (Inertial Measurement Unit) sensor
    accessed through SPI bus

compatible: "st,ism330dhcx"

include: ["spi-device.yaml", "st,ism330dhcx-common.yaml"]
```

## dts/bindings/sensor/st,ism6hg256x-common.yaml
```yaml
# Copyright (c) 2025 STMicroelectronics
# SPDX-License-Identifier: Apache-2.0

description: |
    When setting the accel-range, accel-odr, gyro-range, gyro-odr properties in
    a .dts or .dtsi file you may include ism6hg256x.h and use the macros
    defined there.

include: st,lsm6dsvxxx-common.yaml

properties:
  accel-hg-odr:
    type: int
    default: 0x0
    description: |
      Specify the default accelerometer High-g output data rate expressed in samples per
      second (Hz).
      The values are taken in accordance to ism6hg256x_hg_xl_data_rate_t enumerative in hal/st
      module. Please note that this values will not change the operating mode, which will remain
      High Performance (device default)
      Default is power-up configuration.

      - 0x0 # ISM6HG256X_HG_XL_ODR_OFF
      - 0x3 # ISM6HG256X_HG_XL_ODR_AT_480Hz
      - 0x4 # ISM6HG256X_HG_XL_ODR_AT_960Hz
      - 0x5 # ISM6HG256X_HG_XL_ODR_AT_1920Hz
      - 0x6 # ISM6HG256X_HG_XL_ODR_AT_3840Hz
      - 0x7 # ISM6HG256X_HG_XL_ODR_AT_7680Hz

    enum: [0x0, 0x3, 0x4, 0x5, 0x6, 0x7]

  accel-range:
    type: int
    default: 2
    description: |
      Range in g. Default is power-up configuration.
      Ranges from 32g and above requires the High-g sensor to be turned on (see accel-hg-odr).

      - 2   # ISM6HG256X_DT_FS_2G  (0.061 mg/LSB)
      - 4   # ISM6HG256X_DT_FS_4G  (0.122 mg/LSB)
      - 8   # ISM6HG256X_DT_FS_8G  (0.244 mg/LSB)
      - 16  # ISM6HG256X_DT_FS_16G (0.488 mg/LSB)
      - 32  # ISM6HG256X_DT_FS_32G (0.976 mg/LSB)
      - 64  # ISM6HG256X_DT_FS_64G (1.952 mg/LSB)
      - 128 # ISM6HG256X_DT_FS_128G (3.904 mg/LSB)
      - 256 # ISM6HG256X_DT_FS_256G (7.808 mg/LSB)

    enum: [2, 4, 8, 16, 32, 64, 128, 256]

  gyro-range:
    type: int
    default: 0
    description: |
      Range in dps. Default is power-up configuration.

      - 0x0 # power-up configuration
      - 0x1 # ISM6HG256X_DT_FS_250DPS  (8.75 mdps/LSB)
      - 0x2 # ISM6HG256X_DT_FS_500DPS  (17.50 mdps/LSB)
      - 0x3 # ISM6HG256X_DT_FS_1000DPS (35 mdps/LSB)
      - 0x4 # ISM6HG256X_DT_FS_2000DPS (70 mdps/LSB)
      - 0x5 # ISM6HG256X_DT_FS_4000DPS (140 mdps/LSB)

    enum: [0x0, 0x1, 0x2, 0x3, 0x4, 0x5]

examples:
  - |
    #include <zephyr/dt-bindings/sensor/ism6hg256x.h>

    ism6hg256x: ism6hg256x@0 {
      /* ... */

      accel-range = <ISM6HG256X_DT_FS_8G>;
      accel-odr = <ISM6HG256XDT_ODR_AT_60Hz>;
      gyro-range = <ISM6HG256X_DT_FS_4000DPS>;
      gyro-odr = <ISM6HG256XDT_ODR_AT_60Hz>;
    };
```

## dts/bindings/sensor/st,ism6hg256x-i2c.yaml
```yaml
# Copyright (c) 2025 STMicroelectronics
# SPDX-License-Identifier: Apache-2.0

description: |
    STMicroelectronics ISM6HG256X 6-axis IMU (Inertial Measurement Unit) sensor
    accessed through I2C bus

compatible: "st,ism6hg256x"

include: ["i2c-device.yaml", "st,ism6hg256x-common.yaml"]
```

## dts/bindings/sensor/st,ism6hg256x-i3c.yaml
```yaml
# Copyright (c) 2025 STMicroelectronics
# SPDX-License-Identifier: Apache-2.0

description: |
    STMicroelectronics ISM6HG256X 6-axis IMU (Inertial Measurement Unit) sensor
    accessed through I3C bus

compatible: "st,ism6hg256x"

include: ["i3c-device.yaml", "st,ism6hg256x-common.yaml"]

properties:
  int-en-i3c:
    type: boolean
    description: |
      Enables INT pin when I3C is enabled

  bus-act-sel-us:
    type: int
    default: 50
    description: |
      Bus available time for I3C IBI in microseconds

    enum: [50, 2, 1000, 25000]
```

## dts/bindings/sensor/st,ism6hg256x-spi.yaml
```yaml
# Copyright (c) 2025 STMicroelectronics
# SPDX-License-Identifier: Apache-2.0

description: |
    STMicroelectronics ISM6HG256X 6-axis IMU (Inertial Measurement Unit) sensor
    accessed through SPI bus

compatible: "st,ism6hg256x"

include: ["spi-device.yaml", "st,ism6hg256x-common.yaml"]
```

## dts/bindings/sensor/st,lis2de12-common.yaml
```yaml
# Copyright (c) 2024 STMicroelectronics
# SPDX-License-Identifier: Apache-2.0

description: |
    When setting the accel-range, accel-odr, properties in a .dts or .dtsi
    file you may include lis2de12.h and use the macros defined there.

    Example:
    #include <zephyr/dt-bindings/sensor/lis2de12.h>

    lis2de12: lis2de12@0 {
      ...

      accel-range = <LIS2DE12_DT_FS_16G>;
      accel-odr = <LIS2DE12_DT_ODR_AT_100Hz>;
    };

include: sensor-device.yaml

properties:
  int1-gpios:
    type: phandle-array
    description: |
      INT1 pin

      This pin defaults to active high when produced by the sensor.
      The property value should ensure the flags properly describe
      the signal that is presented to the driver.

  int2-gpios:
    type: phandle-array
    description: |
      INT2 pin

      This pin defaults to active high when produced by the sensor.
      The property value should ensure the flags properly describe
      the signal that is presented to the driver.

  accel-range:
    type: int
    default: 0
    description: |
      Range in g. Default is power-up configuration.

      0 # LIS2DE12_DT_FS_2G  (15.6 mg/LSB)
      1 # LIS2DE12_DT_FS_4G  (31.2 mg/LSB)
      2 # LIS2DE12_DT_FS_8G  (62.5 mg/LSB)
      3 # LIS2DE12_DT_FS_16G (187.5 mg/LSB)

    enum: [0, 1, 2, 3]

  accel-odr:
    type: int
    default: 0x0
    description: |
      Specify the default accelerometer output data rate expressed in samples per second (Hz).
      The values are taken in accordance to lis2de12_md_t enumerative in hal/st
      module. Please note that this values will also enable/disable High performance mode.
      Default is power-up configuration.

      0x00 # LIS2DE12_DT_ODR_OFF
      0x01 # LIS2DE12_DT_ODR_AT_1Hz
      0x02 # LIS2DE12_DT_ODR_AT_10Hz
      0x03 # LIS2DE12_DT_ODR_AT_25Hz
      0x04 # LIS2DE12_DT_ODR_AT_50Hz
      0x05 # LIS2DE12_DT_ODR_AT_100Hz
      0x06 # LIS2DE12_DT_ODR_AT_200Hz
      0x07 # LIS2DE12_DT_ODR_AT_400Hz
      0x08 # LIS2DE12_DT_ODR_AT_1kHz620
      0x09 # LIS2DE12_DT_ODR_AT_5kHz376

    enum: [0x00, 0x01, 0x02, 0x03, 0x04, 0x05, 0x06, 0x07, 0x08, 0x09]

  drdy-pulsed:
    type: boolean
    description: |
      Selects the pulsed mode for data-ready interrupt when enabled,
      and the latched mode when disabled.
```

## dts/bindings/sensor/st,lis2de12-i2c.yaml
```yaml
# Copyright (c) 2024 STMicroelectronics
# SPDX-License-Identifier: Apache-2.0

description: |
    STMicroelectronics LIS2DE12 3-axis ultra-low power accelerometer sensor
    accessed through I2C bus

compatible: "st,lis2de12"

include: ["i2c-device.yaml", "st,lis2de12-common.yaml"]
```

## dts/bindings/sensor/st,lis2de12-spi.yaml
```yaml
# Copyright (c) 2024 STMicroelectronics
# SPDX-License-Identifier: Apache-2.0

description: |
    STMicroelectronics LIS2DE12 3-axis ultra-low power accelerometer sensor
    accessed through SPI bus

compatible: "st,lis2de12"

include: ["spi-device.yaml", "st,lis2de12-common.yaml"]
```

## dts/bindings/sensor/st,lis2dh-common.yaml
```yaml
# Copyright (c) 2018 STMicroelectronics
# SPDX-License-Identifier: Apache-2.0

description: |
    When setting the int1-gpio-config/int2-gpio-config and anym-mode properties
    in a .dts or .dtsi file you may include lis2dh.h and use the macros defined there.

    Example:
    #include <zephyr/dt-bindings/sensor/lis2dh.h>

    lis2dh: lis2dh@0 {
      ...

      int1-gpio-config = <LIS2DH_DT_GPIO_INT_LEVEL_LOW>;
      int2-gpio-config = <LIS2DH_DT_GPIO_INT_LEVEL_LOW>;
      anym-mode = <LIS2DH_DT_ANYM_6D_POSITION>;
    };

include: sensor-device.yaml

properties:
  irq-gpios:
    type: phandle-array
    description: |
      The INT1 and (optional) INT2 signal connections.  These signals
      are active-high as produced by the sensor.

  int1-gpio-config:
    type: int
    default: 0
    description: |
      Select the interrupt configuration for INT1 gpio.

      The default of 0 is the most common situation to avoid multiple interrupts
      to be triggered by same event.

      - 0 # LIS2DH_DT_GPIO_INT_EDGE
      - 1 # LIS2DH_DT_GPIO_INT_EDGE_RISING
      - 2 # LIS2DH_DT_GPIO_INT_EDGE_FALLING
      - 3 # LIS2DH_DT_GPIO_INT_LEVEL_HIGH
      - 4 # LIS2DH_DT_GPIO_INT_LEVEL_LOW

    enum: [0, 1, 2, 3, 4]

  int2-gpio-config:
    type: int
    default: 0
    description: |
      Select the interrupt configuration for INT2 gpio.

      The default of 0 is the most common situation to avoid multiple interrupts
      to be triggered by same event.

      - 0 # LIS2DH_DT_GPIO_INT_EDGE
      - 1 # LIS2DH_DT_GPIO_INT_EDGE_RISING
      - 2 # LIS2DH_DT_GPIO_INT_EDGE_FALLING
      - 3 # LIS2DH_DT_GPIO_INT_LEVEL_HIGH
      - 4 # LIS2DH_DT_GPIO_INT_LEVEL_LOW

    enum: [0, 1, 2, 3, 4]

  disconnect-sdo-sa0-pull-up:
    type: boolean
    description: |
      Indicates the device driver should disconnect SDO/SA0 pull-up
      during device initialization (e.g. to save current
      leakage). Note that only subset of devices supported by this
      binding have SDO/SA0 pull-up (e.g. LIS2DH12, LIS3DH).

  anym-on-int1:
    type: boolean
    description: |
      Indicates that the device driver should use interrupt 1
      for any movement. This is for boards that only have one
      interrupt line connected from the sensor to the processor.

  anym-no-latch:
    type: boolean
    description: |
      Disable the latching of interrupts for any movement.

  anym-mode:
    type: int
    default: 0
    description: |
      Select the interrupt mode for any movement.

      The default of 0 is the power-on-reset value.

      - 0 # LIS2DH_DT_ANYM_OR_COMBINATION
      - 1 # LIS2DH_DT_ANYM_6D_MOVEMENT
      - 2 # LIS2DH_DT_ANYM_AND_COMBINATION
      - 3 # LIS2DH_DT_ANYM_6D_POSITION

    enum: [0, 1, 2, 3]
```

## dts/bindings/sensor/st,lis2dh-i2c.yaml
```yaml
# Copyright (c) 2018 STMicroelectronics
# SPDX-License-Identifier: Apache-2.0

description: |
    STMicroelectronics LIS2DH 3-axis accelerometer accessed through I2C bus.

    This binding is supported by CONFIG_LIS2DH.

    The LIS3DH sensor is supported by the same driver, and should be
    specified in devicetree with:

        compatible = "st,lis3dh", "st,lis2dh";

    The LIS2DH12 sensor is supported by the same driver, and should be
    specified in devicetree with:

        compatible = "st,lis2dh12", "st,lis2dh";

    The accelerometer side of the LSM303DHLC sensor is supported by the
    same driver, and should be specified in devicetree with:

        compatible = "st,lsm303dlhc-accel", "st,lis2dh";

    The accelerometer side of the LSM303AGC sensor is supported by the
    same driver, and should be specified in devicetree with:

        compatible = "st,lsm303agr-accel", "st,lis2dh";


compatible: "st,lis2dh"

include: ["i2c-device.yaml", "st,lis2dh-common.yaml"]
```

## dts/bindings/sensor/st,lis2dh-spi.yaml
```yaml
# Copyright (c) 2018 STMicroelectronics
# SPDX-License-Identifier: Apache-2.0

description: |
    STMicroelectronics LIS2DH 3-axis accelerometer accessed through SPI bus

compatible: "st,lis2dh"

include: ["spi-device.yaml", "st,lis2dh-common.yaml"]
```
