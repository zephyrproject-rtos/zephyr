## dts/bindings/sensor/st,lis2dh12-i2c.yaml
```yaml
# Copyright (c) 2019 Nordic Semiconductor ASA
# SPDX-License-Identifier: Apache-2.0

description: STMicroelectronics LIS2DH12 3-axis accelerometer

compatible: "st,lis2dh12"

include: ["i2c-device.yaml", "st,lis2dh-common.yaml"]
```

## dts/bindings/sensor/st,lis2ds12-common.yaml
```yaml
# Copyright (c) 2021 STMicroelectronics
# SPDX-License-Identifier: Apache-2.0

description: |
    When setting the odr and power-mode properties in a .dts or .dtsi file you may include
    lis2ds12.h and use the macros defined there.

    Example:
    #include <zephyr/dt-bindings/sensor/lis2ds12.h>

    lis2ds12: lis2ds12@0 {
      ...

      power-mode = <LIS2DS12_DT_LOW_POWER>;
      odr = <LIS2DS12_DT_ODR_12Hz5>;
    };

include: sensor-device.yaml

properties:
  irq-gpios:
    type: phandle-array
    description: |
      DRDY pin

      This pin defaults to active high when produced by the sensor.
      The property value should ensure the flags properly describe
      the signal that is presented to the driver.

  range:
    type: int
    default: 2
    description: |
      Range in g. Default is power-up configuration.

      - 16 # 16g (0.488 mg/LSB)
      - 8  #  8g (0.244 mg/LSB)
      - 4  #  4g (0.122 mg/LSB)
      - 2  #  2g (0.061 mg/LSB)

    enum: [16, 8, 4, 2]

  power-mode:
    type: int
    default: 0
    description: |
      Specify the sensor power mode. Default is power-down mode

      - 0 # LIS2DS12_DT_POWER_DOWN
      - 1 # LIS2DS12_DT_LOW_POWER
      - 2 # LIS2DS12_DT_HIGH_RESOLUTION
      - 3 # LIS2DS12_DT_HIGH_FREQUENCY

    enum: [0, 1, 2, 3]

  odr:
    type: int
    default: 0
    description: |
        Specify the default output data rate expressed in samples per second (Hz).
        Default is power-down mode

        - 0  # LIS2DS12_DT_ODR_OFF
        - 1  # LIS2DS12_DT_ODR_1Hz_LP
        - 2  # LIS2DS12_DT_ODR_12Hz5
        - 3  # LIS2DS12_DT_ODR_25Hz
        - 4  # LIS2DS12_DT_ODR_50Hz
        - 5  # LIS2DS12_DT_ODR_100Hz
        - 6  # LIS2DS12_DT_ODR_200Hz
        - 7  # LIS2DS12_DT_ODR_400Hz
        - 8  # LIS2DS12_DT_ODR_800Hz
        - 9  # LIS2DS12_DT_ODR_1600Hz
        - 10 # LIS2DS12_DT_ODR_3200Hz_HF
        - 11 # LIS2DS12_DT_ODR_6400Hz_HF

    enum: [0, 1, 2, 3, 4, 5, 6, 7, 8, 9, 10, 11]
```

## dts/bindings/sensor/st,lis2ds12-i2c.yaml
```yaml
# Copyright (c) 2019 STMicroelectronics
# SPDX-License-Identifier: Apache-2.0

description: STMicroelectronics LIS2DS12 3-axis accelerometer

compatible: "st,lis2ds12"

include: ["i2c-device.yaml", "st,lis2ds12-common.yaml"]
```

## dts/bindings/sensor/st,lis2ds12-spi.yaml
```yaml
# Copyright (c) 2019 STMicroelectronics
# SPDX-License-Identifier: Apache-2.0

description: |
    STMicroelectronics LIS2DS12 3-axis accelerometer accessed through SPI bus

compatible: "st,lis2ds12"

include: ["spi-device.yaml", "st,lis2ds12-common.yaml"]
```

## dts/bindings/sensor/st,lis2du12-common.yaml
```yaml
# Copyright (c) 2023 STMicroelectronics
# SPDX-License-Identifier: Apache-2.0

description: |
    When setting the accel-range, accel-odr, properties in a .dts or .dtsi
    file you may include lis2du12.h and use the macros defined there.

    Example:
    #include <zephyr/dt-bindings/sensor/lis2du12.h>

    lis2du12: lis2du12@0 {
      ...

      accel-range = <LIS2DU12_DT_FS_16G>;
      accel-odr = <LIS2DU12_DT_ODR_AT_50Hz>;
    };

include: sensor-device.yaml

properties:
  int1-gpios:
    type: phandle-array
    description: |
      INT1 pin

      This pin defaults to active high when produced by the sensor.
      The property value should ensure the flags properly describe
      the signal that is presented to the driver.

  int2-gpios:
    type: phandle-array
    description: |
      INT2 pin

      This pin defaults to active high when produced by the sensor.
      The property value should ensure the flags properly describe
      the signal that is presented to the driver.

  drdy-pin:
    type: int
    default: 1
    description: |
      Select DRDY pin number (1 or 2).

      1 = drdy is generated from INT1
      2 = drdy is generated from INT2

      This number represents which of the two interrupt pins
      (INT1 or INT2) the drdy line is attached to. This property is not
      mandatory and if not present it defaults to 1 which is the
      configuration at power-up.
    enum: [1, 2]

  accel-range:
    type: int
    default: 0
    description: |
      Range in g. Default is power-up configuration.

      0 # LIS2DU12_DT_FS_2G  (0.061 mg/LSB)
      1 # LIS2DU12_DT_FS_4G  (0.122 mg/LSB)
      2 # LIS2DU12_DT_FS_8G  (0.244 mg/LSB)
      3 # LIS2DU12_DT_FS_16G (0.488 mg/LSB)

    enum: [0, 1, 2, 3]

  accel-odr:
    type: int
    default: 0x0
    description: |
      Specify the default accelerometer output data rate expressed in samples per second (Hz).
      The values are taken in accordance to lis2du12_md_t enumerative in hal/st
      module. Please note that this values will also enable/disable High performance mode.
      Default is power-up configuration.

      0x00 # LIS2DU12_DT_ODR_OFF
      0x01 # LIS2DU12_DT_ODR_AT_1Hz6_ULP
      0x02 # LIS2DU12_DT_ODR_AT_3Hz_ULP
      0x03 # LIS2DU12_DT_ODR_AT_6Hz_ULP
      0x04 # LIS2DU12_DT_ODR_AT_6Hz
      0x05 # LIS2DU12_DT_ODR_AT_12Hz
      0x06 # LIS2DU12_DT_ODR_AT_25Hz
      0x07 # LIS2DU12_DT_ODR_AT_50Hz
      0x08 # LIS2DU12_DT_ODR_AT_100Hz
      0x09 # LIS2DU12_DT_ODR_AT_200Hz
      0x0a # LIS2DU12_DT_ODR_AT_400Hz
      0x0b # LIS2DU12_DT_ODR_AT_800Hz
      0x0e # LIS2DU12_DT_ODR_TRIG_PIN
      0x0f # LIS2DU12_DT_ODR_TRIG_SW

    enum: [0x00, 0x01, 0x02, 0x03, 0x04, 0x05, 0x06, 0x07, 0x08, 0x09, 0x0a, 0x0b, 0x0e, 0x0f]

  drdy-pulsed:
    type: boolean
    description: |
      Selects the pulsed mode for data-ready interrupt when enabled,
      and the latched mode when disabled.
```

## dts/bindings/sensor/st,lis2du12-i2c.yaml
```yaml
# Copyright (c) 2023 STMicroelectronics
# SPDX-License-Identifier: Apache-2.0

description: |
    STMicroelectronics LIS2DU12 3-axis ultra-low power accelerometer sensor
    accessed through I2C bus

compatible: "st,lis2du12"

include: ["i2c-device.yaml", "st,lis2du12-common.yaml"]
```

## dts/bindings/sensor/st,lis2du12-spi.yaml
```yaml
# Copyright (c) 2023 STMicroelectronics
# SPDX-License-Identifier: Apache-2.0

description: |
    STMicroelectronics LIS2DU12 3-axis ultra-low power accelerometer sensor
    accessed through SPI bus

compatible: "st,lis2du12"

include: ["spi-device.yaml", "st,lis2du12-common.yaml"]
```

## dts/bindings/sensor/st,lis2dux12-common.yaml
```yaml
# Copyright (c) 2024 STMicroelectronics
# SPDX-License-Identifier: Apache-2.0

description: |
    When setting the odr, power-mode, and range properties in a .dts or .dtsi file you may include
    st_lis2dux12.h and use the macros defined there.
    Example:
    #include <zephyr/dt-bindings/sensor/lis2dux12.h>
    lis2dux12: lis2dux12@0 {
      ...
      power-mode = <LIS2DUX12_OPER_MODE_LOW_POWER>;
      odr = <LIS2DUX12_DT_ODR_12Hz5>;
      range = <LIS2DUX12_DT_FS_16G>;
    };

include: sensor-device.yaml

properties:
  int1-gpios:
    type: phandle-array
    description: |
      INT1 pin

      This pin defaults to active high when produced by the sensor.
      The property value should ensure the flags properly describe
      the signal that is presented to the driver.
  int2-gpios:
    type: phandle-array
    description: |
      INT2 pin

      This pin defaults to active high when produced by the sensor.
      The property value should ensure the flags properly describe
      the signal that is presented to the driver.

  drdy-pin:
    type: int
    default: 1
    enum:
      - 1 # drdy is generated from INT1
      - 2 # drdy is generated from INT2
    description: |
      Select DRDY pin number (1 or 2).
      This number represents which of the two interrupt pins
      (INT1 or INT2) the drdy line is attached to. This property is not
      mandatory and if not present it defaults to 1 which is the
      configuration at power-up.


  range:
    type: int
    default: 0
    description: |
      Range in g. Default is power-up configuration.

      - 3  # LIS2DUX12_DT_FS_16G
      - 2  # LIS2DUX12_DT_FS_8G
      - 1  # LIS2DUX12_DT_FS_4G
      - 0  # LIS2DUX12_DT_FS_2G

    enum: [0, 1, 2, 3]

  power-mode:
    type: int
    default: 0
    description: |
      Specify the sensor power mode. Default is power-down mode

      - 0 # LIS2DUX12_OPER_MODE_POWER_DOWN
      - 1 # LIS2DUX12_OPER_MODE_LOW_POWER
      - 2 # LIS2DUX12_OPER_MODE_HIGH_PERFORMANCE
      - 3 # LIS2DUX12_OPER_MODE_SINGLE_SHOT

    enum: [0, 1, 2, 3]

  odr:
    type: int
    default: 0
    description: |
      Specify the default output data rate expressed in samples per second (Hz).
      Default is power-down mode
      - 0  # LIS2DUX12_DT_ODR_OFF
      - 1  # LIS2DUX12_DT_ODR_1Hz_ULP
      - 2  # LIS2DUX12_DT_ODR_3Hz_ULP
      - 3  # LIS2DUX12_DT_ODR_25Hz_ULP
      - 4  # LIS2DUX12_DT_ODR_6Hz
      - 5  # LIS2DUX12_DT_ODR_12Hz5
      - 6  # LIS2DUX12_DT_ODR_25Hz
      - 7  # LIS2DUX12_DT_ODR_50Hz
      - 8  # LIS2DUX12_DT_ODR_100Hz
      - 9  # LIS2DUX12_DT_ODR_200Hz
      - 10 # LIS2DUX12_DT_ODR_400Hz
      - 11 # LIS2DUX12_DT_ODR_800Hz

    enum: [0, 1, 2, 3, 4, 5, 6, 7, 8, 9, 10, 11]

  fifo-mode-sel:
    type: int
    default: 0x0
    description: |
      Specify the sample content to be batched in FIFO.
      Default is power-up configuration.

      - 0x0 # 1x Accelerometer @12bit and 1x temperature @12bit samples
      - 0x1 # 1x Accelerometer @16bit sample
      - 0x2 # 2x Accelerometer @8bit samples (previous and current)

    enum: [0x00, 0x01, 0x02]

  fifo-watermark:
    type: int
    default: 32
    description: |
      Specify the default FIFO watermark threshold. Every unit indicates a FIFO row (1 byte of TAG +
      6 bytes of data). (min 0; max 255)
      A typical threshold value is 32 which is then used as default.

  accel-fifo-batch-rate:
    type: int
    default: 0x0
    description: |
      Specify the default accelerometer FIFO batch data rate expressed as a fraction of the odr.
      The values are taken in accordance to lis2dux12_bdr_xl_t enumerative in hal/st module.
      Default is power-up configuration.

      - 0x0 # LIS2DUX12_DT_BDR_XL_ODR
      - 0x1 # LIS2DUX12_DT_BDR_XL_ODR_DIV_2
      - 0x2 # LIS2DUX12_DT_BDR_XL_ODR_DIV_4
      - 0x3 # LIS2DUX12_DT_BDR_XL_ODR_DIV_8
      - 0x4 # LIS2DUX12_DT_BDR_XL_ODR_DIV_16
      - 0x5 # LIS2DUX12_DT_BDR_XL_ODR_DIV_32
      - 0x6 # LIS2DUX12_DT_BDR_XL_ODR_DIV_64
      - 0x7 # LIS2DUX12_DT_BDR_XL_ODR_OFF

    enum: [0x00, 0x01, 0x02, 0x03, 0x04, 0x05, 0x06, 0x07]

  timestamp-fifo-batch-rate:
    type: int
    default: 0x0
    description: |
      Specify the default timestamp FIFO batch data rate expressed as a fraction od the odr.
      The values are taken in accordance to lis2dux12_dec_ts_t enumerative in hal/st module.
      Default is power-up configuration.

      - 0x0 # LIS2DUX12_DT_DEC_TS_OFF
      - 0x1 # LIS2DUX12_DT_DEC_TS_1
      - 0x2 # LIS2DUX12_DT_DEC_TS_8
      - 0x3 # LIS2DUX12_DT_DEC_TS_32

    enum: [0x00, 0x01, 0x02, 0x03]
```

## dts/bindings/sensor/st,lis2dux12-i2c.yaml
```yaml
# Copyright (c) 2024 STMicroelectronics
# SPDX-License-Identifier: Apache-2.0

description: STMicroelectronics LIS2DUX12 3-axis accelerometer

compatible: "st,lis2dux12"

include: ["i2c-device.yaml", "st,lis2dux12-common.yaml"]
```
