## dts/bindings/sensor/silabs,si7210.yaml
```yaml
# Copyright (c) 2021, Aurelien Jarno
# SPDX-License-Identifier: Apache-2.0

description: Si7210 hall effect magnetic position and temperature sensor

compatible: "silabs,si7210"

include: i2c-device.yaml
```

## dts/bindings/sensor/smart-battery.yaml
```yaml
description: Smart Battery Fuel Gauge

compatible: "smart-battery"

include: i2c-device.yaml
```

## dts/bindings/sensor/st,hts221-common.yaml
```yaml
# Copyright (c) 2017, Linaro Limited
# SPDX-License-Identifier: Apache-2.0

include: sensor-device.yaml

properties:
  drdy-gpios:
    type: phandle-array
    description: DRDY pin

      This pin defaults to active high when produced by the sensor.
      The property value should ensure the flags properly describe
      the signal that is presented to the driver.
```

## dts/bindings/sensor/st,hts221-i2c.yaml
```yaml
# Copyright (c) 2021 Intel Corporation
# SPDX-License-Identifier: Apache-2.0

description: |
    STMicroelectronics HTS221 humidity and temperature sensor on I2C bus

compatible: "st,hts221"

include: ["i2c-device.yaml", "st,hts221-common.yaml"]
```

## dts/bindings/sensor/st,hts221-spi.yaml
```yaml
# Copyright (c) 2021 Intel Corporation
# SPDX-License-Identifier: Apache-2.0

description: |
    STMicroelectronics HTS221 humidity and temperature sensor on SPI bus

compatible: "st,hts221"

include: ["spi-device.yaml", "st,hts221-common.yaml"]
```

## dts/bindings/sensor/st,hts221.yaml
```yaml
# Copyright (c) 2017, Linaro Limited
# SPDX-License-Identifier: Apache-2.0

description: STMicroelectronics HTS221 humidity and temperature sensor

compatible: "st,hts221"

include: i2c-device.yaml

properties:
    drdy-gpios:
      type: phandle-array
      required: false
      description: DRDY pin

        This pin defaults to active high when produced by the sensor.
        The property value should ensure the flags properly describe
        the signal that is presented to the driver.
```

## dts/bindings/sensor/st,i3g4250d.yaml
```yaml
# Copyright (c) 2021 Jonathan Hahn
# SPDX-License-Identifier: Apache-2.0

description: |
    STMicroelectronics I3G4250D 3-axis gyrometer accessed through SPI bus

compatible: "st,i3g4250d"

include: [sensor-device.yaml, spi-device.yaml]
```

## dts/bindings/sensor/st,iis2dh-i2c.yaml
```yaml
# Copyright (c) 2020 STMicroelectronics
# SPDX-License-Identifier: Apache-2.0

description: |
    STMicroelectronics IIS2DH accelerometer accessed through I2C bus

compatible: "st,iis2dh"

include: [sensor-device.yaml, i2c-device.yaml]

properties:
  drdy-gpios:
    type: phandle-array
    description: DRDY pin

      This pin defaults to active high when produced by the sensor.
      The property value should ensure the flags properly describe
      the signal that is presented to the driver.
```

## dts/bindings/sensor/st,iis2dlpc-common.yaml
```yaml
# Copyright (c) 2018 STMicroelectronics
# SPDX-License-Identifier: Apache-2.0

description: |
    When setting the odr property in a .dts or .dtsi file you may include
    iis2dlpc.h and use the macros defined there.

    Example:
    #include <zephyr/dt-bindings/sensor/iis2dlpc.h>

    iis2dlpc: iis2dlpc@0 {
      ...

      tap-mode = <IIS2DLPC_DT_SINGLE_DOUBLE_TAP>;
      power-mode = <IIS2DLPC_DT_HP_MODE>;
    };

include: sensor-device.yaml

properties:
  drdy-gpios:
    type: phandle-array
    description: |
      DRDY pin

      This pin defaults to active high when produced by the sensor.
      The property value should ensure the flags properly describe
      the signal that is presented to the driver.

  drdy-int:
    type: int
    default: 1
    enum: [1, 2]
    description: |
      Select DRDY pin number (1 or 2).

      This number represents which of the two interrupt pins
      (INT1 or INT2) the drdy line is attached to. This property is not
      mandatory and if not present it defaults to 1 which is the
      configuration at power-up.

      - 1 # drdy is generated from INT1
      - 2 # drdy is generated from INT2

  range:
    type: int
    default: 2
    description: |
      Range in g. Default is power-up configuration.

      - 16 # 16g (1.952 mg/LSB)
      - 8  #  8g (0.976 mg/LSB)
      - 4  #  4g (0.488 mg/LSB)
      - 2  #  2g (0.244 mg/LSB)

    enum: [16, 8, 4, 2]

  power-mode:
    type: int
    default: 0
    description: |
      Specify the sensor power mode. Default is power-up configuration.

      - 0 # IIS2DLPC_DT_LP_M1
      - 1 # IIS2DLPC_DT_LP_M2
      - 2 # IIS2DLPC_DT_LP_M3
      - 3 # IIS2DLPC_DT_LP_M4
      - 4 # IIS2DLPC_DT_HP_MODE

    enum: [0, 1, 2, 3, 4]

  # tap and tap-tap configuration section
  # All default values are selected to match the power-up values.
  # tap and tap-tap events can be generated on INT1 only.

  tap-mode:
    type: int
    default: 0
    description: |
      Tap mode. Default is power-up configuration.

      - 0 # IIS2DLPC_DT_SINGLE_TAP
      - 1 # IIS2DLPC_DT_SINGLE_DOUBLE_TAP

    enum: [0, 1]

  tap-threshold:
    type: array
    default: [0, 0, 0]
    description: |
      Tap X/Y/Z axes threshold. Default is power-up configuration.
      (X/Y/Z values range from 0x00 to 0x1F)

      Thresholds to start the tap-event detection procedure on the X/Y/Z axes.
      Threshold values for each axis are unsigned 5-bit corresponding
      to a 2g acceleration full-scale range. A threshold value equal to zero
      corresponds to disable the tap detection on that axis.

      For example, if you want to set the threshold for X to 12, for Z to 14
      and want to disable tap detection on Y, you should specify in Device Tree

          tap-threshold = <12>, <0>, <14>

      which is equivalent to X = 12 * 2g/32 = 750mg and Z = 14 * 2g/32 = 875mg.

  tap-shock:
    type: int
    default: 0x0
    description: |
      Tap shock value. Default is power-up configuration.
      (values range from 0x0 to 0x3)
      This register represents the maximum time of an over-threshold signal
      detection to be recognized as a tap event. Where 0 equals 4*1/ODR and
      1LSB = 8*1/ODR.

  tap-latency:
    type: int
    default: 0x0
    description: |
      Tap latency. Default is power-up configuration.
      (values range from 0x0 to 0xF)
      When double-tap recognition is enabled, this register expresses the
      maximum time between two successive detected taps to determine a
      double-tap event. Where 0 equals 16*1/ODR and 1LSB = 32*1/ODR.

  tap-quiet:
    type: int
    default: 0x0
    description: |
      Expected quiet time after a tap detection. Default is power-up configuration.
      (values range from 0x0 to 0x3)
      This register represents the time after the first detected tap in which
      there must not be any overthreshold event. Where 0 equals 2*1/ODR
      and 1LSB = 4*1/ODR.
```

## dts/bindings/sensor/st,iis2dlpc-i2c.yaml
```yaml
# Copyright (c) 2018 STMicroelectronics
# SPDX-License-Identifier: Apache-2.0

description: |
    STMicroelectronics IIS2DLPC accelerometer accessed through I2C bus

compatible: "st,iis2dlpc"

include: ["i2c-device.yaml", "st,iis2dlpc-common.yaml"]
```

## dts/bindings/sensor/st,iis2dlpc-spi.yaml
```yaml
# Copyright (c) 2019 STMicroelectronics
# SPDX-License-Identifier: Apache-2.0

description: |
    STMicroelectronics IIS2DLPC accelerometer accessed through SPI bus

compatible: "st,iis2dlpc"

include: ["spi-device.yaml", "st,iis2dlpc-common.yaml"]
```

## dts/bindings/sensor/st,iis2iclx-common.yaml
```yaml
# Copyright (c) 2020 STMicroelectronics
# SPDX-License-Identifier: Apache-2.0

description: |
    When setting the range, odr properties in a .dts or .dtsi file you may
    include iis2iclx.h and use the macros defined there.

    Example:
    #include <zephyr/dt-bindings/sensor/iis2iclx.h>

    iis2iclx: iis2iclx@0 {
      ...

      range = <IIS2ICLX_DT_FS_2G>;
      odr = <IIS2ICLX_DT_ODR_833Hz>;
    };

include: sensor-device.yaml

properties:
  drdy-gpios:
    type: phandle-array
    description: |
      DRDY pin

      This pin defaults to active high when produced by the sensor.
      The property value should ensure the flags properly describe
      the signal that is presented to the driver.

  int-pin:
    type: int
    default: 1
    enum: [1, 2]
    description: |
      Select DRDY pin number (1 or 2).

      This number represents which of the two interrupt pins
      (INT1 or INT2) the drdy line is attached to. This property is not
      mandatory and if not present it defaults to 1 which is the
      configuration at power-up.

      - 1 # drdy is generated from INT1
      - 2 # drdy is generated from INT2

  range:
    type: int
    default: 3
    description: |
      Range in g. Default is power-up configuration.

      - 0 # IIS2ICLX_DT_FS_500mG (0.015 mg/LSB)
      - 1 # IIS2ICLX_DT_FS_3G    (0.122 mg/LSB)
      - 2 # IIS2ICLX_DT_FS_1G    (0.031 mg/LSB)
      - 3 # IIS2ICLX_DT_FS_2G    (0.061 mg/LSB)

    enum: [0, 1, 2, 3]

  odr:
    type: int
    default: 0
    description: |
      Specify the default accelerometer output data rate expressed in samples per second (Hz).
      Default is power-up configuration.

      - 0  # IIS2ICLX_DT_ODR_OFF
      - 1  # IIS2ICLX_DT_ODR_12Hz5
      - 2  # IIS2ICLX_DT_ODR_26H
      - 3  # IIS2ICLX_DT_ODR_52Hz
      - 4  # IIS2ICLX_DT_ODR_104Hz
      - 5  # IIS2ICLX_DT_ODR_208Hz
      - 6  # IIS2ICLX_DT_ODR_416Hz
      - 7  # IIS2ICLX_DT_ODR_833Hz

    enum: [0, 1, 2, 3, 4, 5, 6, 7]
```

## dts/bindings/sensor/st,iis2iclx-i2c.yaml
```yaml
# Copyright (c) 2020 STMicroelectronics
# SPDX-License-Identifier: Apache-2.0

description: |
    STMicroelectronics IIS2ICLX 2-axis accelerometer sensor
    accessed through I2C bus

compatible: "st,iis2iclx"

include: ["i2c-device.yaml", "st,iis2iclx-common.yaml"]
```

## dts/bindings/sensor/st,iis2iclx-spi.yaml
```yaml
# Copyright (c) 2020 STMicroelectronics
# SPDX-License-Identifier: Apache-2.0

description: |
    STMicroelectronics IIS2ICLX 2-axis accelerometer sensor
    accessed through SPI bus

compatible: "st,iis2iclx"

include: ["spi-device.yaml", "st,iis2iclx-common.yaml"]
```

## dts/bindings/sensor/st,iis2mdc-i2c.yaml
```yaml
# Copyright (c) 2018 STMicroelectronics
# SPDX-License-Identifier: Apache-2.0

description: |
    STMicroelectronics IIS2MDC magnetometer accessed through I2C bus

compatible: "st,iis2mdc"

include: i2c-device.yaml

properties:
    drdy-gpios:
      type: phandle-array
      required: false
      description: DRDY pin

        This pin defaults to active high when produced by the sensor.
        The property value should ensure the flags properly describe
        the signal that is presented to the driver.
```

## dts/bindings/sensor/st,iis2mdc-spi.yaml
```yaml
# Copyright (c) 2019 STMicroelectronics
# SPDX-License-Identifier: Apache-2.0

description: |
    STMicroelectronics IIS2MDC magnetometer accessed through SPI bus

compatible: "st,iis2mdc"

include: spi-device.yaml

properties:
    drdy-gpios:
      type: phandle-array
      required: false
      description: DRDY pin

        This pin defaults to active high when produced by the sensor.
        The property value should ensure the flags properly describe
        the signal that is presented to the driver.
```

## dts/bindings/sensor/st,iis328dq-common.yaml
```yaml
# Copyright (c) 2018 STMicroelectronics
# Copyright (c) 2024 SILA Embedded Solutions GmbH
# SPDX-License-Identifier: Apache-2.0

include: sensor-device.yaml

properties:
  int1-gpios:
    type: phandle-array
    description: |
      INT_1 pin

      This pin defaults to active high when produced by the sensor. The property value should ensure
      the flags properly describe the signal that is presented to the driver.

  int2-gpios:
    type: phandle-array
    description: |
      INT_2 pin

      This pin defaults to active high when produced by the sensor. The property value should ensure
      the flags properly describe the signal that is presented to the driver.

  drdy-int-pad:
    type: int
    enum: [1, 2]
    description: |
      Select DRDY pin number (1 or 2).

      This number represents which of the two interrupt pins (INT_1 or INT_2), if any, the DRDY
      interrupt should be generated from. If this property is not specified, no data ready
      interrupts can be registered.

      - 1 # drdy is generated on INT1
      - 2 # drdy is generated on INT2

  threshold-int-pad:
    type: int
    enum: [1, 2]
    description: |
      Select threshold interrupt pin number (1 or 2).

      This number represents which of the two interrupt pins (INT_1 or INT_2), if any, the threshold
      interrupt should be generated from. If this property is not specified, no threshold interrupts
      can be registered.

      - 1 # threshold interrupt is generated on INT1
      - 2 # threshold interrupt is generated on INT2

  range:
    type: int
    default: 2
    description: |
      Range in g. Default is power-up configuration.

      - 16 # 16g (1.952 mg/LSB)
      - 8  #  8g (0.976 mg/LSB)
      - 4  #  4g (0.488 mg/LSB)
      - 2  #  2g (0.244 mg/LSB)

    enum: [16, 8, 4, 2]
```

## dts/bindings/sensor/st,iis328dq-i2c.yaml
```yaml
# Copyright (c) 2018 STMicroelectronics
# Copyright (c) 2024 SILA Embedded Solutions GmbH
# SPDX-License-Identifier: Apache-2.0

description: |
    STMicroelectronics IIS328DQ accelerometer accessed through I2C bus

compatible: "st,iis328dq"

include: ["i2c-device.yaml", "st,iis328dq-common.yaml"]
```

## dts/bindings/sensor/st,iis328dq-spi.yaml
```yaml
# Copyright (c) 2019 STMicroelectronics
# Copyright (c) 2024 SILA Embedded Solutions GmbH
# SPDX-License-Identifier: Apache-2.0

description: |
    STMicroelectronics IIS328DQ accelerometer accessed through SPI bus

compatible: "st,iis328dq"

include: ["spi-device.yaml", "st,iis328dq-common.yaml"]
```

## dts/bindings/sensor/st,iis3dhhc-spi.yaml
```yaml
# Copyright (c) 2019 STMicroelectronics
# SPDX-License-Identifier: Apache-2.0

description: |
    STMicroelectronics IIS3DHHC 3-axis accelerometer accessed through SPI bus

compatible: "st,iis3dhhc"

include: [sensor-device.yaml, spi-device.yaml]

properties:
  irq-gpios:
    type: phandle-array
    description: DRDY pin

      This pin defaults to active high when produced by the sensor.
      The property value should ensure the flags properly describe
      the signal that is presented to the driver.
```
