## dts/bindings/sensor/we,wsen-itds-2533020201601-spi.yaml
```yaml
# Copyright (c) 2025 Würth Elektronik eiSos GmbH & Co. KG
# SPDX-License-Identifier: Apache-2.0

description: |
    Würth Elektronik WSEN-ITDS-2533020201601 acceleration sensor with
    integrated temperature sensor (SPI bus)

compatible: "we,wsen-itds-2533020201601"

include: ["spi-device.yaml", "we,wsen-itds-2533020201601-common.yaml"]
```

## dts/bindings/sensor/we,wsen-itds-i2c.yaml
```yaml
# Copyright (c) 2022 Würth Elektronik eiSos GmbH & Co. KG
# SPDX-License-Identifier: Apache-2.0

description: |
    Würth Elektronik WSEN-ITDS 3-axis acceleration sensor (I2C bus)

compatible: "we,wsen-itds"

include: ["i2c-device.yaml", "we,wsen-itds-common.yaml"]
```

## dts/bindings/sensor/we,wsen-itds-spi.yaml
```yaml
# Copyright (c) 2022 Würth Elektronik eiSos GmbH & Co. KG
# SPDX-License-Identifier: Apache-2.0

description: |
    Würth Elektronik WSEN-ITDS 3-axis acceleration sensor (SPI bus)

compatible: "we,wsen-itds"

include: ["spi-device.yaml", "we,wsen-itds-common.yaml"]
```

## dts/bindings/sensor/we,wsen-itds.yaml
```yaml
# SPDX-License-Identifier: Apache-2.0
# Copyright (c) 2020 Linumiz

description: WSEN-ITDS 3-axis accel sensor

compatible: "we,wsen-itds"

include: i2c-device.yaml

properties:
    int-gpios:
      type: phandle-array
      required: false
      description: |
        This property specifies the connection for INT0, the driver maps
        all interrupts to INT0 as default. The signal to output high when
        data produced by the sensor.

    odr:
      type: string
      required: true
      description: Output data rate in Hz
      enum:
        - "1.6"
        - "12.5"
        - "25"
        - "50"
        - "100"
        - "200"
        - "400"
        - "800"
        - "1600"

    op-mode:
      type: string
      required: true
      description: Operating mode of sensor
      enum:
        - "low-power"
        - "normal"
        - "high-perf"
```

## dts/bindings/sensor/we,wsen-pads-2511020213301-common.yaml
```yaml
# Copyright (c) 2025 Würth Elektronik eiSos GmbH & Co. KG
# SPDX-License-Identifier: Apache-2.0

include: sensor-device.yaml

properties:
  interrupt-gpios:
    type: phandle-array
    description: |
      Interrupt pin.
      Interrupt is active high by default.

  odr:
    type: int
    required: true
    enum:
    - 0
    - 1
    - 10
    - 25
    - 50
    - 75
    - 100
    - 200
    description: |
      Sensor output data rate expressed in samples per second.
      Data rates supported by the chip are 0 (power down), 1,
      10, 25, 50, 75, 100 and 200.

  configuration:
    type: string
    default: "Low_Power"
    enum:
    - "Low_Power"
    - "Low_Noise"
    description: |
      Configuration of sensor to either be low power or low noise.
      Maximum ODR in Low Noise configuration is 75Hz.
      Defaults to Low_Power, which is the configuration at power-up.

  additional-low-pass-filter:
    type: boolean
    description: |
      Enable or disable the additional low pass filter of the sensor.

  additional-low-pass-filter-configuration:
    type: int
    default: 0
    enum:
    - 0
    - 1
    description: |
      Configuration of the additional low pass filter of the sensor.
      Defaults to 0, which is the configuration at power-up.

  threshold:
    type: int
    description: |
      Threshold for the differential pressure interrupt in Pa.
```

## dts/bindings/sensor/we,wsen-pads-2511020213301-i2c.yaml
```yaml
# Copyright (c) 2025 Würth Elektronik eiSos GmbH & Co. KG
# SPDX-License-Identifier: Apache-2.0

description: |
    Würth Elektronik WSEN-PADS-2511020213301 absolute pressure sensor (I2C bus)

compatible: "we,wsen-pads-2511020213301"

include: ["i2c-device.yaml", "we,wsen-pads-2511020213301-common.yaml"]
```

## dts/bindings/sensor/we,wsen-pads-2511020213301-spi.yaml
```yaml
# Copyright (c) 2025 Würth Elektronik eiSos GmbH & Co. KG
# SPDX-License-Identifier: Apache-2.0

description: |
    Würth Elektronik WSEN-PADS-2511020213301 absolute pressure sensor (SPI bus)

compatible: "we,wsen-pads-2511020213301"

include: ["spi-device.yaml", "we,wsen-pads-2511020213301-common.yaml"]
```

## dts/bindings/sensor/we,wsen-pads-common.yaml
```yaml
# Copyright (c) 2023 Würth Elektronik eiSos GmbH & Co. KG
# SPDX-License-Identifier: Apache-2.0

include: sensor-device.yaml

properties:
  drdy-gpios:
    type: phandle-array
    description: |
      Data-ready interrupt pin.
      Interrupt is active high by default.

  odr:
    type: int
    required: true
    enum:
    - 0
    - 1
    - 10
    - 25
    - 50
    - 75
    - 100
    - 200
    description: |
      Sensor output data rate expressed in samples per second.
      Data rates supported by the chip are 0 (power down), 1,
      10, 25, 50, 75, 100 and 200.
```

## dts/bindings/sensor/we,wsen-pads-i2c.yaml
```yaml
# Copyright (c) 2023 Würth Elektronik eiSos GmbH & Co. KG
# SPDX-License-Identifier: Apache-2.0

description: |
    Würth Elektronik WSEN-PADS absolute pressure sensor (I2C bus)

compatible: "we,wsen-pads"

include: ["i2c-device.yaml", "we,wsen-pads-common.yaml"]
```

## dts/bindings/sensor/we,wsen-pads-spi.yaml
```yaml
# Copyright (c) 2023 Würth Elektronik eiSos GmbH & Co. KG
# SPDX-License-Identifier: Apache-2.0

description: |
    Würth Elektronik WSEN-PADS absolute pressure sensor (SPI bus)

compatible: "we,wsen-pads"

include: ["spi-device.yaml", "we,wsen-pads-common.yaml"]
```

## dts/bindings/sensor/we,wsen-pdms-25131308XXX05-common.yaml
```yaml
# Copyright (c) 2025 Würth Elektronik eiSos GmbH & Co. KG
# SPDX-License-Identifier: Apache-2.0

include: sensor-device.yaml

properties:
  sensor-type:
    type: int
    required: true
    enum:
    - 0
    - 1
    - 2
    - 3
    - 4
    description: |
      PDMS sensor product variant (pressure measurement range).
      0 - order code 2513130810105, range = -1 to + 1 kPa
      1 - order code 2513130810205, range = -10 to + 10 kPa
      2 - order code 2513130835205, range = -35 to + 35 kPa
      3 - order code 2513130810305, range = 0 to 100 kPa
      4 - order code 2513130810405, range = -100 to 1000 kPa

  crc:
    type: boolean
    description: |
      Enable CRC over the chosen interface.
      When using I2C the correct address with CRC must
      be chosen as well.
```

## dts/bindings/sensor/we,wsen-pdms-25131308XXX05-i2c.yaml
```yaml
# Copyright (c) 2025 Würth Elektronik eiSos GmbH & Co. KG
# SPDX-License-Identifier: Apache-2.0

description: |
    Würth Elektronik WSEN-PDMS-25131308XXX05 differential pressure sensor (I2C bus)
    Note: On some MCUs a speed of more than 100 kHz cannot be used.

compatible: "we,wsen-pdms-25131308XXX05"

include: ["i2c-device.yaml", "we,wsen-pdms-25131308XXX05-common.yaml"]
```

## dts/bindings/sensor/we,wsen-pdms-25131308XXX05-spi.yaml
```yaml
# Copyright (c) 2025 Würth Elektronik eiSos GmbH & Co. KG
# SPDX-License-Identifier: Apache-2.0

description: |
    Würth Elektronik WSEN-PDMS-25131308XXX05 differential pressure sensor (SPI bus)

compatible: "we,wsen-pdms-25131308XXX05"

include: ["spi-device.yaml", "we,wsen-pdms-25131308XXX05-common.yaml"]
```

## dts/bindings/sensor/we,wsen-pdus-25131308XXXXX.yaml
```yaml
# Copyright (c) 2024 Würth Elektronik eiSos GmbH & Co. KG
# SPDX-License-Identifier: Apache-2.0

description: |
  Würth Elektronik WSEN-PDUS-25131308XXXXX differential pressure sensor

compatible: "we,wsen-pdus-25131308XXXXX"

include: [sensor-device.yaml, i2c-device.yaml]

properties:
  sensor-type:
    type: int
    required: true
    enum:
    - 0
    - 1
    - 2
    - 3
    - 4
    - 5
    description: |
      PDUS sensor product variant (pressure measurement range).
      0 - order code 2513130810001, range = -0.1 to +0.1 kPa
      1 - order code 2513130810101 (5V VCC) + 2513130810102 (3.3V VCC), range = -1 to +1 kPa
      2 - order code 2513130810201, range = -10 to +10 kPa
      3 - order code 2513130810301, range =  0 to 100 kPa
      4 - order code 2513130810401 (5V VCC) + 2513130810402 (3.3V VCC), range = -100 to +1000 kPa
      5 - order code 2513130815401, range = 0 to +1500 kPa
```

## dts/bindings/sensor/we,wsen-pdus.yaml
```yaml
# Copyright (c) 2023 Würth Elektronik eiSos GmbH & Co. KG
# SPDX-License-Identifier: Apache-2.0

description: |
  Würth Elektronik WSEN-PDUS differential pressure sensor

compatible: "we,wsen-pdus"

include: [sensor-device.yaml, i2c-device.yaml]

properties:
  sensor-type:
    type: int
    required: true
    enum:
    - 0 # order code 2513130810001, range = -0.1 to +0.1 kPa
    - 1 # order code 2513130810101, range = -1 to +1 kPa
    - 2 # order code 2513130810201, range = -10 to +10 kPa
    - 3 # order code 2513130810301, range =  0 to 100 kPa
    - 4 # order code 2513130810401, range = -100 to +1000 kPa
    description: PDUS sensor product variant (pressure measurement range).
```
