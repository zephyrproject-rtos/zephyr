## dts/bindings/sensor/ti,cc13xx-cc26xx-vbat.yaml
```yaml
# Copyright (c) 2026 Paweł Pielorz <pawel.pielorz@gmail.com>
# SPDX-License-Identifier: Apache-2.0

description: TI CC13XX/CC26xx family VBat sensor

include: sensor-device.yaml

compatible: "ti,cc13xx-cc26xx-vbat"
```

## dts/bindings/sensor/ti,fdc1004.yaml
```yaml
# Copyright (c) 2026 Zephyr Project Developers
# SPDX-License-Identifier: Apache-2.0

title: Texas Instruments FDC1004 4-Channel Capacitance-to-Digital Converter

description: |
  The FDC1004 is a 4-channel, 16-bit capacitance-to-digital converter with
  a ±15 pF input range and a per-channel CAPDAC offset of up to ~100 pF (0..31
  steps of 3.125 pF each). Communicates over I2C at up to 400 kHz.

compatible: "ti,fdc1004"

include: i2c-device.yaml

properties:
  measure-rate:
    type: int
    default: 100
    enum: [100, 200, 400]
    description: |
      Measurement rate in samples per second.
      100 = 100 S/s, 200 = 200 S/s, 400 = 400 S/s.
      Default is 100 S/s, it is the lowest rate which provides
      best accuracy.

  ti,capdac:
    type: array
    default: [0, 0, 0, 0]
    description: |
      Per-channel CAPDAC offset for CIN1, CIN2, CIN3, CIN4 respectively.
      Each value is an integer from 0 to 31; each step equals 3.125 pF of
      offset, shifting the measurement window from [-15, +15] pF to
      [CAPDAC*3.125 - 15, CAPDAC*3.125 + 15] pF.
      Default is [0, 0, 0, 0] which means no offset.
      It centeres the measurement window around GND.
      Non-zero values can be used based on individual project
      parastitic capacitance at each electrode.

examples:
  - |
    fdc1004_0: fdc1004@50 {
      compatible = "ti,fdc1004";
      reg = <0x50>;
      measure-rate = <100>;
      ti,capdac = <0 0 0 0>;
    };
```

## dts/bindings/sensor/ti,fdc2x1x.yaml
```yaml
# Copyright (c) 2020 arithmetics.io
# SPDX-License-Identifier: Apache-2.0

description: Texas Instruments FDC2X1X capacitive sensor

compatible: "ti,fdc2x1x"

include: [sensor-device.yaml, i2c-device.yaml]

properties:
  sd-gpios:
    type: phandle-array
    description: |
      The SD pin defaults to active high when consumed by the sensor.
      The property value should ensure the flags properly describe
      the signal that is presented to the driver.

  intb-gpios:
    type: phandle-array
    description: |
      The INTB pin defaults to active low when produced by the sensor.
      The property value should ensure the flags properly describe
      the signal that is presented to the driver.

  fdc2x14:
    type: boolean
    description: |
      Set to identify the sensor as FDC2114 or FDC2214 (4-channel version)

  autoscan:
    type: boolean
    description: |
      Set the Auto-Scan Mode.

      false = Continuous conversion on the single channel selected by
      "active-channel" (single channel mode).

      true = Auto-Scan conversions as selected by "rr-sequence"
      (multichannel mode).

  fref:
    type: int
    required: true
    description: |
      Reference frequency of the used clock source in KHz.
      The internal clock oscillates at around 43360 KHz (43.36 MHz)
      at 20 degrees Celsius.
      Recommended external clock source frequency is 40000 KHz (40 MHz).

  rr-sequence:
    type: int
    default: 0
    description: |
      Auto-Scan Sequence Configuration.
      The FDC will perform a single conversion on each channel
      in the sequence selected, and then restart the sequence continuously.

      The sensor performs conversion on Channel 0 to 1 by default after
      power-on-reset. This setting only applies if autoscan=true
      (multichannel mode).

      0 = Ch0, Ch1
      1 = Ch0, Ch1, Ch2 (FDC2114, FDC2214 only)
      2 = Ch0, Ch1, Ch2, Ch3 (FDC2114, FDC2214 only)
    enum:
      - 0
      - 1
      - 2

  active-channel:
    type: int
    default: 0
    description: |
      Selects channel for continuous conversions.

      The sensor performs continuous conversion on Channel 0 by default after
      power-on-reset. This setting only applies if autoscan=false
      (single channel mode).

      0 = Perform continuous conversions on Channel 0
      1 = Perform continuous conversions on Channel 1
      2 = Perform continuous conversions on Channel 2 (FDC2114, FDC2214 only)
      3 = Perform continuous conversions on Channel 3 (FDC2114, FDC2214 only)
    enum:
      - 0
      - 1
      - 2
      - 3

  deglitch:
    type: int
    required: true
    description: |
      Input deglitch filter bandwidth. Select the lowest setting that exceeds
      the oscillation tank oscillation frequency.

      1 = 1MHz
      4 = 3.3MHz
      5 = 10MHz
      7 = 33MHz
    enum:
      - 1
      - 4
      - 5
      - 7

  sensor-activate-sel:
    type: string
    default: "low-power"
    description: |
      Sensor Activation Mode Selection.

      The sensor uses low-power activation mode by default after
      power-on-reset.

      full-current = the FDC will drive maximum
      sensor current for a shorter sensor activation time.

      low-power = the FDC uses the value programmed by "idrive" during
      sensor activation to minimize power consumption.
    enum:
      - "full-current"
      - "low-power"

  ref-clk-src:
    type: string
    default: "internal"
    description: |
      Select Reference Frequency Source.

      The sensor uses the internal clock by default after power-on-reset.

      internal = Use Internal oscillator as reference frequency
      external = Reference frequency is provided from CLKIN pin.
    enum:
      - "internal"
      - "external"

  current-drive:
    type: string
    default: "normal"
    description: |
      Select Current Sensor Drive.

      The sensor uses normal current drive by default after power-on-reset.
      High current drive is not supported if autoscan=false and will default
      to normal.

      normal = The FDC will drive all channels with normal sensor current
      (1.5mA max).

      high = The FDC will drive channel 0 with current >1.5mA.
    enum:
      - "normal"
      - "high"

  output-gain:
    type: int
    default: 0
    description: |
      Output gain control (FDC2112, FDC2114 only)

      The default output gain is 0 after power-on-reset.

      0 = Gain = 1   | Effective Resolution 12 bits | 100% full scale
      1 = Gain = 4   | Effective Resolution 14 bits | 25% full scale
      2 = Gain = 8   | Effective Resolution 15 bits | 12.5% full scale
      3 = Gain = 16  | Effective Resolution 16 bits | 6.25% full scale
    enum:
      - 0
      - 1
      - 2
      - 3

child-binding:
  description: |
    Settings for each channel 0-1 (FDC2112 and FDC2212) or
    0-3 (FDC2114 and FDC2214)

  properties:
    rcount:
      type: int
      required: true
      description: |
        Channel X Reference Count Conversion Interval Time.
        Valid range: 256 - 65535

    offset:
      type: int
      default: 0
      description: |
        Channel X Conversion Offset (FDC2112 and FDC2212 only).
        The default offset value after power-on-reset is 0.
        Valid range: 0 - 65535

    settlecount:
      type: int
      required: true
      description: |
        Channel X Conversion Settling.

        The FDC will use this settling time to allow the LC sensor to
        stabilize before initiation of a conversion on Channel X.
        Valid range: 0 - 65535

    fref-divider:
      type: int
      required: true
      description: |
        Channel X Reference Divider.

        Sets the divider for Channel X reference.
        Use this to scale the maximum conversion frequency.
        Valid range: 1 - 1023

    idrive:
      type: int
      required: true
      description: |
        Channel X Sensor drive current.

        This field defines the Drive Current used during the settling +
        conversion time of Channel X sensor clock.
        Valid range: 0 - 31

    fin-sel:
      type: int
      required: true
      description: |
        Channel X Sensor frequency select.

        For differential sensor configuration:
        1 = divide by 1. Choose for sensor frequencies between
        0.01MHz and 8.75MHz
        2 = divide by 2. Choose for sensor frequencies between 5MHz
        and 10MHz

        For single-ended sensor configuration:
        2 = divide by 2. Choose for sensor frequencies between
        0.01MHz and 10MHz
      enum:
        - 1 # Divide by 1
        - 2 # Divide by 2

    inductance:
      type: int
      required: true
      description: |
        Inductor value used on the PCB for the sensing network of the
        specific channel, which is usually 18uH.
```

## dts/bindings/sensor/ti,hdc.yaml
```yaml
# Copyright (c) 2018, Phytec Messtechnik GmbH
# SPDX-License-Identifier: Apache-2.0

description: Texas Instruments temperature and humidity sensor (e.g. HDC1008)

compatible: "ti,hdc"

include: [sensor-device.yaml, i2c-device.yaml]

properties:
  drdy-gpios:
    type: phandle-array
    description: Data ready pin.

      The DRDYn pin of HDC sensor is open-drain, active low.
      If connected directly the MCU pin should be configured
      as pull-up, active low.
```

## dts/bindings/sensor/ti,hdc1008.yaml
```yaml
#
# Copyright (c) 2018, Phytec Messtechnik GmbH
#
# SPDX-License-Identifier: Apache-2.0
#
---
title: HDC1008 Temperature and Humidity Sensor
id: ti,hdc1008
version: 0.1

description: >
    This is a representation of the HDC1008 Temperature and Humidity sensor

inherits:
    !include i2c-device.yaml

properties:
    compatible:
      constraint: "ti,hdc1008"

    drdy-gpios:
      type: compound
      category: required
      generation: define, use-prop-name
...
```

## dts/bindings/sensor/ti,hdc2010.yaml
```yaml
# Copyright (c) 2021, Aurelien Jarno
# SPDX-License-Identifier: Apache-2.0

description: Texas Instruments HDC2010 Temperature and Humidity Sensor

compatible: "ti,hdc2010"

include: ti,hdc20xx.yaml
```

## dts/bindings/sensor/ti,hdc2021.yaml
```yaml
# Copyright (c) 2021, Aurelien Jarno
# SPDX-License-Identifier: Apache-2.0

description: Texas Instruments HDC2021 Temperature and Humidity Sensor

compatible: "ti,hdc2021"

include: ti,hdc20xx.yaml
```

## dts/bindings/sensor/ti,hdc2022.yaml
```yaml
# Copyright (c) 2021, Aurelien Jarno
# SPDX-License-Identifier: Apache-2.0

description: Texas Instruments HDC2022 Temperature and Humidity Sensor

compatible: "ti,hdc2022"

include: ti,hdc20xx.yaml
```

## dts/bindings/sensor/ti,hdc2080.yaml
```yaml
# Copyright (c) 2021, Aurelien Jarno
# SPDX-License-Identifier: Apache-2.0

description: Texas Instruments HDC2080 Temperature and Humidity Sensor

compatible: "ti,hdc2080"

include: ti,hdc20xx.yaml
```

## dts/bindings/sensor/ti,hdc20x0.yaml
```yaml
# Copyright (c) 2020, seeed.cc
# SPDX-License-Identifier: Apache-2.0

description: TI HDC20x0  ±2% ultra-low-power, digital humidity sensor with temperature sensor

compatible: "ti,hdc20x0"

include: i2c-device.yaml
```

## dts/bindings/sensor/ti,hdc20xx.yaml
```yaml
# Copyright (c) 2021, Aurelien Jarno
# SPDX-License-Identifier: Apache-2.0

description: Texas Instruments HDC20XX Temperature and Humidity Sensor

compatible: "ti,hdc20xx"

include: [sensor-device.yaml, i2c-device.yaml]

properties:
  int-gpios:
    type: phandle-array
    description: DRDY/INT pin.

      The DRDY/INT pin of HDC20xx sensor is open-drain, active low. If
      connected directly the MCU pin should be configured as pull-up
      as pull-up, active low.
```

## dts/bindings/sensor/ti,hdc3022.yaml
```yaml
# Copyright (c) 2025 Psicontrol N.V.
# SPDX-License-Identifier: Apache-2.0

description: Texas Instruments HDC3022 Temperature and Humidity Sensor

compatible: "ti,hdc3022"

include: ti,hdc302x.yaml
```

## dts/bindings/sensor/ti,hdc302x.yaml
```yaml
# Copyright (c) 2025, Psicontrol N.V.
# SPDX-License-Identifier: Apache-2.0

description: Texas Instruments HDC302X Temperature and Humidity Sensor
compatible: "ti,hdc302x"
include: [sensor-device.yaml, i2c-device.yaml]

properties:
  int-gpios:
    type: phandle-array
    description: DRDY/INT pin.

      The DRDY/INT pin of HDC302x sensor is open-drain, active low. If
      connected directly the MCU pin should be configured as pull-up
      as pull-up, active low.
```

## dts/bindings/sensor/ti,ina219.yaml
```yaml
# Copyright (c) 2021 Leonard Pollak
# SPDX-License-Identifier: Apache-2.0

description: Texas Instruments Bidirectional Current/Power Sensor

compatible: "ti,ina219"

include: [sensor-device.yaml, i2c-device.yaml]

properties:
  lsb-microamp:
    type: int
    required: true
    description: |
      Current LSB in microAmpere
      Current LSB = max expected current [A] / 2^15
      example: 100 -> ~3A
  shunt-milliohm:
    type: int
    required: true
    description: |
      Value of the shunt resistor in milliOhm
  brng:
    type: int
    default: 1
    description: |
      Bus Voltage Range
      0 = 16 V FSR
      1 = 32 V FSR

      The default of 32V is the power-on reset value of the device.

      Should the expected bus voltage be below 16V set this to 0.
    enum:
      - 0
      - 1
  pg:
    type: int
    default: 3
    description: |
      Programmable Gain
      0 = 1  -> ±40 mV
      1 = /2 -> ±80 mV
      2 = /4 -> ±160 mV
      3 = /8 -> ±320 mV

      The default of ±320 mV is the power-on reset value of the device.

      In case the expected voltage drop across the shunt resistor is lower
      one can adjust this to get more accurate readings.
    enum:
      - 0
      - 1
      - 2
      - 3
  badc:
    type: int
    default: 3
    description: |
      Bus ADC configuration
      0  = 9 bit -> 84 µs
      1  = 10 bit -> 148 µs
      2  = 11 bit -> 276 µs
      3  = 12 bit -> 532 µs
      9  = 12 bit - 2 sample averaging -> 1.06 ms
      10 = 12 bit - 4 sample averaging -> 2.13 ms
      11 = 12 bit - 8 sample averaging -> 4.26 ms
      12 = 12 bit - 16 sample averaging -> 8.51 ms
      13 = 12 bit - 32 sample averaging -> 17.02 ms
      14 = 12 bit - 64 sample averaging -> 34.05 ms
      15 = 12 bit - 128 sample averaging -> 68.10 ms

      The default of 12 bit is the power-on reset value of the device.

      Lowering the resolution of the ADC gives less accurate readings but
      cuts down on conversion times.

      Averaging over multiple samples gives more stable readings but adds
      to overall conversion time.
    enum:
      - 0
      - 1
      - 2
      - 3
      - 9
      - 10
      - 11
      - 12
      - 13
      - 14
      - 15
  sadc:
    type: int
    default: 3
    description: |
      Shunt ADC configuration
      0  = 9 bit -> 84 µs
      1  = 10 bit -> 148 µs
      2  = 11 bit -> 276 µs
      3  = 12 bit -> 532 µs
      9  = 12 bit - 2 sample averaging -> 1.06 ms
      10 = 12 bit - 4 sample averaging -> 2.13 ms
      11 = 12 bit - 8 sample averaging -> 4.26 ms
      12 = 12 bit - 16 sample averaging -> 8.51 ms
      13 = 12 bit - 32 sample averaging -> 17.02 ms
      14 = 12 bit - 64 sample averaging -> 34.05 ms
      15 = 12 bit - 128 sample averaging -> 68.10 ms

      The default of 12 bit is the power-on reset value of the device.

      Lowering the resolution of the ADC gives less accurate readings but
      cuts down on conversion times.

      Averaging over multiple samples gives more stable readings but adds
      to overall conversion time.
    enum:
      - 0
      - 1
      - 2
      - 3
      - 9
      - 10
      - 11
      - 12
      - 13
      - 14
      - 15
```
