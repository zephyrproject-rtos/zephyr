## dts/bindings/sensor/ti,ina226.yaml
```yaml
# Copyright 2024 NXP
# SPDX-License-Identifier: Apache-2.0

description: |
    TI INA226 Bidirectional Current and Power Monitor.
    The <zephyr/dt-bindings/sensor/ina226.h> file should be included in the
    DeviceTree as it provides macros that can be used for initializing the
    configuration registers.

compatible: "ti,ina226"

include: ti,ina2xx-common.yaml

properties:
  avg-count:
    type: int
    description: |
      Number of samples to average (applies to all inputs).
      Default is the power-on reset value.
    default: 1
    enum: [1, 4, 16, 64, 128, 256, 512, 1024]

  vbus-conversion-time-us:
    type: int
    description: |
      Vbus conversion time in microseconds.
      Default is the power-on reset value.
    default: 1100
    enum: [140, 204, 332, 588, 1100, 2116, 4156, 8244]

  vshunt-conversion-time-us:
    type: int
    description: |
      Vshunt conversion time in microseconds.
      Default is the power-on reset value.
    default: 1100
    enum: [140, 204, 332, 588, 1100, 2116, 4156, 8244]

  operating-mode:
    type: string
    description: |
      Selects mode of operation.
      Default is the power-on reset value.
    default: "Shunt and Bus, Continuous"
    enum:
      - "Power-Down (or Shutdown)"
      - "Shunt Voltage, Triggered"
      - "Bus Voltage, Triggered"
      - "Shunt and Bus, Triggered"
      - "Power-Down (or Shutdown)"
      - "Shunt Voltage, Continuous"
      - "Bus Voltage, Continuous"
      - "Shunt and Bus, Continuous"
```

## dts/bindings/sensor/ti,ina228.yaml
```yaml
#
# Copyright 2025 Nova Dynamics LLC
#
# SPDX-License-Identifier: Apache-2.0
#

description: |
    TI INA228 Bidirectional Power/Energy/Charge Monitor.

compatible: "ti,ina228"

include: ti,ina237.yaml
```

## dts/bindings/sensor/ti,ina230.yaml
```yaml
#
# Copyright 2021 The Chromium OS Authors
# Copyright 2021 Grinn
#
# SPDX-License-Identifier: Apache-2.0
#

description: |
    TI INA230, INA231 and INA236 Bidirectional Current and Power Monitor.
    The <zephyr/dt-bindings/sensor/ina230.h> file should be included in the
    DeviceTree and it provides macro that can be used for initializing the
    configuration register.

compatible: "ti,ina230"

include: ti,ina23x-common.yaml

properties:
  config:
    type: int
    deprecated: true
    default: 0x0000
    description: |
      Value of the configuration register
      e.g shunt voltage and bus voltage ADC conversion
      times, ADC and averaging, and ADC operating mode.

  alert-config:
    type: int
    description: Diag alert register, default matches the power-on reset value

  adc-mode:
    type: string
    description: |
      ADC channel conversion configuration.
      Default is the power-on reset value.
    default: "Bus and shunt voltage continuous"
    enum:
      - "Shutdown single shot"
      - "Shunt Voltage single shot"
      - "Bus Voltage single shot"
      - "Bus and Shunt Voltage single shot"
      - "Shutdown continuous"
      - "Shunt voltage continuous"
      - "Bus voltage continuous"
      - "Bus and shunt voltage continuous"

  vbus-conversion-time-us:
    type: int
    description: |
      Vbus conversion time in microseconds.
      Default is the power-on reset value.
    default: 1100
    enum: [140, 204, 332, 588, 1100, 2116, 4156, 8244]

  vshunt-conversion-time-us:
    type: int
    description: |
      Vshunt conversion time in microseconds.
      Default is the power-on reset value.
    default: 1100
    enum: [140, 204, 332, 588, 1100, 2116, 4156, 8244]

  avg-count:
    type: int
    description: |
      Number of samples to average (applies to all inputs).
      Default is the power-on reset value.
    default: 1
    enum: [1, 4, 16, 64, 128, 256, 512, 1024]

  mask:
    type: int
    default: 0
    # default all alert sources to disabled
    description: Mask register, default matches the power-on reset value

  alert-limit:
    type: int
    default: 0
    # default alert limit is 0V
    description: Alert register, default matches the power-on reset value
```

## dts/bindings/sensor/ti,ina232.yaml
```yaml
#
# Copyright 2025 The Zephyr Project Contributors
#
# SPDX-License-Identifier: Apache-2.0
#

description: |
    TI INA232 Bidirectional Current and Power Monitor.
    The <zephyr/dt-bindings/sensor/ina230.h> file includes the
    macro for initializing the config register so it should
    be included.

compatible: "ti,ina232"

include: ti,ina230.yaml

properties:
  high-precision:
    type: boolean
    description: |
      Enable high precision mode (4x the resolution).
```

## dts/bindings/sensor/ti,ina236.yaml
```yaml
#
# Copyright 2024 Tomas Jurena
#
# SPDX-License-Identifier: Apache-2.0
#

description: |
    TI INA236 Bidirectional Current and Power Monitor.
    The <zephyr/dt-bindings/sensor/ina230.h> file should be included in the
    DeviceTree and it provides macro that can be used for initializing the
    configuration register.

compatible: "ti,ina236"

include: ti,ina230.yaml

properties:
  high-precision:
    type: boolean
    description: |
      Enable high precision mode (4x the resolution).
```

## dts/bindings/sensor/ti,ina237.yaml
```yaml
#
# Copyright 2021 Grinn
#
# SPDX-License-Identifier: Apache-2.0
#

description: |
    TI INA237 Bidirectional Current and Power Monitor.
    The <zephyr/dt-bindings/sensor/ina237.h> file should be included in the
    DeviceTree and it provides macros that can be used for initializing the
    configuration registers.

compatible: "ti,ina237"

include: ti,ina2xx-common.yaml

properties:
  alert-config:
    type: int
    description: Diag alert register, default matches the power-on reset value

  adc-mode:
    type: string
    description: |
      ADC channel conversion configuration.
      Default is the power-on reset value.
    default: "Temperature, bus, and shunt voltage continuous"
    enum:
      - "Shutdown single shot"
      - "Bus Voltage single shot"
      - "Shunt Voltage single shot"
      - "Bus and Shunt Voltage single shot"
      - "Temperature Single shot"
      - "Temperature and bus voltage single shot"
      - "Temperature and shunt voltage single shot"
      - "Temperature, bus, and shunt voltage single shot"
      - "Shutdown continuous"
      - "Bus voltage continuous"
      - "Shunt voltage continuous"
      - "Bus and shunt voltage continuous"
      - "Temperature continuous"
      - "Temperature and bus voltage continuous"
      - "Temperature and shunt voltage continuous"
      - "Temperature, bus, and shunt voltage continuous"

  vbus-conversion-time-us:
    type: int
    description: |
      Vbus conversion time in microseconds.
      Default is the power-on reset value.
    default: 1052
    enum: [50, 84, 150, 280, 540, 1052, 2074, 4120]

  vshunt-conversion-time-us:
    type: int
    description: |
      Vshunt conversion time in microseconds.
      Default is the power-on reset value.
    default: 1052
    enum: [50, 84, 150, 280, 540, 1052, 2074, 4120]

  temp-conversion-time-us:
    type: int
    description: |
      Temperature conversion time in microseconds.
      Default is the power-on reset value.
    default: 1052
    enum: [50, 84, 150, 280, 540, 1052, 2074, 4120]

  avg-count:
    type: int
    description: |
      Number of samples to average (applies to all inputs).
      Default is the power-on reset value.
    default: 1
    enum: [1, 4, 16, 64, 128, 256, 512, 1024]

  high-precision:
    type: boolean
    description: |
      Enable high precision mode (4x the resolution).
```

## dts/bindings/sensor/ti,ina23x-common.yaml
```yaml
#
# Copyright 2021 Grinn
#
# SPDX-License-Identifier: Apache-2.0
#

include: [sensor-device.yaml, i2c-device.yaml]

properties:
  current-lsb-microamps:
    type: int
    required: true
    description: |
      This value should be selected so that measurement resolution is
      maximized, that is:

        current-lsb(A) = maximum expected current(A) / 2^15

      (sensor has 15 bits). For example, if maximum expected current is 15A:

        current-lsb(A) = 15A / 2^15 ~= 457uA

      Rounded values may be used for convenience, e.g. 500uA/LSB or 1mA/LSB
      while keeping a good measurement resolution. The units are in uA/LSB
      so that low maximum currents can be measured with enough resolution.

  voltage-lsb-microvolts:
    type: int
    default: 1250
    description: |
      Voltage input resolution in microvolts.
      The default value matches ina230 and ina231.
      Some parts with higher voltage capability (e.g. ina236) need this set.

  rshunt-micro-ohms:
    type: int
    required: true
    description: Shunt resistor value in microOhms

  alert-gpios:
    type: phandle-array
    description: Alert pin
```

## dts/bindings/sensor/ti,ina23x.yaml
```yaml
#
# Copyright 2021 The Chromium OS Authors
#
# SPDX-License-Identifier: Apache-2.0
#


description: |
    TI INA230 and INA231 Bidirectional Current and Power Monitor.
    The <include/dt-bindings/sensor/ina23x.h> file should be included
    in the DeviceTree and it provides Macros that can be used for
    initializing the Configuration register.

compatible: "ti,ina23x"

include: i2c-device.yaml

properties:
    config:
      type: int
      required: true
      description: Configuration register

    current_lsb:
      type: int
      required: true
      description: |
        Value of Current LSB in milliamps. When set to 1mA,
        Current is read in A, Bus Voltage in V, Shunt
        Voltage in V, and Power in mW. Any other value
        results in Current, Voltage, and Power registers
        being read in counts.

    rshunt:
      type: int
      required: true
      description: Shunt resistor value in milliohms

    mask:
      type: int
      required: false
      default: 0
      # default all alert sources to disabled
      description: Mask register, default matches the power-on reset value

    alert_limit:
      type: int
      required: false
      default: 0
      # default alert limit is 0V
      description: Alert register, default matches the power-on reset value

    irq-gpios:
      type: phandle-array
      required: false
      description: IRQ Alert pin
```

## dts/bindings/sensor/ti,ina260.yaml
```yaml
# Copyright (c) 2024 Launch Initiative
# SPDX-License-Identifier: Apache-2.0
# datasheet: http://www.ti.com/lit/ds/symlink/ina260.pdf

description: Texas Instruments Bidirectional Current/Power Sensor

compatible: "ti,ina260"

include: [sensor-device.yaml, i2c-device.yaml]

properties:

  average:
    type: int
    required: true
    description: |
      Averaging Mode.
      Number of samples that are collected and averaged.
      Values correspond to the register configuration bits 0-7
    enum:
      - 1
      - 4
      - 16
      - 64
      - 128
      - 256
      - 512
      - 1024

  mode:
    type: string
    description: |
      Operating Mode
      Selects continuous, triggered, or power-down mode of operation. These bits default to
      continuous shunt and bus measurement mode. The following shows mode settings
      - TRIG_OFF
      - TRIG_CURRENT
      - TRIG_VOLTAGE
      - TRIG_BOTH
      - CONT_OFF
      - CONT_CURRENT
      - CONT_VOLTAGE
      - CONT_BOTH
    default: "CONT_BOTH"
    enum:
      - "TRIG_OFF"
      - "TRIG_CURRENT"
      - "TRIG_VOLTAGE"
      - "TRIG_BOTH"
      - "CONT_OFF"
      - "CONT_CURRENT"
      - "CONT_VOLTAGE"
      - "CONT_BOTH"

  v-conv-time:
    type: int
    required: true
    description: |
      Bus Voltage Conversion Time in microseconds
      Values correspond to the register configuration bits 0-7
    enum:
      - 140
      - 204
      - 332
      - 588
      - 1100
      - 2116
      - 4156
      - 8244
  i-conv-time:
    type: int
    required: true
    description: |
      Shunt Current Conversion Time in microseconds
      Values correspond to the register configuration bits 0-7
    enum:
      - 140
      - 204
      - 332
      - 588
      - 1100
      - 2116
      - 4156
      - 8244
```

## dts/bindings/sensor/ti,ina2xx-common.yaml
```yaml
#
# Copyright 2021 Grinn
#
# SPDX-License-Identifier: Apache-2.0
#

include: [sensor-device.yaml, i2c-device.yaml]

properties:
  current-lsb-microamps:
    type: int
    required: true
    description: |
      This value should be selected so that measurement resolution is
      maximized, that is:

        current-lsb(A) = maximum expected current(A) / 2^15

      (sensor has 15 bits). For example, if maximum expected current is 15A:

        current-lsb(A) = 15A / 2^15 ~= 457uA

      Rounded values may be used for convenience, e.g. 500uA/LSB or 1mA/LSB
      while keeping a good measurement resolution. The units are in uA/LSB
      so that low maximum currents can be measured with enough resolution.

  rshunt-micro-ohms:
    type: int
    required: true
    description: Shunt resistor value in microOhms

  alert-gpios:
    type: phandle-array
    description: Alert pin
```

## dts/bindings/sensor/ti,ina3221.yaml
```yaml
# Copyright (c) 2023 Nordic Semiconductor ASA
# SPDX-License-Identifier: Apache-2.0

description: Texas Instruments INA3221 Triple-Channel Current/Power Monitor

compatible: "ti,ina3221"

include: [sensor-device.yaml, i2c-device.yaml]

properties:
  conv-time-shunt:
    type: int
    default: 4
    description: |
      Shunt-voltage conversion time.
      The default of 1.1 ms is the power-on reset value of the device.
      0 = 140 μs
      1 = 204 μs
      2 = 332 μs
      3 = 588 μs
      4 = 1.1 ms (default)
      5 = 2.116 ms
      6 = 4.156 ms
      7 = 8.244 ms
    enum:
      - 0
      - 1
      - 2
      - 3
      - 4
      - 5
      - 6
      - 7
  conv-time-bus:
    type: int
    default: 4
    description: |
      Bus-voltage conversion time.
      The default of 1.1 ms is the power-on reset value of the device.
      0 = 140 μs
      1 = 204 μs
      2 = 332 μs
      3 = 588 μs
      4 = 1.1 ms (default)
      5 = 2.116 ms
      6 = 4.156 ms
      7 = 8.244 ms
    enum:
      - 0
      - 1
      - 2
      - 3
      - 4
      - 5
      - 6
      - 7
  avg-mode:
    type: int
    default: 0
    description: |
      Averaging mode (number of samples that are collected and averaged together).
      The default of one sample (no averaging) is the power-on reset value of the device.
      0 = 1 (default)
      1 = 4
      2 = 16
      3 = 64
      4 = 128
      5 = 256
      6 = 512
      7 = 1024
    enum:
      - 0
      - 1
      - 2
      - 3
      - 4
      - 5
      - 6
      - 7
  enable-channel:
    type: array
    default: [1, 1, 1]
    description: |
      List of flags to enable or disable each of the three channels.
  shunt-resistors:
    type: array
    description: |
      List of shunt resistor values for all three channels in mOhms.
```
