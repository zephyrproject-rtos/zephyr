## dts/bindings/sensor/invensense,icm45686.yaml
```yaml
# Copyright (c) 2024 Intel Corporation
# Copyright (c) 2025 Croxel Inc.
# Copyright (c) 2025 CogniPilot Foundation
# SPDX-License-Identifier: Apache-2.0

description: |
    ICM45686 High-precision 6-axis motion tracking device
    When setting the accel-pm, accel-range, accel-odr, gyro-pm, gyro-range,
    gyro-odr properties in a .dts or .dtsi file you may include icm45686.h
    and use the macros defined there.

    Example:
    #include <zephyr/dt-bindings/sensor/icm45686.h>

    icm42688: icm45686@0 {
      ...

      accel-pwr-mode = <ICM45686_DT_ACCEL_LN>;
      accel-fs = <ICM45686_DT_ACCEL_FS_32>;
      accel-odr = <ICM45686_DT_ACCEL_ODR_800>;
      gyro-pwr-mode= <ICM45686_DT_GYRO_LN>;
      gyro-fs = <ICM45686_DT_GYRO_FS_4000>;
      gyro-odr = <ICM45686_DT_GYRO_ODR_800>;
    };

compatible: "invensense,icm45686"
include: [sensor-device.yaml, spi-device.yaml]

properties:
  int-gpios:
    type: phandle-array
    description: |
      The INT signal default configuration is active-high. The
      property value should ensure the flags properly describe the
      signal that is presented to the driver.

  accel-pwr-mode:
    type: int
    default: 0
    description: |
      Specify the default accelerometer power mode.
      Default is power-up configuration.
    enum:
      - 0 # ICM45686_DT_ACCEL_OFF
      - 2 # ICM45686_DT_ACCEL_LP
      - 3 # ICM45686_DT_ACCEL_LN

  accel-odr:
    type: int
    default: 6
    description: |
      Specify the default accelerometer output data rate expressed in samples per second (Hz).
      Default is power-up configuration.
    enum:
      - 3 # ICM45686_DT_ACCEL_ODR_6400 (LN-mode only)
      - 4 # ICM45686_DT_ACCEL_ODR_3200 (LN-mode only)
      - 5 # ICM45686_DT_ACCEL_ODR_1600 (LN-mode only)
      - 6 # ICM45686_DT_ACCEL_ODR_800 (LN-mode only)
      - 7 # ICM45686_DT_ACCEL_ODR_400
      - 8 # ICM45686_DT_ACCEL_ODR_200
      - 9 # ICM45686_DT_ACCEL_ODR_100
      - 10 # ICM45686_DT_ACCEL_ODR_50
      - 11 # ICM45686_DT_ACCEL_ODR_25
      - 12 # ICM45686_DT_ACCEL_ODR_12_5
      - 13 # ICM45686_DT_ACCEL_ODR_6_25 (LP-mode only)
      - 14 # ICM45686_DT_ACCEL_ODR_3_125 (LP-mode only)
      - 15 # ICM45686_DT_ACCEL_ODR_1_5625 (LP-mode only)

  accel-fs:
    type: int
    default: 0
    description: |
      Specify the accelerometer range in g.
      Default is power-up configuration.
    enum:
      - 0 # ICM45686_DT_ACCEL_FS_32
      - 1 # ICM45686_DT_ACCEL_FS_16
      - 2 # ICM45686_DT_ACCEL_FS_8
      - 3 # ICM45686_DT_ACCEL_FS_4
      - 4 # ICM45686_DT_ACCEL_FS_2

  accel-lpf:
    type: int
    default: 0
    description: |
      Specify the accelerometer low pass filter cut-off frequency
      as a fraction of the output data rate.
      Default is power-up configuration.
    enum:
      - 0 # ICM45686_DT_ACCEL_LPF_BW_OFF
      - 1 # ICM45686_DT_ACCEL_LPF_BW_1_4
      - 2 # ICM45686_DT_ACCEL_LPF_BW_1_8
      - 3 # ICM45686_DT_ACCEL_LPF_BW_1_16
      - 4 # ICM45686_DT_ACCEL_LPF_BW_1_32
      - 5 # ICM45686_DT_ACCEL_LPF_BW_1_64
      - 6 # ICM45686_DT_ACCEL_LPF_BW_1_128

  gyro-pwr-mode:
    type: int
    default: 0
    description: |
      Specify the default gyro power mode.
      Default is power-up configuration.
    enum:
      - 0 # ICM42688_DT_GYRO_OFF
      - 1 # ICM42688_DT_GYRO_STANDBY
      - 2 # ICM42688_DT_GYRO_LP
      - 3 # ICM42688_DT_GYRO_LN

  gyro-odr:
    type: int
    default: 6
    description: |
      Specify the default gyro output data rate expressed in samples per second (Hz).
      Default is power-up configuration.
    enum:
      - 3 # ICM45686_DT_GYRO_ODR_6400 (LN-mode only)
      - 4 # ICM45686_DT_GYRO_ODR_3200 (LN-mode only)
      - 5 # ICM45686_DT_GYRO_ODR_1600 (LN-mode only)
      - 6 # ICM45686_DT_GYRO_ODR_800 (LN-mode only)
      - 7 # ICM45686_DT_GYRO_ODR_400
      - 8 # ICM45686_DT_GYRO_ODR_200
      - 9 # ICM45686_DT_GYRO_ODR_100
      - 10 # ICM45686_DT_GYRO_ODR_50
      - 11 # ICM45686_DT_GYRO_ODR_25
      - 12 # ICM45686_DT_GYRO_ODR_12_5
      - 13 # ICM45686_DT_GYRO_ODR_6_25 (LP-mode only)
      - 14 # ICM45686_DT_GYRO_ODR_3_125 (LP-mode only)
      - 15 # ICM45686_DT_GYRO_ODR_1_5625 (LP-mode only)

  gyro-fs:
    type: int
    default: 0
    description: |
      Specify the gyro range in degrees per second.
      Default is power-up configuration.
    enum:
      - 0 # ICM45686_DT_GYRO_FS_4000
      - 1 # ICM45686_DT_GYRO_FS_2000
      - 2 # ICM45686_DT_GYRO_FS_1000
      - 3 # ICM45686_DT_GYRO_FS_500
      - 4 # ICM45686_DT_GYRO_FS_250
      - 5 # ICM45686_DT_GYRO_FS_125
      - 6 # ICM45686_DT_GYRO_FS_62_5
      - 7 # ICM45686_DT_GYRO_FS_31_25
      - 8 # ICM45686_DT_GYRO_FS_15_625

  gyro-lpf:
    type: int
    default: 0
    description: |
      Specify the gyro low pass filter cut-off frequency
      as a fraction of the output data rate.
      Default is power-up configuration.
    enum:
      - 0 # ICM45686_DT_GYRO_LPF_BW_OFF
      - 1 # ICM45686_DT_GYRO_LPF_BW_1_4
      - 2 # ICM45686_DT_GYRO_LPF_BW_1_8
      - 3 # ICM45686_DT_GYRO_LPF_BW_1_16
      - 4 # ICM45686_DT_GYRO_LPF_BW_1_32
      - 5 # ICM45686_DT_GYRO_LPF_BW_1_64
      - 6 # ICM45686_DT_GYRO_LPF_BW_1_128

  fifo-watermark:
    type: int
    default: 0
    description: |
      Specify the FIFO watermark level in frame count.
      Default is power-up configuration (disabled).
      Valid range: 0 - 104
```

## dts/bindings/sensor/invensense,icm56622-i2c.yaml
```yaml
# Copyright (c) 2025 Croxel Inc.
# SPDX-License-Identifier: Apache-2.0

description: |
    ICM56622 High-precision 6-axis motion tracking device.
    When setting the accel-pm, accel-range, accel-odr, gyro-pm, gyro-range,
    gyro-odr properties in devicetree, you may include icm566xx.h
    and use the macros defined there.

compatible: "invensense,icm56622"

properties:
  accel-fs:
    type: int
    default: 1
    description: |
      Specify the accelerometer range in g.
      Default is power-up configuration.
    enum:
      - 1 # ICM566XX_DT_ACCEL_FS_16
      - 2 # ICM566XX_DT_ACCEL_FS_8
      - 3 # ICM566XX_DT_ACCEL_FS_4
      - 4 # ICM566XX_DT_ACCEL_FS_2

  gyro-fs:
    type: int
    default: 1
    description: |
      Specify the gyro range in degrees per second.
      Default is power-up configuration.
    enum:
      - 1 # ICM566XX_DT_GYRO_FS_2000
      - 2 # ICM566XX_DT_GYRO_FS_1000
      - 3 # ICM566XX_DT_GYRO_FS_500
      - 4 # ICM566XX_DT_GYRO_FS_250
      - 5 # ICM566XX_DT_GYRO_FS_125
      - 6 # ICM566XX_DT_GYRO_FS_62_5
      - 7 # ICM566XX_DT_GYRO_FS_31_25
      - 8 # ICM566XX_DT_GYRO_FS_15_625

include: ["i2c-device.yaml", "invensense,icm566xx-common.yaml"]

examples:
  - |
    #include <zephyr/dt-bindings/sensor/icm566xx.h>

    &arduino_i2c {
        status = "okay";
        clock-frequency = <400000>;

        icm56622: icm56622@68 {
                compatible = "invensense,icm56622";
                reg = <0x68>;
                int-gpios = <&arduino_header 8 GPIO_ACTIVE_HIGH>;

                accel-fs = <1>;
                accel-odr = <13>;
                accel-lpf = <1>;
                accel-pwr-mode = <2>;

                gyro-fs = <1>;
                gyro-odr = <13>;
                gyro-lpf = <1>;
                gyro-pwr-mode = <2>;
        };
    };
```

## dts/bindings/sensor/invensense,icm56686-spi.yaml
```yaml
# Copyright (c) 2025 Croxel Inc.
# SPDX-License-Identifier: Apache-2.0

description: |
    ICM56686 High-precision 6-axis motion tracking device.
    When setting the accel-pm, accel-range, accel-odr, gyro-pm, gyro-range,
    gyro-odr properties in devicetree, you may include icm566xx.h
    and use the macros defined there.

compatible: "invensense,icm56686"

properties:
  accel-fs:
    type: int
    default: 0
    description: |
      Specify the accelerometer range in g.
      Default is power-up configuration.
    enum:
      - 0 # ICM566XX_DT_ACCEL_FS_32
      - 1 # ICM566XX_DT_ACCEL_FS_16
      - 2 # ICM566XX_DT_ACCEL_FS_8
      - 3 # ICM566XX_DT_ACCEL_FS_4
      - 4 # ICM566XX_DT_ACCEL_FS_2

  gyro-fs:
    type: int
    default: 0
    description: |
      Specify the gyro range in degrees per second.
      Default is power-up configuration.
    enum:
      - 0 # ICM566XX_DT_GYRO_FS_4000
      - 1 # ICM566XX_DT_GYRO_FS_2000
      - 2 # ICM566XX_DT_GYRO_FS_1000
      - 3 # ICM566XX_DT_GYRO_FS_500
      - 4 # ICM566XX_DT_GYRO_FS_250
      - 5 # ICM566XX_DT_GYRO_FS_125
      - 6 # ICM566XX_DT_GYRO_FS_62_5
      - 7 # ICM566XX_DT_GYRO_FS_31_25
      - 8 # ICM566XX_DT_GYRO_FS_15_625

include: ["spi-device.yaml", "invensense,icm566xx-common.yaml"]

examples:
  - |
    #include <zephyr/dt-bindings/sensor/icm566xx.h>

    &arduino_spi {
        status = "okay";
        cs-gpios = <&gpio1 10 GPIO_ACTIVE_LOW>;

        icm56686: icm56686@0 {
                compatible = "invensense,icm56686";
                reg = <0>;
                spi-max-frequency = <1000000>;
                int-gpios = <&arduino_header 8 GPIO_ACTIVE_HIGH>;

                accel-fs = <0>;
                accel-odr = <13>;
                accel-lpf = <1>;
                accel-pwr-mode = <2>;

                gyro-fs = <0>;
                gyro-odr = <13>;
                gyro-lpf = <1>;
                gyro-pwr-mode = <2>;
        };
    };
```

## dts/bindings/sensor/invensense,icp10125.yaml
```yaml
# Copyright (c) 2022, Mizuki Agawa  <agawa.mizuki@fujitsu.com>
# SPDX-License-Identifier: Apache-2.0

description: ICP10125 barometric pressure/temperature sensor

compatible: "invensense,icp10125"

include: [sensor-device.yaml, i2c-device.yaml]

properties:
  temperature-measurement-mode:
    type: string
    required: true
    description: Mode of ambient temperature measurement
    enum:
      - "low-power"
      - "normal"
      - "low-noise"
      - "ultra-low-noise"

  pressure-measurement-mode:
    type: string
    required: true
    description: Mode of barometric pressure measurement
    enum:
      - "low-power"
      - "normal"
      - "low-noise"
      - "ultra-low-noise"
```

## dts/bindings/sensor/invensense,icp101xx.yaml
```yaml
# Copyright (c) 2024 TDK Invensense
# SPDX-License-Identifier: Apache-2.0

description: ICP101xx High Accuracy, Low Power, Barometric Pressure and Temperature Sensors IC

compatible: "invensense,icp101xx"

include: [sensor-device.yaml, i2c-device.yaml]

properties:
  mode:
    type: string
    default: "normal"
    description: Mode of pressure and temperature measurement
    enum:
      - "low-power"
      - "normal"
      - "low-noise"
      - "ultra-low-noise"
```

## dts/bindings/sensor/invensense,icp201xx-i2c.yaml
```yaml
# Copyright (c) 2025 TDK Invensense
# SPDX-License-Identifier: Apache-2.0

description: ICP201xx High Accuracy, Low Power, Barometric Pressure and Temperature Sensor IC

compatible: "invensense,icp201xx"

include: [i2c-device.yaml, "invensense,icp201xx.yaml"]
```

## dts/bindings/sensor/invensense,icp201xx.yaml
```yaml
# Copyright (c) 2025 TDK Invensense
# SPDX-License-Identifier: Apache-2.0

description: ICP201xx High Accuracy, Low Power, Barometric Pressure and Temperature Sensor IC

compatible: "invensense,icp201xx"

include: [sensor-device.yaml]

properties:
  int-gpios:
    type: phandle-array
    description: |
      The INT signal default configuration is active-high. The
      property value should ensure the flags properly describe the
      signal that is presented to the driver.

  op-mode:
    type: string
    default: mode0
    description: |
      Default mode for sensor.
      Mode selection is a trade-off between measurement time, consumption and noise.
      Operation modes are the following:
      - Mode0: odr=25Hz,  noise=0.5rms, current=211uA
      - Mode1: odr=120Hz, noise=1rms,   current=222uA
      - Mode2: odr=40Hz,  noise=2.5rms, current=49uA
      - Mode3: odr=2Hz,   noise=0.5rms, current=23uA
      - Mode4: odr=25Hz,  noise=0.3rms, current=250uA
      Default set to mode0 which is the sensor default value.
    enum:
      - mode0
      - mode1
      - mode2
      - mode3
      - mode4

  drive-strength:
    type: string
    default: current_12mA_1_8V
    description: |
      IO device strength register value.
      Define max current when switching IO state.
      Default set to current_12mA_1_8V which is the sensor default value.
    enum:
      - current_2mA_1_8V
      - current_4mA_1_8V
      - current_8mA_1_8V
      - current_12mA_1_8V
      - current_2mA_1_2V
      - current_4mA_1_2V
      - current_6mA_1_2V
      - current_8mA_1_2V
```

## dts/bindings/sensor/invensense,iim46234.yaml
```yaml
# Copyright (c) 2025 Sentry Technologies ApS
#
# SPDX-License-Identifier: Apache-2.0

compatible: "invensense,iim46234"

include: invensense,iim4623x.yaml

properties:
  accel-fs:
    type: int
    default: 1
    description: |
      Specify the accelerometer range in g.
      Default to the power-up default.
    enum:
      - 2
      - 4
      - 8

  gyro-fs:
    type: int
    default: 2
    description: |
      Specify the gyroscope range in degrees per second.
      Default to the power-up default.
    enum:
      - 250
      - 480
```
