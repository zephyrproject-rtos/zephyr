## dts/bindings/sensor/invensense,icm4268x.yaml
```yaml
# Copyright (c) 2025 Croxel, Inc.
# SPDX-License-Identifier: Apache-2.0

compatible: "invensense,icm4268x"
include: [sensor-axis-align.yaml, sensor-device.yaml, spi-device.yaml]

properties:
  int-gpios:
    type: phandle-array
    description: |
      The INT signal default configuration is active-high. The
      property value should ensure the flags properly describe the
      signal that is presented to the driver.

  accel-pwr-mode:
    type: int
    default: 0
    description: |
      Specify the default accelerometer power mode.
      Default is power-up configuration.
    enum:
      - 0 # ICM4268X_DT_ACCEL_OFF
      - 2 # ICM4268X_DT_ACCEL_LP
      - 3 # ICM4268X_DT_ACCEL_LN

  accel-odr:
    type: int
    default: 6
    description: |
      Specify the default accelerometer output data rate expressed in samples per second (Hz).
      Default is power-up configuration.
    enum:
      - 1  # ICM4268X_DT_ACCEL_ODR_32000
      - 2  # ICM4268X_DT_ACCEL_ODR_16000
      - 3  # ICM4268X_DT_ACCEL_ODR_8000
      - 4  # ICM4268X_DT_ACCEL_ODR_4000
      - 5  # ICM4268X_DT_ACCEL_ODR_2000
      - 6  # ICM4268X_DT_ACCEL_ODR_1000
      - 7  # ICM4268X_DT_ACCEL_ODR_200
      - 8  # ICM4268X_DT_ACCEL_ODR_100
      - 9  # ICM4268X_DT_ACCEL_ODR_50
      - 10 # ICM4268X_DT_ACCEL_ODR_25
      - 11 # ICM4268X_DT_ACCEL_ODR_12_5
      - 12 # ICM4268X_DT_ACCEL_ODR_6_25
      - 13 # ICM4268X_DT_ACCEL_ODR_3_125
      - 14 # ICM4268X_DT_ACCEL_ODR_1_5625
      - 15 # ICM4268X_DT_ACCEL_ODR_500

  accel-fs:
    type: int
    default: 0
    description: |
      Specify the accelerometer range in g.
      Default is power-up configuration.
    enum:
      - 0 # ICM42686_DT_ACCEL_FS_32 | ICM42688_DT_ACCEL_FS_16
      - 1 # ICM42686_DT_ACCEL_FS_16 | ICM42688_DT_ACCEL_FS_8
      - 2 # ICM42686_DT_ACCEL_FS_8  | ICM42688_DT_ACCEL_FS_4
      - 3 # ICM42686_DT_ACCEL_FS_4  | ICM42688_DT_ACCEL_FS_2
      - 4 # ICM42686_DT_ACCEL_FS_2

  gyro-pwr-mode:
    type: int
    default: 0
    description: |
      Specify the default gyro power mode.
      Default is power-up configuration.
    enum:
      - 0 # ICM4268X_DT_GYRO_OFF
      - 1 # ICM4268X_DT_GYRO_STANDBY
      - 3 # ICM4268X_DT_GYRO_LN

  gyro-odr:
    type: int
    default: 6
    description: |
      Specify the default gyro output data rate expressed in samples per second (Hz).
      Default is power-up configuration.
    enum:
      - 1  # ICM4268X_DT_GYRO_ODR_32000
      - 2  # ICM4268X_DT_GYRO_ODR_16000
      - 3  # ICM4268X_DT_GYRO_ODR_8000
      - 4  # ICM4268X_DT_GYRO_ODR_4000
      - 5  # ICM4268X_DT_GYRO_ODR_2000
      - 6  # ICM4268X_DT_GYRO_ODR_1000
      - 7  # ICM4268X_DT_GYRO_ODR_200
      - 8  # ICM4268X_DT_GYRO_ODR_100
      - 9  # ICM4268X_DT_GYRO_ODR_50
      - 10 # ICM4268X_DT_GYRO_ODR_25
      - 11 # ICM4268X_DT_GYRO_ODR_12_5
      - 15 # ICM4268X_DT_GYRO_ODR_500

  gyro-fs:
    type: int
    default: 0
    description: |
      Specify the gyro range in degrees per second.
      Default is power-up configuration.
    enum:
      - 0 # ICM42686_DT_GYRO_FS_4000  | ICM42688_DT_GYRO_FS_2000
      - 1 # ICM42686_DT_GYRO_FS_2000  | ICM42688_DT_GYRO_FS_1000
      - 2 # ICM42686_DT_GYRO_FS_1000  | ICM42688_DT_GYRO_FS_500
      - 3 # ICM42686_DT_GYRO_FS_500   | ICM42688_DT_GYRO_FS_250
      - 4 # ICM42686_DT_GYRO_FS_250   | ICM42688_DT_GYRO_FS_125
      - 5 # ICM42686_DT_GYRO_FS_125   | ICM42688_DT_GYRO_FS_62_5
      - 6 # ICM42686_DT_GYRO_FS_62_5  | ICM42688_DT_GYRO_FS_31_25
      - 7 # ICM42686_DT_GYRO_FS_31_25 | ICM42688_DT_GYRO_FS_15_625

  fifo-hires:
    type: boolean
    description: |
      Enables hires for fifo
```

## dts/bindings/sensor/invensense,icm45605-common.yaml
```yaml
# Copyright (c) 2024 Intel Corporation
# Copyright (c) 2025 Croxel Inc.
# Copyright (c) 2025 CogniPilot Foundation
# Copyright (c) 2026 Swarovski Optik AG & Co KG.
# SPDX-License-Identifier: Apache-2.0

include: sensor-device.yaml

properties:
  int-gpios:
    type: phandle-array
    description: |
      The INT signal default configuration is active-high. The
      property value should ensure the flags properly describe the
      signal that is presented to the driver.

  accel-pwr-mode:
    type: int
    default: 0
    description: |
      Specify the default accelerometer power mode.
      Default is power-up configuration.
    enum:
      - 0 # ICM45605_DT_ACCEL_OFF
      - 2 # ICM45605_DT_ACCEL_LP
      - 3 # ICM45605_DT_ACCEL_LN

  accel-odr:
    type: int
    default: 6
    description: |
      Specify the default accelerometer output data rate expressed in samples per second (Hz).
      Default is power-up configuration.
    enum:
      - 3 # ICM45605_DT_ACCEL_ODR_6400 (LN-mode only)
      - 4 # ICM45605_DT_ACCEL_ODR_3200 (LN-mode only)
      - 5 # ICM45605_DT_ACCEL_ODR_1600 (LN-mode only)
      - 6 # ICM45605_DT_ACCEL_ODR_800 (LN-mode only)
      - 7 # ICM45605_DT_ACCEL_ODR_400
      - 8 # ICM45605_DT_ACCEL_ODR_200
      - 9 # ICM45605_DT_ACCEL_ODR_100
      - 10 # ICM45605_DT_ACCEL_ODR_50
      - 11 # ICM45605_DT_ACCEL_ODR_25
      - 12 # ICM45605_DT_ACCEL_ODR_12_5
      - 13 # ICM45605_DT_ACCEL_ODR_6_25 (LP-mode only)
      - 14 # ICM45605_DT_ACCEL_ODR_3_125 (LP-mode only)
      - 15 # ICM45605_DT_ACCEL_ODR_1_5625 (LP-mode only)

  accel-fs:
    type: int
    default: 0
    description: |
      Specify the accelerometer range in g.
      Default is power-up configuration.
    enum:
      - 0 # ICM45605_DT_ACCEL_FS_16
      - 1 # ICM45605_DT_ACCEL_FS_8
      - 2 # ICM45605_DT_ACCEL_FS_4
      - 3 # ICM45605_DT_ACCEL_FS_2

  accel-lpf:
    type: int
    default: 0
    description: |
      Specify the accelerometer low pass filter cut-off frequency
      as a fraction of the output data rate.
      Default is power-up configuration.
    enum:
      - 0 # ICM45605_DT_ACCEL_LPF_BW_OFF
      - 1 # ICM45605_DT_ACCEL_LPF_BW_1_4
      - 2 # ICM45605_DT_ACCEL_LPF_BW_1_8
      - 3 # ICM45605_DT_ACCEL_LPF_BW_1_16
      - 4 # ICM45605_DT_ACCEL_LPF_BW_1_32
      - 5 # ICM45605_DT_ACCEL_LPF_BW_1_64
      - 6 # ICM45605_DT_ACCEL_LPF_BW_1_128

  gyro-pwr-mode:
    type: int
    default: 0
    description: |
      Specify the default gyro power mode.
      Default is power-up configuration.
    enum:
      - 0 # ICM42688_DT_GYRO_OFF
      - 1 # ICM42688_DT_GYRO_STANDBY
      - 2 # ICM42688_DT_GYRO_LP
      - 3 # ICM42688_DT_GYRO_LN

  gyro-odr:
    type: int
    default: 6
    description: |
      Specify the default gyro output data rate expressed in samples per second (Hz).
      Default is power-up configuration.
    enum:
      - 3 # ICM45605_DT_GYRO_ODR_6400 (LN-mode only)
      - 4 # ICM45605_DT_GYRO_ODR_3200 (LN-mode only)
      - 5 # ICM45605_DT_GYRO_ODR_1600 (LN-mode only)
      - 6 # ICM45605_DT_GYRO_ODR_800 (LN-mode only)
      - 7 # ICM45605_DT_GYRO_ODR_400
      - 8 # ICM45605_DT_GYRO_ODR_200
      - 9 # ICM45605_DT_GYRO_ODR_100
      - 10 # ICM45605_DT_GYRO_ODR_50
      - 11 # ICM45605_DT_GYRO_ODR_25
      - 12 # ICM45605_DT_GYRO_ODR_12_5
      - 13 # ICM45605_DT_GYRO_ODR_6_25 (LP-mode only)
      - 14 # ICM45605_DT_GYRO_ODR_3_125 (LP-mode only)
      - 15 # ICM45605_DT_GYRO_ODR_1_5625 (LP-mode only)

  gyro-fs:
    type: int
    default: 0
    description: |
      Specify the gyro range in degrees per second.
      Default is power-up configuration.
    enum:
      - 0 # ICM45605_DT_GYRO_FS_2000
      - 1 # ICM45605_DT_GYRO_FS_1000
      - 2 # ICM45605_DT_GYRO_FS_500
      - 3 # ICM45605_DT_GYRO_FS_250
      - 4 # ICM45605_DT_GYRO_FS_125
      - 5 # ICM45605_DT_GYRO_FS_62_5
      - 6 # ICM45605_DT_GYRO_FS_31_25
      - 7 # ICM45605_DT_GYRO_FS_15_625

  gyro-lpf:
    type: int
    default: 0
    description: |
      Specify the gyro low pass filter cut-off frequency
      as a fraction of the output data rate.
      Default is power-up configuration.
    enum:
      - 0 # ICM45605_DT_GYRO_LPF_BW_OFF
      - 1 # ICM45605_DT_GYRO_LPF_BW_1_4
      - 2 # ICM45605_DT_GYRO_LPF_BW_1_8
      - 3 # ICM45605_DT_GYRO_LPF_BW_1_16
      - 4 # ICM45605_DT_GYRO_LPF_BW_1_32
      - 5 # ICM45605_DT_GYRO_LPF_BW_1_64
      - 6 # ICM45605_DT_GYRO_LPF_BW_1_128

  fifo-watermark:
    type: int
    default: 0
    description: |
      Specify the FIFO watermark level in frame count.
      Default is power-up configuration (disabled).
      Valid range: 0 - 104

  fifo-watermark-equals:
    type: boolean
    description: |
      This value changes the FIFO watermark interrupt behavior by only triggering when the number
      of samples is equal to the threshold (count = watermark).

      Otherwise, it will generate interrupts when the level is greater or equals the FIFO Watermark
      Threshold (count >= watermark).
```

## dts/bindings/sensor/invensense,icm45686-common.yaml
```yaml
# Copyright (c) 2024 Intel Corporation
# Copyright (c) 2025 Croxel Inc.
# Copyright (c) 2025 CogniPilot Foundation
# Copyright (c) 2026 TDK Invensense
# SPDX-License-Identifier: Apache-2.0

properties:
  accel-fs:
    type: int
    default: 0
    description: |
      Specify the accelerometer range in g.
      Default is power-up configuration.
    enum:
      - 0 # ICM45686_DT_ACCEL_FS_32
      - 1 # ICM45686_DT_ACCEL_FS_16
      - 2 # ICM45686_DT_ACCEL_FS_8
      - 3 # ICM45686_DT_ACCEL_FS_4
      - 4 # ICM45686_DT_ACCEL_FS_2

  gyro-fs:
    type: int
    default: 0
    description: |
      Specify the gyro range in degrees per second.
      Default is power-up configuration.
    enum:
      - 0 # ICM45686_DT_GYRO_FS_4000
      - 1 # ICM45686_DT_GYRO_FS_2000
      - 2 # ICM45686_DT_GYRO_FS_1000
      - 3 # ICM45686_DT_GYRO_FS_500
      - 4 # ICM45686_DT_GYRO_FS_250
      - 5 # ICM45686_DT_GYRO_FS_125
      - 6 # ICM45686_DT_GYRO_FS_62_5
      - 7 # ICM45686_DT_GYRO_FS_31_25
      - 8 # ICM45686_DT_GYRO_FS_15_625

include: invensense,icm45600-common.yaml
```

## dts/bindings/sensor/invensense,icm45686-spi.yaml
```yaml
# Copyright (c) 2025 Croxel Inc.
# SPDX-License-Identifier: Apache-2.0

description: |
    ICM45686 High-precision 6-axis motion tracking device
    When setting the accel-pm, accel-range, accel-odr, gyro-pm, gyro-range,
    gyro-odr properties in a .dts or .dtsi file you may include icm45686.h
    and use the macros defined there.

    Example:
    #include <zephyr/dt-bindings/sensor/icm45686.h>

    &spi0 {
      ...

      icm42688: icm45686@0 {
        ...

        accel-pwr-mode = <ICM45686_DT_ACCEL_LN>;
        accel-fs = <ICM45686_DT_ACCEL_FS_32>;
        accel-odr = <ICM45686_DT_ACCEL_ODR_800>;
        gyro-pwr-mode= <ICM45686_DT_GYRO_LN>;
        gyro-fs = <ICM45686_DT_GYRO_FS_4000>;
        gyro-odr = <ICM45686_DT_GYRO_ODR_800>;
      };
    };

compatible: "invensense,icm45686"

include: ["spi-device.yaml", "invensense,icm45686-common.yaml"]
```
