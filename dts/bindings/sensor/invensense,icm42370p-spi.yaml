## dts/bindings/sensor/invensense,icm42370p-spi.yaml
```yaml
# Copyright (c) 2022 Esco Medical ApS
# Copyright (c) 2020 TDK Invensense
# SPDX-License-Identifier: Apache-2.0

description: ICM-42370-P motion tracking device

compatible: "invensense,icm42370p"

include: [spi-device.yaml, "invensense,icm42x70.yaml"]
```

## dts/bindings/sensor/invensense,icm42605.yaml
```yaml
# Copyright (c) 2020 TDK Invensense
# SPDX-License-Identifier: Apache-2.0

description: ICM-42605 motion tracking device

# ICM-42605 is SPI.
compatible: "invensense,icm42605"

include: spi-device.yaml

properties:
    int-gpios:
      type: phandle-array
      required: true
      description: |
        The INT signal default configuration is active-high.  The
        property value should ensure the flags properly describe the
        signal that is presented to the driver.

    accel-hz:
      type: int
      required: false
      default: 12
      description: |
        Default frequency of accelerometer. (Unit - Hz)
        Maps to ACCEL_ODR field in ACCEL_CONFIG0 setting
      enum:
        - 1
        - 3
        - 6
        - 12
        - 25
        - 50
        - 100
        - 200
        - 500
        - 1000
        - 2000
        - 4000
        - 8000

    gyro-hz:
      type: int
      required: false
      default: 12
      description: |
        Default frequency of gyroscope. (Unit - Hz)
        Maps to GYRO_ODR field in GYRO_CONFIG0 setting
      enum:
        - 12
        - 25
        - 50
        - 100
        - 200
        - 500
        - 1000
        - 2000
        - 4000
        - 8000

    accel-fs:
      type: int
      required: false
      default: 16
      description: |
        Default full scale of accelerometer. (Unit - g)
        Maps to ACCEL_FS_SEL field in ACCEL_CONFIG0 setting
      enum:
        - 16
        - 8
        - 4
        - 2

    gyro-fs:
      type: int
      required: false
      default: 2000
      description: |
        Default full scale of gyroscope. (Unit - DPS)
        Maps to GYRO_FS_SEL field in GYRO_CONFIG0 setting
      enum:
        - 2000
        - 1000
        - 500
        - 250
        - 125
        - 62.5
        - 31.25
        - 15.625
```

## dts/bindings/sensor/invensense,icm42670-common.yaml
```yaml
# Copyright (c) 2024 TDK Invensense
# SPDX-License-Identifier: Apache-2.0

include: [sensor-device.yaml]

properties:
  int-gpios:
    type: phandle-array
    required: true
    description: |
      The INT signal default configuration is active-high.  The
      property value should ensure the flags properly describe the
      signal that is presented to the driver.

  power-mode:
    type: string
    default: "low noise"
    description: |
      Power mode.
      Low power mode is allowed for accelerometer sensor only from
      1.5625Hz to 400Hz.
      The default is chosen to support both accelerometer and
      gyroscope sensors.
    enum:
      - "low noise"
      - "low power"

  accel-hz:
    type: int
    default: 800
    description: |
      Accelerometer frequency. (Unit - Hz)
      Maps to ACCEL_ODR field in ACCEL_CONFIG0 setting.
      The default corresponds to the reset value of the register field.
    enum:
      - 0
      - 1600
      - 800
      - 400
      - 200
      - 100
      - 50
      - 25
      - 12
      - 6
      - 3
      - 1

  accel-fs:
    type: int
    default: 16
    description: |
      Accelerometer full scale. (Unit - g)
      Maps to ACCEL_UI_FS_SEL field in ACCEL_CONFIG0 setting.
      The default corresponds to the reset value of the register field.
    enum:
      - 16
      - 8
      - 4
      - 2

  accel-avg:
    type: int
    default: 32
    description: |
      Averaging filter setting to create accelerometer output
      in accelerometer low power mode.
      Maps to ACCEL_UI_AVG field in ACCEL_CONFIG1 setting.
      The default corresponds to the reset value of the register field.
    enum:
      - 2
      - 4
      - 8
      - 16
      - 32
      - 64

  accel-filt-bw:
    type: int
    default: 180
    description: |
      Accelerometer low pass filter bandwidth frequency.
      Maps to ACCEL_UI_FILT_BW field in ACCEL_CONFIG1 setting.
      The default corresponds to the reset value of the register field.
    enum:
      - 0
      - 180
      - 121
      - 73
      - 53
      - 34
      - 25
      - 16

  gyro-hz:
    type: int
    default: 800
    description: |
      Gyroscope frequency. (Unit - Hz)
      Maps to GYRO_ODR field in GYRO_CONFIG0 setting.
      The default corresponds to the reset value of the register field.
    enum:
      - 0
      - 1600
      - 800
      - 400
      - 200
      - 100
      - 50
      - 25
      - 12

  gyro-fs:
    type: int
    default: 2000
    description: |
      Gyroscope full scale. (Unit - DPS)
      Maps to GYRO_UI_FS_SEL field in GYRO_CONFIG0 setting.
      The default corresponds to the reset value of the register field.
    enum:
      - 2000
      - 1000
      - 500
      - 250

  gyro-filt-bw:
    type: int
    default: 180
    description: |
      Gyroscope low pass filter bandwidth frequency.
      Maps to GYRO_UI_FILT_BW field in GYRO_CONFIG1 setting.
      The default corresponds to the reset value of the register field.
    enum:
      - 0
      - 180
      - 121
      - 73
      - 53
      - 34
      - 25
      - 16
```

## dts/bindings/sensor/invensense,icm42670-i2c.yaml
```yaml
# Copyright (c) 2024 Espressif Systems (Shanghai) Co., Ltd.
# SPDX-License-Identifier: Apache-2.0

description: ICM-42670 motion tracking device

compatible: "invensense,icm42670"

include: [i2c-device.yaml, "invensense,icm42670.yaml"]
```

## dts/bindings/sensor/invensense,icm42670-spi.yaml
```yaml
# Copyright (c) 2022 Esco Medical ApS
# Copyright (c) 2020 TDK Invensense
# SPDX-License-Identifier: Apache-2.0

description: ICM-42670 motion tracking device

compatible: "invensense,icm42670"

include: [spi-device.yaml, "invensense,icm42670.yaml"]
```

## dts/bindings/sensor/invensense,icm42670.yaml
```yaml
# Copyright (c) 2024 TDK Invensense
# Copyright (c) 2022 Esco Medical ApS
# Copyright (c) 2020 TDK Invensense
# SPDX-License-Identifier: Apache-2.0

description: ICM-42670 motion tracking device

include: [sensor-device.yaml]

properties:
  int-gpios:
    type: phandle-array
    description: |
      The INT signal default configuration is active-high. The
      property value should ensure the flags properly describe the
      signal that is presented to the driver.

  accel-hz:
    type: int
    required: true
    description: |
      Default frequency of accelerometer. (Unit - Hz)
      Maps to ACCEL_ODR field in ACCEL_CONFIG0 setting
      Power-on reset value is 800.
    enum:
      - 0
      - 1600
      - 800
      - 400
      - 200
      - 100
      - 50
      - 25
      - 12
      - 6
      - 3
      - 1

  gyro-hz:
    type: int
    required: true
    description: |
      Default frequency of gyroscope. (Unit - Hz)
      Maps to GYRO_ODR field in GYRO_CONFIG0 setting
      Power-on reset value is 800.
    enum:
      - 0
      - 1600
      - 800
      - 400
      - 200
      - 100
      - 50
      - 25
      - 12

  power-mode:
    type: string
    default: "low-noise"
    description: |
      Power mode.
      Low power mode is allowed for accelerometer sensor only from
      1.5625Hz to 400Hz.
      The default is chosen to support both accelerometer and
      gyroscope sensors.
    enum:
      - "low-noise"
      - "low-power"


  accel-fs:
    type: int
    required: true
    description: |
      Default full scale of accelerometer. (Unit - g)
      Maps to ACCEL_FS_SEL field in ACCEL_CONFIG0 setting
      Power-on reset value is 16
    enum:
      - 16
      - 8
      - 4
      - 2

  accel-avg:
    type: int
    default: 32
    description: |
      Averaging filter setting to create accelerometer output
      in accelerometer low power mode.
      Maps to ACCEL_UI_AVG field in ACCEL_CONFIG1 setting.
      The default corresponds to the reset value of the register field.
    enum:
      - 2
      - 4
      - 8
      - 16
      - 32
      - 64

  accel-filt-bw-hz:
    type: int
    default: 180
    description: |
      Accelerometer low pass filter bandwidth frequency (Unit - Hz).
      Maps to ACCEL_UI_FILT_BW field in ACCEL_CONFIG1 setting.
      The default corresponds to the reset value of the register field.
    enum:
      - 0
      - 180
      - 121
      - 73
      - 53
      - 34
      - 25
      - 16


  gyro-fs:
    type: int
    required: true
    description: |
      Default full scale of gyroscope. (Unit - DPS)
      Maps to GYRO_FS_SEL field in GYRO_CONFIG0 setting
      Power-on reset value is 2000
    enum:
      - 2000
      - 1000
      - 500
      - 250

  gyro-filt-bw-hz:
    type: int
    default: 180
    description: |
      Gyroscope low pass filter bandwidth frequency (Unit - Hz).
      Maps to GYRO_UI_FILT_BW field in GYRO_CONFIG1 setting.
      The default corresponds to the reset value of the register field.
    enum:
      - 0
      - 180
      - 121
      - 73
      - 53
      - 34
      - 25
      - 16

  apex:
    type: string
    default: "none"
    description: |
      APEX (Advanced Pedometer and Event Detection) features. It consists of:
      * Pedometer: Tracks step count, and provide details such as the cadence and
                   the estimated activity type (Walk, Run, Unknown).
      * Tilt Detection: Detects the Tilt when tilting the board with an angle of
                        30 degrees or more held for 4 seconds.
      * Wake on Motion (WoM): Detects motion per axis exceeding 195 mg threshold.
      * Significant Motion Detector (SMD): Detects when the user has moved significantly.
    enum:
      - "none"
      - "pedometer"
      - "tilt"
      - "smd"
      - "wom"
```

## dts/bindings/sensor/invensense,icm42670p-i2c.yaml
```yaml
# Copyright (c) 2024 Espressif Systems (Shanghai) Co., Ltd.
# SPDX-License-Identifier: Apache-2.0

description: ICM-42670-P motion tracking device

compatible: "invensense,icm42670p"

include: [i2c-device.yaml, "invensense,icm42670.yaml"]
```

## dts/bindings/sensor/invensense,icm42670p-spi.yaml
```yaml
# Copyright (c) 2022 Esco Medical ApS
# Copyright (c) 2020 TDK Invensense
# SPDX-License-Identifier: Apache-2.0

description: ICM-42670-P motion tracking device

compatible: "invensense,icm42670p"

include: [spi-device.yaml, "invensense,icm42670.yaml"]
```

## dts/bindings/sensor/invensense,icm42670s-spi.yaml
```yaml
# Copyright (c) 2022 Esco Medical ApS
# Copyright (c) 2020 TDK Invensense
# SPDX-License-Identifier: Apache-2.0

description: ICM-42670-S motion tracking device

compatible: "invensense,icm42670s"

include: [spi-device.yaml, "invensense,icm42670.yaml"]
```

## dts/bindings/sensor/invensense,icm42686.yaml
```yaml
# Copyright (c) 2024 Intel Corporation
# Copyright (c) 2022 Esco Medical ApS
# Copyright (c) 2020 TDK Invensense
# Copyright 2024 NXP
# SPDX-License-Identifier: Apache-2.0

description: |
    ICM-42686 motion tracking device.
    The properties included in this bindings file are the ones which
    are different in different models. Common ones are in icm4268x.yaml.
    When setting the accel-pwr-mode, accel-fs, accel-odr, gyro-pwr-mode,
    gyro-fs, gyro-odr properties in a .dts or .dtsi file you may include
    icm4268x.h and use the macros defined there.

    Example:
    #include <zephyr/dt-bindings/sensor/icm4268x.h>

    icm42686: icm42686@0 {
      ...

      accel-pwr-mode = <ICM4268X_DT_ACCEL_LN>;
      accel-fs = <ICM42686_DT_ACCEL_FS_32>;
      accel-odr = <ICM4268X_DT_ACCEL_ODR_2000>;
      gyro-pwr-mode= <ICM4268X_DT_GYRO_LN>;
      gyro-fs = <ICM42686_DT_GYRO_FS_2000>;
      gyro-odr = <ICM4268X_DT_GYRO_ODR_2000>;
    };

    Where,
    ICM42686_DT_GYRO_FS_2000 represents +-2000 deg per sec
    as the full scale range of the gyroscope.

    ICM42686_DT_ACCEL_FS_32 represents +-32 times g as the maximum
    acceleration this device can measure.

compatible: "invensense,icm42686"
include: invensense,icm4268x-common.yaml

properties:
  accel-fs:
    type: int
    default: 0
    description: |
      Specify the accelerometer range in g.
      Default accel full scale as recommended in manufacturer datasheet is 32g.

      0 # ICM42686_DT_ACCEL_FS_32
      1 # ICM42686_DT_ACCEL_FS_16
      2 # ICM42686_DT_ACCEL_FS_8
      3 # ICM42686_DT_ACCEL_FS_4
      4 # ICM42686_DT_ACCEL_FS_2

    enum: [0, 1, 2, 3, 4]

  gyro-fs:
    type: int
    default: 0
    description: |
      Specify the gyro range in degrees per second.
      Default gyro full scale as recommended in manufacturer datasheet is 4000 degrees per second.

      0 # ICM42686_DT_GYRO_FS_4000
      1 # ICM42686_DT_GYRO_FS_2000
      2 # ICM42686_DT_GYRO_FS_1000
      3 # ICM42686_DT_GYRO_FS_500
      4 # ICM42686_DT_GYRO_FS_250
      5 # ICM42686_DT_GYRO_FS_125
      6 # ICM42686_DT_GYRO_FS_62_5
      7 # ICM42686_DT_GYRO_FS_31_25

    enum: [0, 1, 2, 3, 4, 5, 6, 7]
```

## dts/bindings/sensor/invensense,icm42688-i2c.yaml
```yaml
# Copyright (c) 2025 ZARM, University Bremen
# Copyright (c) 2024 Intel Corporation
# Copyright (c) 2022 Esco Medical ApS
# Copyright (c) 2020 TDK Invensense
# SPDX-License-Identifier: Apache-2.0

description: |
    ICM-42688 motion tracking device

compatible: "invensense,icm42688"

include: ["i2c-device.yaml", "invensense,icm42688-common.yaml"]
```

## dts/bindings/sensor/invensense,icm42688.yaml
```yaml
# Copyright (c) 2024 Intel Corporation
# Copyright (c) 2022 Esco Medical ApS
# Copyright (c) 2020 TDK Invensense
# Copyright (c) 2025 Croxel, Inc.
# SPDX-License-Identifier: Apache-2.0

description: |
    ICM-42688 motion tracking device.

    When setting the accel-pm, accel-range, accel-odr, gyro-pm, gyro-range,
    gyro-odr properties in a .dts or .dtsi file you may include icm42688.h
    and use the macros defined there.

    Example:
    #include <zephyr/dt-bindings/sensor/icm42688.h>

    icm42688: icm42688@0 {
      compatible = "invensense,icm42688", "invensense,icm4268x"
      ...

      accel-pwr-mode = <ICM42688_DT_ACCEL_LN>;
      accel-fs = <ICM42688_DT_ACCEL_FS_16>;
      accel-odr = <ICM42688_DT_ACCEL_ODR_2000>;
      gyro-pwr-mode= <ICM42688_DT_GYRO_LN>;
      gyro-fs = <ICM42688_DT_GYRO_FS_2000>;
      gyro-odr = <ICM42688_DT_GYRO_ODR_2000>;
    };
compatible: "invensense,icm42688"
include: ["invensense,icm4268x.yaml"]
```
