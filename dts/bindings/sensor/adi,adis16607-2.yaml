## dts/bindings/sensor/ams,as7341.yaml
```yaml
# Copyright (c) 2026 Dotcom IoT LLP
# SPDX-License-Identifier: Apache-2.0

description: AMS AS7341 11-channel spectral color sensor

compatible: "ams,as7341"

include: [sensor-device.yaml, i2c-device.yaml]
```

## dts/bindings/sensor/ams,tcs34725.yaml
```yaml
description: TCS34725 color sensor

compatible: "ams,tcs34725"

include: [sensor-device.yaml, i2c-device.yaml]

properties:
  gain:
    type: int
    default: 0
    description: |
      RGBC analog gain (AGAIN) setting.
      0 = 1x, 1 = 4x, 2 = 16x, 3 = 60x
    enum:
      - 0
      - 1
      - 2
      - 3

  atime:
    type: int
    default: 0xFF
    description: |
      RGBC integration time register (ATIME).
      Integration time (ms) = 2.4 * (256 - ATIME)

  wtime:
    type: int
    default: 0xFF
    description: |
      Wait time register (WTIME). Only used if wait-enable is set.
      Wait time (ms) = 2.4 * (256 - WTIME), or x12 if wlong is set.

  wlong:
    type: boolean
    description: |
      Extend wait cycles by 12x (datasheet CONFIG register, WLONG bit).

  wait-enable:
    type: boolean
    description: |
      Enable the Wait state between RGBC conversion cycles to reduce
      average power consumption (datasheet System Timing / Power
      Management sections).
```

## dts/bindings/sensor/ams,tmf8801.yaml
```yaml
# Copyright (c) 2026 Dotcom IoT LLP
# SPDX-License-Identifier: Apache-2.0

description: AMS TMF8801 ToF sensor

compatible: "ams,tmf8801"

include: [sensor-device.yaml, i2c-device.yaml]
```

## dts/bindings/sensor/ams,tsl2522.yaml
```yaml
# Copyright (c) 2026 Carl Zeiss Meditec AG
# SPDX-License-Identifier: Apache-2.0

description: |
  ams OSRAM TSL2522 ambient light sensing and light flicker detection sensor. See datasheet at
  https://look.ams-osram.com/m/297a255d37b15c/original/TSL2522-Highly-sensitive-ambient-light-sensor-with-light-flicker-detection.pdf

compatible: "ams,tsl2522"

include: [sensor-device.yaml, i2c-device.yaml]

properties:
  int-gpios:
    type: phandle-array
    description: |
      Identifies the interrupt pin

  measurement-time-steps:
    type: int
    default: 720
    min: 1
    max: 2048
    description: |
      ALS measurement time step. Sets the time in steps of 1.388889μs
      modulator clock.

  number-of-samples:
    type: int
    default: 64
    min: 1
    max: 2048
    description: |
      Number of samples taken in one conversion

  # Keep enums sorted, the driver depends on it.
  # modulator-gain-16X is the initial value, it can be changed during
  # runtime with SENSOR_ATTR_GAIN
  modulator-gain:
    type: string
    default: modulator-gain-16X
    enum:
      - modulator-gain-half
      - modulator-gain-1X
      - modulator-gain-2X
      - modulator-gain-4X
      - modulator-gain-8X
      - modulator-gain-16X
      - modulator-gain-32X
      - modulator-gain-64X
      - modulator-gain-128X
      - modulator-gain-256X
      - modulator-gain-512X
      - modulator-gain-1024X
      - modulator-gain-2048X
      - modulator-gain-4096X
    description: |
      Gain used in both modulators

  glass-attenuation:
    type: int
    default: 100000
    min: 0
    max: 5000000
    description: |
      Visible light attenuation.
      Integer value for a representation with 5 decimal points.
      This default value (1.00000) is chosen for free open space (no glass).
      Example: 1.2 would be 120000

  glass-ir-attenuation:
    type: int
    default: 100000
    min: 0
    max: 5000000
    description: |
      Infra-red light attenuation.
      Integer value for a representation with 5 decimal points.
      This default value (1.00000) is chosen for free open space (no glass).
      Example: 1.2 would be 120000
```

## dts/bindings/sensor/asahi-kasei,ak09940a-common.yaml
```yaml
# SPDX-FileCopyrightText: Copyright The Zephyr Project Contributors
# SPDX-License-Identifier: Apache-2.0

include: sensor-device.yaml

properties:
  reset-gpios:
    type: phandle-array
    description: |
      GPIO connected to the RSTN pin. RSTN is active low, so the flags should
      include GPIO_ACTIVE_LOW. The sensor is reset through this pin at
      initialization, and through its soft reset register when the property
      is absent.

  sensor-drive:
    type: string
    default: "low-power-1"
    enum:
      - "low-power-1"
      - "low-power-2"
      - "low-noise-1"
      - "low-noise-2"
      - "ultra-low-power"
    description: |
      Sensor drive, trading current consumption for noise. It also bounds the
      sampling frequency available in continuous measurement mode:
      - low-power-1: up to 1000 Hz
      - low-power-2: up to 400 Hz
      - low-noise-1 and low-noise-2: up to 200 Hz
      - ultra-low-power: up to 2500 Hz
      The default is the power-on setting of the sensor.
```

## dts/bindings/sensor/asahi-kasei,ak09940a-i2c.yaml
```yaml
# SPDX-FileCopyrightText: Copyright The Zephyr Project Contributors
# SPDX-License-Identifier: Apache-2.0

title: Asahi Kasei AK09940A 3-axis Electronic Magnetometer (I2C)

description: |
  Ultrahigh precision 3-axis TMR magnetometer with 18-bit output and a
  temperature sensor. See
  https://www.akm.com/global/en/products/tri-axis-magnetic-sensor/lineup-tri-axis-magnetic-sensor/ak09940a/

compatible: "asahi-kasei,ak09940a"

include: [i2c-device.yaml, "asahi-kasei,ak09940a-common.yaml"]

examples:
  - |
    &i2c0 {
        magnetometer@c {
            compatible = "asahi-kasei,ak09940a";
            reg = <0x0c>;
            reset-gpios = <&gpio0 5 GPIO_ACTIVE_LOW>;
            sensor-drive = "low-noise-1";
        };
    };
```

## dts/bindings/sensor/avago,apds9960.yaml
```yaml
# Copyright (c) 2018, Phytec Messtechnik GmbH
# SPDX-License-Identifier: Apache-2.0

description: APDS9960 digital proximity, ambient light, RGB, and gesture sensor

compatible: "avago,apds9960"

include: [sensor-device.yaml, i2c-device.yaml]

properties:
  int-gpios:
    type: phandle-array
    description: Interrupt pin.

      The interrupt pin of APDS9960 is open-drain, active low.
      If connected directly the MCU pin should be configured
      as pull-up, active low.

  pled-boost:
    type: int
    default: 150
    description: |
      Additional LDR current during proximity and gesture LED pulses, as a
      percentage of the current LDRIVE selects. The default favours range over
      power; raise it when cover glass attenuates the LED.
    enum:
      - 100
      - 150
      - 200
      - 300

  pgain:
    type: int
    default: 2
    description: |
      Proximity gain, as a multiplier. The driver's proximity thresholds are
      set against the default; raise it to detect objects further away, and
      lower it if nearby objects saturate the proximity ADC.
    enum:
      - 1
      - 2
      - 4
      - 8

  again:
    type: int
    default: 4
    description: |
      ALS and color gain, as a multiplier. The default leaves the clear channel
      headroom in ordinary indoor light; raise it for dim environments, and
      lower it if the clear channel saturates.
    enum:
      - 1
      - 4
      - 16
      - 64

  ppulse-length:
    type: int
    default: 8
    description: |
      LED-on pulse width during a proximity LDR pulse, in microseconds. The
      default matches the sensor's reset value and the datasheet's proximity
      test conditions; longer pulses gather more signal per pulse.
    enum:
      - 4
      - 8
      - 16
      - 32

  ppulse-count:
    type: int
    default: 8
    min: 1
    max: 64
    description: |
      Number of proximity pulses emitted per proximity measurement. The default
      is the driving condition the datasheet recommends; other counts trade
      measurement time and average LED current against range.

  proximity:
    type: int
    description: Gesture Proximity Enter Threshold
    default: 40

  ir-difference:
    type: int
    description: Minimum IR diode difference for gesture
    default: 5
```

## dts/bindings/sensor/bosch,bma400-common.yaml
```yaml
# Copyright (c) 2026 Luca Gessi
# SPDX-License-Identifier: Apache-2.0

include: [sensor-device.yaml]

properties:

  int1-gpios:
    type: phandle-array
    description: |
      GPIO to which the sensor INT1 line is connected. All interrupt sources
      (FIFO watermark, FIFO full, motion/GEN2) are mapped onto INT1 and served
      by a single RTIO chain that reads the global INT_STAT0 register, so a
      second interrupt pin is not used.

  auto-wakeup-num-of-samples:
    type: int
    default: 0
    description: |
      Specify the number of samples for auto wakeup mode in ticks.
      The default corresponds to the reset value of the register field.
      Valid range: 0 - 7
    enum: [0, 1, 2, 3, 4, 5, 6, 7]

  auto-lowpower-en:
    type: boolean
    description: |
      Auto low power functionality

  auto-wakeup-en:
    type: boolean
    description: |
      Auto wakeup functionality

  auto-wakeup-threshold:
    type: int
    default: 0
    description: |
      Specify the threshold for auto wakeup mode.
      The default corresponds to the reset value of the register field.
      Valid range: 0 - 255

  auto-lowpower-threshold:
    type: int
    default: 0
    description: |
      Specify the threshold for inactivity detection for auto low power mode.
      The default corresponds to the reset value of the register field.
      Valid range: 0 - 255

  auto-lowpower-duration:
    type: int
    default: 0
    description: |
      Specify the default duration for inactivity detection for auto low power mode in ticks.
      The default corresponds to the reset value of the register field.
      Valid range: 0 - 65535

  fullscale-range:
    type: int
    default: 1
    description: |
      Selects the full scale range for the bma400.
      The default corresponds to the reset value of the register field.
      0: +- 2g
      1: +- 4g (default)
      2: +- 8g
      3: +- 16g
    enum: [0, 1, 2, 3]

  odr:
    type: int
    default: 4
    description: |
      Selects the output data rate for the bma400.
      The default corresponds to the reset value of the register field.
      0: 12.5Hz
      1: 25Hz
      2: 50Hz
      3: 100Hz
      4: 200Hz (default)
      5: 400Hz
      6: 800Hz
    enum: [0, 1, 2, 3, 4, 5, 6]

  filt1-bw:
    type: int
    default: 0
    description: |
      Selects the bandwidth for the first filter stage.
      The default corresponds to the reset value of the register field.
      0: 0.4xODR
      1: 0.2xODR
    enum: [0, 1]

  osr-lp:
    type: int
    default: 0
    description: |
      Select the oversampling ratio for low power mode.
      The default corresponds to the reset value of the register field.
      0: lowest power, lowest oversampling rate, lowest accuracy
      3: highest accuracy, highest oversampling rate, highest power settings 0, 1, 2 and 3 allow
        linearly trading power versus accuracy(noise
    enum: [0, 1, 2, 3]

  motion-threshold:
    type: int
    default: 0
    description: |
      Motion detection threshold in 8 mg/LSB.
      The default corresponds to the reset value of the register field.
      Valid range: 0 - 255

  motion-duration:
    type: int
    default: 0
    description: |
      Motion duration in ticks.
      The timebase for the ticks is determined by the output data rate (ODR) of the sensor.
      The default corresponds to the reset value of the register field.
      Valid range: 0 - 65535

  fifo-watermark:
    type: int
    default: 0
    description: |
      FIFO watermark level in bytes.
      The default corresponds to the reset value of the register field.
      Valid range: 0 - 2047
```

## dts/bindings/sensor/bosch,bme680-i2c.yaml
```yaml
# Copyright (c) 2018, Bosch Sensortec GmbH
# SPDX-License-Identifier: Apache-2.0

title: Bosch BME680 Environmental Sensor (I2C)

description: |
    The BME680 is an integrated environmental sensor that measures
    temperature, pressure, humidity and air quality. The driver also
    supports the BME688, detected at runtime from the variant ID
    register.

compatible: "bosch,bme680"

include: [sensor-device.yaml, i2c-device.yaml]
```

## dts/bindings/sensor/bosch,bme680-spi.yaml
```yaml
# Copyright (c) 2022, Leonard Pollak
# SPDX-License-Identifier: Apache-2.0

title: Bosch BME680 Environmental Sensor (SPI)

description: |
    The BME680 is an integrated environmental sensor that measures
    temperature, pressure, humidity and air quality. The driver also
    supports the BME688 and BME690, detected at runtime from the
    variant ID register.

compatible: "bosch,bme680"

include: [sensor-device.yaml, spi-device.yaml]
```

## dts/bindings/sensor/bosch,bmi260-i2c.yaml
```yaml
# Copyright (c) 2021, Bosch Sensortec GmbH
# Copyright (c) 2022, Nordic Semiconductor ASA
# Copyright (c) 2026, Shreyas Acharya
# SPDX-License-Identifier: Apache-2.0

compatible: "bosch,bmi260"

include: [i2c-device.yaml, "bosch,bmi260.yaml"]
```

## dts/bindings/sensor/bosch,bmi260-spi.yaml
```yaml
# Copyright (c) 2022, Nordic Semiconductor ASA
# Copyright (c) 2026, Shreyas Acharya
# SPDX-License-Identifier: Apache-2.0

compatible: "bosch,bmi260"

include: ["spi-device.yaml", "bosch,bmi260.yaml"]
```
