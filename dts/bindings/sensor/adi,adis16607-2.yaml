## dts/bindings/sensor/adi,adis16607-2.yaml
```yaml
# Copyright (c) 2026 Analog Devices Inc.
# SPDX-License-Identifier: Apache-2.0

description: ADIS16607-2 6-DoF IMU, +/-450 deg/s gyroscope, +/-40 g accelerometer

compatible: "adi,adis16607-2"

include: adi,adis16607-common.yaml
```

## dts/bindings/sensor/adi,adis16607-3.yaml
```yaml
# Copyright (c) 2026 Analog Devices Inc.
# SPDX-License-Identifier: Apache-2.0

description: ADIS16607-3 6-DoF IMU, +/-2000 deg/s gyroscope, +/-40 g accelerometer

compatible: "adi,adis16607-3"

include: adi,adis16607-common.yaml
```

## dts/bindings/sensor/adi,adis16607-common.yaml
```yaml
# Copyright (c) 2026 Analog Devices Inc.
# SPDX-License-Identifier: Apache-2.0

description: |
  ADIS16607 6-Degrees-of-Freedom IMU (accelerometer + gyroscope)

  SPI half-duplex protocol: reads require two SPI transfers (CS toggled
  between), writes use a single 3-byte transfer. Burst reads keep CS
  asserted for the entire frame. Maximum SPI clock frequency is 15 MHz
  for burst reads; 2 MHz for individual register reads/writes.

  Example:
    &spi0 {
      adis16607: adis16607@0 {
        compatible = "adi,adis16607-3";
        reg = <0>;
        spi-max-frequency = <1000000>;
        spi-cpol;
        spi-cpha;
        drdy-gpios = <&gpio0 5 GPIO_ACTIVE_HIGH>;
      };
    };

include: spi-device.yaml

properties:
  drdy-gpios:
    type: phandle-array
    description: |
      Data ready interrupt output from the sensor. Active high.
      Connect to a GPIO input on the host. Needed for trigger support;
      omit when using polling mode.

  reset-gpios:
    type: phandle-array
    description: |
      Optional hardware reset pin. Active low: assert low to reset,
      release high for normal operation. If absent, software reset is used.

  odr:
    type: int
    description: |
      Output data rate in Hz. The driver computes DEC_RATE = (8000 / odr) - 1.
      Must be a divisor of 8000 (e.g. 8000, 4000, 2000, 1000, 500 ...).
      A value of 0 leaves the register at the power-on default (8 kHz).
    default: 0
```

## dts/bindings/sensor/adi,admt4000.yaml
```yaml
# Copyright (c) 2026 Analog Devices, Inc.
#
# SPDX-License-Identifier: Apache-2.0

description: ADMT4000 True Power-On Multiturn Sensor

compatible: "adi,admt4000"

include: [sensor-device.yaml, spi-device.yaml]

properties:
  busy-gpios:
    type: phandle-array
    description: GPIO to signal device busy status

  acalc-gpios:
    type: phandle-array
    description: GPIO for analog calculation enable/control

  coil-rs-gpios:
    type: phandle-array
    description: GPIO for coil reset control

  cnv-gpios:
    type: phandle-array
    description: GPIO for conversion trigger

  adi,vdd-variant:
    type: int
    description: Voltage variant selection (0 = 3.3V, 1 = 5V)
```

## dts/bindings/sensor/adi,adt7604.yaml
```yaml
# Copyright (c) 2026 Analog Devices Inc.
# SPDX-License-Identifier: Apache-2.0

description: |
  ADT7604 20-Channel Digital Temperature Measurement System

  The ADT7604 supports multiple sensor types including RTDs, thermocouples,
  thermistors, diodes, and direct ADC measurements across 20 channels.

examples:
  - |
    #include <zephyr/dt-bindings/sensor/adt7604.h>

    &spi0 {
        adt7604: adt7604@1 {
            compatible = "adi,adt7604";
            reg = <0>;
            spi-max-frequency = <1000000>;

            reset-gpios = <&gpio0 18 GPIO_ACTIVE_LOW>;
            int-gpios = <&gpio0 19 GPIO_ACTIVE_HIGH>;

            adi,mux-delay-config-us = <0>;
            adi,filter-notch-freq = "50-60hz";

            #address-cells = <1>;
            #size-cells = <0>;

            channel@2 {
                reg = <0x2>;
                adi,sensor-type = <ADT7604_SENSOR_TYPE_RSENSE>;
                adi,rsense-val = "100";
                adi,rsense-mohm;
            };

            channel@4 {
                reg = <0x4>;
                adi,sensor-type = <ADT7604_SENSOR_TYPE_COPPER_TRACE>;
                adi,rsense-channel = <12>;
                adi,excitation-current = <ADT7604_CT_EXCITATION_CURRENT_10_UA>;
                adi,sub-ohm;
            };

            channel@12 {
                reg = <0x12>;
                adi,sensor-type = <ADT7604_SENSOR_TYPE_RTD_PT_100>;
                adi,rsense-channel = <12>;
                adi,sensor-configuration = <ADT7604_RTD_CONFIG_2_WIRE_INTERNAL>;
                adi,excitation-current = <ADT7604_RTD_EXCITATION_CURRENT_1_MA>;
                adi,rtd-curve = "european-curve";
            };

            channel@e {
                reg = <0xe>;
                adi,sensor-type = <ADT7604_SENSOR_TYPE_LEAK_DETECTOR>;
                adi,rsense-channel = <12>;
                adi,excitation-current = <ADT7604_LEAK_EXCITATION_CURRENT_10_UA>;
            };

            channel@14 {
                reg = <0x14>;
                adi,sensor-type = <ADT7604_SENSOR_TYPE_THERMISTOR_44006>;
                adi,rsense-channel = <12>;
                adi,sensor-configuration = <ADT7604_THERMISTOR_CONFIG_DIFF_SHARE_NO_ROTATE>;
                adi,excitation-current = <ADT7604_THERMISTOR_EXCITATION_CURRENT_10_UA>;
            };
        };
    };

compatible: "adi,adt7604"

include: [sensor-device.yaml, spi-device.yaml]

properties:
  reset-gpios:
    type: phandle-array
    description: |
      Active low reset pin.

  int-gpios:
    type: phandle-array
    description: |
      Active high interrupt pin.

  adi,mux-delay-config-us:
    type: int
    default: 0
    description: |
      Multiplexer delay configuration in microseconds.
      Adds settling time between channel switches.

  adi,filter-notch-freq:
    type: string
    enum:
      - "50-60hz"
      - "60hz"
      - "50hz"
    default: "50-60hz"
    description: |
      Digital filter notch frequency for line noise rejection. Default is
      power-on setting ("50-60hz").
      - "50-60hz": Rejection of both 50Hz and 60Hz
      - "60hz": 60Hz rejection only
      - "50hz": 50Hz rejection only

child-binding:
  description: Channel configuration

  properties:
    reg:
      type: int
      min: 1
      max: 20
      required: true
      description: |
        Channel number (1-20)

    adi,sensor-type:
      type: int
      required: true
      description: |
        Sensor type for this channel. Use macros from dt-bindings/sensor/adt7604.h:
          ADT7604_SENSOR_TYPE_RTD_PT_10 (10) = RTD PT-10
          ADT7604_SENSOR_TYPE_RTD_PT_50 (11) = RTD PT-50
          ADT7604_SENSOR_TYPE_RTD_PT_100 (12) = RTD PT-100
          ADT7604_SENSOR_TYPE_RTD_PT_200 (13) = RTD PT-200
          ADT7604_SENSOR_TYPE_RTD_PT_500 (14) = RTD PT-500
          ADT7604_SENSOR_TYPE_RTD_PT_1000 (15) = RTD PT-1000
          ADT7604_SENSOR_TYPE_RTD_1000 (16) = RTD 1000
          ADT7604_SENSOR_TYPE_RTD_NI_120 (17) = RTD NI-120
          ADT7604_SENSOR_TYPE_COPPER_TRACE (18) = Copper Trace
          ADT7604_SENSOR_TYPE_THERMISTOR_44004 (19) = Thermistor 44004/44033
          ADT7604_SENSOR_TYPE_THERMISTOR_44005 (20) = Thermistor 44005/44030
          ADT7604_SENSOR_TYPE_THERMISTOR_44007 (21) = Thermistor 44007/44034
          ADT7604_SENSOR_TYPE_THERMISTOR_44006 (22) = Thermistor 44006/44031
          ADT7604_SENSOR_TYPE_THERMISTOR_44008 (23) = Thermistor 44008/44032
          ADT7604_SENSOR_TYPE_THERMISTOR_YSI_400 (24) = Thermistor YSI-400
          ADT7604_SENSOR_TYPE_THERMISTOR_SPECTRUM (25) = Thermistor Spectrum
          ADT7604_SENSOR_TYPE_THERMISTOR_CUSTOM (26) = Thermistor Custom
          ADT7604_SENSOR_TYPE_LEAK_DETECTOR (27) = Leak Detector
          ADT7604_SENSOR_TYPE_RSENSE (29) = Sense Resistor

    adi,rsense-channel:
      type: int
      default: 0
      description: |
        Reference sense resistor channel number for RTD, thermistor,
        copper trace, or custom sensor types. Must point to a channel
        configured as sense resistor (type 29).

    adi,rsense-val:
      type: string
      default: "0"
      description: |
        Value of the reference sense resistor in ohms or mohms. Ohm values
        can be fractional. Valid only if the sensor type is a sense resistor
        (type 29).

    adi,rsense-mohm:
      type: boolean
      description: |
        Indicates whether the reference sense resistor value is specified in milliohms.

    adi,sensor-configuration:
      type: int
      default: 0
      description: |
        Sensor configuration bit value. Use macros from dt-bindings/sensor/adt7604.h:
        - RTD sensors: ADT7604_RTD_CONFIG_* (wire type + excitation mode)
        - Thermistors: ADT7604_THERMISTOR_CONFIG_* (differential/single-ended + sharing)
        - Copper trace: Fixed value 0x9
        - Leak sensor: Fixed value 0x1
        Default 0 = basic configuration.

    adi,excitation-current:
      type: int
      default: 0
      description: |
        Excitation current bit value for the sensor. Use macros from
        dt-bindings/sensor/adt7604.h for correct values:
        - RTD sensors: ADT7604_RTD_EXCITATION_CURRENT_* (5µA to 1mA)
        - Copper trace ≥1Ω: ADT7604_CT_EXCITATION_CURRENT_* (5µA to 1mA)
        - Thermistors: ADT7604_THERMISTOR_EXCITATION_CURRENT_* (250nA to 1mA, AUTO)
        - Leak sensors: ADT7604_LEAK_EXCITATION_CURRENT_* (250nA to 1mA)
        Default 0 = reserved/disabled.

    adi,rtd-curve:
      type: string
      enum:
        - "european-curve"
        - "american"
        - "japanese"
        - "its-90"
        - "rtd1000-375"
        - "ni-120"
      default: "european-curve"
      description: |
        RTD curve type for this channel. See the datasheet for corresponding
        Callendar-Van Dusen coefficients. Valid only if the sensor type is an RTD.

    adi,sub-ohm:
      type: boolean
      description: |
        Indicates whether the resistance of copper trace sensor tied to ADT7604 is
        in sub-ohms (e.g. 0.25ohms). Valid only if the sensor type is a copper
        trace resistor (type 18).
        Note: Custom sensor data table address and length are automatically managed
        at runtime when adt7604_write_custom_sensor_data_table() is called.
```

## dts/bindings/sensor/adi,adxl313.yaml
```yaml
# Copyright (c) 2026 RAKwireless Technology Limited
# SPDX-License-Identifier: Apache-2.0

description: |
  ADXL313 3-axis I2C accelerometer.
  When setting the accelerometer DTS properties, include adxl313.h and use the
  macros defined there.

  SENSOR_ATTR_FULL_SCALE uses integer g via sensor_ms2_to_g(). Because ±0.5 g
  cannot be represented as a non-zero integer g, pass a value that rounds to 0
  (for example 0.5 g in m/s^2) to select the ±0.5 g range.

compatible: "adi,adxl313"

include: ["i2c-device.yaml", "sensor-device.yaml"]

properties:
  range:
    type: int
    default: 2
    description: |
      Accelerometer measurement range.
      Default is ±2 g as a practical mid-range setting that covers ±1 g
      gravity with margin for moderate dynamics. Override for higher
      resolution (±0.5 g, the power-on reset value) or for ±4 g.
    enum:
      - 0 # ADXL313_DT_RANGE_0_5G
      - 1 # ADXL313_DT_RANGE_1G
      - 2 # ADXL313_DT_RANGE_2G
      - 3 # ADXL313_DT_RANGE_4G

  odr:
    type: int
    default: 10
    description: |
      Accelerometer sampling frequency (ODR). Default matches power-on reset
      (100 Hz).
    enum:
      - 6  # ADXL313_DT_ODR_6_25
      - 7  # ADXL313_DT_ODR_12_5
      - 8  # ADXL313_DT_ODR_25
      - 9  # ADXL313_DT_ODR_50
      - 10 # ADXL313_DT_ODR_100
      - 11 # ADXL313_DT_ODR_200
      - 12 # ADXL313_DT_ODR_400
      - 13 # ADXL313_DT_ODR_800
      - 14 # ADXL313_DT_ODR_1600
      - 15 # ADXL313_DT_ODR_3200

examples:
  - |
    #include <zephyr/dt-bindings/sensor/adxl313.h>

    adxl313: adxl313@53 {
      compatible = "adi,adxl313";
      reg = <0x53>;
      range = <ADXL313_DT_RANGE_2G>;
      odr = <ADXL313_DT_ODR_100>;
    };
```

## dts/bindings/sensor/adi,adxl373-i2c.yaml
```yaml
# Copyright (c) 2026 Jhonata Poma-Hansen
# SPDX-License-Identifier: Apache-2.0

description: |
  ADXL373 3-axis high-g accelerometer, accessed through I2C bus.

compatible: "adi,adxl373"

include: ["i2c-device.yaml", "adi,adxl372-common.yaml"]
```

## dts/bindings/sensor/adi,adxl373-spi.yaml
```yaml
# Copyright (c) 2026 Jhonata Poma-Hansen
# SPDX-License-Identifier: Apache-2.0

description: |
  ADXL373 3-axis high-g accelerometer, accessed through SPI bus.

compatible: "adi,adxl373"

include: ["spi-device.yaml", "adi,adxl372-common.yaml"]
```
