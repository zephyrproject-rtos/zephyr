## dts/bindings/sensor/bosch,bmi088.yaml
```yaml
# Copyright (c) 2018, Linaro Limited
# SPDX-License-Identifier: Apache-2.0

description: BMI088 inertial measurement unit

compatible: "bosch,bmi088"

include: spi-device.yaml
```

## dts/bindings/sensor/bosch,bmi08x-accel-i2c.yaml
```yaml
# Copyright (c) 2022 Meta Platforms, Inc. and its affiliates.
# SPDX-License-Identifier: Apache-2.0

description: BMI08X Accel inertial measurement unit

compatible: "bosch,bmi08x-accel"

include: [i2c-device.yaml, "bosch,bmi08x-accel.yaml"]
```

## dts/bindings/sensor/bosch,bmi08x-accel-spi.yaml
```yaml
# Copyright (c) 2022 Meta Platforms, Inc. and its affiliates.
# SPDX-License-Identifier: Apache-2.0

description: BMI08X Accel inertial measurement unit

compatible: "bosch,bmi08x-accel"

include: [spi-device.yaml, "bosch,bmi08x-accel.yaml"]
```

## dts/bindings/sensor/bosch,bmi08x-accel.yaml
```yaml
# Copyright (c) 2022 Meta Platforms, Inc. and its affiliates.
# SPDX-License-Identifier: Apache-2.0

description: BMI08X Accel inertial measurement unit

include: sensor-device.yaml

properties:
  int-gpios:
    type: phandle-array
    description: |
      This property specifies the connection for INT, because the
      Zephyr driver maps all interrupts to INT.  The signal defaults
      to output low when produced by the sensor.

  int1-map-io:
    type: int
    description: |
      Bit[0]: Map Interrupt A to INT1, Accel Data Ready
      Bit[1]: Map Interrupt B to INT1
      Bit[2]: Map Interrupt C to INT1

  int2-map-io:
    type: int
    description: |
      Bit[0]: Map Interrupt A to INT2, Accel Data Ready
      Bit[1]: Map Interrupt B to INT2
      Bit[2]: Map Interrupt C to INT2

  int1-conf-io:
    type: int
    description: |
      Bit[0]: reserved
      Bit[1]: if set to 1, INT1 is active high, otherwise it's active low
      Bit[2]: if set to 1, INT1 is open-drain, otherwise it's push-pull
      Bit[3]: if set to 1, enable INT1 as an output pin
      Bit[4]: if set to 1, enable INT1 as an input pin
      Bit[7:5] : reserved

  int2-conf-io:
    type: int
    description: |
      Bit[0]: reserved
      Bit[1]: if set to 1, INT2 is active high, otherwise it's active low
      Bit[2]: if set to 1, INT2 is open-drain, otherwise it's push-pull
      Bit[3]: if set to 1, enable INT2 as an output pin
      Bit[4]: if set to 1, enable INT2 as an input pin
      Bit[7:5] : reserved

  accel-hz:
    type: string
    required: true
    description: |
      Default frequency of accelerometer. (Unit - Hz)
    enum:
      - "12.5"
      - "25"
      - "50"
      - "100"
      - "200"
      - "400"
      - "800"
      - "1600"

  accel-fs:
    type: int
    required: true
    description: |
      Default full scale of accelerometer. (Unit - g)
    enum:
      - 2
      - 3
      - 4
      - 6
      - 8
      - 12
      - 16
      - 24

  data-sync:
    type: phandle
    description: |
      Enables data sync if defined. This is to point to the bmi08x-gyro definition
      that is within the same IC as the bmi08x-accel.
```

## dts/bindings/sensor/bosch,bmi08x-gyro-i2c.yaml
```yaml
# Copyright (c) 2022 Meta Platforms, Inc. and its affiliates.
# SPDX-License-Identifier: Apache-2.0

description: BMI08X Gyro inertial measurement unit

compatible: "bosch,bmi08x-gyro"

include: [i2c-device.yaml, "bosch,bmi08x-gyro.yaml"]
```

## dts/bindings/sensor/bosch,bmi08x-gyro.yaml
```yaml
# Copyright (c) 2022 Meta Platforms, Inc. and its affiliates.
# SPDX-License-Identifier: Apache-2.0

description: BMI08X Gyro inertial measurement unit

include: sensor-device.yaml

properties:
  int-gpios:
    type: phandle-array
    description: |
      This property specifies the connection for INT, because the
      Zephyr driver maps all interrupts to INT. The signal defaults
      to output low when produced by the sensor.

  int3-4-map-io:
    type: int
    description: |
      Bit[0] will map the data ready interrupt on INT3
      Bit[2] will map the fifo interrupt on INT3
      Bit[5] will map the fifo interrupt on INT4
      Bit[7] will enable the data ready interrupt on INT4

  int3-4-conf-io:
    type: int
    description: |
      Bit[0]: if set to 1, INT3 is active high, otherwise it's active low
      Bit[1]: if set to 1, INT3 is open-drain, otherwise it's push-pull
      Bit[2]: if set to 1, INT4 is active high, otherwise it's active low
      Bit[3]: if set to 1, INT4 is open-drain, otherwise it's push-pull

  gyro-hz:
    type: string
    required: true
    description: |
      Default frequency of accelerometer. (Unit - Hz)
    enum:
      - "2000_532"
      - "2000_230"
      - "1000_116"
      - "400_47"
      - "200_23"
      - "100_12"
      - "200_64"
      - "100_32"

  gyro-fs:
    type: int
    required: true
    description: |
      Default full scale of accelerometer. (Unit - g)
    enum:
      - 2000
      - 1000
      - 500
      - 250
      - 125

  data-sync:
    type: boolean
    description: |
      Enables data sync if defined. Must be set if bmi08x-accel data-sync is set as well.
```

## dts/bindings/sensor/bosch,bmi160-i2c.yaml
```yaml
# Copyright (c) 2018, Linaro Limited
# SPDX-License-Identifier: Apache-2.0

description: BMI160 inertial measurement unit

compatible: "bosch,bmi160"

include: [i2c-device.yaml, "bosch,bmi160.yaml"]
```

## dts/bindings/sensor/bosch,bmi160-spi.yaml
```yaml
# Copyright (c) 2018, Linaro Limited
# SPDX-License-Identifier: Apache-2.0

description: BMI160 inertial measurement unit

compatible: "bosch,bmi160"

include: [spi-device.yaml, "bosch,bmi160.yaml"]
```

## dts/bindings/sensor/bosch,bmi160.yaml
```yaml
# Copyright (c) 2018, Linaro Limited
# SPDX-License-Identifier: Apache-2.0

description: BMI160 inertial measurement unit

compatible: "bosch,bmi160"

include: spi-device.yaml

properties:
    int-gpios:
      type: phandle-array
      required: false
      description: |
        This property specifies the connection for INT1, because the
        Zephyr driver maps all interrupts to INT1.  The signal defaults
        to output low when produced by the sensor.
```

## dts/bindings/sensor/bosch,bmi260.yaml
```yaml
# Copyright (c) 2021, Bosch Sensortec GmbH
# Copyright (c) 2022, Nordic Semiconductor ASA
# SPDX-License-Identifier: Apache-2.0

description: |
  The BMI260 is an inertial measurement unit. See more info at:
  https://www.bosch-sensortec.com/products/motion-sensors/imus/bmi260.html

include: sensor-device.yaml

compatible: "bosch,bmi260"

properties:
  irq-gpios:
    type: phandle-array
    description: |
      The INT1 and (optional) INT2 signal connections.
```

## dts/bindings/sensor/bosch,bmi270-i2c.yaml
```yaml
# Copyright (c) 2021, Bosch Sensortec GmbH
# Copyright (c) 2022, Nordic Semiconductor ASA
# SPDX-License-Identifier: Apache-2.0

compatible: "bosch,bmi270"

include: [i2c-device.yaml, "bosch,bmi270.yaml"]

properties:
  irq-gpios:
    type: phandle-array
    description: |
      The INT1 and (optional) INT2 signal connections.
```

## dts/bindings/sensor/bosch,bmi270-spi.yaml
```yaml
# Copyright (c) 2022, Nordic Semiconductor ASA
# SPDX-License-Identifier: Apache-2.0

compatible: "bosch,bmi270"

include: ["spi-device.yaml", "bosch,bmi270.yaml"]
```

## dts/bindings/sensor/bosch,bmi270.yaml
```yaml
# Copyright (c) 2021, Bosch Sensortec GmbH
# Copyright (c) 2022, Nordic Semiconductor ASA
# SPDX-License-Identifier: Apache-2.0

description: |
    The BMI270 is an inertial measurement unit. See more info at:
    https://www.bosch-sensortec.com/products/motion-sensors/imus/bmi270.html

    By default the driver loads the "max_fifo" feature-set configuration
    file, which does not support the any-motion feature. To use the
    any-motion trigger (SENSOR_TRIG_MOTION), select the "base" feature
    set by listing bosch,bmi270-base before this compatible:

        compatible = "bosch,bmi270-base", "bosch,bmi270";

include: sensor-device.yaml

compatible: "bosch,bmi270"

properties:
  irq-gpios:
    type: phandle-array
    description: |
      The INT1 and (optional) INT2 signal connections.
```

## dts/bindings/sensor/bosch,bmi323-i2c.yaml
```yaml
# Copyright (c) 2025 Alif Semiconductor
# SPDX-License-Identifier: Apache-2.0

compatible: "bosch,bmi323"

include: ["i2c-device.yaml", "bosch,bmi323.yaml"]
```

## dts/bindings/sensor/bosch,bmi323-i3c.yaml
```yaml
# Copyright (c) 2025 Alif Semiconductor
# SPDX-License-Identifier: Apache-2.0

compatible: "bosch,bmi323"

include: ["i3c-device.yaml", "bosch,bmi323.yaml"]
```

## dts/bindings/sensor/bosch,bmi323-spi.yaml
```yaml
# Copyright (c) 2023 Trackunit Corporation
# SPDX-License-Identifier: Apache-2.0

compatible: "bosch,bmi323"

include: ["spi-device.yaml", "bosch,bmi323.yaml"]
```

## dts/bindings/sensor/bosch,bmm150-i2c.yaml
```yaml
# Copyright (c) 2019, Linaro Limited
# SPDX-License-Identifier: Apache-2.0

description: |
    Bosch BMM150 Geomagnetic sensor.  See more info at:
    https://www.bosch-sensortec.com/bst/products/all_products/bmm150

compatible: "bosch,bmm150"

include: ["i2c-device.yaml", "bosch,bmm150.yaml"]
```

## dts/bindings/sensor/bosch,bmm150.yaml
```yaml
# Copyright (c) 2019, Linaro Limited
# SPDX-License-Identifier: Apache-2.0

# Common fields for BMM150

include: sensor-device.yaml

properties:
  drdy-gpios:
    type: phandle-array
    description: |
      This property specifies the connection for data ready pin.
      The polarity default is active high when sensor data is ready.
```

## dts/bindings/sensor/bosch,bmm350-i2c.yaml
```yaml
# Copyright (c) 2024, Bosch Sensortec GmbH

# SPDX-License-Identifier: Apache-2.0

description: |
    Bosch BMM350 Geomagnetic sensor.  See more info at:
    https://www.bosch-sensortec.com/products/motion-sensors/magnetometers/bmm350/

compatible: "bosch,bmm350"

include: [i2c-device.yaml, "bosch,bmm350.yaml"]
```

## dts/bindings/sensor/bosch,bmm350.yaml
```yaml
# Copyright (c) 2024, Bosch Sensortec GmbH

# SPDX-License-Identifier: Apache-2.0

include: sensor-device.yaml

properties:
  drdy-gpios:
    type: phandle-array
    description: |
      This property specifies the connection for data ready pin.
      The polarity default is active high when sensor data is ready.

  odr:
    type: string
    description: |
      Default output data rate in Hz. Only the following values are allowed:
        400    - 400     - 2.5ms
        200    - 200     - 5ms
        100    - 100     - 10ms
        50     - 50      - 20ms
        25     - 25      - 40ms
        12.5   - 25/2    - 80ms
        6.25   - 25/4    - 160ms
        3.125  - 25/8    - 320ms
        1.5625 - 25/16   - 640ms
      Reset Value of the BMM350 is 100Hz.
    default: "100"
    enum:
      - "400"
      - "200"
      - "100"
      - "50"
      - "25"
      - "12.5"
      - "6.25"
      - "3.125"
      - "1.5625"

  osr:
    type: int
    description: |
      Default oversampling. Only the following values are allowed:
        8 - 8x
        4 - 4x
        2 - 2x
        1 - 1x
      Reset Value of the BMM350 is 2x.
    default: 2
    enum:
      - 1
      - 2
      - 4
      - 8

  push-pull-int:
    type: boolean
    description: |
      Set for push-pull interrupt. Otherwise, it is open-drain.

  active-high-int:
    type: boolean
    description: |
      Set for a active high interrupt. Otherwise, it is active-low.

  drive-strength:
    type: int
    description: |
      The pad drive strength. 7 is the strongest. 0 is the weakest.
      Reset Value of the BMM350 is 7.
    default: 7
    enum:
      - 0
      - 1
      - 2
      - 3
      - 4
      - 5
      - 6
      - 7
```

## dts/bindings/sensor/bosch,bmp085.yaml
```yaml
# Copyright (c) 2024, Mario Paja
# SPDX-License-Identifier: Apache-2.0

description: Bosch BMP085 pressure sensor

compatible: "bosch,bmp085"

include: [sensor-device.yaml, i2c-device.yaml]

properties:
  oversampling:
    type: int
    required: true
    description: |
      The oversampling rate. Required for the pressure measurement

      - 0 # BMP085_MODE_1_ULTRALOWPOWER
      - 1 # BMP085_MODE_2_STANDARD
      - 2 # BMP085_MODE_3_HIGHRES
      - 3 # BMP085_MODE_4_ULTRAHIGHRES

    enum: [0, 1, 2, 3]
```

## dts/bindings/sensor/bosch,bmp180-i2c.yaml
```yaml
# Copyright (c) 2024 Chris Ruehl
# SPDX-License-Identifier: Apache-2.0

description: |
    Bosch BMP180 pressure sensor accessed through I2C bus

compatible: "bosch,bmp180"

include: [i2c-device.yaml, "bosch,bmp180.yaml"]
```

## dts/bindings/sensor/bosch,bmp180.yaml
```yaml
# Copyright (c) 2024 Chris Ruehl
# SPDX-License-Identifier: Apache-2.0

description: |
    Bosch BMP180 pressure sensor accessed through I2C bus

compatible: "bosch,bmp180"

include: [i2c-device.yaml, sensor-device.yaml]

properties:
  osr-press:
    type: int
    required: true
    description: |
      Default pressure oversampling rate. Only the following values are
      allowed:
        0 ultra low power, 1 sample
        1 standard,        2 sample
        2 high,            4 sample
        3 ultra high,      8 sample
    enum:
      - 0
      - 1
      - 2
      - 3
```

## dts/bindings/sensor/bosch,bmp280.yaml
```yaml
# Copyright (c) 2025 Sentry Robotics
# SPDX-License-Identifier: Apache-2.0

description: |
  Bosch BMP280 Pressure sensor.  See more info at:
  https://www.bosch-sensortec.com/products/environmental-sensors/pressure-sensors/bmp280/

compatible: "bosch,bmp280"

include: [sensor-device.yaml, i2c-device.yaml]

properties:
    odr:
      type: string
      required: false
      description: |
        Default output data rate in Hz. Only the following values are allowed:
          2000  - 2000    - 0.5ms  (default; chip reset value)
          16    - 16      - 62.5ms
          8     - 8       - 125ms
          4     - 4       - 250ms
          2     - 2       - 500ms
          1     - 1       - 1000ms
          0.5   - 1/2     - 2000ms
          0.25  - 1/4     - 4000ms
      default: "2000"
      enum:
        - "2000"
        - "16"
        - "8"
        - "4"
        - "2"
        - "1"
        - "0.5"
        - "0.25"

    standby-time:
        type: string
        required: false
        description: |
            Default standby time in ms. Only the following values are allowed:
            0.5   - 0.5ms  (default; chip reset value)
            62.5  - 62.5ms
            125   - 125ms
            250   - 250ms
            500   - 500ms
            1000  - 1000ms
            2000  - 2000ms
            4000  - 4000ms
        default: "0.5"
        enum:
            - "0.5"
            - "62.5"
            - "125"
            - "250"
            - "500"
            - "1000"
            - "2000"
            - "4000"

    osr-pressure:
      type: int
      required: false
      description: |
        Pressure oversampling rate. To skip pressure measurement, set to 0.
      default: 4
      enum:
        - 0
        - 1
        - 2
        - 4
        - 8
        - 16

    osr-temperature:
      type: int
      required: false
      description: |
        Temperature oversampling rate. To skip temperature measurement, set to 0.
      default: 1
      enum:
        - 0
        - 1
        - 2
        - 4
        - 8
        - 16

    iir-filter:
      type: int
      required: false
      description: |
        IIR filter coefficient. The default 0 is no IIR filtering.
      default: 0
      enum:
        - 0
        - 2
        - 4
        - 8
        - 16
```

## dts/bindings/sensor/bosch,bmp388-i2c.yaml
```yaml
# Copyright (c) 2020 Facebook, Inc. and its affiliates
# SPDX-License-Identifier: Apache-2.0

description: |
    Bosch BMP388 pressure sensor accessed through I2C bus

compatible: "bosch,bmp388"

include: [i2c-device.yaml, "bosch,bmp388.yaml"]
```
