## dts/bindings/sensor/adi,adxl362.yaml
```yaml
# Copyright (c) 2018, NXP
# SPDX-License-Identifier: Apache-2.0

description: |
  ADXL362 3-axis SPI accelerometer
  When setting the accelerometer DTS properties and want to use
  streaming functionality, make sure to include adxl362.h and
  use the macros defined there for fifo-mode and fifo-watermark properties.

  Example:
  #include <zephyr/dt-bindings/sensor/adxl362.h>

  adxl362: adxl362@0 {
    ...
    fifo-mode = <ADXL362_FIFO_MODE_STREAM>;
    fifo-watermark = <0x80>;
  };

compatible: "adi,adxl362"

include: [sensor-device.yaml, spi-device.yaml]

properties:
  int1-gpios:
    type: phandle-array
    description: |
      The INT1 signal defaults to active high as produced by the
      sensor.  The property value should ensure the flags properly
      describe the signal that is presented to the driver.

  wakeup-mode:
    type: boolean
    description: |
      This mode is intended for extremely low power consumption,
      checking for motion only about six times a second.

  autosleep:
    type: boolean
    description: |
      Enter Wake-Up mode when inactivity is detected,
      reenter Measurement mode when activity is detected.
      Only applies for Linked and Loop mode, ignored otherwise.

  fifo-mode:
    type: int
    description: |
          Accelerometer FIFO Mode.
          0 # ADXL362_FIFO_MODE_DISABLED
          1 # ADXL362_FIFO_MODE_OLDEST_SAVED
          2 # ADXL362_FIFO_MODE_STREAM
          3 # ADXL362_FIFO_MODE_TRIGGERED
    enum:
      - 0
      - 1
      - 2
      - 3

  fifo-watermark:
    type: int
    description: |
      Specify the FIFO watermark level in frame count.
      Valid range: 0 - 511
```

## dts/bindings/sensor/adi,adxl366-i2c.yaml
```yaml
# Copyright (c) 2023 Analog Devices Inc.
# SPDX-License-Identifier: Apache-2.0

description: ADXL366 3-axis nanopower accelerometer, accessed through I2C bus

compatible: "adi,adxl366"

include: ["i2c-device.yaml", "adi,adxl367-common.yaml"]
```

## dts/bindings/sensor/adi,adxl366-spi.yaml
```yaml
# Copyright (c) 2023 Analog Devices Inc.
# SPDX-License-Identifier: Apache-2.0

description: ADXL366 3-axis nanopower accelerometer, accessed through SPI bus

compatible: "adi,adxl366"

include: ["spi-device.yaml", "adi,adxl367-common.yaml"]
```

## dts/bindings/sensor/adi,adxl367-common.yaml
```yaml
# Copyright (c) 2023 Analog Devices Inc.
# SPDX-License-Identifier: Apache-2.0

description: |
  ADXL367 3-axis accelerometer
  When setting the accelerometer DTS properties and want to use
  streaming functionality, make sure to include adxl367.h and
  use the macros defined there for fifo-mode property.

  Example:
  #include <zephyr/dt-bindings/sensor/adxl367.h>

  adxl367: adxl367@0 {
    ...

    fifo-mode = <ADXL367_FIFO_MODE_STREAM>;
  };


include: sensor-device.yaml

properties:
  odr:
    type: int
    default: 0
    description: |
          Accelerometer sampling frequency (ODR). Default is power on reset value.
            0 # 12.5Hz
            1 # 25Hz
            2 # 50Hz
            3 # 100Hz
            4 # 200Hz
            5 # 400Hz
    enum:
      - 0
      - 1
      - 2
      - 3
      - 4
      - 5

  int1-gpios:
    type: phandle-array
    description: |
      The INT1 signal defaults to active high as produced by the
      sensor.  The property value should ensure the flags properly
      describe the signal that is presented to the driver.

  fifo-mode:
    type: int
    description: |
          Accelerometer FIFO Mode.
          0 # ADXL367_FIFO_MODE_DISABLED
          1 # ADXL367_FIFO_MODE_OLDEST_SAVED
          2 # ADXL367_FIFO_MODE_STREAM
          3 # ADXL367_FIFO_MODE_TRIGGERED
    enum:
      - 0
      - 1
      - 2
      - 3
```

## dts/bindings/sensor/adi,adxl367-spi.yaml
```yaml
# Copyright (c) 2023 Analog Devices Inc.
# SPDX-License-Identifier: Apache-2.0

description: ADXL367 3-axis nanopower accelerometer, accessed through SPI bus

compatible: "adi,adxl367"

include: ["spi-device.yaml", "adi,adxl367-common.yaml"]
```

## dts/bindings/sensor/adi,adxl372-common.yaml
```yaml
# Copyright (c) 2022 Analog Devices Inc.
# SPDX-License-Identifier: Apache-2.0

include: sensor-device.yaml

properties:
  odr:
    type: int
    default: 0
    description: |
          Accelerometer sampling frequency (ODR). Default is power on reset value.
            0 # 400Hz
            1 # 800Hz
            2 # 1600Hz
            3 # 3200Hz
            4 # 6400Hz
    enum:
      - 0
      - 1
      - 2
      - 3
      - 4

  bw:
    type: int
    default: 12
    description: |
          Low-Pass (Antialiasing) Filter corner frequency. Default is power on reset value.
            0 # 200Hz
            1 # 400Hz
            2 # 800Hz
            3 # 1600Hz
            4 # 3200Hz
            12 # Disabled
    enum:
      - 0
      - 1
      - 2
      - 3
      - 4
      - 12

  hpf:
    type: int
    default: 4
    description: |
          High-Pass Filter corner frequency. Default is power on reset value.
            0 # ODR/210
            1 # ODR/411
            2 # ODR/812
            3 # ODR/1616
            4 # Disabled
    enum:
      - 0
      - 1
      - 2
      - 3
      - 4

  int1-gpios:
    type: phandle-array
    description: |
      The INT1 signal defaults to active high as produced by the
      sensor.  The property value should ensure the flags properly
      describe the signal that is presented to the driver.
```

## dts/bindings/sensor/adi,adxl372-i2c.yaml
```yaml
# Copyright (c) 2018 Analog Devices Inc.
# SPDX-License-Identifier: Apache-2.0

description: ADXL372 3-axis high-g accelerometer, accessed through I2C bus

compatible: "adi,adxl372"

include: ["i2c-device.yaml", "adi,adxl372-common.yaml"]
```
