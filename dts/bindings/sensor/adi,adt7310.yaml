## dts/bindings/sensor/adi,adt7310.yaml
```yaml
description: ADT7310 16-Bit digital SPI temperature sensor

compatible: "adi,adt7310"

include: [sensor-device.yaml, spi-device.yaml]

properties:
  int-gpios:
    type: phandle-array
    description: |
      The INT signal defaults to active low open drain, so requires a
      pull-up on the board or in the flags cell of this entry.
```

## dts/bindings/sensor/adi,adt7410.yaml
```yaml
# Copyright (c) 2026 Analog Devices Inc.
# SPDX-License-Identifier: Apache-2.0

description: ADT7410 16-Bit digital I2C temperature sensor

compatible: "adi,adt7410"

include: ["i2c-device.yaml", "adi,adt74xx-common.yaml"]
```

## dts/bindings/sensor/adi,adt7420.yaml
```yaml
# Copyright (c) 2026 Analog Devices Inc.
# SPDX-License-Identifier: Apache-2.0

description: ADT7420 16-Bit digital I2C temperature sensor

compatible: "adi,adt7420"

include: ["i2c-device.yaml", "adi,adt74xx-common.yaml"]
```

## dts/bindings/sensor/adi,adt7422.yaml
```yaml
# Copyright (c) 2026 Analog Devices Inc.
# SPDX-License-Identifier: Apache-2.0

description: ADT7422 16-Bit digital I2C temperature sensor

compatible: "adi,adt7422"

include: ["i2c-device.yaml", "adi,adt74xx-common.yaml"]
```

## dts/bindings/sensor/adi,adt74xx-common.yaml
```yaml
# Copyright (c) 2026 Analog Devices Inc.
# SPDX-License-Identifier: Apache-2.0

description: ADT74XX 16-Bit digital I2C temperature sensor

include: sensor-device.yaml

properties:
  int-gpios:
    type: phandle-array
    description: |
      The INT signal defaults to active low open drain, so requires a
      pull-up on the board or in the flags cell of this entry.

  ct-gpios:
    type: phandle-array
    description: |
      The CT signal defaults to active low open drain, so requires a
      pull-up on the board or in the flags cell of this entry.

  int-polarity-active-high:
    type: boolean
    description: |
      Configures the INT pin on the device to output active-low or active-high.

  ct-polarity-active-high:
    type: boolean
    description: |
      Configures the CT pin on the device to output active-low or active-high.

  op-mode:
    type: string
    description: Determines the Initial operating mode of the device.
    enum: ["continuous", "one-shot", "1sps", "shutdown"]
    default: "continuous"

  set-resolution:
    type: int
    enum: [13, 16]
    default: 13
    description: |
      Temperature bit resolution. Set if 13-bit is desired. Else 13-bit is
      used by default.

  set-comparator-mode:
    type: boolean
    description: |
      Configures the device to run on comparator mode, triggering an interrupt
      if the temperature measured drops below T_HIGH - T_HYST
      or rises above T_LOW + T_HYST limits.
```

## dts/bindings/sensor/adi,adt75.yaml
```yaml
description: ADT75 12-Bit digital I2C temperature sensor

compatible: "adi,adt75"

include: [sensor-device.yaml, i2c-device.yaml]
```

## dts/bindings/sensor/adi,adxl313-common.yaml
```yaml
# Copyright (c) 2025 Lothar Rubusch <l.rubusch@gmail.com>
# SPDX-License-Identifier: Apache-2.0

description: |
  ADXL313 3-axis accelerometer
  When setting the accelerometer DTS properties and want to use
  streaming functionality, make sure to include adxl313.h and
  use the macros defined there.

  Example:
  #include <zephyr/dt-bindings/sensor/adxl313.h>

  adxl313: adxl313@0 {
    compatible = "adi,adxl313";
    reg = <0>;
    spi-cpha;
    spi-cpol;
    spi-max-frequency = <5000000>;
    int1-gpios =  <&gpio0 4 GPIO_ACTIVE_HIGH>;
    drdy-pin = <1>;
    fifo-watermark = <30>;
  };

include: sensor-device.yaml

properties:
  int1-gpios:
    type: phandle-array
    description: |
      Specify if this gpio line is connected and available. None, only one or
      both interrupt lines can be connected. The pin defaults to active high
      when produced by the sensor. The property specifies the INT_1 line of
      the sensor.

  int2-gpios:
    type: phandle-array
    description: |
      Specify if this gpio line is connected and available. None, only one or
      both interrupt lines can be connected. The pin defaults to active high
      when produced by the sensor. The property specifies the INT_2 line of
      the sensor.

  drdy-pin:
    type: int
    enum: [1, 2]
    description: |
      Specify which of the two interrupt lines (INT_1 or INT_2), if any,
      actively delivers the data signal.
      This number represents which of the two interrupt pins
      (INT1 or INT2) the drdy line is attached to. This property is not
      mandatory and if not present it defaults to 2.
      - 1 # INT1
      - 2 # INT2

  fifo-watermark:
    default: 0
    type: int
    description: |
      Acceleration samples can be read either directly from the sensor or via
      the internal FIFO buffer. When FIFO buffering is enabled, an interrupt
      line must be configured to signal FIFO watermark events. Other events,
      such as Activity or Inactivity, do not rely on FIFO configuration.
      Valid range: from 1 to 31. A value of 0 disables FIFO buffering and is the
      default. The setting thus is optional.

  odr:
    type: int
    default: 6
    description: |
      Accelerometer output data rate (ODR). The recommended range is between
      12.5 Hz and 400 Hz. This is an optional setting, defaults to 400 Hz.
      - 0 # 6_25Hz
      - 1 # 12.5Hz
      - 2 # 25Hz
      - 3 # 50Hz
      - 4 # 100Hz
      - 5 # 200Hz
      - 6 # 400Hz
      - 7 # 800Hz
      - 8 # 1600Hz
      - 9 # 3200Hz
    enum:
      - 0
      - 1
      - 2
      - 3
      - 4
      - 5
      - 6
      - 7
      - 8
      - 9

  range:
    type: int
    default: 3
    description: |
      Accelerometer g ranges. This is an optional setting, defaults to 4g.
      - 0 # 0.5g
      - 1 # 1g
      - 2 # 2g
      - 3 # 4g
      Note, the device is always in full resolution mode, where the output
      resolution increases with the g range set by the range bits to maintain
      1024 LSB/g sensitivity.
    enum:
      - 0
      - 1
      - 2
      - 3
```

## dts/bindings/sensor/adi,adxl313-i2c.yaml
```yaml
# Copyright (c) 2025 Lothar Rubusch <l.rubusch@gmail.com>
# SPDX-License-Identifier: Apache-2.0

description: adxl313 3-axis I2C accelerometer

compatible: "adi,adxl313"

include: ["i2c-device.yaml", "adi,adxl313-common.yaml"]
```

## dts/bindings/sensor/adi,adxl313-spi.yaml
```yaml
# Copyright (c) 2025 Lothar Rubusch <l.rubusch@gmail.com>
# SPDX-License-Identifier: Apache-2.0

description: adxl313 3-axis accelerometer with SPI connection

compatible: "adi,adxl313"

include: ["spi-device.yaml", "adi,adxl313-common.yaml"]
```

## dts/bindings/sensor/adi,adxl345-common.yaml
```yaml
# Copyright (c) 2022 Analog Devices Inc.
# SPDX-License-Identifier: Apache-2.0

description: |
  ADXL345 3-axis accelerometer
  When setting the accelerometer DTS properties, make sure to include
  adxl345.h and use the macros defined there.

  Example:
  #include <zephyr/dt-bindings/sensor/adxl345.h>

  adxl345: adxl345@1d {
    ...

    odr = <ADXL345_DT_ODR_25>;
  };

include: sensor-device.yaml

properties:
  odr:
    type: int
    default: 10
    description: |
          Accelerometer sampling frequency (ODR). Default is power on reset value.
    enum:
      - 7 # ADXL345_DT_ODR_12_5
      - 8 # ADXL345_DT_ODR_25
      - 9 # ADXL345_DT_ODR_50
      - 10 # ADXL345_DT_ODR_100
      - 11 # ADXL345_DT_ODR_200
      - 12 # ADXL345_DT_ODR_400

  fifo-watermark:
    type: int
    description: |
      Specify the FIFO watermark level in frame count.
      Valid range: 1 - 31

  int2-gpios:
    type: phandle-array
    description: |
      The INT2 signal defaults to active high as produced by the
      sensor.  The property value should ensure the flags properly
      describe the signal that is presented to the driver.
```

## dts/bindings/sensor/adi,adxl345-i2c.yaml
```yaml
# Copyright (c) 2020 Antmicro <www.antmicro.com>
# SPDX-License-Identifier: Apache-2.0

description: ADXL345 3-axis I2C accelerometer

compatible: "adi,adxl345"

include: ["i2c-device.yaml", "adi,adxl345-common.yaml"]
```

## dts/bindings/sensor/adi,adxl345-spi.yaml
```yaml
# Copyright (c) 2022 TOKITA Hiroshi <tokita.hiroshi@fujitsu.com>
# SPDX-License-Identifier: Apache-2.0

description: ADXL345 3-axis accelerometer with SPI connection

compatible: "adi,adxl345"

include: [sensor-device.yaml, spi-device.yaml]
```

## dts/bindings/sensor/adi,adxl34x-common.yaml
```yaml
#
# Copyright (c) 2024 Chaim Zax
# SPDX-License-Identifier: Apache-2.0
#

include: sensor-device.yaml

properties:
  int-gpios:
    type: phandle-array
    description: |
      Interrupt GPIO to support FIFO mode and other interrupts.

  int-pin:
    type: int
    default: 1
    enum:
      - 1 # interrupt is generated from INT1
      - 2 # interrupt is generated from INT2
    description: |
      Select the interrupt pin in use when data is available, or an event
      occurred (1 or 2). The ADXL34x has two interrupt pins of which only one is
      needed for this driver. The other interrupt can be used to control other
      hardware directly. Defaults to 1 (INT1), the power-on reset value.

  packet-size:
    type: int
    default: 16
    description: |
      The number of accelerometer samples in one packet when streaming data. The
      size ranges from 1 to 31 samples and defaults to halve the FIFO size.

  accel-frequency:
    type: string
    default: "100"
    description: |
      Default frequency of accelerometer. Power-on reset value is 100 Hz.
    enum:
      - "0.10"
      - "0.20"
      - "0.39"
      - "0.78"
      - "1.56"
      - "3.13"
      - "6.25"
      - "12.5"
      - "25"
      - "50"
      - "100"
      - "200"
      - "400"
      - "800"
      - "1600"
      - "3200"

  accel-range:
    type: int
    default: 16
    description: |
      Default range of accelerometer. Power-on reset value is +-16 g.
    enum:
      - 2
      - 4
      - 8
      - 16
```

## dts/bindings/sensor/adi,adxl34x-i2c.yaml
```yaml
#
# Copyright (c) 2024 Chaim Zax
# SPDX-License-Identifier: Apache-2.0
#

description: |
  ADXL34x accelerometer sensors of ADI. Supported are the ADXL343, ADXL344,
  ADXL345 and ADXL346 Three Axis I2C accelerometer.

  Example definition in devicetree:

    accel: adxl34x@12 {
        compatible = "adi,adxl34x";
        reg = <0x12>;
        int-gpios = <&gpio0 0 (GPIO_PULL_UP | GPIO_ACTIVE_LOW)>;
        int-pin = <1>;
        packet-size = <16>;
        accel-frequency = "800";
        accel-range = 16;
    };

compatible: "adi,adxl34x"

include: ["sensor-device.yaml", "i2c-device.yaml", "adi,adxl34x-common.yaml"]
```

## dts/bindings/sensor/adi,adxl34x-spi.yaml
```yaml
#
# Copyright (c) 2024 Chaim Zax
# SPDX-License-Identifier: Apache-2.0
#

description: |
  ADXL34x accelerometer sensors of ADI. Supported are the ADXL343, ADXL344,
  ADXL345 and ADXL346 Three Axis SPI accelerometer.

  Example definition in devicetree:

    adxl34x {
        compatible = "adi,adxl34x";
        int-gpios = <&gpio0 0 (GPIO_PULL_UP | GPIO_ACTIVE_LOW)>;
        int-pin = <1>;
        packet-size = <16>;
        accel-frequency = "800";
        accel-range = 16;
    };

compatible: "adi,adxl34x"

include: ["sensor-device.yaml", "spi-device.yaml", "adi,adxl34x-common.yaml"]
```

## dts/bindings/sensor/adi,adxl355-common.yaml
```yaml
# Copyright (c) 2026 Analog Devices Inc.
# SPDX-License-Identifier: Apache-2.0

description: |
  ADXL355 3-axis accelerometer
  When setting the accelerometer DTS properties, make sure to include
  adxl355.h and use the macros defined there.

  Example:
  #include <zephyr/dt-bindings/sensor/adxl355.h>

  adxl355: adxl355@1d {
    ...

  };

include: sensor-device.yaml

properties:
  odr:
    type: int
    description: Output data rate. Default is power on reset value.
    enum:
      - 0 # ADXL355_DT_ODR_4000
      - 1 # ADXL355_DT_ODR_2000
      - 2 # ADXL355_DT_ODR_1000
      - 3 # ADXL355_DT_ODR_500
      - 4 # ADXL355_DT_ODR_250
      - 5 # ADXL355_DT_ODR_125
      - 6 # ADXL355_DT_ODR_62_5
      - 7 # ADXL355_DT_ODR_31_25
      - 8 # ADXL355_DT_ODR_15_625
      - 9 # ADXL355_DT_ODR_7_813
      - 10 # ADXL355_DT_ODR_3_906
    default: 0

  fifo-watermark:
    type: int
    description: |
      Specify the FIFO watermark level in frame count.
      Valid range: 1 - 96. Default value is the reset value.
    default: 96

  range:
    type: int
    description: |
          Accelerometer range. Default is power on reset value.
    enum:
      - 1 # ADXL355_DT_RANGE_2G
      - 2 # ADXL355_DT_RANGE_4G
      - 3 # ADXL355_DT_RANGE_8G
    default: 1

  hpf-corner:
    type: int
    description: |
      High pass filter corner frequency setting.
      Default is power on reset value.
    enum:
      - 0 # ADXL355_DT_HPF_OFF
      - 1 # ADXL355_DT_HPF_24_7e_4
      - 2 # ADXL355_DT_HPF_6_208e_4
      - 3 # ADXL355_DT_HPF_1_5545e_4
      - 4 # ADXL355_DT_HPF_0_3862e_4
      - 5 # ADXL355_DT_HPF_0_0954e_4
      - 6 # ADXL355_DT_HPF_0_0238e_4
    default: 0

  ext-clk:
    type: boolean
    description: |
      Enable external clock input. Default is power on reset value.

  ext-sync:
    type: int
    description: |
      Enable external sync input. Default is power on reset value.
    enum:
      - 0
      - 1
      - 2
    default: 0

  i2c-fast-mode:
    type: boolean
    description: |
      Enable I2C in fast mode. By default, High-Speed mode is used.

  int-pol:
    type: int
    description: |
      Interrupt polarity configuration.
      Default is power on reset value.
    enum:
      - 0 # ADXL355_DT_INT_POL_ACTIVE_LOW
      - 1 # ADXL355_DT_INT_POL_ACTIVE_HIGH
    default: 0

  int1-gpios:
    type: phandle-array
    description: |
      The INT1 signal defaults to active low as produced by the
      sensor.  The property value should ensure the flags properly
      describe the signal that is presented to the driver.
      Either this or INT2 will be used to route interrupts. If both
      are defined, then int1 is prioritized.

  int2-gpios:
    type: phandle-array
    description: |
      The INT2 signal defaults to active low as produced by the
      sensor.  The property value should ensure the flags properly
      describe the signal that is presented to the driver.
      Either this or INT1 will be used to route interrupts. If both
      are defined, then int1 is prioritized.

  self-test-enable:
    type: boolean
    description: |
      Run Self-Test on initialization.

      Note: Enabling this property adds approximately 200ms delay during
      device initialization. Consider increasing CONFIG_ADXL355_INIT_PRIORITY
      (e.g., to 90) to defer initialization if boot time is critical.
```

## dts/bindings/sensor/adi,adxl355-i2c.yaml
```yaml
# Copyright (c) 2026 Analog Devices Inc.
# SPDX-License-Identifier: Apache-2.0

description: ADXL355 3-axis accelerometer with I2C connection

compatible: "adi,adxl355"

include: ["i2c-device.yaml", "adi,adxl355-common.yaml"]
```

## dts/bindings/sensor/adi,adxl355-spi.yaml
```yaml
# Copyright (c) 2026 Analog Devices Inc.
# SPDX-License-Identifier: Apache-2.0

description: ADXL355 3-axis accelerometer with SPI connection

compatible: "adi,adxl355"

include: ["spi-device.yaml", "adi,adxl355-common.yaml"]
```
