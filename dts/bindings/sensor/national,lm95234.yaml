## dts/bindings/sensor/national,lm95234.yaml
```yaml
# Copyright (c) 2024 Calian Advanced Technologies
# SPDX-License-Identifier: Apache-2.0

description: LM95234 Quad Remote Diode and Local Temperature Sensor with SMBus Interface

compatible: "national,lm95234"

include: [sensor-device.yaml, i2c-device.yaml]
```

## dts/bindings/sensor/nooploop,tofsense-can.yaml
```yaml
# Copyright (c) 2025 Alex Fabre
# SPDX-License-Identifier: Apache-2.0

description: Nooploop TOFSense Time Of Flight Sensor through CAN bus.

compatible: "nooploop,tofsense"

include: "nooploop,tofsense-common.yaml"

properties:
  id:
    type: int
    required: true
    description: Device ID on CAN network

  can-bus:
    type: boolean
    description: |
      This property is used by the driver to distinguish between
      uart binding and CAN binding, given that CAN controllers
      have no property 'bus: can'.
```

## dts/bindings/sensor/nooploop,tofsense-common.yaml
```yaml
# Copyright (c) 2025 Alex Fabre
# SPDX-License-Identifier: Apache-2.0

title: Nooploop TOFSense properties shared by UART and CAN implementation.

description: |
    When setting the odr property in a .dts or .dtsi file you may include
    tofsense.h and use the macros defined there.

    Example:
    #include <zephyr/dt-bindings/sensor/tofsense.h>

    tofsense: tofsense {
      ...
      operating-mode = <TOFSENSE_MODE_ACTIVE>;
      active-mode-frequency = <30>;
    };

include: "sensor-device.yaml"

properties:
  operating-mode:
    type: int
    required: true
    description: |
      Specify the sensor operating mode for CAN or UART.

      - ACTIVE mode: the module actively outputs measurement
      information at a frequency of 30Hz.

      - QUERY mode: the controller sends a query instruction
      containing the module ID to the expected query module,
      and the module can output one frame of measurement information

      - 0 # TOFSENSE_MODE_ACTIVE
      - 1 # TOFSENSE_MODE_QUERY

    enum:
      - 0
      - 1

  active-mode-frequency:
    type: int
    default: 30
    description: |
      Specify the sensor data output frequency.
      It's required only when 'operating-mode' is set to 'ACTIVE'.

      Default is 30Hz (The sensor will emit new data message every ~33ms).
```

## dts/bindings/sensor/nooploop,tofsense-uart.yaml
```yaml
# Copyright (c) 2025 Alex Fabre
# SPDX-License-Identifier: Apache-2.0

description: Nooploop TOFSense Time Of Flight Sensor through UART bus

compatible: "nooploop,tofsense"

include: ["nooploop,tofsense-common.yaml", "uart-device.yaml"]

properties:
  id:
    type: int
    required: true
    description: Device ID
```

## dts/bindings/sensor/nordic,npm10xx-adc.yaml
```yaml
# Copyright (c) 2026 Nordic Semiconductor
# SPDX-License-Identifier: Apache-2.0

description: Nordic nPM10xx PMIC ADC

include: sensor-device.yaml

compatible: "nordic,npm10xx-adc"

properties:
  thermistor-beta:
    type: int
    description: |
      Beta value of the battery thermistor. If not provided, the battery temperature
      measurement will not be available.

examples:
  - |
    npm1012: pmic@6a {
      reg = <0x6a>;
      compatible = "nordic,npm10xx";
      /* ... */

      sensor {
        compatible = "nordic,npm10xx-adc";
        thermistor-beta = <3434>;
      };

      /* ... */
    };
```

## dts/bindings/sensor/nordic,npm1300-charger.yaml
```yaml
#
# Copyright (c) 2023 Nordic Semiconductor ASA
#
# SPDX-License-Identifier: Apache-2.0
#

description: NPM1300 PMIC Charger

compatible: "nordic,npm1300-charger"

include: "nordic,npm13xx-charger-common.yaml"

properties:
  term-microvolt:
    type: int
    required: true
    description: |
      Charge termination voltage in uV.
      Available range is 3.5 V to 3.65 V and 4.0 V to 4.45 V in 50 mV steps.

  term-warm-microvolt:
    type: int
    description: |
      Charge termination voltage when warm in uV.
      Available range is 3.5 V to 3.65 V and 4.0 V to 4.45 V in 50 mV steps.
      If omitted, the term-microvolt value will be used.

  current-microamp:
    type: int
    required: true
    description: |
      Charge current in uA.
      Available range is 32 mA to 800 mA in 2mA steps.

  dischg-limit-microamp:
    type: int
    required: true
    enum:
      - 200000
      - 1000000
    description: |
      Discharge current limit in uA.
      Available values are 200 mA and 1000 mA.

  term-current-percent:
    type: int
    enum:
      - 10
      - 20
    default: 10
    description: |
      Termination current, as a percentage of current-microamp.
      Charge completes when the charge current falls below this value.
      If omitted the device default of 10% is used.
```

## dts/bindings/sensor/nordic,npm1304-charger.yaml
```yaml
# Copyright (c) 2025 Nordic Semiconductor ASA
# SPDX-License-Identifier: Apache-2.0

description: nPM1304 PMIC Charger

compatible: "nordic,npm1304-charger"

include: "nordic,npm13xx-charger-common.yaml"

properties:
  term-microvolt:
    type: int
    required: true
    description: |
      Charge termination voltage in uV.
      Available range is 3.6 V to 3.65 V and 4.0 V to 4.65 V in 50 mV steps.

  term-warm-microvolt:
    type: int
    description: |
      Charge termination voltage when warm in uV.
      Available range is 3.6 V to 3.65 V and 4.0 V to 4.65 V in 50 mV steps.
      If omitted, the term-microvolt value will be used.

  current-microamp:
    type: int
    required: true
    description: |
      Charge current in uA.
      Available range is 4 mA to 100 mA in 0.5 mA steps.

  dischg-limit-microamp:
    type: int
    const: 125000
    default: 125000
    description: |
      Discharge current limit in uA. Fixed to 125 mA on nPM1304.

  term-current-percent:
    type: int
    enum:
      - 10
      - 5
    default: 10
    description: |
      Termination current, as a percentage of current-microamp.
      Charge completes when the charge current falls below this value.
      If omitted the device default of 10% is used.
```

## dts/bindings/sensor/nordic,npm2100-vbat.yaml
```yaml
#
# Copyright (c) 2024 Nordic Semiconductor ASA
#
# SPDX-License-Identifier: Apache-2.0
#

description: NPM2100 PMIC Battery Voltage

compatible: "nordic,npm2100-vbat"

include: [sensor-device.yaml]

properties:
  vout-min-microvolt:
    type: int
    description: |
      Minimum Vout level.
      When Vout falls to this level, the PMIC will allow more current to flow
      from the battery by dropping to the vbatminl battery threshold.

  vbat-min-microvolt:
    type: int
    description: |
      Initial value for vbatminl and vbatminh.
      The boost converter will not allow the battery to drop below this level.
```

## dts/bindings/sensor/nordic,nrf-lpcomp.yaml
```yaml
# Copyright (c) 2022, Nordic Semiconductor ASA
# SPDX-License-Identifier: Apache-2.0

description: Nordic nRF family LPCOMP (Low-power Comparator)

compatible: "nordic,nrf-lpcomp"

include: base.yaml

properties:
  reg:
    required: true

  interrupts:
    required: true

  "#io-channel-cells":
    type: int
    const: 1
    required: true

io-channel-cells:
  - input
```

## dts/bindings/sensor/nordic,nrf-qdec.yaml
```yaml
# Copyright (c) 2018, Nordic Semiconductor ASA
# SPDX-License-Identifier: Apache-2.0

description: Nordic nRF quadrature decoder (QDEC) node

compatible: "nordic,nrf-qdec"

include: [sensor-device.yaml, pinctrl-device.yaml]

properties:
  reg:
    required: true

  interrupts:
    required: true

  pinctrl-0:
    required: true

  pinctrl-names:
    required: true

  enable-pin:
    type: int
    description: |
      The enable pin to use, to enable a connected QDEC device

      For pins P0.0 through P0.31, use the pin number. For example,
      to use P0.16 for the A pin, set:

          enable-pin = <16>;

      For pins P1.0 through P1.31, add 32 to the pin number. For
      example, to use P1.2 for the A pin, set:

          enable-pin = <34>;  /* 32 + 2 */

  led-pre:
    type: int
    description: Time LED is enabled prior to sampling event (in us)
    required: true

  steps:
    type: int
    description: Number of steps on the rotating wheel
    required: true

  nordic,period:
    type: string
    default: SAMPLEPER_2048US
    enum:
      - SAMPLEPER_128US
      - SAMPLEPER_256US
      - SAMPLEPER_512US
      - SAMPLEPER_1024US
      - SAMPLEPER_2048US
      - SAMPLEPER_4096US
      - SAMPLEPER_8192US
      - SAMPLEPER_16384US
    description: |
      The sampling period of the QDEC device. The default value is SAMPLEPER_2048US, which
      reflects the previously hardcoded configuration.
```

## dts/bindings/sensor/nordic,nrf-temp-nrfs.yaml
```yaml
# Copyright (c) 2024 Nordic Semiconductor ASA
# SPDX-License-Identifier: Apache-2.0

description: |
  Nordic nRF family temperature sensor accessed via nRF Services (nrfs)

compatible: "nordic,nrf-temp-nrfs"

include: base.yaml
```

## dts/bindings/sensor/nordic,nrf-temp.yaml
```yaml
# Copyright (c) 2018, Nordic Semiconductor ASA
# SPDX-License-Identifier: Apache-2.0

description: Nordic nRF family TEMP node

compatible: "nordic,nrf-temp"

interrupt-source: true

include: sensor-device.yaml

properties:
  reg:
    required: true
```

## dts/bindings/sensor/ntc-thermistor-generic.yaml
```yaml
# Copyright (c) 2023 Nordic Semiconductor ASA
# SPDX-License-Identifier: Apache-2.0

description: Generic NTC thermistor

compatible: "ntc-thermistor-generic"

include: ntc-thermistor.yaml

properties:
  zephyr,compensation-table:
    type: array
    required: true
    description: |
      Compensation table, formatted as temperature, resistance pairs. A script
      to generate a valid table is provided in
      scripts/utils/ntc_thermistor_table.py.
```

## dts/bindings/sensor/ntc-thermistor.yaml
```yaml
# Copyright (c) 2022 Google LLC
# SPDX-License-Identifier: Apache-2.0

description: Generic NTC Thermistor

include: [sensor-device.yaml]

properties:
  io-channels:
    required: true
    description: |
      ADC IO channel connected to this NTC thermistor.

  pullup-uv:
    type: int
    description: |
      The pullup voltage microvoltage in the circuit.
      If not specified, it is assumed that the pullup voltage is VDD. Therefore,
      the specified ADC IO channel must be configured so that VDD is used as the
      reference voltage.

  pullup-ohm:
    type: int
    description: |
      The pullup resistance in the circuit.

  pulldown-ohm:
    type: int
    description: |
      The pulldown resistance in the circuit.

  connected-positive:
    type: boolean
    description: |
      Indicates how the thermistor is connected in series with a pull-up and/or
      a pull-down resistor. If this flag is NOT specified, the thermistor is
      assumed to be connected-ground, which usually means a pull-down resistance
      of zero but complex arrangements are possible.
```

## dts/bindings/sensor/nuvoton,adc-cmp.yaml
```yaml
# Copyright (c) 2022 Intel Corporation
# SPDX-License-Identifier: Apache-2.0
description: |
    This will perform signal comparison with threshold established.

compatible: "nuvoton,adc-cmp"

include: sensor-device.yaml

properties:
  io-channels:
    type: phandle-array
    required: true
    description: |
      ADC channel that will perform measurement.

  threshold-mv:
    type: int
    description: |
      Value in millivolts present on ADC data as threshold assert.

  comparison:
    type: string
    description: |
      Determines the condition to be met between ADC data and
      threshold assert value that will trigger comparator event.
    enum:
      - ADC_CMP_NPCX_GREATER
      - ADC_CMP_NPCX_LESS_OR_EQUAL

  thr-sel:
    type: string
    description: |
        Determines the register for threshold control and event.
    enum:
      - ADC_CMP_NPCX_THRCTL1
      - ADC_CMP_NPCX_THRCTL2
      - ADC_CMP_NPCX_THRCTL3
      - ADC_CMP_NPCX_THRCTL4
      - ADC_CMP_NPCX_THRCTL5
      - ADC_CMP_NPCX_THRCTL6
```

## dts/bindings/sensor/nuvoton,npcx-adc-v2t.yaml
```yaml
# Copyright (c) 2025 Intel Corporation
# SPDX-License-Identifier: Apache-2.0
description: |
    This will perform V2T measurements.

compatible: "nuvoton,npcx-adc-v2t"

include: sensor-device.yaml

properties:
  adc-dev:
    type: phandle
    required: true
    description: |
      ADC Device for temperature conversion:
      adc-dev = <&adc_node>;
  support-npckn-v1:
    type: boolean
    description: |
        This option enables the ADC-V2T support for NPCKn V1.
```

## dts/bindings/sensor/nxp,fxas21002-i2c.yaml
```yaml
# Copyright (c) 2018, NXP
# SPDX-License-Identifier: Apache-2.0

description: FXAS21002 3-axis gyroscope sensor

compatible: "nxp,fxas21002"

include: ["i2c-device.yaml", "nxp,fxas21002-common.yaml"]
```

## dts/bindings/sensor/nxp,fxas21002-spi.yaml
```yaml
# Copyright (c) 2018, NXP
# SPDX-License-Identifier: Apache-2.0

description: FXAS21002 3-axis gyroscope sensor

compatible: "nxp,fxas21002"

include: ["spi-device.yaml", "nxp,fxas21002-common.yaml"]
```

## dts/bindings/sensor/nxp,fxas21002.yaml
```yaml
# Copyright (c) 2018, NXP
# SPDX-License-Identifier: Apache-2.0

description: FXAS21002 3-axis gyroscope sensor

compatible: "nxp,fxas21002"

include: i2c-device.yaml

properties:
    int1-gpios:
      type: phandle-array
      required: false
      description: |
        INT1 pin
        This pin defaults to active low when produced by the sensor.
        The property value should ensure the flags properly describe
        the signal that is presented to the driver.

    int2-gpios:
      type: phandle-array
      required: false
      description: |
        INT2 pin
        This pin defaults to active low when produced by the sensor.
        The property value should ensure the flags properly describe
        the signal that is presented to the driver.
```

## dts/bindings/sensor/nxp,fxls8974-common.yaml
```yaml
# Copyright 2024 NXP
# SPDX-License-Identifier: Apache-2.0

description: FXLS8974 3-axis accelerometer sensor

include: sensor-device.yaml

properties:
  reset-gpios:
    type: phandle-array
    description: |
      RST pin
      This pin defaults to active high when consumed by the sensor.
      The property value should ensure the flags properly describe
      the signal that is presented to the driver.

  int1-gpios:
    type: phandle-array
    description: |
      INT1 pin
      This pin defaults to active low when produced by the sensor.
      The property value should ensure the flags properly describe
      the signal that is presented to the driver.

  int2-gpios:
    type: phandle-array
    description: |
      INT2 pin
      This pin defaults to active low when produced by the sensor.
      The property value should ensure the flags properly describe
      the signal that is presented to the driver.

  range:
    type: int
    default: 2
    description: |
      Range in g. Default value is 2 because it is the most sensitive setting.
      16g (7.81 mg/LSB), 8g (3.91 mg/LSB), 4g (1.95 mg/LSB), 2g (0.98 mg/LSB).
    enum:
      - 16
      - 8
      - 4
      - 2
```

## dts/bindings/sensor/nxp,fxls8974-spi.yaml
```yaml
# Copyright (c) 2024, NXP
# SPDX-License-Identifier: Apache-2.0

description: FXLS8974 3-axis accelerometer sensor

compatible: "nxp,fxls8974"

include: ["spi-device.yaml", "nxp,fxls8974-common.yaml"]
```

## dts/bindings/sensor/nxp,fxos8700-spi.yaml
```yaml
# Copyright (c) 2018, NXP
# SPDX-License-Identifier: Apache-2.0

description: FXOS8700 6-axis accelerometer/magnetometer sensor

compatible: "nxp,fxos8700"

include: ["spi-device.yaml", "nxp,fxos8700-common.yaml"]
```
