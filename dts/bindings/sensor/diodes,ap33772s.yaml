## dts/bindings/sensor/isentek,ist8308.yaml
```yaml
# SPDX-FileCopyrightText: Copyright The Zephyr Project Contributors
# SPDX-License-Identifier: Apache-2.0

description: iSentek IST8308 3-axis magnetometer

compatible: "isentek,ist8308"

include: [i2c-device.yaml, sensor-device.yaml]
```

## dts/bindings/sensor/melexis,mlx90640.yaml
```yaml
# Copyright (c) 2026 RAKwireless Technology Limited
# SPDX-License-Identifier: Apache-2.0

description: |
    Melexis MLX90640 32x24 far infrared thermal array.

    The sensor is accessed over I2C using 16-bit register addresses.
    Default 7-bit address is 0x33. A complete frame is 768 pixels
    (row-major, 32 columns). See the datasheet at
    https://www.melexis.com/en/documents/documentation/datasheets/datasheet-mlx90640

compatible: "melexis,mlx90640"

include: [sensor-device.yaml, i2c-device.yaml, power.yaml]

properties:
  refresh-rate:
    type: int
    default: 2
    enum:
      - 0
      - 1
      - 2
      - 3
      - 4
      - 5
      - 6
      - 7
    description: |
      RAM subpage refresh-rate field written to Control register 1 (0x800D)
      bits 9:7. Encoded values:

        0 = 0.5 Hz, 1 = 1 Hz, 2 = 2 Hz, 3 = 4 Hz,
        4 = 8 Hz, 5 = 16 Hz, 6 = 32 Hz, 7 = 64 Hz

      Use the MLX90640_REFRESH_* macros from
      include/zephyr/dt-bindings/sensor/mlx90640.h.

  emissivity:
    type: int
    default: 950000
    description: |
      Default object emissivity in millionths (950000 = 0.95). Can be
      overridden at runtime with MLX90640_SENSOR_ATTR_EMISSIVITY.

  ta-shift:
    type: int
    default: 8
    description: |
      Reflected-temperature shift in degrees Celsius subtracted from Ta
      (datasheet open-air typical value is 8).
```

## dts/bindings/sensor/microchip,emc1702.yaml
```yaml
# Copyright (c) 2026  Microchip Technology Inc. and its subsidiaries
# SPDX-License-Identifier: Apache-2.0

description: |
  Microchip EMC1702 high-side current sense and dual temperature monitor.

  Measures bus voltage on SENSE+, voltage across an external sense resistor
  (VSENSE), internal die temperature, ambient temperature and computes
  power as a ratio.

  The external (ambient) temperature channel is only usable when a diode is
  wired to DP/DN. For setups without the external temperature diode must leave
  external-diode-is-present unset, in which case the external channel is
  masked in hardware and SENSOR_CHAN_AMBIENT_TEMP / SENSOR_CHAN_EMC1702_FAULT
  report -ENOTSUP.

  The driver has trigger support. When enabled, the GPIO pins will indicate when
  a limit has been passed.

  Datasheet can be found at https://ww1.microchip.com/downloads/aemDocuments/documents/OTH/ProductDocuments/DataSheets/EMC1702-Data-Sheet-DS20006455A.pdf

compatible: "microchip,emc1702"

include: i2c-device.yaml

properties:
  sense-resistor-milliohms:
    type: int
    default: 10
    min: 1
    description: |
      Value of the external sense resistor in milliohms. Used to convert the
      measured VSENSE differential voltage into current.

  current-sense-range-mv:
    type: int
    default: 80
    enum: [10, 20, 40, 80]
    description: |
      Full-scale range of the differential voltage measurement across the
      sense resistor, in millivolts. Defaults to 80 mV (the chip's default
      and trimmed accuracy point per the datasheet).

  current-sense-sampling-time:
    type: int
    default: 82
    enum: [82, 164, 328]
    description: |
      Set the amount of time the capacitor is allowed to charge in ms.

  current-sense-queue:
    type: int
    default: 1
    enum: [1, 2, 3, 4]
    description: |
      Set the number of consecutive sense voltage measurements that must be
      over limit to flag an alarm.

  voltage-source-queue:
    type: int
    default: 1
    enum: [1, 2, 3, 4]
    description: |
      Set the number of consecutive source voltage measurements that must be
      over limit to flag an alarm.

  external-diode-is-present:
    type: boolean
    description: |
      When true, an external diode is connected to the DP/DN pins and the
      external temperature channel is enabled. When false (default) the
      external channel is masked in the Channel Mask register so that a
      missing/open diode cannot assert ALERT, the diode-fault check is
      skipped, and the ambient temperature channel is reported as
      unsupported.

  resistance-error-correction:
    type: boolean
    description: |
      When true, the resistance error correction is applied to
      the external diode. Ignored when external-diode-is-present is false.

  conversion-rate:
    type: int
    default: 4000
    enum: [62, 125, 250, 500, 1000, 2000, 4000, 8000]
    description: |
      Set conversion rate in ms for temperature, current and voltage channels.

  alert-gpios:
    type: phandle-array
    description: |
      GPIO connected to the EMC1702 ALERT pin (open-drain, active low).
      Required when CONFIG_EMC1702_TRIGGER is enabled. The pin should be
      configured GPIO_ACTIVE_LOW and may use GPIO_PULL_UP if no external
      pull-up is present on the board.

  smbus-timeout:
    type: boolean
    description: |
      When true, the SMBus timeout feature is enabled.

  therm-consecutive:
    type: int
    default: 4
    enum: [1, 2, 3, 4]
    description: |
      Set the number of consecutive measurements that must exceed the
      thermal critical limit before the THERM pin is asserted.

  alert-consecutive:
    type: int
    default: 1
    enum: [1, 2, 3, 4]
    description: |
      Set the number of consecutive measurements that must exceed the
      thermal alert limit or diode fault before the ALERT pin is asserted.
```

## dts/bindings/sensor/microchip,tc74.yaml
```yaml
# Copyright 2026 Ahmed Ashraf NourEldeen <a.programmer55559@gmail.com>
# SPDX-License-Identifier: Apache-2.0

description: TC74 ambient temperature sensor

compatible: "microchip,tc74"

include: [sensor-device.yaml, i2c-device.yaml]
```

## dts/bindings/sensor/nordic,nrf-vbat.yaml
```yaml
# Copyright (c) 2026 Nordic Semiconductor ASA
#
# SPDX-License-Identifier: Apache-2.0

description: |
  nRF SoC battery voltage measurement via the SAADC (Zephyr ADC driver).
  Reports SENSOR_CHAN_VOLTAGE in volts (sensor_value).

compatible: "nordic,nrf-vbat"

include: sensor-device.yaml

properties:
  io-channels:
    type: phandle-array
    required: true
    description: |
      SAADC channel used for internal VBAT.

  invert-voltage:
    type: boolean
    description: |
      If true, the voltage value is inverted
      i.e. for use when positive pin used for ground.

  divider-ratio:
    type: array
    default: [1, 1]
    description: |
      Ratio between the VBAT voltage and the voltage presented to the SAADC,
      expressed as two cells containing the numerator and denominator. For
      example, <11 2> represents a ratio of 5.5.
      The default value is set to <1 1> for input voltages that have not been divided.
```

## dts/bindings/sensor/nxp,fxas21002-common.yaml
```yaml
# Copyright (c) 2018, NXP
# SPDX-License-Identifier: Apache-2.0

description: FXAS21002 3-axis gyroscope sensor

include: sensor-device.yaml

properties:
  reset-gpios:
    type: phandle-array
    description: |
      RST pin
      This pin defaults to active low when consumed by the sensor.
      The property value should ensure the flags properly describe
      the signal that is presented to the driver.

  int1-gpios:
    type: phandle-array
    description: |
      INT1 pin
      This pin defaults to active low when produced by the sensor.
      The property value should ensure the flags properly describe
      the signal that is presented to the driver.

  int2-gpios:
    type: phandle-array
    description: |
      INT2 pin
      This pin defaults to active low when produced by the sensor.
      The property value should ensure the flags properly describe
      the signal that is presented to the driver.

  bus-mode-gpios:
    type: phandle-array
    description: |
      I2C_B/SPI pin. Active low selects I2C, so GPIO_ACTIVE_LOW is the
      flag to use. The driver holds the pin for the life of the device.
      In I2C mode it is driven active. In SPI mode it is driven inactive.

  spi-cs-gpios:
    type: phandle-array
    description: |
      SPI_CS_B pin. Active low, so GPIO_ACTIVE_LOW is the flag to use.
      When the device is on I2C the driver holds this pin inactive.
      When the device is on SPI the controller owns the chip select
      and this property is ignored.
```

## dts/bindings/sensor/omron,d7s.yaml
```yaml
# Copyright (c) 2026 RAKwireless Technology Limited
# SPDX-License-Identifier: Apache-2.0

title: Omron D7S Seismic Sensor

description: |
  Omron D7S vibration sensor.

  The D7S reports the spectral intensity (SI) and the peak ground
  acceleration (PGA) of an earthquake. Both are derived from an internal
  three-axis accelerometer, using the two axes that are horizontal at the
  mounting angle.

compatible: "omron,d7s"

include: [sensor-device.yaml, i2c-device.yaml]

properties:
  int1-gpios:
    type: phandle-array
    description: |
      Shutoff output. Asserted when the shutoff judgement condition or the
      collapse detection condition is met, and released when the EVENT
      register is read. The pin is open drain, so the flags must describe
      an active low signal.

  int2-gpios:
    type: phandle-array
    description: |
      Processing notification output. Asserted while the sensor calculates
      an earthquake, acquires an offset, or runs a self-diagnostic. The
      transition back to inactive is what signals that a result is ready.
      The pin is open drain, so the flags must describe an active low
      signal.

  shutoff-threshold:
    type: string
    default: "high"
    enum: ["high", "low"]
    description: |
      Earthquake shutoff judgement threshold. "high" asserts the shutoff
      output at a JMA seismic intensity equivalent to 5 Upper or higher.
      The sensor default is "high".

  axis-mode:
    type: string
    default: "switch-at-install"
    enum: ["yz", "xz", "xy", "auto", "switch-at-install"]
    description: |
      Which pair of accelerometer axes is used for the SI calculation.
      "yz", "xz" and "xy" fix the pair. "auto" recalculates it whenever
      Normal Mode starts. "switch-at-install" recalculates it only on entry
      to Initial Installation Mode, and is the sensor default.

examples:
  - |
    &i2c0 {
        d7s: d7s@55 {
            compatible = "omron,d7s";
            reg = <0x55>;
            int1-gpios = <&gpio0 12 GPIO_ACTIVE_LOW>;
            int2-gpios = <&gpio0 10 GPIO_ACTIVE_LOW>;
        };
    };
```

## dts/bindings/sensor/plantower,pmsa003i.yaml
```yaml
# Copyright (c) 2026, RAKwireless Technology Limited
# SPDX-License-Identifier: Apache-2.0

description: |
  Plantower PMSA003I air pollution sensor.
  Air pollution sensor capable of measuring mass concentration of dust.

compatible: "plantower,pmsa003i"

include: [sensor-device.yaml, i2c-device.yaml]

properties:
  reset-gpios:
    type: phandle-array
    description: |
      Module reset pin, which the sensor drives low to reset and pulls up
      on its own, so a board wiring it up states GPIO_ACTIVE_LOW. Leave
      the property out where the pin is not connected.

  set-gpios:
    type: phandle-array
    description: |
      Sleep pin, which the sensor treats as awake when high or left alone
      and asleep when low, and pulls up on its own, so a board wiring it
      up states GPIO_ACTIVE_HIGH. Leave the property out where the pin is
      not connected.
```

## dts/bindings/sensor/rakwireless,rak12035.yaml
```yaml
# Copyright (c) 2026 RAKwireless Technology Limited
# SPDX-License-Identifier: Apache-2.0

description: |
  RAKwireless RAK12035 capacitive soil moisture and temperature sensor.

  The probe is an ATtiny441 with RAKwireless firmware, accessed over I2C.
  Default 7-bit address is 0x20 (programmable). See the datasheet at
  https://docs.rakwireless.com/product-categories/wisblock/rak12035/datasheet/

  The sensor reports an unscaled capacitance value, probe temperature, and a
  two-point calibrated soil moisture percentage. The percentage is relative
  to the stored dry and wet calibration points; it is not air relative
  humidity or volumetric water content.

compatible: "rakwireless,rak12035"

include: [sensor-device.yaml, i2c-device.yaml, power.yaml]

properties:
  reset-gpios:
    type: phandle-array
    description: |
      Optional active-low reset signal. The driver leaves the signal
      deasserted and uses it to reset the sensor during initialization.
```

## dts/bindings/sensor/sensirion,scd30.yaml
```yaml
# Copyright (c) 2026 MASSDRIVER EI (massdriver.space)
# SPDX-License-Identifier: Apache-2.0

title: Sensirion SCD30 carbon dioxide, temperature and relative humidity sensor module

description: |
  Sensirion SCD30 dual channel Non-Dispersive Infrared carbon dioxide sensor module with
  an onboard SHT31 providing temperature and relative humidity.
  The host I2C controller must support extensive clock stretching up to 150ms,
  and the maximum I2C bitrate is 100 kHz, with recommendations to use lower speeds.
  The sensor address is always 0x61.

compatible: "sensirion,scd30"

include: [sensor-device.yaml, i2c-device.yaml]

examples:
  - |
    &i2c {
      clock-frequency = <I2C_BITRATE_STANDARD>;

      scd30: scd30@61 {
        compatible = "sensirion,scd30";
        reg = <0x61>;
        status = "okay";
        ready-gpios = <&gpio0 16 (GPIO_PULL_DOWN | GPIO_ACTIVE_HIGH)>;
      };
    };

properties:
  ready-gpios:
    type: phandle-array
    description: |
      Optional READY pin.

      This pin signals active high that data is ready for reading.

  one-shot-measurement:
    type: boolean
    description: |
      Only start measurements when queried.
      This increases the sensor response time and functionally disables self-calibration.

  default-measurement-period:
    type: int
    min: 2
    max: 1800
    description: |
      How long to wait in seconds for the measurements by default.
      The default in one-shot mode is the CO2 sensor stabilization time,
      to ensure samples as accurate as possible.
      In continuous periodic mode, it is the length stored in NVM if this is unset.
```

## dts/bindings/sensor/sensirion,sts35.yaml
```yaml
# Copyright (c) 2026 Dotcom IoT LLP
# SPDX-License-Identifier: Apache-2.0

description: STS35-DIS high-accuracy digital temperature sensor

compatible: "sensirion,sts35"

include: [sensor-device.yaml, i2c-device.yaml]

properties:
  repeatability:
    type: int
    default: 2
    enum: [0, 1, 2]
    description: |
      Measurement repeatability setting.

      0 = Low, 1 = Medium, 2 = High

      Higher repeatability reduces measurement noise but requires a
      longer measurement duration and may increase power consumption.

      The default is 2 (High) because it gives the lowest noise
      (0.04 degC, 3-sigma, compared to 0.08 degC for Medium and 0.15 degC
      for Low), which suits a high-accuracy sensor. Measurements are
      single-shot, so the longer conversion time (up to 15.5 ms,
      compared to 4.5 ms for Low) is only spent when a sample is
      requested. Select a lower value if latency or energy per sample
      matters more than noise.
```
