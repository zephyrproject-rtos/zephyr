## dts/bindings/sensor/excelitas,tpi1s1385.yaml
```yaml
# Copyright (c) 2026 BayLibre, SAS
# SPDX-License-Identifier: Apache-2.0

description: |
  Excelitas CaliPile TPiS 1S 1385 infrared thermopile sensor.

  Product page:
    https://www.excelitas.com/fr/product/tpis-1s-1385-calipile-sensor-smd

compatible: "excelitas,tpi1s1385"

include: [sensor-device.yaml, i2c-device.yaml]

properties:
  int-gpios:
    type: phandle-array
    description: |
      GPIO wired to the open drain active low INT pin of the sensor.

  slp1:
    type: int
    default: 11
    description: |
      Select code for the low pass filter LP1 time constant. This field
      occupies bits 3:0 of register 0x14. The binary codes 0110 and 0111
      are reserved by the datasheet and therefore not accepted. The
      datasheet recommends the value 11 (one second) for the presence
      detection use case.
    enum:
      - 0   # 512 s
      - 1   # 256 s
      - 2   # 128 s
      - 3   # 64 s
      - 4   # 32 s
      - 5   # 16 s
      - 8   # 8 s
      - 9   # 4 s
      - 10  # 2 s
      - 11  # 1 s
      - 12  # 0.5 s
      - 13  # 0.25 s

  slp2:
    type: int
    default: 8
    description: |
      Select code for the low pass filter LP2 time constant. This field
      occupies bits 7:4 of register 0x14. The binary codes 0110 and 0111
      are reserved by the datasheet and therefore not accepted. The
      datasheet recommends the value 8 (eight seconds) for the presence
      detection use case.
    enum:
      - 0   # 512 s
      - 1   # 256 s
      - 2   # 128 s
      - 3   # 64 s
      - 4   # 32 s
      - 5   # 16 s
      - 8   # 8 s
      - 9   # 4 s
      - 10  # 2 s
      - 11  # 1 s
      - 12  # 0.5 s
      - 13  # 0.25 s

  slp3:
    type: int
    default: 10
    description: |
      Select code for the low pass filter LP3 time constant. This field
      occupies bits 3:0 of register 0x15. The binary codes 0110 and 0111
      are reserved by the datasheet and therefore not accepted. The
      datasheet recommends the value 10 (two seconds) for the ambient
      temperature shock detection use case.
    enum:
      - 0   # 512 s
      - 1   # 256 s
      - 2   # 128 s
      - 3   # 64 s
      - 4   # 32 s
      - 5   # 16 s
      - 8   # 8 s
      - 9   # 4 s
      - 10  # 2 s
      - 11  # 1 s
      - 12  # 0.5 s
      - 13  # 0.25 s

  src-select:
    type: int
    min: 0
    max: 3
    default: 1
    description: |
      Selects the pair of signals subtracted to produce the presence
      counter. This field occupies bits 3:2 of register 0x1A. The value 0
      selects TPobject minus TPobjLP2. The value 1 selects TPobjLP1 minus
      TPobjLP2 and is the recommended combination. The value 2 selects
      TPobject minus TPobjLP2 frozen. The value 3 selects TPobjLP1 minus
      TPobjLP2 frozen.

  cycle-time:
    type: int
    min: 0
    max: 3
    default: 2
    description: |
      Cycle time used for the motion differentiation. This field occupies
      bits 1:0 of register 0x1A. The value 0 selects 30 ms, the value 1
      selects 60 ms, the value 2 selects 120 ms and is the recommended
      setting, and the value 3 selects 140 ms.

  tpot-direction-falls-below:
    type: boolean
    description: |
      Fire the TPOT interrupt when TPobject falls below the threshold
      instead of when it exceeds it. This drives bit 4 of register 0x1A.

  presence-threshold:
    type: int
    min: 0
    max: 255
    default: 50
    description: |
      Unsigned eight bit threshold written to register 0x16. Accepted
      values run from 0 to 255. The datasheet recommends 50.

  motion-threshold:
    type: int
    min: 0
    max: 255
    default: 10
    description: |
      Unsigned eight bit threshold written to register 0x17. Accepted
      values run from 0 to 255. The datasheet recommends 10.

  amb-shock-threshold:
    type: int
    min: 0
    max: 255
    default: 10
    description: |
      Unsigned eight bit threshold written to register 0x18. Accepted
      values run from 0 to 255. The datasheet recommends 10.
```

## dts/bindings/sensor/infineon,dps310-spi.yaml
```yaml
# SPDX-FileCopyrightText: Copyright The Zephyr Project Contributors
# SPDX-License-Identifier: Apache-2.0

description: Infineon DPS310 temperature and pressure sensor on SPI

include: [sensor-device.yaml, spi-device.yaml]

compatible: "infineon,dps310"
```

## dts/bindings/sensor/infineon,dps310.yaml
```yaml
# SPDX-FileCopyrightText: Copyright (c) 2026 Infineon Technologies AG,
# SPDX-FileCopyrightText: or an affiliate of Infineon Technologies AG. All rights reserved.
#
# SPDX-License-Identifier: Apache-2.0


description: Infineon DPS310 temperature and pressure sensor

include: [sensor-device.yaml, i2c-device.yaml]

compatible: "infineon,dps310"
```

## dts/bindings/sensor/infineon,tle493d.yaml
```yaml
# SPDX-FileCopyrightText: Copyright The Zephyr Project Contributors
# SPDX-License-Identifier: Apache-2.0

description: |
  Infineon TLE493D magnetic sensor.

compatible: "infineon,tle493d"

include: [sensor-device.yaml, i2c-device.yaml]

examples:
  - |
    &i2c1 {
        tle493d: tle493d@35 {
            compatible = "infineon,tle493d";
            reg = <0x35>;
        };
    };
```

## dts/bindings/sensor/invensense,icm20689.yaml
```yaml
# Copyright (c) 2025 Silicon Laboratories Inc. www.silabs.com
# SPDX-License-Identifier: Apache-2.0

description: |
  TDK InvenSense ICM-20689 6-axis SPI inertial sensor.

  When setting the accel-fs, gyro-fs, accel-dlpf, or gyro-dlpf
  properties, include <zephyr/dt-bindings/sensor/icm20689.h> and use
  the macros defined there.

compatible: "invensense,icm20689"

examples:
  - |
    #include <zephyr/dt-bindings/sensor/icm20689.h>

    &spi0 {
        status = "okay";

        icm20689: icm20689@0 {
            compatible = "invensense,icm20689";
            reg = <0>;
            spi-max-frequency = <8000000>;

            int-gpios = <&gpio0 10 GPIO_ACTIVE_HIGH>;

            accel-fs = <ICM20689_DT_ACCEL_FS_2G>;
            gyro-fs = <ICM20689_DT_GYRO_FS_250DPS>;

            accel-dlpf = <ICM20689_DT_ACCEL_DLPF_99HZ>;
            gyro-dlpf = <ICM20689_DT_GYRO_DLPF_41HZ>;

            smplrt-div = <9>;
        };
    };

include:
  - sensor-axis-align.yaml
  - sensor-device.yaml
  - spi-device.yaml

properties:
  spi-max-frequency:
    max: 8000000

  int-gpios:
    type: phandle-array
    description: |
      GPIO connected to the INT pin. The GPIO flags must describe
      the interrupt polarity configured by the driver.

  accel-fs:
    type: int
    default: 2
    description: |
      Initial accelerometer full-scale range in g.
      The hardware reset value is 2 g.
    enum:
      - 2  # ICM20689_DT_ACCEL_FS_2G
      - 4  # ICM20689_DT_ACCEL_FS_4G
      - 8  # ICM20689_DT_ACCEL_FS_8G
      - 16 # ICM20689_DT_ACCEL_FS_16G

  gyro-fs:
    type: int
    default: 250
    description: |
      Initial gyroscope full-scale range in degrees per second.
      The hardware reset value is 250 dps.
    enum:
      - 250  # ICM20689_DT_GYRO_FS_250DPS
      - 500  # ICM20689_DT_GYRO_FS_500DPS
      - 1000 # ICM20689_DT_GYRO_FS_1000DPS
      - 2000 # ICM20689_DT_GYRO_FS_2000DPS

  smplrt-div:
    type: int
    default: 0
    min: 0
    max: 255
    description: |
      Initial value written to the shared SMPLRT_DIV register.

      For accelerometer filter modes with ACCEL_FCHOICE_B equal to zero,
      the output data rate is 1000 / (1 + smplrt-div) Hz. Accelerometer
      DLPF bypass has a fixed 4 kHz output data rate.

      For gyroscope filter modes with FCHOICE_B equal to zero and DLPF_CFG
      between 1 and 6, the output data rate is 1000 / (1 + smplrt-div) Hz.
      Gyroscope DLPF_CFG values 0 and 7 have a fixed 8 kHz output data
      rate, while DLPF bypass modes have a fixed 32 kHz output data rate.

      Because SMPLRT_DIV is shared, it affects both sensor paths whenever
      their selected filter modes use the divider.

  accel-dlpf:
    type: int
    default: 0
    description: |
      Initial accelerometer filter configuration. The value packs
      ACCEL_CONFIG2.A_DLPF_CFG into bits 2:0 and
      ACCEL_CONFIG2.ACCEL_FCHOICE_B into bit 3.
    enum:
      - 0 # ICM20689_DT_ACCEL_DLPF_218_1HZ_CFG0
      - 1 # ICM20689_DT_ACCEL_DLPF_218_1HZ_CFG1
      - 2 # ICM20689_DT_ACCEL_DLPF_99HZ
      - 3 # ICM20689_DT_ACCEL_DLPF_44_8HZ
      - 4 # ICM20689_DT_ACCEL_DLPF_21_2HZ
      - 5 # ICM20689_DT_ACCEL_DLPF_10_2HZ
      - 6 # ICM20689_DT_ACCEL_DLPF_5_1HZ
      - 7 # ICM20689_DT_ACCEL_DLPF_420HZ
      - 8 # ICM20689_DT_ACCEL_BYPASS_1046HZ

  gyro-dlpf:
    type: int
    default: 0
    description: |
      Initial gyroscope filter configuration. The value packs
      CONFIG.DLPF_CFG into bits 2:0 and GYRO_CONFIG.FCHOICE_B into
      bits 4:3.
    enum:
      - 0   # ICM20689_DT_GYRO_DLPF_250HZ
      - 1   # ICM20689_DT_GYRO_DLPF_176HZ
      - 2   # ICM20689_DT_GYRO_DLPF_92HZ
      - 3   # ICM20689_DT_GYRO_DLPF_41HZ
      - 4   # ICM20689_DT_GYRO_DLPF_20HZ
      - 5   # ICM20689_DT_GYRO_DLPF_10HZ
      - 6   # ICM20689_DT_GYRO_DLPF_5HZ
      - 7   # ICM20689_DT_GYRO_DLPF_3281HZ_8KHZ
      - 8   # ICM20689_DT_GYRO_BYPASS_8173HZ_32KHZ
      - 16  # ICM20689_DT_GYRO_BYPASS_3281HZ_32KHZ
```

## dts/bindings/sensor/invensense,icm20948-i2c.yaml
```yaml
# Copyright (c) 2026 T3 Gemstone
# 	T3 Gemstone Developer Team <support@t3gemstone.org>
# Copyright (c) 2026 Richard Osterloh <richard.osterloh@gmail.com>
#
# SPDX-License-Identifier: Apache-2.0

description: |
    InvenSense ICM-20948 Nine-Axis Motion Tracking device. The accelerometer
    and the gyroscope sit behind the primary interface, the AK09916
    magnetometer behind an auxiliary I2C bus the device masters itself.

    In I2C mode the device answers at 0x68, or 0x69 with AD0 pulled high.

compatible: "invensense,icm20948"

include: [sensor-device.yaml, i2c-device.yaml, "invensense,icm20948-common.yaml"]
```

## dts/bindings/sensor/invensense,icm20948-spi.yaml
```yaml
# Copyright (c) 2026 T3 Gemstone
# 	T3 Gemstone Developer Team <support@t3gemstone.org>
#
# SPDX-License-Identifier: Apache-2.0

description: |
    InvenSense ICM-20948 Nine-Axis Motion Tracking device. The accelerometer
    and the gyroscope sit behind the primary interface, the AK09916
    magnetometer behind an auxiliary I2C bus the device masters itself.

    The SPI clock of the device must not exceed 7 MHz.

compatible: "invensense,icm20948"

include: [sensor-device.yaml, spi-device.yaml, "invensense,icm20948-common.yaml"]
```

## dts/bindings/sensor/invensense,icm20948.yaml
```yaml
# Copyright (c) 2026 T3 Gemstone
# 	T3 Gemstone Developer Team <support@t3gemstone.org>
#
# SPDX-License-Identifier: Apache-2.0

description: |
    InvenSense ICM-20948 Nine-Axis Motion Tracking device. Only the
    accelerometer and the gyroscope are supported, the magnetometer behind
    the auxiliary I2C bus is not.

    The SPI clock of the device must not exceed 7 MHz.

compatible: "invensense,icm20948"

include: [sensor-device.yaml, spi-device.yaml]

properties:
  gyro-fs:
    type: int
    default: 250
    enum: [250, 500, 1000, 2000]
    description: |
      Full scale range of the gyroscope in degrees per second. The default
      is the reset value of the device.

  accel-fs:
    type: int
    default: 2
    enum: [2, 4, 8, 16]
    description: |
      Full scale range of the accelerometer in g. The default is the reset
      value of the device.

  gyro-dlpf:
    type: int
    default: 197
    enum: [197, 152, 120, 51, 24, 12, 6, 361]
    description: |
      3 dB bandwidth of the gyroscope low pass filter in Hz, rounded to the
      nearest integer. The values are listed in the order the device expects
      them, which is not the order of the bandwidths themselves.

  accel-dlpf:
    type: int
    default: 246
    enum: [246, 111, 50, 24, 12, 6, 473]
    description: |
      3 dB bandwidth of the accelerometer low pass filter in Hz, rounded to
      the nearest integer. The device has two configurations that give
      246 Hz, only the first of them is exposed.
```

## dts/bindings/sensor/invensense,icm42605-i2c.yaml
```yaml
# Copyright 2026 Ahmed Ashraf NourEldeen <a.programmer55559@gmail.com>
# SPDX-License-Identifier: Apache-2.0

description: ICM-42605 motion tracking device in I2C mode

compatible: "invensense,icm42605"

include: [sensor-device.yaml, i2c-device.yaml, "invensense,icm42605-common.yaml"]
```

## dts/bindings/sensor/invensense,icm42605-spi.yaml
```yaml
# Copyright 2026 Ahmed Ashraf NourEldeen <a.programmer55559@gmail.com>
# SPDX-License-Identifier: Apache-2.0

description: ICM-42605 motion tracking device in SPI mode

compatible: "invensense,icm42605"

include: [sensor-device.yaml, spi-device.yaml, "invensense,icm42605-common.yaml"]
```

## dts/bindings/sensor/invensense,ictx53xx-i2c.yaml
```yaml
# Copyright (c) 2024 TDK Invensense
# SPDX-License-Identifier: Apache-2.0

description: ICTx53xx High Accuracy TMR Magnetometer Sensor

compatible: "invensense,ictx53xx"

include: [sensor-device.yaml, i2c-device.yaml]

properties:
  mode:
    type: string
    default: "sleep"
    description: |
      Default mode for sensor.
      Maps to MODE field in MODE_CTRL setting
      Power-on reset value is mode SLEEP.
    enum:
      - "sleep"
      - "pulsed"
      - "single-shot"
      - "mrm"

  odr-hz:
    type: int
    default: 100
    description: |
      Default frequency of magnetometer measurement pulsed. (Unit - Hz)
      Maps to ODR field in MODE_CTRL setting
      Power-on reset value is 100.
    enum:
      - 100
      - 50
      - 10
      - 5
      - 320
      - 200
```

## dts/bindings/sensor/invensense,iim42652.yaml
```yaml
# Copyright (c) 2026 RAKwireless Technology Limited
# SPDX-License-Identifier: Apache-2.0

description: |
    IIM-42652 high-performance 6-Axis SmartIndustrial MotionTracking MEMS
    device accessed over I2C.

    When setting the accel-pwr-mode, accel-fs, accel-odr, gyro-pwr-mode,
    gyro-fs, and gyro-odr properties in a .dts or .dtsi file you may include
    iim42652.h and use the macros defined there.

compatible: "invensense,iim42652"
include: [i2c-device.yaml, "invensense,icm4268x.yaml"]

examples:
  - |
    #include <zephyr/dt-bindings/gpio/gpio.h>
    #include <zephyr/dt-bindings/sensor/iim42652.h>

    &i2c0 {
      status = "okay";

      iim42652: iim42652@69 {
        compatible = "invensense,iim42652", "invensense,icm4268x";
        reg = <0x69>;
        int-gpios = <&gpio0 17 GPIO_ACTIVE_HIGH>;
        accel-pwr-mode = <IIM42652_DT_ACCEL_LN>;
        accel-fs = <IIM42652_DT_ACCEL_FS_16>;
        accel-odr = <IIM42652_DT_ACCEL_ODR_1000>;
        gyro-pwr-mode = <IIM42652_DT_GYRO_LN>;
        gyro-fs = <IIM42652_DT_GYRO_FS_2000>;
        gyro-odr = <IIM42652_DT_GYRO_ODR_1000>;
      };
    };
```

## dts/bindings/sensor/invensense,iim42653.yaml
```yaml
# SPDX-FileCopyrightText: Copyright The Zephyr Project Contributors
# SPDX-License-Identifier: Apache-2.0

title: TDK InvenSense IIM-42653 6-axis IMU

description: |
  IIM-42653 industrial motion tracking device.

  When setting the accel-pwr-mode, accel-fs, accel-odr, gyro-pwr-mode,
  gyro-fs and gyro-odr properties in a .dts or .dtsi file you may include
  iim42653.h and use the macros defined there.

compatible: "invensense,iim42653"
include: ["invensense,icm4268x.yaml"]

examples:
  - |
    #include <zephyr/dt-bindings/sensor/iim42653.h>

    iim42653: iim42653@0 {
      compatible = "invensense,iim42653", "invensense,icm4268x";
      /* ... */

      accel-pwr-mode = <IIM42653_DT_ACCEL_LN>;
      accel-fs = <IIM42653_DT_ACCEL_FS_32>;
      accel-odr = <IIM42653_DT_ACCEL_ODR_1000>;
      gyro-pwr-mode = <IIM42653_DT_GYRO_LN>;
      gyro-fs = <IIM42653_DT_GYRO_FS_4000>;
      gyro-odr = <IIM42653_DT_GYRO_ODR_1000>;
    };
```
