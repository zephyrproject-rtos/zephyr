## dts/bindings/sensor/cfsensor,xgzp68xxd.yaml
```yaml
# Copyright (c) 2026 Nexrem
# SPDX-License-Identifier: Apache-2.0

title: CFSensor XGZP68XXD Pressure Sensor

description: |
  The XGZP68XXD family of pressure sensors provide digital calibrated
  pressure and temperature readings over I2C. Sensors exist in ranges
  from -100kPa to 1500kPa. Both absolute and differential versions
  are supported.

compatible: "cfsensor,xgzp68xxd"

include: [sensor-device.yaml, i2c-device.yaml]

properties:
  k-value:
    type: int
    default: 8
    description: |
      The K value is selected for the appropriate pressure kPa range:
      Pressure range      | K value
      500 < kPa <= 1000   | 8
      260 < kPa <= 500    | 16
      130 < kPa <= 260    | 32
      65  < kPa <= 130    | 64
      32  < kPa <= 65     | 128
      16  < kPa <= 32     | 256
      8   < kPa <= 16     | 512
      4   < kPa <= 8      | 1024
      2   < kPa <= 4      | 2048
      1   < kPa <= 2      | 4096
    enum:
      - 8
      - 16
      - 32
      - 64
      - 128
      - 256
      - 512
      - 1024
      - 2048
      - 4096
```

## dts/bindings/sensor/cirque,pinnacle-spi.yaml
```yaml
# Copyright (c) 2024 Ilia Kharin
# SPDX-License-Identifier: Apache-2.0

description: Cirque Pinnacle 1CA027 based device with SPI connection

compatible: "cirque,pinnacle"

include: [sensor-device.yaml, spi-device.yaml]

properties:
  data-ready-gpios:
    type: phandle-array
    description: |
      Data Ready (DR) GPIO pin. The DR pin is connected to Pinncale HW_DR
      which is active high when SW_DR or SW_CC are asserted. If connected
      directly, the MCU pin should be configured as active low.

  idle-packets-count:
    type: int
    default: 0
    description: |
      The number of empty packets where both X and Y are set to 0. They are
      started to be sent when a finger presence is detected missing (no touch
      detected) every 10 ms. They are stopped to be sent when a finger presence
      it detected. An application can count these packets in order to detect
      taps. When set to 0, no empty packets are sent. Supported values from 0
      to 255.

  clipping-enable:
    type: boolean
    description: |
      Enable clipping of reported coordinates which are outside of the active
      range.

  active-range-x-min:
    type: int
    default: 128
    description: |
      The minimum X value which can be reported.

  active-range-x-max:
    type: int
    default: 1920
    description: |
      The maximum X value which can be reported.

  active-range-y-min:
    type: int
    default: 64
    description: |
      The minimum Y value which can be reported.

  active-range-y-max:
    type: int
    default: 1472
    description: |
      The maximum Y value which can be reported.

  scaling-enable:
    type: boolean
    description: |
      Enable scaling of reported coordinates according to arbitrary resolutions
      for X and Y axises. The scaling is assumed to be enabled when
      the clipping is enabled.

  scaling-x-resolution:
    type: int
    default: 1024
    description: Resolution for the X axis.

  scaling-y-resolution:
    type: int
    default: 1024
    description: Resolution for the Y axis.
```

## dts/bindings/sensor/dfrobot,a01nyub.yaml
```yaml
# Copyright (c) 2023 Steadconnect
# SPDX-License-Identifier: Apache-2.0

description: DFRobot A01NYUB Distance Sensor

compatible: "dfrobot,a01nyub"

include: [sensor-device.yaml, uart-device.yaml]
```

## dts/bindings/sensor/dti,pvt.yaml
```yaml
# Copyright (c) 2024, Rapid Silicon
# SPDX-License-Identifier: Apache-2.0

description: Process, Voltage and Thermal Sensor Module

compatible: "dti,pvt"

include: [base.yaml]

properties:

  clock-frequency:
    type: int
    required: true
    description:
      Clock frequency of the PVT Module.
```

## dts/bindings/sensor/epcos,b57861s0103a039.yaml
```yaml
# Copyright (c) 2023 Nordic Semiconductor ASA
# SPDX-License-Identifier: Apache-2.0

description: EPCOS B57861S0103A039 thermistor

compatible: "epcos,b57861s0103a039"

include: ntc-thermistor.yaml
```

## dts/bindings/sensor/espressif,esp32-pcnt.yaml
```yaml
# Copyright (c) 2022 Espressif Systems (Shanghai) Co., Ltd.
# SPDX-License-Identifier: Apache-2.0

description: |

  ESP32 Pulse Counter (PCNT)

  The pulse counter module is designed to count the number of
  rising and/or falling edges of an input signal.

  The original ESP32 has 8 independent counting units (0 to 7). ESP32-S2,
  ESP32-S3, ESP32-C5, ESP32-C6 and ESP32-H2 each have 4 units (0 to 3).

  Each pulse counter unit has a 16-bit signed counter register.

  Each unit has two independent channel: ch0 and ch1 that can be configured
  to either increment or decrement the counter.

  Each channel has two inputs: a signal input that accepts signal edges
  to be detected, as well as a control input that can be used to enable
  or disable the signal input.

  Each pulse counter unit also features a filter on each of the four inputs,
  adding the option to ignore short glitches in the signals.

  By combining the usage of both signal and control inputs, a PCNT unit can
  act as a quadrature decoder.

  The mapping between signal and control input and the pin is done through pinctrl.
  Check espressif,esp32-pinctrl.yaml for complete documentation regarding pinctrl.

compatible: "espressif,esp32-pcnt"

include: [sensor-device.yaml, pinctrl-device.yaml]

child-binding:
  description: PCNT Unit configuration.

  properties:
    reg:
      type: int
      required: true
      enum:
      - 0
      - 1
      - 2
      - 3
      - 4
      - 5
      - 6
      - 7

      description: |
        The PCNT unit index.
        The ESP32 has 8 PCNT units. ESP32S2/S3 have 4 PCNT units.

    filter:
      type: int
      description: |
        Glitch filter threshold in APB clock cycles (typical APB = 80 MHz
        so 1 cycle = 12.5 ns). Pulses shorter than this value are
        ignored. Maximum 1023; driver clamps higher values. Omit or set
        to 0 to disable the filter.

    counts-per-revolution:
      type: int
      description: |
        Number of encoder counts per full mechanical revolution.
        When non-zero, SENSOR_CHAN_ROTATION returns degrees [0..360).
        When zero (default), SENSOR_CHAN_ROTATION returns raw counts
        (legacy behavior, preserved for backward compatibility).
        SENSOR_CHAN_ENCODER_COUNT always returns raw counts.

    high-limit:
      type: int
      description: |
        Upper watchpoint. When the counter reaches this value the
        PCNT hardware auto-resets the counter to zero and raises a
        HIGH_LIMIT event. Value must fit in int16_t (range -32768..32767).
        Omit to disable the high-limit watchpoint.

    low-limit:
      type: int
      description: |
        Lower watchpoint. When the counter reaches this value the
        PCNT hardware auto-resets the counter to zero and raises a
        LOW_LIMIT event. Value must fit in int16_t (range -32768..32767).
        Omit to disable the low-limit watchpoint.

    zero-cross-event:
      type: boolean
      description: |
        When present, the PCNT hardware raises a ZERO_CROSS event
        whenever the counter crosses zero. The event fires a threshold
        trigger at counter index 0 on the unit.

  child-binding:
    description: PCNT Channel configuration.

    properties:
      reg:
        type: int
        required: true
        enum:
        - 0
        - 1

        description: The PCNT channel index.

      sig-pos-mode:
        type: int
        enum:
        - 0
        - 1
        - 2

        description: |
          Define what to do on the positive edge of pulse input.
          0 (Default) - Inhibit counter (counter value will not change in this condition).
          1 - Increase counter value.
          2 - Decrease counter value.

      sig-neg-mode:
        type: int
        enum:
        - 0
        - 1
        - 2

        description: |
          Define what to do on the negative edge of pulse input.
          0 (Default) - Inhibit counter (counter value will not change in this condition).
          1 - Increase counter value.
          2 - Decrease counter value.

      ctrl-h-mode:
        type: int
        enum:
        - 0
        - 1
        - 2

        description: |
          Define what to do when the control input is high.
          0 (Default) - Don't change counter mode.
          1 - Invert counter mode(increase -> decrease, decrease -> increase).
          2 - Control mode: Inhibit counter (counter value will not change in this condition).

      ctrl-l-mode:
        type: int
        enum:
        - 0
        - 1
        - 2

        description: |
          Define what to do when the control input is low.
          0 (Default) - Don't change counter mode.
          1 - Invert counter mode(increase -> decrease, decrease -> increase).
          2 - Control mode: Inhibit counter (counter value will not change in this condition).

examples:
- |
  /* Use PCNT to read a rotary-encoder */
  &pinctrl {
      pcnt_default: pcnt_default {
          group1 {
              pinmux = <PCNT0_CH0SIG_GPIO14>,
                      <PCNT0_CH0CTRL_GPIO15>;
              bias-pull-up;
          };
      };
  };
  &pcnt {
    pinctrl-0 = <&pcnt_default>;
    pinctrl-names = "default";
    status = "okay";
    #address-cells = <1>;
    #size-cells = <0>;
    unit0@0 {
      reg = <0>;
      #address-cells = <1>;
      #size-cells = <0>;
      filter = <100>;
      channelA@0 {
          reg = <0>;
          sig-pos-mode = <2>;
          sig-neg-mode = <1>;
          ctrl-h-mode = <0>;
          ctrl-l-mode = <1>;
      };
    };
  };
```

## dts/bindings/sensor/espressif,esp32-temp.yaml
```yaml
# Copyright (c) 2022-2025 Espressif Systems (Shanghai) Co., Ltd.
# SPDX-License-Identifier: Apache-2.0

description: |

  ESP32 internal temperature sensor

  This peripheral supports a number of measurement ranges with different
  precisions, based on the temperature range expected for the device to operate:

      Range (°C)      Error
      50 to 125       < 3°C
      20 to 100       < 2°C
      -10 to 80       < 1°C
      -30 to 50       < 2°C
      -40 to 20       < 3°C

  The range and corresponding expected precision are selected through the
  user-defined `range-min` and `range-max` properties. The default values
  represent a typical operating temperature range while selecting the best
  precision.

compatible: "espressif,esp32-temp"

include: sensor-device.yaml

properties:
  range-min:
    type: int
    description: |
      Minimum temperature (°C) for the configured measuring range.
    default: -10

  range-max:
    type: int
    description: |
      Maximum temperature (°C) for the configured measuring range.
    default: 80
```

## dts/bindings/sensor/everlight,als-pt19.yaml
```yaml
# Copyright (c) 2025 Dipak Shetty <shetty.dipak@gmx.com>
# SPDX-License-Identifier: Apache-2.0

description: Everlight ALS-PT19 Ambient Light Sensor

compatible: "everlight,als-pt19"

include: sensor-device.yaml

properties:
  load-resistor:
    type: int
    required: true
    description: |
      Load resistor value in ohms

  io-channels:
    type: phandle-array
    required: true
    description: |
      ADC IO channel to use.
```

## dts/bindings/sensor/festo,veaa-x-3.yaml
```yaml
# Copyright (c) 2024 Vitrolife A/S
# SPDX-License-Identifier: Apache-2.0

description: |
  Festo VEAA proportional pressure regulator using 3/3-way valve.
  Only voltage controlled valve is supported.

compatible: "festo,veaa-x-3"

include: sensor-device.yaml

properties:
  io-channels:
    type: phandle-array
    required: true
    description: |
      ADC used to get the actual value:
      <&adc_node channel>
  dac:
    type: phandle
    required: true
    description: |
      DAC used to set the setpoint value:
      <&dac_node channel resolution buffered>
  dac-channel-id:
    type: int
    required: true
  dac-resolution:
    type: int
    required: true
  pressure-range-type:
    type: string
    enum: ["D2", "D9", "D11"]
    required: true
    description: |
      The device pressure range type.
      | Type  | Range [kPa] |
      | D11   | 5-1000      |
      | D9    | 3-600       |
      | D2    | 1-200       |
```

## dts/bindings/sensor/fintek,f75303.yaml
```yaml
# Copyright (c) 2023 Google LLC
# SPDX-License-Identifier: Apache-2.0

description: |
    F75303 temperature sensor IC. This device has three temperature
    channels - one local (on-chip), and two remote.

compatible: "fintek,f75303"

include: [sensor-device.yaml, i2c-device.yaml]
```

## dts/bindings/sensor/focaltech,ft5336.yaml
```yaml
#
# Copyright (c) 2019, NXP
#
# SPDX-License-Identifier: Apache-2.0
#
---
title: FT5336 capacitive touch panel
version: 0.1

description: >
    This is a representation of the FT5336 capacitive touch panel

inherits:
    !include i2c-device.yaml

properties:
    compatible:
      constraint: "focaltech,ft5336"

    int-gpios:
      type: compound
      category: optional
      generation: define, use-prop-name
...
```

## dts/bindings/sensor/fujitsu,frammb85rs64v-spi.yaml
```yaml
# Copyright (c) 2019, Linaro Limited
# SPDX-License-Identifier: Apache-2.0

description: FRAMMB85RS64V integrated environmental sensor

compatible: "fujitsu,frammb85rs64v"

include: spi-device.yaml
```

## dts/bindings/sensor/grmn,lidar-lite-v4.yaml
```yaml
# Copyright (c) 2025 Alex Aylward
# SPDX-License-Identifier: Apache-2.0

description: Garmin LIDAR-Lite v4 laser rangefinder

compatible: "grmn,lidar-lite-v4"

include: [sensor-device.yaml, i2c-device.yaml]
```
