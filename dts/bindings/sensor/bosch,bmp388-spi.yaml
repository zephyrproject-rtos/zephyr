## dts/bindings/sensor/bosch,bmp388-spi.yaml
```yaml
# Copyright (c) 2020 Facebook, Inc. and its affiliates
# SPDX-License-Identifier: Apache-2.0

description: |
    Bosch BMP388 pressure sensor accessed through SPI bus

compatible: "bosch,bmp388"

include: [spi-device.yaml, "bosch,bmp388.yaml"]
```

## dts/bindings/sensor/bosch,bmp388.yaml
```yaml
# Copyright (c) 2020 Facebook, Inc. and its affiliates
# SPDX-License-Identifier: Apache-2.0

# Common fields for BMP388

include: sensor-device.yaml

properties:
  int-gpios:
    type: phandle-array

  odr:
    type: string
    description: |
      Default output data rate in Hz. Only the following values are allowed:
        200   - 200     - 5ms  (default; chip reset value)
        100   - 100     - 10ms
        50    - 50      - 20ms
        25    - 25      - 40ms
        12.5  - 25/2    - 80ms
        6.25  - 25/4    - 160ms
        3.125 - 25/8    - 320ms
        1.563 - 25/16   - 640ms
        .781  - 25/32   - 1.28s
        .391  - 25/64   - 2.56s
        .195  - 25/128  - 5.12s
        .098  - 25/256  - 10.24s
        .049  - 25/512  - 20.48s
        .024  - 25/1024 - 40.96s
        .012  - 25/2048 - 81.92s
        .006  - 25/4096 - 163.84s
        .003  - 25/8192 - 327.68s
    default: "200"
    enum:
      - "200"
      - "100"
      - "50"
      - "25"
      - "12.5"
      - "6.25"
      - "3.125"
      - "1.563"
      - ".781"
      - ".391"
      - ".195"
      - ".098"
      - ".049"
      - ".024"
      - ".012"
      - ".006"
      - ".003"

  osr-press:
    type: int
    description: |
      Default pressure oversampling rate. Only the following values are
      allowed:
        1 sample, 16-bit, 2.64 Pa
        2 samples, 17-bit, 1.32 Pa
        4 samples, 18-bit, 0.66 Pa (default; chip reset value)
        8 samples, 19-bit, 0.33 Pa
        16 samples, 20-bit, 0.17 Pa
        32 Samples, 21-bit, 0.085 Pa
    default: 4
    enum:
      - 1
      - 2
      - 4
      - 8
      - 16
      - 32

  osr-temp:
    type: int
    description: |
      Default temperature oversampling rate. Only the following values are
      allowed:
        1 sample, 16-bit, .0050 C (default; chip reset value)
        2 samples, 17-bit, .0025 C
        4 samples, 18-bit, .0012 C
        8 samples, 19-bit, .0006 C
        16 samples, 20-bit, .0003 C
        32 Samples, 21-bit, .00015 C
    default: 1
    enum:
      - 1
      - 2
      - 4
      - 8
      - 16
      - 32

  iir-filter:
    type: int
    description: |
      Default IIR filter coefficient. The default 0 is the chip reset value.
    default: 0
    enum:
      - 0
      - 1
      - 3
      - 7
      - 15
      - 31
      - 63
      - 127
```

## dts/bindings/sensor/bosch,bmp390-i2c.yaml
```yaml
# Copyright (c) 2024 Chris Ruehl
# SPDX-License-Identifier: Apache-2.0

description: |
    Bosch BMP390 pressure sensor accessed through I2C bus

compatible: "bosch,bmp390"

include: [i2c-device.yaml, "bosch,bmp390.yaml"]
```

## dts/bindings/sensor/bosch,bmp390-spi.yaml
```yaml
# Copyright (c) 2024 Chris Ruehl
# SPDX-License-Identifier: Apache-2.0

description: |
    Bosch BMP390 pressure sensor accessed through SPI bus

compatible: "bosch,bmp390"

include: [spi-device.yaml, "bosch,bmp390.yaml"]
```

## dts/bindings/sensor/bosch,bmp390.yaml
```yaml
# Copyright (c) 2020 Facebook, Inc. and its affiliates
# SPDX-License-Identifier: Apache-2.0

include: bosch,bmp3xx-base.yaml
```

## dts/bindings/sensor/bosch,bmp581-i3c.yaml
```yaml
description: |
    The BMP581 is a Barometric pressure sensor on I3C. See more info at:
    https://www.bosch-sensortec.com/products/environmental-sensors/pressure-sensors/bmp581/

    When setting the sensor DTS properties, make sure to include
    bmp581.h and use the macros defined there.

compatible: "bosch,bmp581"

include: ["i3c-device.yaml", "bosch,bmp581-common.yaml"]

examples:
  - |
    #include <zephyr/dt-bindings/sensor/bmp581.h>

    &i3c0 {
        bmp581: bmp581@460000000000000046 {
            compatible = "bosch,bmp581";
            reg = <0x46 0x00 0x46>;
            odr = <BMP581_DT_ODR_50_HZ>;
            press-osr = <BMP581_DT_OVERSAMPLING_8X>;
            temp-osr = <BMP581_DT_OVERSAMPLING_4X>;
            press-iir = <BMP581_DT_IIR_FILTER_COEFF_7>;
            temp-iir = <BMP581_DT_IIR_FILTER_COEFF_3>;
            power-mode = <BMP581_DT_MODE_NORMAL>;
        };
    };
```

## dts/bindings/sensor/bosch,bmp581-spi.yaml
```yaml
description: |
    The BMP581 is a Barometric pressure sensor on SPI. See more info at:
    https://www.bosch-sensortec.com/products/environmental-sensors/pressure-sensors/bmp581/

    When setting the sensor DTS properties, make sure to include
    bmp581.h and use the macros defined there.

compatible: "bosch,bmp581"

include: ["spi-device.yaml", "bosch,bmp581-common.yaml"]

examples:
  - |
    #include <zephyr/dt-bindings/sensor/bmp581.h>

    &spi0 {
        bmp581: bmp581@0 {
            compatible = "bosch,bmp581";
            reg = <0>;
            spi-max-frequency = <12000000>;
            odr = <BMP581_DT_ODR_50_HZ>;
            press-osr = <BMP581_DT_OVERSAMPLING_8X>;
            temp-osr = <BMP581_DT_OVERSAMPLING_4X>;
            press-iir = <BMP581_DT_IIR_FILTER_COEFF_7>;
            temp-iir = <BMP581_DT_IIR_FILTER_COEFF_3>;
            power-mode = <BMP581_DT_MODE_NORMAL>;
        };
    };
```

## dts/bindings/sensor/bosch,bmp581.yaml
```yaml
description: |
    The BMP581 is a Barometric pressure sensor. See more info at:
    https://www.bosch-sensortec.com/products/environmental-sensors/pressure-sensors/bmp581/

    When setting the sensor DTS properties, make sure to include
    bmp581.h and use the macros defined there.

    Example:
    #include <zephyr/dt-bindings/sensor/bmp581.h>

    bmp581@46 {
        ...
        odr = <BMP581_DT_ODR_50_HZ>;
        press-osr = <BMP581_DT_OVERSAMPLING_8X>;
        temp-osr = <BMP581_DT_OVERSAMPLING_4X>;
        press-iir = <BMP581_DT_IIR_FILTER_COEFF_7>;
        temp-iir = <BMP581_DT_IIR_FILTER_COEFF_3>;
        power-mode = <BMP581_DT_MODE_NORMAL>;
    };

compatible: "bosch,bmp581"

include: [sensor-device.yaml, i2c-device.yaml]

properties:
  int-gpios:
    type: phandle-array
    description: Interrupt pin.

      The interrupt pin of BMP581 is open-drain, active low. If connected directly to the MCU,
      the pin should be configured as pull-up, active low.

  odr:
    type: int
    default: 0x1C  # BMP581_DT_ODR_1_HZ
    description: |
      Output data rate. Please note this is only valid on BMP581_DT_MODE_NORMAL.
      Default is power-on reset.
    enum:
      - 0x00 # BMP581_DT_ODR_240_HZ
      - 0x01 # BMP581_DT_ODR_218_5_HZ
      - 0x02 # BMP581_DT_ODR_199_1_HZ
      - 0x03 # BMP581_DT_ODR_179_2_HZ
      - 0x04 # BMP581_DT_ODR_160_HZ
      - 0x05 # BMP581_DT_ODR_149_3_HZ
      - 0x06 # BMP581_DT_ODR_140_HZ
      - 0x07 # BMP581_DT_ODR_129_8_HZ
      - 0x08 # BMP581_DT_ODR_120_HZ
      - 0x09 # BMP581_DT_ODR_110_1_HZ
      - 0x0A # BMP581_DT_ODR_100_2_HZ
      - 0x0B # BMP581_DT_ODR_89_6_HZ
      - 0x0C # BMP581_DT_ODR_80_HZ
      - 0x0D # BMP581_DT_ODR_70_HZ
      - 0x0E # BMP581_DT_ODR_60_HZ
      - 0x0F # BMP581_DT_ODR_50_HZ
      - 0x10 # BMP581_DT_ODR_45_HZ
      - 0x11 # BMP581_DT_ODR_40_HZ
      - 0x12 # BMP581_DT_ODR_35_HZ
      - 0x13 # BMP581_DT_ODR_30_HZ
      - 0x14 # BMP581_DT_ODR_25_HZ
      - 0x15 # BMP581_DT_ODR_20_HZ
      - 0x16 # BMP581_DT_ODR_15_HZ
      - 0x17 # BMP581_DT_ODR_10_HZ
      - 0x18 # BMP581_DT_ODR_5_HZ
      - 0x19 # BMP581_DT_ODR_4_HZ
      - 0x1A # BMP581_DT_ODR_3_HZ
      - 0x1B # BMP581_DT_ODR_2_HZ
      - 0x1C # BMP581_DT_ODR_1_HZ
      - 0x1D # BMP581_DT_ODR_0_5_HZ
      - 0x1E # BMP581_DT_ODR_0_250_HZ
      - 0x1F # BMP581_DT_ODR_0_125_HZ

  press-osr:
    type: int
    default: 0x00  # BMP581_DT_OVERSAMPLING_1X
    description: |
      Pressure oversampling rate.
      Default is power-on reset.
    enum:
      - 0x00 # BMP581_DT_OVERSAMPLING_1X
      - 0x01 # BMP581_DT_OVERSAMPLING_2X
      - 0x02 # BMP581_DT_OVERSAMPLING_4X
      - 0x03 # BMP581_DT_OVERSAMPLING_8X
      - 0x04 # BMP581_DT_OVERSAMPLING_16X
      - 0x05 # BMP581_DT_OVERSAMPLING_32X
      - 0x06 # BMP581_DT_OVERSAMPLING_64X
      - 0x07 # BMP581_DT_OVERSAMPLING_128X

  temp-osr:
    type: int
    default: 0x00  # BMP581_DT_OVERSAMPLING_1X
    description: |
      Temperature oversampling rate.
      Default is power-on reset.
    enum:
      - 0x00 # BMP581_DT_OVERSAMPLING_1X
      - 0x01 # BMP581_DT_OVERSAMPLING_2X
      - 0x02 # BMP581_DT_OVERSAMPLING_4X
      - 0x03 # BMP581_DT_OVERSAMPLING_8X
      - 0x04 # BMP581_DT_OVERSAMPLING_16X
      - 0x05 # BMP581_DT_OVERSAMPLING_32X
      - 0x06 # BMP581_DT_OVERSAMPLING_64X
      - 0x07 # BMP581_DT_OVERSAMPLING_128X

  power-mode:
    type: int
    default: 1  # BMP581_DT_MODE_NORMAL
    description: |
      Power mode.
      Default favors ease of use by simply setting ODR and OSR. Otherwise user
      needs to look into driver details, as the other modes require some quirks
      (e.g: Forced mode does not just work).
    enum:
      - 1 # BMP581_DT_MODE_NORMAL
      - 2 # BMP581_DT_MODE_FORCED
      - 3 # BMP581_DT_MODE_CONTINUOUS

  press-iir:
    type: int
    default: 0x00  # BMP581_DT_IIR_FILTER_BYPASS
    description: |
      Pressure IIR filter coefficient.
      Default is power-on reset (bypass).
    enum:
      - 0x00 # BMP581_DT_IIR_FILTER_BYPASS
      - 0x01 # BMP581_DT_IIR_FILTER_COEFF_1
      - 0x02 # BMP581_DT_IIR_FILTER_COEFF_3
      - 0x03 # BMP581_DT_IIR_FILTER_COEFF_7
      - 0x04 # BMP581_DT_IIR_FILTER_COEFF_15
      - 0x05 # BMP581_DT_IIR_FILTER_COEFF_31
      - 0x06 # BMP581_DT_IIR_FILTER_COEFF_63
      - 0x07 # BMP581_DT_IIR_FILTER_COEFF_127

  temp-iir:
    type: int
    default: 0x00  # BMP581_DT_IIR_FILTER_BYPASS
    description: |
      Temperature IIR filter coefficient.
      Default is power-on reset (bypass).
    enum:
      - 0x00 # BMP581_DT_IIR_FILTER_BYPASS
      - 0x01 # BMP581_DT_IIR_FILTER_COEFF_1
      - 0x02 # BMP581_DT_IIR_FILTER_COEFF_3
      - 0x03 # BMP581_DT_IIR_FILTER_COEFF_7
      - 0x04 # BMP581_DT_IIR_FILTER_COEFF_15
      - 0x05 # BMP581_DT_IIR_FILTER_COEFF_31
      - 0x06 # BMP581_DT_IIR_FILTER_COEFF_63
      - 0x07 # BMP581_DT_IIR_FILTER_COEFF_127
```

## dts/bindings/sensor/bosch,bmp581.yml
```yaml
description: |
    The BMP581 is a Barometric pressure sensor. See more info at:
    https://www.bosch-sensortec.com/products/environmental-sensors/pressure-sensors/bmp581/

compatible: "bosch,bmp581"

include: [sensor-device.yaml, i2c-device.yaml]

properties:
  int-gpios:
    type: phandle-array
    required: false
    description: Interrupt pin.

      The interrupt pin of BMP581 is open-drain, active low. If connected directly to the MCU,
      the pin should be configured as pull-up, active low.
```

## dts/bindings/sensor/bosch,bmx160.yaml
```yaml
# Copyright (c) 2020, Linumiz
# SPDX-License-Identifier: Apache-2.0

description: BMX160 inertial measurement unit

compatible: "bosch,bmx160"

include: i2c-device.yaml

properties:
    int-gpios:
      type: phandle-array
      required: false
      description: |
        This property specifies the connection for INT1, because the
        Zephyr driver maps all interrupts to INT1.  The signal defaults
        to output low when produced by the sensor.
```

## dts/bindings/sensor/bosch,bno055-i2c.yaml
```yaml
# SPDX-License-Identifier: Apache-2.0

description: BNO055 accelerometer, gyroscope, magnetometer and orientation sensor

compatible: "bosch,bno055"

include: i2c-device.yaml
```

## dts/bindings/sensor/brcm,afbr-s50.yaml
```yaml
# Copyright (c) 2025 Croxel Inc.
# Copyright (c) 2025 CogniPilot Foundation
# SPDX-License-Identifier: Apache-2.0

description: |
    AFBR-S50 3D ToF sensor

    This sensor requires the SPI bus attached to it, to define the following
    pinctrl states:
    - pinctrl-0: default (SPI mode).
    - pinctrl-1: GPIO mode (used to access the internal EEPROM).

    It also requires defining the GPIO pins used for the SPI bus in GPIO mode,
    under the AFBR node.

    Example:

    #include <zephyr/dt-bindings/sensor/afbr_s50.h>

    &spi_bus {
        status = "okay";
        pinctrl-0 = <&spi_bus_default>;
        pinctrl-1 = <&spi_bus_gpio>;
        pinctrl-names = "default", "priv_start";
        ...

        afbr_s50: afbr_s50@0 {
          compatible = "brcm,afbr-s50";
          reg = <0>;
          spi-max-frequency = <10000000>;
          measurement-mode = <AFBR_S50_DT_MODE_SHORT_RANGE>;
          dual-freq-mode = <AFBR_S50_DT_DFM_MODE_OFF>;
          odr = <10>;
          int-gpios = <&gpio0 10 (GPIO_ACTIVE_LOW | GPIO_PULL_UP)>;
          spi-mosi-gpios = <&gpio0 24 GPIO_ACTIVE_HIGH>;
          spi-sck-gpios = <&gpio0 25 GPIO_ACTIVE_HIGH>;
          spi-miso-gpios = <&gpio0 26 GPIO_ACTIVE_HIGH>;
        };
    };

compatible: "brcm,afbr-s50"
include: [sensor-device.yaml, spi-device.yaml]

properties:
  int-gpios:
    type: phandle-array
    required: true
    description: |
      The INT signal default configuration is active-low. The
      property value should ensure the flags properly describe the
      signal that is presented to the driver.

  measurement-mode:
    type: int
    required: true
    description: |
      Specify Measurement Mode setting.
    enum:
      - 1 # AFBR_S50_DT_MODE_SHORT_RANGE
      - 2 # AFBR_S50_DT_MODE_LONG_RANGE
      - 5 # AFBR_S50_DT_MODE_HIGH_SPEED_SHORT_RANGE
      - 6 # AFBR_S50_DT_MODE_HIGH_SPEED_LONG_RANGE
      - 9 # AFBR_S50_DT_MODE_HIGH_PRECISION_SHORT_RANGE
      - 129 # AFBR_S50_DT_MODE_SHORT_RANGE_LASER_CLASS_2
      - 130 # AFBR_S50_DT_MODE_LONG_RANGE_LASER_CLASS_2
      - 133 # AFBR_S50_DT_MODE_HIGH_SPEED_SHORT_RANGE_LASER_CLASS_2
      - 134 # AFBR_S50_DT_MODE_HIGH_SPEED_LONG_RANGE_LASER_CLASS_2
      - 137 # AFBR_S50_DT_MODE_HIGH_PRECISION_SHORT_RANGE_LASER_CLASS_2

  dual-freq-mode:
    type: int
    required: true
    description: |
      Specify Dual Frequency Mode setting.
    enum:
      - 0 # AFBR_S50_DT_DFM_MODE_OFF
      - 1 # AFBR_S50_DT_DFM_MODE_4X
      - 2 # AFBR_S50_DT_DFM_MODE_8X

  odr:
    type: int
    default: 10
    description: |
      Specify the default output data rate expressed in samples per second (Hz).
      Default configuration used from all sample-codes provided by vendor.
      Please note the range is limited with Dual Frequency Mode enabled (up to 100 Hz).

  spi-mosi-gpios:
    type: phandle-array
    required: true
    description: |
      SPI MOSI GPIO pin. Used by the driver in order to use the bus in GPIO
      mode, which is required to interact with the internal EEPROM the
      AFBR contains (mandatory).
      This property is required since the SPI bus is configured and used
      through pinctrl, which is not directly mapped to a GPIO port/pin.

  spi-miso-gpios:
    type: phandle-array
    required: true
    description: |
      SPI MISO GPIO pin. Used by the driver in order to use the bus in GPIO
      mode, which is required to interact with the internal EEPROM the
      AFBR contains (mandatory).
      This property is required since the SPI bus is configured and used
      through pinctrl, which is not directly mapped to a GPIO port/pin.

  spi-sck-gpios:
    type: phandle-array
    required: true
    description: |
      SPI CLK GPIO pin. Used by the driver in order to use the bus in GPIO
      mode, which is required to interact with the internal EEPROM the
      AFBR contains (mandatory).
      This property is required since the SPI bus is configured and used
      through pinctrl, which is not directly mapped to a GPIO port/pin.
```
