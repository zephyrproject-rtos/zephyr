## dts/bindings/sensor/ltrf216a.yaml
```yaml
# Copyright (c) 2023, Trridonic
# SPDX-License-Identifier: Apache-2.0

description: LiteOn F216A ambient light sensor

compatible: "ltr,f216a"

include: [sensor-device.yaml, i2c-device.yaml]
```

## dts/bindings/sensor/magntek,mt6701.yaml
```yaml
# Copyright (c) 2024, Vinicius Miguel
# SPDX-License-Identifier: Apache-2.0

description: |
    MagnTek MT6701 Angular position sensor

compatible: "magntek,mt6701"

include: [sensor-device.yaml, spi-device.yaml]
```

## dts/bindings/sensor/max,max30101.yaml
```yaml
# Copyright (c) 2018, NXP
# SPDX-License-Identifier: Apache-2.0

description: MAX30101 heart rate sensor

compatible: "max,max30101"

include: i2c-device.yaml
```

## dts/bindings/sensor/maxbotix,mb7040.yaml
```yaml
description: MB7040 ultrasonic distance sensor

compatible: "maxbotix,mb7040"

include: [sensor-device.yaml, i2c-device.yaml]

properties:
  status-gpios:
    type: phandle-array
    description: |
      GPIO pin connected to Pin 2 (Address Announce/Status) to monitor sensor
      state. Pin is high during range reading and low when ready for I2C communication.
```

## dts/bindings/sensor/maxim,ds18b20.yaml
```yaml
# Copyright (c) 2021, Thomas Stranger
# SPDX-License-Identifier: Apache-2.0

description: Maxim 1-Wire temperature sensor

compatible: "maxim,ds18b20"

include: w1-slave.yaml

properties:
    resolution:
      type: int
      required: true
      description: |
          Resolution of the temperature reading in bit.
          Valid configurations are from 9 to 12 bits.
```

## dts/bindings/sensor/maxim,ds18s20.yaml
```yaml
# Copyright (c) 2024, Fredrik Gihl
# SPDX-License-Identifier: Apache-2.0

description: Maxim 1-Wire ds18s20 temperature sensor

compatible: "maxim,ds18s20"

include: [sensor-device.yaml, w1-slave.yaml]
```

## dts/bindings/sensor/maxim,ds3231-sensor.yaml
```yaml
# Copyright (c) 2024 Gergo Vari <work@gergovari.com>
#
# SPDX-License-Identifier: Apache-2.0
#

description: Maxim DS3231 I2C temperature sensor

compatible: "maxim,ds3231-sensor"

include: [sensor-device.yaml]
```

## dts/bindings/sensor/maxim,max17055.yaml
```yaml
#
# Copyright 2020 Google LLC
#
# SPDX-License-Identifier: Apache-2.0
#

description: Maxim MAX17055 Fuel Gauge

compatible: "maxim,max17055"

include: [sensor-device.yaml, i2c-device.yaml]

properties:
  design-capacity:
    type: int
    required: true
    description: The design capacity (aka label capacity) of the cell in mAh

  design-voltage:
    type: int
    required: true
    description: Battery Design Voltage in mV (3300 to 4400)

  desired-voltage:
    type: int
    required: true
    description: Battery Desired Voltage in mV (3300 to 4400)

  desired-charging-current:
    type: int
    required: true
    description: Battery Design Charging Current in mA (e.g. 2000)

  i-chg-term:
    type: int
    required: true
    description: The charge termination current in mA

  rsense-mohms:
    type: int
    required: true
    description: |
      Value of Rsense resistor in milliohms (e.g. 5). It cannot be 0.

  v-empty:
    type: int
    required: true
    description: The empty voltage of the cell in mV
```

## dts/bindings/sensor/maxim,max17262.yaml
```yaml
#
# Copyright 2020 Matija Tudan
#
# SPDX-License-Identifier: Apache-2.0
#

description: Maxim MAX17262 Fuel Gauge

compatible: "maxim,max17262"

include: i2c-device.yaml

properties:
    design-voltage:
      type: int
      required: true
      description: Battery Design Voltage in mV (3300 to 4400)

    desired-voltage:
      type: int
      required: true
      description: Battery Desired Voltage in mV (3300 to 4400)

    desired-charging-current:
      type: int
      required: true
      description: Battery Design Charging Current in mA (e.g. 2000)

    design-cap:
      type: int
      required: true
      description: Battery Capacity in mAh (default 3000)

    empty-voltage:
      type: int
      required: true
      description: Empty voltage target during load in mV (default 3300)

    recovery-voltage:
      type: int
      required: true
      description: The voltage level for clearing empty detection in mV (default 3880)

    charge-voltage:
      type: int
      required: true
      description: Charge voltage in mV
```

## dts/bindings/sensor/maxim,max1726x.yaml
```yaml
#
# Copyright 2020 Matija Tudan
#
# SPDX-License-Identifier: Apache-2.0
#

description: Maxim MAX1726X Fuel Gauge

compatible: "maxim,max1726x"

include: i2c-device.yaml

properties:
    design-voltage:
      type: int
      required: true
      description: Battery Design Voltage in mV (3300 to 4400)

    desired-voltage:
      type: int
      required: true
      description: Battery Desired Voltage in mV (3300 to 4400)

    desired-charging-current:
      type: int
      required: true
      description: Battery Design Charging Current in mA (e.g. 2000)

    design-cap:
      type: int
      required: true
      description: Battery Capacity in mAh (default 3000)

    empty-voltage:
      type: int
      required: true
      description: Empty voltage target during load in mV (default 3300)

    recovery-voltage:
      type: int
      required: true
      description: The voltage level for clearing empty detection in mV (default 3880)

    charge-voltage:
      type: int
      required: true
      description: Charge voltage in mV

    hibernate-threshold:
      type: int
      required: false
      default: 7
      description: |
          Used to set the threshold level (in mA) for entering or exiting
          hibernate mode. The threshold is defined by the following equation:
          threshold (mA) = (FullCap(mAh) / 0.8hrs) / 2 ^ (hibernate-threshold).
          Value must be betweew 0 and 15.
          Hardware default to 7 at startup.

    hibernate-scalar:
      type: int
      required: false
      default: 4
      description: |
          Used to set the task period while in hibernate mode. The task period is
          defined by the following equation:
          Task Period (s) = 351ms x 2 ^ (hibernate-scalar).
          Value must be between 0 and 7.
          Hardware default to 4 at startup.

    hibernate-exit-time:
      type: int
      required: false
      default: 3
      description: |
          Used to set the required time period of consecutive current readings
          above the hib-threshold value before the IC exits hibernate and return
          to active mode of operation. The exit time is defined by the following
          equation:
          Exit Time (s) = (hibernate-exit-time+1) x 702ms x 2 ^ (hibernate-scalar).
          Value must be between 0 and 3.
          Hardware default to 3 at startup.

    hibernate-enter-time:
      type: int
      required: false
      default: 0
      description: |
          Used to set the time period that consecutive current readings must
          remain below the hib-threshold value before the IC enters hibernate
          mode. The enter time is defined by the following equation:
          2.812s x 2 ^ (hibernate-enter-time) < Entry Time < 2.812s x 2 ^ (hibernate-enter-time + 1).
          Value must be between 0 and 7.
          Hardware default to 0 at startup.
```

## dts/bindings/sensor/maxim,max30101.yaml
```yaml
# Device Tree binding for Maxim MAX30101
#
# Copyright (c) 2018, NXP
# Copyright (c) 2025, CATIE
#
# SPDX-License-Identifier: Apache-2.0

description: MAX30101 heart rate and pulse oximeter sensor

compatible: "maxim,max30101"

include: maxim,max3010x-common.yaml

properties:
  led-pa:
    default: [0xff, 0xff, 0xff]
    description: |
      [0]: Red LED
      [1]: IR LED
      [2]: Green LED
      Default set to [0xff, 0xff, 0xff], activate any chosen LED channel.
```

## dts/bindings/sensor/maxim,max30102.yaml
```yaml
# Device Tree binding for Maxim MAX30102
#
# Copyright (c) 2026, Md Shofiqul Islam
#
# SPDX-License-Identifier: Apache-2.0

description: |
  MAX30102 heart rate and pulse oximeter sensor.

  The MAX30102 has two LED channels (Red + IR) and is register-compatible
  with the MAX30101 except that the Green LED (LED3) is not present.

compatible: "maxim,max30102"

include: maxim,max3010x-common.yaml

properties:
  led-pa:
    default: [0xff, 0xff]
    description: |
      [0]: Red LED
      [1]: IR LED
      The MAX30102 has no Green LED. Array must have exactly 2 elements.
```

## dts/bindings/sensor/maxim,max30208.yaml
```yaml
# Copyright (c) 2021, Silvano Cortesi
# Copyright (c) 2021, ETH Zürich
# SPDX-License-Identifier: Apache-2.0

description: MAX30208 digital temperature sensor

compatible: "maxim,max30208"

include: i2c-device.yaml

properties:
    int-gpios:
      type: phandle-array
      required: false
      description: |
        The INT signal defaults to active low open drain, so requires a
        pull-up on the board or in the flags cell of this entry.
    fifo-a-full:
      type: int
      required: false
      default: 0
      description: |
        Set the trigger for the FIFO_A_FULL interrupt (e.g. if set to 2,
        then the flag is set when the 30th word is written to the FIFO).
        Range: 0-31, Default: 0, same as after Power Reset
    fifo-rollover-en:
      type: boolean
      required: false
      description: |
        Controls the behavior of the FIFO when the FIFO becomes completely
        filled with data. If set, the FIFO address rolls over to zero and the
        FIFO continues to fill with new data. If not set, then the FIFO is
        not updated until FIFO_DATA is read or the WRITE/READ pointer
        positions are changed.
    fifo-a-full-type:
      type: boolean
      required: false
      description: |
        If false, then the A_FULL status bit is asserted on each sample for
        which the condition persists. If true, then the bit is asserted only
        once until the next A_FULL condition.
    fifo-stat-clr:
      type: boolean
      required: false
      description: |
        If true, then A_FULL and TEMP_RDY bit are cleared by a FIFO_DATA register read.
    gpio0-mode:
      type: int
      required: false
      default: 2
      enum:
       - 0
       - 1
       - 2
       - 3
      description: |
        The mode for GPIO0.
        0 = High impedance input
        1 = Output (open-drain)
        2 = Input with 1MOhm pulldown
        3 = Interrupt output (active low)
        Default: 2, same as after Power Reset
    gpio1-mode:
      type: int
      required: false
      default: 2
      enum:
       - 0
       - 1
       - 2
       - 3
      description: |
        The mode for GPIO1.
        0 = High impedance input
        1 = Output (open-drain)
        2 = Input with 1MOhm pulldown
        3 = Convert Temperature input (active low)
        Default: 2, same as after Power Reset
```

## dts/bindings/sensor/maxim,max31790-fan-speed.yaml
```yaml
# Copyright (c) 2024 SILA Embedded Solutions GmbH
# SPDX-License-Identifier: Apache-2.0

description: fan speed measurement of Maxim Integrated MAX31790 PWM Controller

compatible: "maxim,max31790-fan-speed"

include: [sensor-device.yaml]

on-bus: max31790

properties:
  channel:
    type: int
    enum:
      - 1
      - 2
      - 3
      - 4
      - 5
      - 6
    required: true
    description: PWM channel number
```

## dts/bindings/sensor/maxim,max31826.yaml
```yaml
# Copyright (c) 2026 Foss Analytical A/S
# SPDX-License-Identifier: Apache-2.0

description: Maxim MAX31826 1-Wire temperature sensor

compatible: "maxim,max31826"

include: [sensor-device.yaml, w1-slave.yaml]
```

## dts/bindings/sensor/maxim,max31855-spi.yaml
```yaml
# Copyright (c) 2020, Christian Hirsch
# SPDX-License-Identifier: Apache-2.0

description: MAX31855 SPI-based cold-junction compensated thermocouple-to-digital converter.

compatible: "maxim,max31855"

include: [sensor-device.yaml, spi-device.yaml]
```

## dts/bindings/sensor/maxim,max31865.yaml
```yaml
# Copyright (c) 2022, HAW Hamburg FTZ-DIWIP
# SPDX-License-Identifier: Apache-2.0


description: |
  Maxim MAX31865 SPI RTD-to-Digital Converter Temperature Sensor.
  Find the datasheet here:
  https://datasheets.maximintegrated.com/en/ds/MAX31865.pdf

compatible: "maxim,max31865"

include: [sensor-device.yaml, spi-device.yaml]

properties:
  resistance-at-zero:
    type: int
    required: true
    description: Sensor resistance in ohms at 0 Celsius (100 ohms for PT100, 1000 ohms for PT1000)

  resistance-reference:
    type: int
    required: true
    description: Circuit reference resistance in ohms (recommended on MAX31865 datasheet 400 ohms
      for PT100, 4000 ohms for PT1000, the Adafruit boards use 430 ohms and 4300 ohms)

  low-threshold:
    type: int
    default: 0
    description: Low fault threshold (ADC CODE, 15-bit value, unit-free, default value is the
      minimum value)

  high-threshold:
    type: int
    default: 32767
    description: High fault threshold (ADC CODE, 15-bit value, unit-free, default value is the
      maximum value)

  maxim,3-wire:
    type: boolean
    description: 3-wire enabled (@a true) or 2-wire/4-wire (@a false)

  filter-50hz:
    type: boolean
    description: 50 Hz filter enabled (@a true) or 60 Hz filter enabled (@a false)
```

## dts/bindings/sensor/maxim,max31875.yaml
```yaml
#
# Copyright 2022 Pete Dietl <petedietl@gmail.com>
#
# SPDX-License-Identifier: Apache-2.0
#

description: |
  Maxim MAX31875 Low-Power I2C Temperature Sensor.
  Find the datasheet here:
  https://datasheets.maximintegrated.com/en/ds/MAX31875.pdf

compatible: "maxim,max31875"

include: "i2c-device.yaml"

properties:
  conversions-per-second:
    description: |
      Number of temperature readings performed by the MAX31875 per second.
      0.25 converions per second is the power-on reset configuration.
    type: string
    default: "0.25"
    # Note: the driver relies on the ordering of this enum,
    # so change it with care.
    enum:
      - "0.25"
      - "1"
      - "4"
      - "8"
  extended-mode:
    description: |
      When true, use 13-bit data format to allow for measuring
      temperatures > 128°C
    type: boolean
  resolution:
    description: |
      The number of bits used for each temperature sample.
      A resolution of 10 bits takes 35ms to convert.
      Each 1-bit increase doubles the conversion time.
      Similarly, each 1-bit decrease halves the conversion time.
      10 bits of resolution is the power-on reset configuration.
    type: int
    default: 10
    # Note: the driver relies on the ordering of this enum,
    # so change it with care.
    enum:   # Conversion time (ms)
      - 8   # 8.75
      - 9   # 17.5
      - 10  # 35
      - 12  # 140
```
