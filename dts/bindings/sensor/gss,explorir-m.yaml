## dts/bindings/sensor/gss,explorir-m.yaml
```yaml
# Copyright (c) 2025 Prevas A/S
# SPDX-License-Identifier: Apache-2.0

description: Gas Sensing Solutions CO2 sensor

compatible: "gss,explorir-m"

include: [sensor-device.yaml, uart-device.yaml]
```

## dts/bindings/sensor/gxcas,gxhtc3.yaml
```yaml
# Copyright (c) 2024 LCKFB
# SPDX-License-Identifier: Apache-2.0

description: GXCAS GXHTC3 temperature and humidity sensor

compatible: "gxcas,gxhtc3"

include: [sensor-device.yaml, i2c-device.yaml]
```

## dts/bindings/sensor/hamamatsu,s11059.yaml
```yaml
# Copyright (c) 2022, Hiroki Tada
# SPDX-License-Identifier: Apache-2.0

description: |
  Hamamatsu Photonics S11059 Color Sensor.  See datasheet at
  https://datasheetspdf.com/pdf/1323325/Hamamatsu/S11059-02DT/1

compatible: "hamamatsu,s11059"

include: [sensor-device.yaml, i2c-device.yaml]

properties:
  high-gain:
    type: boolean
    description: |
      When present, the high gain is enabled.
      The gain ratio is 10 times from low to high.

  integration-time:
    type: int
    default: 546000
    description: |
      Integration time (unit is us).
      By setting this value to the desired integration time,
      the Integration time setting and Manual timing register
      values are set automatically.

      The default value is 546ms. See datasheet, bottom of page 3.
```

## dts/bindings/sensor/hamamatsu,s9706.yaml
```yaml
# Copyright (c) 2026 Carl Zeiss AG
# SPDX-License-Identifier: Apache-2.0

description: |
  Hamamatsu S9706 Digital Color Sensor. See datasheet at
  https://www.hamamatsu.com/content/dam/hamamatsu-photonics/sites/documents/99_SALES_LIBRARY/ssd/s9706_kpic1060e.pdf

compatible: "hamamatsu,s9706"

include: [sensor-device.yaml]

properties:
  range-gpios:
    type: phandle-array
    description: GPIO connected to range control pin.

  gate-gpios:
    type: phandle-array
    required: true
    description: GPIO connected to gate pin.

  data-gpios:
    type: phandle-array
    required: true
    description: GPIO connected to DOUT pin.

  clk-gpios:
    type: phandle-array
    required: true
    description: GPIO connected to clock pin.

  max-frequency:
    type: int
    required: true
    description: |
      Max serial clock frequency. According to the datasheet, this should be at
      or below 2MHz.

  integration-time:
    type: int
    required: true
    description: Integration time of the sensor in microseconds.
```

## dts/bindings/sensor/hc-sr04.yaml
```yaml
# Copyright (c) 2024, Adrien Leravat
# SPDX-License-Identifier: Apache-2.0

description: HC-SR04 ultrasound sensor.

compatible: "hc-sr04"

include: sensor-device.yaml

properties:
  trigger-gpios:
    type: phandle-array
    required: true
    description: |
      Output pin used to trigger the distance measurement.
  echo-gpios:
    type: phandle-array
    required: true
    description: |
      Input pin. The pulse received on this pin corresponds to
      the duration between the ultrasonic pulse emission and
      the reception of its "echo".

  echo-timeout-ms:
    type: int
    default: 10
    description: |
      Maximum time the driver waits for the echo to return.
      Default value of 10ms is equivalent to approx. 1.5m maximum range.
      Measurements with no target will abort when timeout is reached.
```

## dts/bindings/sensor/hilink,ld2410.yaml
```yaml
# SPDX-License-Identifier: Apache-2.0

description: |
  Hi-Link LD2410 radar sensor

compatible: "hilink,ld2410"

include: [sensor-device.yaml, uart-device.yaml]


properties:
  engineering-mode:
    type: boolean
    description: |
      In this mode the sensor sends additional data.

  distance-resolution:
    type: int
    default: 0
    description: |
      Programmable distance resolution per gate
      0 =  -> 75cm per gate
      1 =  -> 20cm per gate
    enum:
      - 0
      - 1

  motion-sensitivity:
    type: array
    default: [50, 50, 40, 30, 20, 15, 15, 15, 15]
    description: |
      Array of 9 motion sensitivty values (0-100 per gate)

  stationary-sensitivity:
    type: array
    default: [0, 0, 40, 40, 30, 30, 20, 20, 20]
    description: |
      Array of 9 stationary sensitivty values (0-100 per gate)

  max-motion-gate:
    type: int
    default: 8
    description: |
      The maximum detection range motion gate index (2-8)

  max-stationary-gate:
    type: int
    default: 8
    description: |
      The maximum detection range stationary gate index (2-8)

  presence-timeout:
    type: int
    default: 5
    description: |
      Timeout of the presence detection (0-65535 seconds)

  int-gpios:
    type: phandle-array
    description: |
      Interrupt pin. When the presence is detected, the GPIO is set to high.
```

## dts/bindings/sensor/honeywell,hmc5883l.yaml
```yaml
# Copyright (c) 2019 Linaro Limited
# SPDX-License-Identifier: Apache-2.0

description: Honeywell HMC5883L 3-axis magnetometer sensor

compatible: "honeywell,hmc5883l"

include: i2c-device.yaml

properties:
    int-gpios:
      type: phandle-array
      required: false
      description: DRDY pin

        This pin is active low, with an internal pullup in the sensor.
        The property value should ensure the flags properly describe
        the signal that is presented to the driver.
```

## dts/bindings/sensor/honeywell,mpr.yaml
```yaml
# SPDX-License-Identifier: Apache-2.0

description: |
    Honeywell Digital Pressure Sensor. For details see here:
    https://sensing.honeywell.com/micropressure-mpr-series

compatible: "honeywell,mpr"

include: [sensor-device.yaml, i2c-device.yaml]
```

## dts/bindings/sensor/honeywell,sm351lt.yaml
```yaml
# Copyright (c) 2020, Laird Connectivity
# SPDX-License-Identifier: Apache-2.0

description: SM351LT magnetoresistive sensor

compatible: "honeywell,sm351lt"

include: base.yaml

properties:
   gpios:
      type: phandle-array
      required: true
      description: GPIO connected to the sensor
```

## dts/bindings/sensor/hoperf,hp206c.yaml
```yaml
# Copyright (c) 2019, Linaro Limited
# SPDX-License-Identifier: Apache-2.0

description: |
    HopeRF Electronic HP206C precision barometer and altimeter.
    See more info at:
    https://www.hoperf.com/sensor/pressure_sensor/HP206C.html

compatible: "hoperf,hp206c"

include: [sensor-device.yaml, i2c-device.yaml]
```

## dts/bindings/sensor/hoperf,th02.yaml
```yaml
# Copyright (c) 2019, Linaro Limited
# SPDX-License-Identifier: Apache-2.0

description: |
    TH02 Temperature and Humidity sensor. See datasheet at
    http://www.datasheetspdf.com/mobile/748107/TH02.html

compatible: "hoperf,th02"

include: [sensor-device.yaml, i2c-device.yaml]
```

## dts/bindings/sensor/hzgrow,r502a.yaml
```yaml
# Copyright (c) 2021, Linumiz
# SPDX-License-Identifier: Apache-2.0

description: HZ-Grow GROW_R502A Fingerprint sensor.

compatible: "hzgrow,r502a"

include: [sensor-device.yaml, uart-device.yaml]

properties:
  reg:
    required: true
  int-gpios:
    type: phandle-array
    required: true
    description: |
      Interrupt pin. When the sensor is touched, the GPIO is set to high.
      It is used to trigger a fingerprint enroll or match operations.
  vin-gpios:
    type: phandle-array
    description: |
      Voltage input pin to the fingerprint sensor.
  act-gpios:
    type: phandle-array
    description: |
      Finger detection power pin to detect the presence of finger.
```

## dts/bindings/sensor/iclegend,s3km1110.yaml
```yaml
# SPDX-FileCopyrightText: Copyright The Zephyr Project Contributors
# SPDX-License-Identifier: Apache-2.0

description: |
  Iclegend S3KM1110 24 GHz mmWave presence radar.

compatible: "iclegend,s3km1110"

include: [sensor-device.yaml, uart-device.yaml]
```

## dts/bindings/sensor/infineon,autanalog-die-temp.yaml
```yaml
# SPDX-FileCopyrightText: <text>Copyright (c) 2026 Infineon Technologies AG,
# or an affiliate of Infineon Technologies AG. All rights reserved.</text>
#
# SPDX-License-Identifier: Apache-2.0

description: |
  Infineon PSOC Edge AutAnalog die temperature sensor.

  Exposes the on-chip die temperature measured through the AutAnalog SAR ADC
  internal temperature-sensor MUX channel as a standard Zephyr sensor
  (SENSOR_CHAN_DIE_TEMP).

  The sensor is a thin wrapper around the AutAnalog SAR ADC driver: it samples
  the configured io-channel and converts the raw accumulated SAR counts to
  degrees Celsius using the PDL temperature-conversion routine.

  The referenced io-channel must point at a MUX channel configured for the
  internal temperature sensor (IFX_AUTANALOG_SAR_PIN_MUX_TEMP_SENSOR) in
  differential mode with the VBGR reference, as required for accurate die
  temperature conversion.  See samples/boards/infineon/lp_temp_sensor for a
  reference SAR ADC configuration.

compatible: "infineon,autanalog-die-temp"

include: sensor-device.yaml

properties:
  io-channels:
    required: true
    description: |
      ADC channel for the internal die temperature sensor.  Must reference a
      MUX channel of an infineon,autanalog-sar-adc controller configured for
      the internal temperature sensor input.

  sar-index:
    type: int
    default: 0
    description: |
      Index of the SAR ADC subsystem within the AutAnalog block.  Passed as the
      sarIdx argument to the PDL temperature-conversion routine.  Defaults to 0.

  sar-sequencer:
    type: int
    default: 0
    description: |
      SAR sequencer entry index used to produce the temperature result.  Passed
      as the sarSequencer argument to the PDL temperature-conversion routine.
      Defaults to 0.
```

## dts/bindings/sensor/infineon,thermistor.yaml
```yaml
# Copyright (c) 2023 Cypress Semiconductor Corporation (an Infineon company) or
# an affiliate of Cypress Semiconductor Corporation
#
# SPDX-License-Identifier: Apache-2.0

description: Infineon thermistor temperature sensor

compatible: "infineon,thermistor"

include: sensor-device.yaml

properties:
  io-channels:
    required: true
    description: ADC channel for temperature sensor voltage (thermistor output)

  vdd-gpios:
    type: phandle-array
    required: true
    description: Thermistor VDD gpio

  gnd-gpios:
    type: phandle-array
    required: true
    description: Thermistor GND gpio

  r-ref:
    type: int
    required: true
    description: Resistance of the reference resistor

  b-const:
    type: int
    required: true
    description: Beta constant of the thermistor

  r-infinity:
    type: int
    required: true
    description: |
      Projected resistance of the thermistor at infinity
      This value will be divided by 1,000,000

  wiring:
    type: int
    required: true
    description: |
      Defines the NTC thermistor circuitry
      Vin-Thermistor-R-GND or Vin-R-Thermistor-GND
```

## dts/bindings/sensor/infineon,tle9104-diagnostics.yaml
```yaml
# Copyright (c) 2024 SILA Embedded Solutions GmbH
# SPDX-License-Identifier: Apache-2.0

description: Output diagnostics of the powertrain switch TLE9104

compatible: "infineon,tle9104-diagnostics"

include: [sensor-device.yaml]

on-bus: tle9104

properties:
  "#sensor-cells":
    type: int
    const: 0
```

## dts/bindings/sensor/infineon,tlv493d.yaml
```yaml
# Copyright(c) 2026 Junseo Pyun
# SPDX-License-Identifier: Apache-2.0

description: |
    TLV493D 3D Magnetic sensor.

compatible: "infineon,tlv493d"

include: [sensor-device.yaml, i2c-device.yaml]

properties:
  operating-mode:
    type: string
    default: master-controlled
    description: |
      Operating mode for sensor.
      Operating modes are the following:
      - powerdown: fastmode=0, lowpower=0, odr=0Hz
      - fast: fastmode=1, lowpower=0, odr=3.3kHz
      - low-power: fastmode=0, lowpower=1, odr=100Hz
      - ultra-low-power: fastmode=0, lowpower=1, odr=10Hz
      - master-controlled: fastmode=1, lowpower=1, odr=0Hz ~ 3.3kHz
      Default set to master-controlled.
    enum:
      - powerdown
      - fast
      - low-power
      - ultra-low-power
      - master-controlled

  temp-disable:
    type: boolean
    description: |
      Disable die temperature measurement, enabled by default.
```

## dts/bindings/sensor/infineon,xmc4xxx-temp.yaml
```yaml
# Copyright (c) 2023 Andriy Gelman <andriy.gelman@gmail.com>
# SPDX-License-Identifier: Apache-2.0

description: Infineon XMC4XXX die temperature sensor

compatible: "infineon,xmc4xxx-temp"

include: sensor-device.yaml
```

## dts/bindings/sensor/invensense,ch101.yaml
```yaml
# Copyright (c) 2017, Linaro Limited
# SPDX-License-Identifier: Apache-2.0

description: TDK CH101 chirp ToF sensor

compatible: "invensense,ch101"

include: invensense-chirp-common.yaml
```

## dts/bindings/sensor/invensense,icm20608.yaml
```yaml
# Copyright (c) 2024 Han Wu
# email: wuhanstudio@gmail.com
# SPDX-License-Identifier: Apache-2.0

description: |
  ICM-20608 motion tracking device

compatible: "invensense,icm20608"

include: [sensor-device.yaml, i2c-device.yaml]

properties:
  irq-gpios:
    type: phandle-array
    description: |
      The INT signal default configuration is active-high.  The
      property value should ensure the flags properly describe the
      signal that is presented to the driver.
      This property is required when the trigger mode is used.

  gyro-sr-div:
    type: int
    required: true
    description: |
      Default gyrscope sample rate divider. This divider is only effective
      when gyro-dlpf is in range 5-176.
      rate = sample_rate / (1 + gyro-sr-div)
      Valid range: 0 - 255

  gyro-dlpf:
    type: int
    required: true
    description: |
      Default digital low pass filter frequency of gyroscope.
      Maps to DLPF_CFG field in Configuration setting.
    enum:
      - 250
      - 176
      - 92
      - 41
      - 20
      - 10
      - 5
      - 3281

  gyro-fs:
    type: int
    required: true
    description: |
      Default full scale of gyroscope. (Unit - DPS).
      Maps to GYRO_FS_SEL field in Gyroscope Configuration setting.
    enum:
      - 250
      - 500
      - 1000
      - 2000

  accel-fs:
    type: int
    required: true
    description: |
      Default full scale of accelerometer. (Unit - g)
      Maps to ACCEL_FS_SEL field in Accelerometer Configuration setting
    enum:
      - 2
      - 4
      - 8
      - 16

  accel-dlpf:
    type: string
    required: true
    description: |
      Default digital low pass filter frequency of accelerometer.
      Maps to DLPF_CFG field in Accelerometer Configuration 2 setting.
    enum:
      - "218.1"
      - "218.1a"
      - "99.0"
      - "44.8"
      - "21.2"
      - "10.2"
      - "5.10"
      - "420.0"
```
