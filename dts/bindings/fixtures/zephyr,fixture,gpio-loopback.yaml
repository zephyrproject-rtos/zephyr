## dts/bindings/fixtures/zephyr,fixture,gpio-loopback.yaml
```yaml
#
# Copyright (c) 2019-2020 Nordic Semiconductor ASA
#
# SPDX-License-Identifier: Apache-2.0
#

description: |
    This binding provides resources required to support tests that
    require the gpio-loopback feature.

    Presence of a node with this compatible, even with status "okay",
    does not imply that the shorted connections required to run tests
    with this feature are present.

compatible: "zephyr,fixture,gpio-loopback"

properties:
    out-gpios:
        type: phandle-array
        required: true
        description: |
          Identity of a GPIO that will be configured as an output.  This
          must be on the same device as in-gpios, and physically
          connected to in-gpios.

          Where a board has an Arduino-compatible header this is
          preferred to be one of the following:

            out-gpios = <&arduino_header 6 0>; /* Arduino D0 */
            out-gpios = <&arduino_header 0 0>; /* Arduino A0 */

    in-gpios:
        type: phandle-array
        required: true
        description: |
          Identity of a GPIO that will be configured as an input.  This
          must be on the same device as out-gpios,and physically
          connected to out-gpios.

          Where a board has an Arduino-compatible header this is
          preferred to be one of the following:

            out-gpios = <&arduino_header 7 0>; /* Arduino D1 */
            out-gpios = <&arduino_header 1 0>; /* Arduino A1 */
```

## dts/bindings/flash/nxp,lpc-spifi-nor.yaml
```yaml
# Private Porting
# by David Hor - Xtooltech 2025
# david.hor@xtooltech.com

# Copyright (c) 2024, VCI Development - LPC54S018J4MET180E single-core M4
# SPDX-License-Identifier: Apache-2.0

description: NXP LPC SPIFI NOR flash driver for W25Q32JV 4MB QSPI flash

compatible: "nxp,lpc-spifi-nor"

include: [flash-controller.yaml, pinctrl-device.yaml]

properties:
  reg:
    type: array
    required: true
    description: SPIFI controller register base address

  interrupts:
    required: true

  jedec-id:
    type: uint8-array
    required: true
    description: JEDEC ID of the flash device

  size:
    type: int
    required: true
    description: Flash size in bits

  spi-max-frequency:
    type: int
    required: true
    description: Maximum SPI frequency

  has-dpd:
    type: boolean
    description: Flash supports deep power down mode

  pinctrl-0:
    required: true

  pinctrl-names:
    required: true
```

## dts/bindings/flash_controller/adi,max32-flash-controller.yaml
```yaml
# Copyright (c) 2023 Analog Devices, Inc.
# SPDX-License-Identifier: Apache-2.0

description: MAX32XXX flash controller

compatible: "adi,max32-flash-controller"

include: flash-controller.yaml
```

## dts/bindings/flash_controller/adi,max32-spixf-nor.yaml
```yaml
# Copyright (c) 2025 Analog Devices, Inc
# SPDX-License-Identifier: Apache-2.0

description: |
    MAX32 SPIXF NOR Flash controller supporting the JEDEC CFI interface

    Representation of a serial flash on a SPIXF bus:

        mx25u64: mx25u6432f@0 {
            compatible = "adi,max32-spixf-nor";
            reg = <0x0 DT_SIZE_M(8)>; /* 64 Mbits */
            qspi-max-frequency = <80000000>;
            jedec-id = [c2 37 25];
            reset-cmd;
            spi-bus-width = <4>;
            writeoc = "PP_1_1_4";
            status = "okay";
        };

compatible: "adi,max32-spixf-nor"

include: ["flash-controller.yaml", "jedec,jesd216.yaml", "jedec,spi-nor-common.yaml"]

on-bus: qspi

properties:
  reg:
    required: true
    description: Flash Memory base address and size in bytes
  qspi-max-frequency:
    type: int
    required: true
    description: Maximum clock frequency of device's QSPI interface in Hz
  reset-gpios:
    type: phandle-array
    description: RESETn pin
  reset-gpios-duration:
    type: int
    description: The duration (in ms) for the flash memory reset pulse
  reset-cmd:
    type: boolean
    description: Send reset command on initialization
  reset-cmd-wait:
    type: int
    default: 35
    description: |
      The duration (in us) to wait after reset command. The default value of
      35us is long enough for commonly used NOR flash, but this can be
      adjusted as needed based on the specific flash used.
  spi-bus-width:
    type: int
    description: The width of (Q)SPI bus to which flash memory is connected.
                 Now only value of 4 (when using SIO[0123]) is supported.
  writeoc:
    type: string
    enum:
      - "PP_1_1_4"      # Quad data line SPI, PP 1-1-4 (0x32)
      - "PP_1_4_4"      # Quad data line SPI, PP 1-4-4 (0x38)
    description: |
      The value encodes number of I/O lines used for the opcode,
      address, and data.

      There is no info about quad page program opcodes in the SFDP
      tables, hence it has been assumed that NOR flash memory
      supporting 1-4-4 mode also would support fast page programming.

      If absent, then 1-4-4 program page is used in quad mode.

  force-quad-address-write:
    type: boolean
    description: |
      Force 4 I/O lines for addressing even when using PP_1_1_4 writes.
      This is mostly useful for Microchip NOR flash which require this quirk.
```

## dts/bindings/flash_controller/aesc,spi-flash-controller.yaml
```yaml
# SPDX-FileCopyrightText: 2026 Aesc Silicon
# SPDX-License-Identifier: Apache-2.0

description: |
  Aesc Silicon SPI flash controller.

  Exposes the execute-in-place (XIP) mapped SPI NOR flash as a read-only flash
  device. The flash region is described by a soc-nv-flash child node.

  The soc-nv-flash node must carry the standard flash properties the flash API
  and partition manager rely on: write-block-size and erase-block-size, and -
  because partition offsets are expressed relative to the flash node but the
  flash is read through the XIP window - a ranges entry mapping offset 0 onto the
  XIP base address, plus #address-cells / #size-cells. For example:

    flash_controller: flash-controller@f0024000 {
        compatible = "aesc,spi-flash-controller";
        reg = <0xf0024000 0x2000>;
        ranges;
        #address-cells = <1>;
        #size-cells = <1>;

        flash0: flash@a0000000 {
            compatible = "soc-nv-flash";
            reg = <0xa0000000 DT_SIZE_K(512)>;
            write-block-size = <1>;
            erase-block-size = <DT_SIZE_K(4)>;
            /* Map the partition offset space onto the XIP window. */
            ranges = <0x0 0xa0000000 DT_SIZE_K(512)>;
            #address-cells = <1>;
            #size-cells = <1>;

            partitions {
                ranges;
                #address-cells = <1>;
                #size-cells = <1>;

                slot0_partition: partition@0 {
                    compatible = "zephyr,mapped-partition";
                    label = "code";
                    reg = <0x0 DT_SIZE_K(512)>;
                };
            };
        };
    };

compatible: "aesc,spi-flash-controller"

include: flash-controller.yaml

properties:
  aesc,quad-mode:
    type: boolean
    description: |
      Switch the XIP controller to quad (4-bit) SPI protocol at driver init.
      Use this when no first-stage bootloader has already configured the
      flash interface. When absent, the controller keeps its reset (single
      bit) read mode.
```

## dts/bindings/flash_controller/altr,nios2-qspi-nor.yaml
```yaml
# Copyright (c) 2020, Linaro limited
# SPDX-License-Identifier: Apache-2.0

description: Altera NIOS2 QSPI Flash controller supporting the JEDEC CFI interface

compatible: "altr,nios2-qspi-nor"

include: ["flash-controller.yaml", "jedec,jesd216.yaml"]

on-bus: qspi

properties:
    reg:
      required: true
    size:
      required: true
      description: Flash Memory size in bits
```

## dts/bindings/flash_controller/ambiq,apollo3-flash-controller.yaml
```yaml
description: Apollo3 flash controller

compatible: "ambiq,apollo3-flash-controller"

include: flash-controller.yaml
```

## dts/bindings/flash_controller/ambiq,flash-controller.yaml
```yaml
# Copyright (c) 2023, Ambiq Micro Inc.
# SPDX-License-Identifier: Apache-2.0

description: Ambiq flash controller

compatible: "ambiq,flash-controller"

include: flash-controller.yaml
```

## dts/bindings/flash_controller/atmel,sam-flash-controller.yaml
```yaml
# Copyright (c) 2018, Aurelien Jarno
# SPDX-License-Identifier: Apache-2.0

description: Atmel SAM Enhanced Embedded Flash Controller (EEFC)

compatible: "atmel,sam-flash-controller"

include: flash-controller.yaml

properties:
  clocks:
    required: true

  "#erase-block-cells":
    type: int
    const: 2

erase-block-cells:
  - pages-count
  - pages-size
```

## dts/bindings/flash_controller/atmel,sam-flash-qspi.yaml
```yaml
# Copyright (c) 2026 Eve Redero
# SPDX-License-Identifier: Apache-2.0

description: |
  Atmel SAM QSPI Flash controller

  Drives a QSPI Flash memory through the Atmel QSPI SAM controller peripheral,
  atmel,sam-flash.

compatible: "atmel,sam-flash-qspi"

include:
  - name: "flash-controller.yaml"
  - name: "jedec,jesd216.yaml"

on-bus: qspi

properties:
  reg:
    required: true
    description: Flash Memory base address and size in bytes

  qspi-max-frequency:
    type: int
    required: true
    description: Max frequency input on QSPI

  nb-dummy:
    type: int
    description: Number of dummy cycles before starting flash transfer. Default is 0.

  writeoc:
    type: string
    enum:
      - "1_1_1"      # Single data line SPI, 1-1-1 (Command 0x02, IFR config 0x0)
      - "1_1_2"      # Dual data line SPI, 1-1-2 (Command 0xA2, IFR config 0x1)
      - "1_1_4"      # Quad data line SPI, 1-1-4 (Command 0x32, IFR config 0x2)
      - "1_4_4"      # Quad data line SPI, 1-4-4 (Command 0x38, IFR config 0x4)
    description: |
      The value encodes number of I/O lines used for the write opcode,
      address, and data.

      If absent, then 1-1-1 program page is used, in single data mode.

  readoc:
    type: string
    enum:
      - "1_1_1"      # Single data line SPI, 1-1-1 (opcode 0x03)
      - "1_1_2"      # Dual data line SPI, 1-1-2 (opcode 0x3B)
      - "1_1_4"      # Quad data line SPI, 1-1-4 (opcode 0x6B)
      - "1_4_4"      # Quad data line SPI, 1-4-4 (opcode 0xEB)
    description: |
      The value encodes number of I/O lines used for the read opcode,
      address, and data.

      If absent, then 1-1-1 is used, in single mode.

  compat-cypress:
    type: boolean
    description: Compatibility option for Cypress flash memories.
      In those, status register 3 is 0x33, and not 0x15 as specified by JEDEC standards.

examples:
  - |
    &qspi {
        s25fl116k: qspi-nor-flash@0 {
            compatible = "atmel,sam-flash-qspi";
            reg = <0x0>;
            size = <DT_SIZE_M(16)>;
            qspi-max-frequency = <DT_FREQ_M(1)>;
            status = "okay";
            writeoc = "1_1_1";
            readoc = "1_4_4";
            jedec-id = [01 40 15];
            nb-dummy = <8>;
            compat-cypress;
        };
    };
```

## dts/bindings/flash_controller/atmel,sam0-nvmctrl.yaml
```yaml
description: Atmel SAM0 NVMC (Non-Volatile Memory Controller)

compatible: "atmel,sam0-nvmctrl"

include: flash-controller.yaml

properties:
  lock-regions:
    type: int
    required: true
    description: Number of lock regions
```

## dts/bindings/flash_controller/atmel,sam4l-flashcalw-controller.yaml
```yaml
# Copyright (c) 2022, Gerson Fernando Budke <nandojve@gmail.com>
# SPDX-License-Identifier: Apache-2.0

description: Atmel SAM4L Flash Controller Double Word (FLASHCALW)

compatible: "atmel,sam4l-flashcalw-controller"

include: flash-controller.yaml
```

## dts/bindings/flash_controller/atmosic,external-flash-controller.yaml
```yaml
# Copyright (c) 2024 Atmosic
#
# SPDX-License-Identifier: Apache-2.0

description: Flash controller

compatible: "atmosic,external-flash-controller"

include: flash-controller.yaml

properties:
    clk-pin:
      type: int
      required: false
      description: QSPI_CLK pin to use

    csn-pin:
      type: int
      required: false
      description: QSPI_CSN pin to use

    d0-pin:
      type: int
      required: false
      description: QSPI_D0 pin to use

    d1-pin:
      type: int
      required: false
      description: QSPI_D1 pin to use

    d2-pin:
      type: int
      required: false
      description: QSPI_D2 pin to use

    d3-pin:
      type: int
      required: false
      description: QSPI_D3 pin to use
```

## dts/bindings/flash_controller/atmosic,rram-controller.yaml
```yaml
# Copyright (c) 2024 Atmosic
#
# SPDX-License-Identifier: Apache-2.0

description: RRAM controller

compatible: "atmosic,rram-controller"

include: flash-controller.yaml
properties:
    no-erase-before-write:
        type: boolean
        required: false
        description: Set if erase is not required before re-writing byte
```

## dts/bindings/flash_controller/bflb,bl70x_l-psram.yaml
```yaml
# Copyright The Zephyr Project Contributors
# SPDX-License-Identifier: Apache-2.0

description: |
  BL70x/BL70xL external SPI PSRAM via SF_CTRL.

  The BL70x and BL70xL manage external PSRAM through the same SF_CTRL
  peripheral that handles flash (bank 2, SF2 pad set). This node is a
  child of the flash controller and describes the memory-mapped PSRAM
  region.

compatible: "bflb,bl70x_l-psram"

include:
  - base.yaml
  - name: zephyr,memory-region.yaml
    property-allowlist:
      - zephyr,memory-region

properties:
  reg:
    required: true
```

## dts/bindings/flash_controller/bflb,flash-controller.yaml
```yaml
description: Bouffalolab Flash Controller

compatible: "bflb,flash-controller"

include: flash-controller.yaml
```

## dts/bindings/flash_controller/cdns,nand.yaml
```yaml
# Copyright (c) 2023 Intel Corporation
# SPDX-License-Identifier: Apache-2.0

description: Cadence Nand flash controller

compatible: "cdns,nand"

include: [flash-controller.yaml, reset-device.yaml]

properties:
  data-rate-mode:
    type: int
    required: true
    description: Data Rate mode Selection. 0 - SDR , 1 - NVDDR.
    enum:
      - 0
      - 1

  block-size:
    type: int
    required: true
    description: Erase Block size of Cadence Nand
```

## dts/bindings/flash_controller/cdns,qspi-nor.yaml
```yaml
# Copyright (c) 2022 - 2023 Intel Corporation
# SPDX-License-Identifier: Apache-2.0

description: Cadence Quad-SPI NOR flash controller

compatible: "cdns,qspi-nor"

include: flash-controller.yaml

properties:
  clock-frequency:
    type: int
    description: clock frequency information for Cadence QSPI NOR Flash
```

## dts/bindings/flash_controller/cypress,psoc6-flash-controller.yaml
```yaml
# Copyright (c) 2018, Cypress
# SPDX-License-Identifier: Apache-2.0

description: Cypress flash controller

compatible: "cypress,psoc6-flash-controller"

include: flash-controller.yaml
```

## dts/bindings/flash_controller/emulated-flash-controller.yaml
```yaml
---
title: flash controller Base Structure
id: emulated-flash-controller
version: 0.1

description: >
    This binding gives the base structures for all flash controller devices

properties:
    label:
      type: string
      category: required
      description: Human readable string describing the device (used by Zephyr for API name)
      generation: define

    compatible:
      type: string
      category: required
      description: compatible strings
      constraint: "emulated-flash-controller"

...
```

## dts/bindings/flash_controller/ene,kb106x-flash-controller.yaml
```yaml
# Copyright (c) 2025-2026 ENE Technology Inc.
# SPDX-License-Identifier: Apache-2.0

description: ENE KB106X flash controller

compatible: "ene,kb106x-flash-controller"

include: flash-controller.yaml
```

## dts/bindings/flash_controller/espressif,esp32-flash-controller.yaml
```yaml
description: ESP32 flash controller

compatible: "espressif,esp32-flash-controller"

include: flash-controller.yaml
```
