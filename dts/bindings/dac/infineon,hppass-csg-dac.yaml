## dts/bindings/dac/infineon,hppass-csg-dac.yaml
```yaml
# SPDX-FileCopyrightText: <text>Copyright (c) 2026 Infineon Technologies AG,
# or an affiliate of Infineon Technologies AG. All rights reserved.</text>
#
# SPDX-License-Identifier: Apache-2.0

description: |
  Infineon HPPASS CSG DAC.

  Represents the 10-bit, 30 Msps DAC inside a single CSG slice.  This node
  must be a child of an "infineon,hppass-csg" CSG MFD parent.

  This DAC has no external output pin.  Its output is wired internally to
  the paired comparator's negative input, and may optionally be
  routed to the SAR ADC for observation through CSG_CTRL.VDAC_OUT_SEL.
  The DAC therefore cannot be used in isolation: the paired comparator
  child node (same slice index) must also be configured and enabled.

  Resolution is fixed at 10 bits.  Only direct-write mode is supported
  through the standard Zephyr DAC API.  Advanced modes (buffered, slope,
  LUT) are not yet supported.

compatible: "infineon,hppass-csg-dac"

include: [dac-controller.yaml]

properties:
  reg:
    type: array
    required: true
    description: |
      Register region covering this slice's DAC_CFG, DAC_VAL_A, DAC_VAL_B
      and DAC_VAL within the CSG block.  Slice index is derived at
      compile time from the offset divided by the CSG slice stride.

  interrupts:
    description: |
      DAC interrupt line for this slice.  DAC interrupt only occurs in
      advanced modes: HW start trigger, SLOPE/LUT done, or BUFFERED/HYSTERETIC
      buffer empty.

  deglitch:
    type: int
    default: 0
    min: 0
    max: 7
    description: |
      DAC output deglitch length in HPPASS clock cycles
      (DAC_CFG.DAC_DEGLITCH, 0-7).  Glitches shorter than this width are
      filtered out on the DAC analog output before it is driven into the
      paired comparator's negative input.

  initial-value:
    type: int
    min: 0
    max: 1023
    description: |
      Optional 10-bit value (0..1023) to write into SLICE[s].DAC_VAL at
      driver init, before the HPPASS AC enters its locked state.  When
      omitted, DAC_VAL is left at its hardware reset value of 0
      (~0 V output).  Useful when the paired comparator must see a
      stable mid-rail or other reference before the application has a
      chance to call dac_write_value().

  "#io-channel-cells":
    const: 1

io-channel-cells:
  - output
```

## dts/bindings/dac/lltc,ltc1660.yaml
```yaml
# Copyright (C) 2023 Marcus Folkesson <marcus.folkesson@gmail.com>
# SPDX-License-Identifier: Apache-2.0

include: [dac-controller.yaml, spi-device.yaml]

description: Linear Technology Micropower octal 10-Bit DAC

compatible: "lltc,ltc1660"
```

## dts/bindings/dac/lltc,ltc1665.yaml
```yaml
# Copyright (C) 2023 Marcus Folkesson <marcus.folkesson@gmail.com>
# SPDX-License-Identifier: Apache-2.0

include: [dac-controller.yaml, spi-device.yaml]

description: Linear Technology Micropower octal 8-Bit DAC

compatible: "lltc,ltc1665"
```

## dts/bindings/dac/microchip,dac-g1.yaml
```yaml
# Copyright (c) 2025-2026 Microchip Technology Inc.
# SPDX-License-Identifier: Apache-2.0

title: Microchip G1 DAC

description: |
  Microchip G1 DAC peripherals.

  Group G1 DAC includes the following hardware peripherals:
    - module name="DAC" id="U2502" version="1.0.0"

compatible: "microchip,dac-g1"

include:
  - name: dac-controller.yaml
  - name: pinctrl-device.yaml

properties:
  reg:
    required: true

  clocks:
    required: true

  clock-names:
    required: true

  "#io-channel-cells":
    type: int
    required: true
    const: 1
    description: |
      Number of cells needed to represent a channel.

  "#address-cells":
    const: 1

  "#size-cells":
    const: 0

  refsel:
    type: string
    required: true
    enum:
      - "vref_au"
      - "vdd_ana"
      - "vref_ab"
      - "int_ref"
    description: |
      Reference Voltage selection.

      Must be one of:
      - "vref_au" (0x0) - Unbuffered External Voltage Reference
      - "vdd_ana" (0x1) - Voltage Supply
      - "vref_ab" (0x2) - Buffered External Voltage Reference
      - "int_ref" (0x3) - Internal Bandgap Reference

  max-channels:
    type: int
    default: 2
    description: |
      Maximum number of channels

child-binding:
  description: |
    Channel configuration.
    All child nodes using this binding must be named "channel".

  properties:
    reg:
      type: int
      required: true
      description: |
        DAC channel number.

        Allowed channel numbers are 0 to (max-channels - 1).
        For example, if max-channels = 2, the allowed channels are 0 and 1.

    rate:
      type: int
      required: true
      description: |
        Conversion Speed in KSPS(Kilo Samples per second)
      enum:
        - 100
        - 500
        - 1000

    ext-filter:
      type: boolean
      description: |
        Enable External Filter

    data-adj:
      type: string
      default: right
      enum:
        - "right"
        - "left"
      description: |
        Controls how the DAC value is aligned in the DATA register.

        "right" selects right alignment and "left" selects left alignment,
        as controlled by the LEFTADJ bit. The default is "right", which
        matches the hardware reset value of LEFTADJ = 0.
        Right alignment places the LSB of the 12-bit value at bit 0 of DATA.

    dither-mode:
      type: boolean
      description: |
        Enable the Dithering Mode

    sampling-ratio:
      type: int
      default: 1
      enum:
        - 1
        - 2
        - 4
        - 8
        - 16
        - 32
      description: |
        Set the Oversampling Ratio

        Setting oversampling disables the refresh rate.

    refresh-period:
      type: int
      default: 0
      description: |
        Refresh Period in us ( 0 - Disabled )
      enum:
        - 0
        - 30
        - 60
        - 90
        - 120
        - 150
        - 180
        - 210
        - 240
        - 270
        - 300
        - 330
        - 360
        - 390
        - 420
        - 450
```

## dts/bindings/dac/microchip,dac-g2.yaml
```yaml
# Copyright (c) 2026 Microchip Technology Inc.
# SPDX-License-Identifier: Apache-2.0

title: Microchip G2 DAC

description: |
  Microchip G2 DAC peripherals.

  Group G2 DAC includes the following hardware peripherals:
    - module name="DAC" id="U2214" version="2.1.0"

compatible: "microchip,dac-g2"

include:
  - name: dac-controller.yaml
  - name: pinctrl-device.yaml

properties:
  reg:
    required: true

  clocks:
    required: true

  clock-names:
    required: true

  "#io-channel-cells":
    type: int
    required: true
    const: 1
    description: |
      Number of cells needed to represent a channel.

  refsel:
    type: string
    enum:
      - "int_ref"
      - "a_vdd"
      - "v_ext"
    default: a_vdd
    description: |
      Reference Voltage selection.

      Must be one of:
      - "int_ref" (0x0) - Internal Bandgap Reference
      - "a_vdd"   (0x1) - Analog Voltage Supply
      - "v_ext"   (0x2) - External Voltage Reference

  max-channels:
    type: int
    default: 1
    description: |
      Maximum number of channels.

  external-pin-en:
    type: int
    required: true
    enum:
      - 0
      - 1
    description: |
      Enable external output pin for the channel.

  volt-pump-disable:
    type: int
    enum:
      - 0
      - 1
    default: 0
    description: |
      Voltage pump provides power when dac supply voltage
      is less than 3.3v, writing 1 will disable it.

  run-in-standby:
    type: int
    enum:
      - 0
      - 1
    default: 0
    description: |
      The Run in Standby controls the DAC in standby mode.

      when bit is reset, the output buffer is disabled and when set, the DAC output
      buffer will keep its value in Standby Sleep mode.

examples:
  - |
    dac: dac@42005000 {
      compatible = "microchip,dac-g2";
      reg = <0x42005000 0x15>;
      pinctrl-0 = <&dac_default>;
      pinctrl-names = "default";
      external_pin_en = <1>;
    };

io-channel-cells:
  - output
```

## dts/bindings/dac/microchip,mcp4725.yaml
```yaml
# Copyright (c) 2021 Laird Connectivity
# SPDX-License-Identifier: Apache-2.0

description: Microchip MCP4725 12-bit DAC

compatible: "microchip,mcp4725"

include: [dac-controller.yaml, i2c-device.yaml]

properties:
  "#io-channel-cells":
    const: 1

io-channel-cells:
  - output
```

## dts/bindings/dac/microchip,mcp4728.yaml
```yaml
description: Microchip MCP4728 12-bit 4-channel DAC

compatible: "microchip,mcp4728"

include: [dac-controller.yaml, i2c-device.yaml]

properties:
  "#io-channel-cells":
    const: 1

  voltage-reference:
    type: array
    required: true
    description: |
      DAC voltage reference select.
      0 - Vdd
      1 - Internal voltage reference (2.048V)
      Note: array entries correspond to the successive channels

  power-down-mode:
    type: array
    required: true
    description: |
      Power-down mode select.
      0 - normal mode
      1 - Vout is loaded with 1 kOhm resistor to ground
      2 - Vout is loaded 100 kOhm resistor to ground
      3 - Vout is loaded with 500 kOhm resistor to ground
      Note: with values bigger than 0 most of channel circuits are powered off
      Note: array entries correspond to the successive channels

  gain:
    type: array
    default: [0, 0, 0, 0]
    description: |
      Gain selection bit.
      0 = x1 (gain of 1)
      1 = x2 (gain of 2)
      Note: applicable only when internal Vref is selected
      Note: array entries correspond to the successive channels

io-channel-cells:
  - output
```

## dts/bindings/dac/microchip,mcp4802.yaml
```yaml
# Copyright (c) 2024 Novatech LLC
# SPDX-License-Identifier: Apache-2.0

description: Microchip 8-Bit 2-channel SPI DAC

compatible: "microchip,mcp4802"

include: microchip,mcp48xx-base.yaml
```

## dts/bindings/dac/microchip,mcp4812.yaml
```yaml
# Copyright (c) 2024 Novatech LLC
# SPDX-License-Identifier: Apache-2.0

description: Microchip 10-Bit 2-channel SPI DAC

compatible: "microchip,mcp4812"

include: microchip,mcp48xx-base.yaml
```

## dts/bindings/dac/microchip,mcp4822.yaml
```yaml
# Copyright (c) 2024 Novatech LLC
# SPDX-License-Identifier: Apache-2.0

description: Microchip 12-Bit 2-channel SPI DAC

compatible: "microchip,mcp4822"

include: microchip,mcp48xx-base.yaml
```

## dts/bindings/dac/microchip,mcp48xx-base.yaml
```yaml
# Copyright (c) 2024 Novatech LLC
# SPDX-License-Identifier: Apache-2.0

include: [dac-controller.yaml, spi-device.yaml]

properties:
  "#io-channel-cells":
    const: 1

  latch-gpios:
    type: phandle-array
    description: "GPIO to sync DAC outputs"

  powerdown:
    type: array
    required: true
    description: |
      Power-down mode select.
      0 - Vout is loaded with 500kOhm resistor to ground
      1 - normal mode
      Note: array entries correspond to the successive channels

  gain:
    type: array
    default: [1, 1]
    description: |
      Gain selection bit.
      0 = x2 (gain of 2)
      1 = x1 (gain of 1)
      Note: applicable onle when internal Vref is selected
      Note: array entries correspond to the successive channels

io-channel-cells:
  - output
```

## dts/bindings/dac/microchip,mcp4921.yaml
```yaml
# Copyright (c) 2022 Renesas Electronics Corporation
# SPDX-License-Identifier: Apache-2.0

description: Microchip MCP4921 12-bit DAC

compatible: "microchip,mcp4921"

include: [dac-controller.yaml, spi-device.yaml]

properties:
    "#io-channel-cells":
      const: 1
      
io-channel-cells:
    - output
```

## dts/bindings/dac/microchip,pic32cxsg-dac.yaml
```yaml
# Copyright (c) 2024 Microchip
# SPDX-License-Identifier: Apache-2.0

description: Microchip PIC32CXSG family DAC

compatible: "microchip,pic32cxsg-dac"

include:
  - name: dac-controller.yaml
  - name: pinctrl-device.yaml

properties:
  reg:
    required: true

  clocks:
    required: true

  clock-names:
    required: true

  reference:
    type: string
    description: Reference voltage source
    enum:
      - "intref"
      - "vddana"
      - "vrefa"

  "#io-channel-cells":
    const: 0
```

## dts/bindings/dac/nxp,dac12.yaml
```yaml
# Copyright (c) 2020 Henrik Brix Andersen <henrik@brixandersen.dk>
# Copyright (c) 2025 PHYTEC America LLC
# SPDX-License-Identifier: Apache-2.0

description: NXP MCUX DAC12

compatible: "nxp,dac12"

include: dac-controller.yaml

properties:
  reg:
    required: true

  voltage-reference:
    type: int
    required: true
    description: DAC voltage reference select

  buffered:
    type: boolean
    description: Enable output buffer

  "#io-channel-cells":
    const: 1

io-channel-cells:
  - output
```

## dts/bindings/dac/nxp,gau-dac.yaml
```yaml
# Copyright 2023 NXP
# SPDX-License-Identifier: Apache-2.0

description: NXP GAU DAC

compatible: "nxp,gau-dac"

include: dac-controller.yaml

properties:
  nxp,dac-reference:
    type: string
    enum:
      - "internal"
      - "external"
    default: "internal"
    description: |
      DAC reference select.
      Default is "internal" because that is the reset value.

  nxp,output-voltage-range:
    type: string
    enum:
      - "small"
      - "medium"
      - "large"
    default: "large"
    description: |
      See specific platform Reference Manual for equations describing the options.
      Default is large because that is the reset value.

  nxp,conversion-rate:
    type: string
    enum:
      - "62.5K"
      - "125K"
      - "250K"
      - "500K"
    default: "62.5K"
    description: |
      DAC conversion rate.
      Default is "62.5K" because that is the reset value.

  "#io-channel-cells":
    const: 0
```

## dts/bindings/dac/nxp,hpdac.yaml
```yaml
# SPDX-FileCopyrightText: Copyright 2026 NXP
# SPDX-License-Identifier: Apache-2.0

description: NXP MCUX HPDAC (14-bit DAC)

compatible: "nxp,hpdac"

include: dac-controller.yaml

properties:
  reg:
    required: true

  "#io-channel-cells":
    const: 1

  resolution:
    type: int
    required: true
    description: DAC resolution in bits.

io-channel-cells:
  - output
```

## dts/bindings/dac/nxp,kinetis-dac.yaml
```yaml
# Copyright (c) 2020 Henrik Brix Andersen <henrik@brixandersen.dk>
# SPDX-License-Identifier: Apache-2.0

description: NXP Kinetis MCUX DAC

compatible: "nxp,kinetis-dac"

include: dac-controller.yaml

properties:
  reg:
    required: true

  voltage-reference:
    type: int
    required: true
    description: DAC voltage reference select

  low-power-mode:
    type: boolean
    description: Enable low-power mode

  "#io-channel-cells":
    const: 1

io-channel-cells:
  - output
```

## dts/bindings/dac/nxp,kinetis-dac32.yaml
```yaml
# Copyright (c) 2020 Henrik Brix Andersen <henrik@brixandersen.dk>
# SPDX-License-Identifier: Apache-2.0

description: NXP Kinetis MCUX DAC32

compatible: "nxp,kinetis-dac32"

include: [dac-controller.yaml, pinctrl-device.yaml]

properties:
    reg:
      required: true

    voltage-reference:
      type: int
      required: true
      description: DAC voltage reference select

    low-power-mode:
      type: boolean
      required: false
      description: Enable low-power mode

    buffered:
      type: boolean
      required: false
      description: Enable output buffer

    "#io-channel-cells":
      const: 1

io-channel-cells:
    - output
```

## dts/bindings/dac/nxp,lpdac.yaml
```yaml
# Copyright (c) 2023, NXP
# SPDX-License-Identifier: Apache-2.0

description: NXP MCUX LPDAC

compatible: "nxp,lpdac"

include: [dac-controller.yaml, pinctrl-device.yaml]

properties:
  reg:
    required: true

  voltage-reference:
    type: int
    required: true
    description: |
      DAC voltage reference select. The meaning of the value may be
      different for different SoCs.

  low-power-mode:
    type: boolean
    description: Enable low-power mode

  "#io-channel-cells":
    const: 1

io-channel-cells:
  - output
```
