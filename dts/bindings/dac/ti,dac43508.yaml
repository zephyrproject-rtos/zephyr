## dts/bindings/dac/ti,dac43508.yaml
```yaml
# SPDX-FileCopyrightText: Copyright The Zephyr Project Contributors
# SPDX-License-Identifier: Apache-2.0

description: TI DAC43508 8-bit DAC

compatible: "ti,dac43508"

include: ti,dacx3508-base.yaml
```

## dts/bindings/dac/ti,dac43608.yaml
```yaml
# Copyright (c) 2020 Matija Tudan
# SPDX-License-Identifier: Apache-2.0

description: TI DAC43608 8-bit 8 channel DAC

compatible: "ti,dac43608"

include: ti,dacx3608-base.yaml
```

## dts/bindings/dac/ti,dac5311.yaml
```yaml
# Copyright (c) 2025 Andreas Wolf <awolf002@gmail.com>
# SPDX-License-Identifier: Apache-2.0

description: Texas Instrument 8-Bit DAC 5311

compatible: "ti,dac5311"

include: ti,dacx311-base.yaml
```

## dts/bindings/dac/ti,dac53508.yaml
```yaml
# SPDX-FileCopyrightText: Copyright The Zephyr Project Contributors
# SPDX-License-Identifier: Apache-2.0

description: TI DAC53508 10-bit DAC

compatible: "ti,dac53508"

include: ti,dacx3508-base.yaml
```

## dts/bindings/dac/ti,dac53608.yaml
```yaml
# Copyright (c) 2020 Matija Tudan
# SPDX-License-Identifier: Apache-2.0

description: TI DAC53608 10-bit 8 channel DAC

compatible: "ti,dac53608"

include: ti,dacx3608-base.yaml
```

## dts/bindings/dac/ti,dac60508.yaml
```yaml
# Copyright (c) 2020 M2I Corporation
# SPDX-License-Identifier: Apache-2.0

description: TI DAC60508 12-bit DAC

compatible: "ti,dac60508"

include: ti,dacx0508-base.yaml
```

## dts/bindings/dac/ti,dac6311.yaml
```yaml
# Copyright (c) 2025 Andreas Wolf <awolf002@gmail.com>
# SPDX-License-Identifier: Apache-2.0

description: Texas Instrument 10-Bit DAC 6311

compatible: "ti,dac6311"

include: ti,dacx311-base.yaml
```

## dts/bindings/dac/ti,dac63508.yaml
```yaml
# SPDX-FileCopyrightText: Copyright The Zephyr Project Contributors
# SPDX-License-Identifier: Apache-2.0

description: TI DAC63508 12-bit DAC

compatible: "ti,dac63508"

include: ti,dacx3508-base.yaml
```

## dts/bindings/dac/ti,dac70508.yaml
```yaml
# Copyright (c) 2020 M2I Corporation
# SPDX-License-Identifier: Apache-2.0

description: TI DAC70508 14-bit DAC

compatible: "ti,dac70508"

include: ti,dacx0508-base.yaml
```

## dts/bindings/dac/ti,dac7311.yaml
```yaml
# Copyright (c) 2025 Andreas Wolf <awolf002@gmail.com>
# SPDX-License-Identifier: Apache-2.0

description: Texas Instrument 12-Bit DAC 7311

compatible: "ti,dac7311"

include: ti,dacx311-base.yaml
```

## dts/bindings/dac/ti,dac80508.yaml
```yaml
# Copyright (c) 2020 M2I Corporation
# SPDX-License-Identifier: Apache-2.0

description: TI DAC80508 16-bit DAC

compatible: "ti,dac80508"

include: ti,dacx0508-base.yaml
```

## dts/bindings/dac/ti,dac8311.yaml
```yaml
# Copyright (c) 2025 Andreas Wolf <awolf002@gmail.com>
# SPDX-License-Identifier: Apache-2.0

description: Texas Instrument 14-Bit DAC 8311

compatible: "ti,dac8311"

include: ti,dacx311-base.yaml
```

## dts/bindings/dac/ti,dac8411.yaml
```yaml
# Copyright (c) 2025 Andreas Wolf <awolf002@gmail.com>
# SPDX-License-Identifier: Apache-2.0

description: Texas Instrument 16-Bit DAC 8411

compatible: "ti,dac8411"

include: ti,dacx311-base.yaml
```

## dts/bindings/dac/ti,dacx0508-base.yaml
```yaml
# Copyright (c) 2020 M2I Corporation
# SPDX-License-Identifier: Apache-2.0

include: [dac-controller.yaml, spi-device.yaml]

properties:
    voltage-reference:
      type: int
      required: true
      description: |
        DAC voltage reference select

        See constants in dt-bindings/dac/dacx0508.h.

    channel0-gain:
      type: int
      required: true
      description: |
        Channel 0 gain select

        See constants in dt-bindings/dac/dacx0508.h.

    channel1-gain:
      type: int
      required: true
      description: |
        Channel 1 gain select

        See constants in dt-bindings/dac/dacx0508.h.

    channel2-gain:
      type: int
      required: true
      description: |
        Channel 2 gain select

        See constants in dt-bindings/dac/dacx0508.h.

    channel3-gain:
      type: int
      required: true
      description: |
        Channel 3 gain select

        See constants in dt-bindings/dac/dacx0508.h.

    channel4-gain:
      type: int
      required: true
      description: |
        Channel 4 gain select

        See constants in dt-bindings/dac/dacx0508.h.

    channel5-gain:
      type: int
      required: true
      description: |
        Channel 5 gain select

        See constants in dt-bindings/dac/dacx0508.h.

    channel6-gain:
      type: int
      required: true
      description: |
        Channel 6 gain select

        See constants in dt-bindings/dac/dacx0508.h.

    channel7-gain:
      type: int
      required: true
      description: |
        Channel 7 gain select

        See constants in dt-bindings/dac/dacx0508.h.

    "#io-channel-cells":
      const: 1

io-channel-cells:
    - output
```

## dts/bindings/dac/ti,dacx311-base.yaml
```yaml
# Copyright (c) 2025 Andreas Wolf <awolf002@gmail.com>
# SPDX-License-Identifier: Apache-2.0

include: [dac-controller.yaml, spi-device.yaml]

properties:
  "#io-channel-cells":
    const: 1

  power-down-mode:
    type: string
    default: "normal"
    enum:
      - "normal"
      - "power-down-1k"
      - "power-down-100k"
      - "power-down-3-state"
    description: |
      Power-down mode select.
      - Normal mode (reg: 0).
      - 1 kOhm output impedance (reg: 1).
      - 100 kOhm output impedance (reg: 2).
      - Three-state output impedance (reg: 3).
      The default corresponds to the reset value of the register field.

io-channel-cells:
  - output
```

## dts/bindings/dac/ti,dacx3608-base.yaml
```yaml
# Copyright (c) 2020 Matija Tudan
# SPDX-License-Identifier: Apache-2.0

include: [dac-controller.yaml, i2c-device.yaml]

properties:
  "#io-channel-cells":
    const: 1

io-channel-cells:
  - output
```

## dts/bindings/dac/zephyr,dac-emul.yaml
```yaml
# Copyright (c) 2026 Vaisala Oyj
# SPDX-License-Identifier: Apache-2.0

description: Emulated DAC

compatible: "zephyr,dac-emul"

include: dac-controller.yaml

properties:
  nchannels:
    type: int
    required: true
    description: |
      Number of channels supported by this instance.
```

## dts/bindings/dai/amd,acp-sdw-dai.yaml
```yaml
# SPDX-FileCopyrightText: Copyright The Zephyr Project Contributors
# Copyright (c) 2026 AMD
# SPDX-License-Identifier: Apache-2.0

description: AMD ACP SoundWire DAI node

compatible: "amd,acp-sdw-dai"

include: [base.yaml]

properties:
  dai-index:
    type: int
    description: |
      Use this property to specify the index of the DAI. At the
      moment, this is only used by SOF to fetch the "struct device"
      associated with the DAI whose index Linux passes to SOF
      through an IPC. If this property is not specified, the DAI
      index will be considered 0.
```

## dts/bindings/dai/amd,tdm-dai.yaml
```yaml
# SPDX-FileCopyrightText: Copyright (c) 2026 AMD
# SPDX-License-Identifier: Apache-2.0

description: AMD ACP Unified TDM DAI (HS/SP/BT)

compatible: "amd,tdm-dai"

include: [base.yaml]

properties:
  dai-index:
    type: int
    description: |
      TDM instance index: 0=HS, 1=SP, 2=BT.
      Used by SOF to fetch the device for a given DAI index.
```

## dts/bindings/dai/dai,intel,dmic.yaml
```yaml
# Copyright (c) 2022 Intel Corporation
# SPDX-License-Identifier: Apache-2.0

description: Intel Digital PDM Microphone (DMIC) node

compatible: "intel,dai,dmic"

include: base.yaml

properties:
    reg:
        required: true

    shim:
      type: array
      required: true
```

## dts/bindings/dai/intel,adsp-dmic-vss.yaml
```yaml
# Copyright (c) 2022 Intel Corporation
#
# SPDX-License-Identifier: Apache-2.0

description: Intel DMIC Vendor SHIM Controller

compatible: "intel,adsp-dmic-vss"

include: base.yaml

properties:
  reg:
    required: true
```

## dts/bindings/dai/intel,uaol-dai.yaml
```yaml
# Copyright (c) 2023 Intel Corporation
# SPDX-License-Identifier: Apache-2.0

description: Intel USB Audio Offload Link (UAOL) DAI node

compatible: "intel,uaol-dai"

include: base.yaml

properties:
  reg:
    required: true

  link:
    type: int
    required: true

  stream:
    type: int
    required: true

  alh-stream:
    type: int

  dma-handshake:
    type: int
```

## dts/bindings/dai/intel,uaol-link.yaml
```yaml
# Copyright (c) 2023 Intel Corporation
# SPDX-License-Identifier: Apache-2.0

description: Intel USB Audio Offload Link (UAOL) IP node

compatible: "intel,uaol-link"

include: base.yaml

properties:
  reg:
    required: true

  link:
    type: int
    required: true

  shim:
    type: phandle
    required: true
```

## dts/bindings/dai/mediatek,afe.yaml
```yaml
description: Mediatek Audio Front End

compatible: "mediatek,afe"

include: base.yaml

properties:
  dai_id:
    type: int
    required: true
    description: Host-defined SOF DAI index.  Must match the Linux kernel driver.
  afe_name:
    type: string
    required: true
  downlink:
    type: boolean
    description: True/present for downlink (capture) channels

  # These three are two-register arrays defining the DSP registers
  # that store the hi and low words of a 64 bit bus/host address.
  #
  base:
    type: array
  end:
    type: array
  cur:
    type: array

  # The remaining registers below are three-cell arrays describing a
  # bit field as <addr lshift width>.  Most of them are defaultable by
  # the driver and can be eliminated from DTS for hardware that does
  # not support the feature.  See the driver source for details.
  #
  enable:
    type: array
    description: Channel enable flag
  agent_disable:
    type: array
    description: Channel disable flag
  fs:
    type: array
    description: Sample rate register
  hd:
    type: array
    description: Sample format register
  ch_num:
    type: array
    description: Channel count register
  mono:
    type: array
    description: Mono flag register
  mono_invert:
    type: boolean
    description: Sense/meaning of mono flag
  quad_ch:
    type: array
    description: Quad channel flag register
  int_odd:
    type: array
  msb:
    type: array
  msb2:
    type: array
```

## dts/bindings/dai/nxp,dai-esai.yaml
```yaml
# Copyright 2024 NXP
# SPDX-License-Identifier: Apache-2.0

description: NXP Enhanced Serial Audio Interface (ESAI)

compatible: "nxp,dai-esai"

include: base.yaml

properties:
  reg:
    required: true
  dai-index:
    type: int
    description: |
      Use this property to specify the index of the DAI. At the
      moment, this is only used by SOF to fetch the "struct device"
      associated with the DAI whose index Linux passes to SOF
      through an IPC. If this property is not specified, the DAI
      index will be considered 0.
  tx-fifo-watermark:
    type: int
    description: |
      Use this property to specify the watermark value for the TX
      FIFO. This value needs to be in FIFO words (NOT BYTES). This
      value needs to be in the following interval: (0, DEFAULT_FIFO_DEPTH],
      otherwise a BUILD_ASSERT() failure will be raised. If unspecified,
      the TX FIFO watermark will be set to DEFAULT_FIFO_DEPTH / 2.
  rx-fifo-watermark:
    type: int
    description: |
      Use this property to specify the watermark value for the RX
      FIFO. This values needs to be in FIFO words (NOT BYTES). This
      value needs to be in the following interval: (0, DEFAULT_FIFO_DEPTH],
      otherwise a BUILD_ASSERT() failure will be raised. If unspecified,
      the RX FIFO watermark will be set to DEFAULT_FIFO_DEPTH / 2.
  fifo-depth:
    type: int
    description: |
      Use this property to set the FIFO depth that will be reported
      to upper layer applications calling dai_get_properties(). This
      value should be in the following interval: (0, DEFAULT_FIFO_DEPTH],
      otherwise a BUILD_ASSERT() failure will be raised. By DEFAULT_FIFO_DEPTH
      we mean the actual (hardware) value of the FIFO depth. This is needed
      because some applications (e.g: SOF) use this value directly as the
      DMA burst size in which case DEFAULT_FIFO_DEPTH cannot be used.
      Generally, reporting a false FIFO depth should be avoided. Please note
      that the sanity check for tx/rx-fifo-watermark uses DEFAULT_FIFO_DETPH
      instead of this value so use with caution. If unsure, it's better to
      not use this property at all, in which case the reported value will be
      DEFAULT_FIFO_DEPTH.
  word-width:
    type: int
    description: |
      This property is used to specify the width of a word. If unspecified,
      the word width used will be 24.
  esai-pin-modes:
    type: array
    description: |
      This property is used to configure the ESAI pins. Each ESAI pin
      supports 4 modes:
        1) DISCONNECTED (PDC[i] = 0, PC[i] = 0)
        2) GPIO input (PDC[i] = 0, PC[i] = 1)
        3) GPIO output (PDC[i] = 1, PC[i] = 0)
        4) ESAI (PDC[i] = 1, PC[i] = 1)
      If pin is not used then DISCONNECTED mode should be used for said pin.
      If unsure, don't specify this property at all. By default, all pins will
      be set to ESAI mode.
  esai-clock-configuration:
    type: array
    description: |
      Use this property to configure the directions of the ESAI clocks (HCLK, BCLK, FSYNC).
      This provides extra flexibility since the bespoke configuration is not direction-based.
      The values from this array will overwrite the values set through the bespoke
      configuration. If unspecified, the values from the bespoke configuration will be used.
```
