## dts/bindings/dac/adi,ad5601.yaml
```yaml
# SPDX-FileCopyrightText: Copyright The Zephyr Project Contributors
# SPDX-License-Identifier: Apache-2.0

description: Analog Devices 8-Bit single-channel SPI DAC

compatible: "adi,ad5601"

include: adi,ad56x1-base.yaml
```

## dts/bindings/dac/adi,ad5621.yaml
```yaml
# SPDX-FileCopyrightText: Copyright The Zephyr Project Contributors
# SPDX-License-Identifier: Apache-2.0

description: Analog Devices 12-Bit single-channel SPI DAC

compatible: "adi,ad5621"

include: adi,ad56x1-base.yaml
```

## dts/bindings/dac/adi,ad5628.yaml
```yaml
# Copyright (c) 2023 SILA Embedded Solutions GmbH
# SPDX-License-Identifier: Apache-2.0

description: Analog Devices 12-Bit 8-channel SPI DAC

compatible: "adi,ad5628"

include: adi,ad56xx-base.yaml
```

## dts/bindings/dac/adi,ad5648.yaml
```yaml
# Copyright (c) 2023 SILA Embedded Solutions GmbH
# SPDX-License-Identifier: Apache-2.0

description: Analog Devices 14-Bit 8-channel SPI DAC

compatible: "adi,ad5648"

include: adi,ad56xx-base.yaml
```

## dts/bindings/dac/adi,ad5674.yaml
```yaml
# Copyright (c) 2023 SILA Embedded Solutions GmbH
# SPDX-License-Identifier: Apache-2.0

description: Analog Devices 12-Bit 16-channel SPI DAC

compatible: "adi,ad5674"

include: adi,ad56xx-base.yaml
```

## dts/bindings/dac/adi,ad5679.yaml
```yaml
# Copyright (c) 2023 SILA Embedded Solutions GmbH
# SPDX-License-Identifier: Apache-2.0

description: Analog Devices 16-Bit 16-channel SPI DAC

compatible: "adi,ad5679"

include: adi,ad56xx-base.yaml
```

## dts/bindings/dac/adi,ad5684.yaml
```yaml
# Copyright (c) 2023 SILA Embedded Solutions GmbH
# SPDX-License-Identifier: Apache-2.0

description: Analog Devices 12-Bit 4-channel SPI DAC

compatible: "adi,ad5684"

include: adi,ad56xx-base.yaml
```

## dts/bindings/dac/adi,ad5686.yaml
```yaml
# Copyright (c) 2023 SILA Embedded Solutions GmbH
# SPDX-License-Identifier: Apache-2.0

description: Analog Devices 16-Bit 4-channel SPI DAC

compatible: "adi,ad5686"

include: adi,ad56xx-base.yaml
```

## dts/bindings/dac/adi,ad5687.yaml
```yaml
# Copyright (c) 2023 SILA Embedded Solutions GmbH
# SPDX-License-Identifier: Apache-2.0

description: Analog Devices 12-Bit 2-channel SPI DAC

compatible: "adi,ad5687"

include: adi,ad568x-base.yaml

bus: ad5687
```

## dts/bindings/dac/adi,ad5689.yaml
```yaml
# Copyright (c) 2023 SILA Embedded Solutions GmbH
# SPDX-License-Identifier: Apache-2.0

description: Analog Devices 16-Bit 2-channel SPI DAC

compatible: "adi,ad5689"

include: adi,ad56xx-base.yaml
```

## dts/bindings/dac/adi,ad5691.yaml
```yaml
# Copyright (c) 2024 Jan Kubiznak <jan.kubiznak@deveritec.com>
# SPDX-License-Identifier: Apache-2.0

description: Driver for AD5691 (12-bit) DAC.

compatible: "adi,ad5691"

include: adi,ad569x-base.yaml
```

## dts/bindings/dac/adi,ad5692.yaml
```yaml
# Copyright (c) 2024 Jan Kubiznak <jan.kubiznak@deveritec.com>
# SPDX-License-Identifier: Apache-2.0

description: Driver for AD5692 (14-bit) DAC.

compatible: "adi,ad5692"

include: adi,ad569x-base.yaml
```

## dts/bindings/dac/adi,ad5693.yaml
```yaml
# Copyright (c) 2024 Jan Kubiznak <jan.kubiznak@deveritec.com>
# SPDX-License-Identifier: Apache-2.0

description: Driver for AD5693 (16-bit) DAC.

compatible: "adi,ad5693"

include: adi,ad569x-base.yaml
```

## dts/bindings/dac/adi,ad569x-base.yaml
```yaml
# Copyright (c) 2024 Jan Kubiznak <jan.kubiznak@deveritec.com>
# SPDX-License-Identifier: Apache-2.0

include: [dac-controller.yaml]

properties:
  "#io-channel-cells":
    const: 1

  resolution:
    type: int
    required: true
    description: DAC resolution.

  voltage-reference-mv:
    type: int
    required: true
    description: DAC reference voltage in mV.

  voltage-reference:
    type: string
    default: "internal"
    enum:
      - "internal"
      - "external"
    description: |
      DAC voltage reference select.
      - Internal voltage reference - 2.5V (reg: 0).
      - External voltage reference (reg: 1).
      The default corresponds to the reset value of the register field.

  gain:
    type: string
    default: "gain-1"
    enum:
      - "gain-1"
      - "gain-2"
    description: |
      Gain selection bit.
      - Gain of 1 (reg: 0).
      - Gain of 2 (reg: 1).
      The default corresponds to the reset value of the register field.

  power-down-mode:
    type: string
    default: "normal"
    enum:
      - "normal"
      - "power-down-1k"
      - "power-down-100k"
      - "power-down-3-state"
    description: |
      Power-down mode select.
      - Normal mode (reg: 0).
      - 1 kOhm output impedance (reg: 1).
      - 100 kOhm output impedance (reg: 2).
      - Three-state output impedance (reg: 3).
      The default corresponds to the reset value of the register field.

io-channel-cells:
  - output
```

## dts/bindings/dac/adi,ad56x1-base.yaml
```yaml
# SPDX-FileCopyrightText: Copyright The Zephyr Project Contributors
# SPDX-License-Identifier: Apache-2.0

include: [dac-controller.yaml, spi-device.yaml]

properties:
  "#io-channel-cells":
    const: 1

io-channel-cells:
  - output
```

## dts/bindings/dac/adi,ad56xx-base.yaml
```yaml
# Copyright (c) 2023 SILA Embedded Solutions GmbH
# SPDX-License-Identifier: Apache-2.0

include: [dac-controller.yaml, spi-device.yaml]

properties:
  "#io-channel-cells":
    const: 1

  reset-gpios:
    type: phandle-array
    description: "GPIO for reset"

io-channel-cells:
  - output
```

## dts/bindings/dac/adi,max22017-dac.yaml
```yaml
# Copyright (c) 2024 Analog Devices Inc.
# Copyright (c) 2024 BayLibre SAS
# SPDX-License-Identifier: Apache-2.0

include: dac-controller.yaml

description: Analog Devices MAX22017 16bit DAC

properties:
  "#io-channel-cells":
    const: 2

  num-channels:
    type: int
    description: Number of DAC output channels.
    default: 2

  resolution:
    type: int
    description: DAC resolution.
    default: 16

  busy-gpios:
    description: Busy line indicating the DAC is calculating next sample.
    type: phandle-array

  ldac-gpios:
    description: Load both DAC latches at the same time.
    type: phandle-array

  polarity-mode:
    description: |
      Unipolar/bipolar mode selection for channels.
      0 Indicates bipolar mode and 1 unipolar mode.
      The default settings to bipolar here align with the default mode of the device.
    default: [0, 0]
    type: uint8-array

  dac-mode:
    description: |
      Voltage/current mode selection for channels.
      0 indicates voltage mode and 1 indicates current mode.
      The default settings to voltage mode here align with the default mode of the device.
    default: [0, 0]
    type: uint8-array

  latch-mode:
    description: |
      Latch mode selection for channels.
      0 means the channel is not latched, 1 means latched.
      The default settings to non latched should be more straightforward to use than the latched
      mode. The latch mode can be used eitheir with the ldac-gpios to load both channels at the
      same time or if no ldac-gpios property is set, latching will be done per channel with a
      register write.
    default: [0, 0]
    type: uint8-array

  overcurrent-mode:
    description: |
      Overcurrent mode selection for channels.
      0 for current limiting mode
      1 for short circuit protection auto power up mode
      2 for short circuit protection shutdown mode
      The default setting to current limiting mode here aligns with the default mode of the device.
    default: [0, 0]
    type: uint8-array

  timeout:
    description: |
      Timeout in ms.
      The value should be between 100 and 1600ms in increments of 100ms.
    type: int

compatible: "adi,max22017-dac"
```

## dts/bindings/dac/adi,max22017.yaml
```yaml
# Copyright (c) 2024 Analog Devices Inc.
# Copyright (c) 2024 BayLibre SAS
# SPDX-License-Identifier: Apache-2.0

include: [dac-controller.yaml, spi-device.yaml]

bus: max22017

description: Analog devices MAX22017 16bit DAC

properties:
  "#io-channel-cells":
    const: 2

  num-channels:
    type: int
    description: Number of DAC output channels.

  resolution:
    type: int
    description: DAC resolution.

  busy-gpios:
    description: Busy line indicating the DAC is calculating next sample.
    type: phandle-array

  rst-gpios:
    description: Reset pin for max22017.
    type: phandle-array

  ldac-gpios:
    description: Load both DAC latches at the same time.
    type: phandle-array

  int-gpios:
    description: Interrupt gpio
    type: phandle-array

  polarity-mode:
    description: |
      Unipolar/bipolar mode selection for channels.
      0 Indicates bipolar mode and 1 unipolar mode.
    default: [0, 0]
    type: uint8-array

  dac-mode:
    description: |
      Voltage/current mode selection for channels.
      0 indicates voltage mode and 1 indicates current mode.
    default: [0, 0]
    type: uint8-array

  latch-mode:
    description: |
      Latch mode selection for channels.
      0 means the channel is not latched, 1 means latched.
    default: [0, 0]
    type: uint8-array

  crc-mode:
    description: Enables crc over SPI.
    type: boolean

  timeout:
    description: |
      Timeout in ms.
      The value should be between 100 and 1600ms in increments of 100ms.
    type: int

compatible: "adi,max22017"
```

## dts/bindings/dac/atmel,sam-dac.yaml
```yaml
# Copyright (c) 2021 Piotr Mienkowski
# SPDX-License-Identifier: Apache-2.0

description: Atmel SAM family DAC

compatible: "atmel,sam-dac"

include:
  - name: dac-controller.yaml
  - name: pinctrl-device.yaml

properties:
  reg:
    required: true

  clocks:
    required: true

  prescaler:
    type: int
    default: 15
    description: |
      Peripheral Clock to DAC Clock Ratio. Prescaler value is calcuated as
      PRESCAL = (MCK / DACClock) - 2. Should be in range from 0 to 15. The
      value will be written to DACC_MR.PRESCALER bit-field. The property is
      applicable only to SAME70, SAMV71 series devices.

  "#io-channel-cells":
    const: 1

io-channel-cells:
  - output
```

## dts/bindings/dac/atmel,sam0-dac.yaml
```yaml
# Copyright (c) 2020 Google LLC.
# Copyright (c) 2024 Gerson Fernando Budke <nandojve@gmail.com>
# SPDX-License-Identifier: Apache-2.0

description: Atmel SAM0 family DAC

compatible: "atmel,sam0-dac"

include:
  - name: dac-controller.yaml
  - name: pinctrl-device.yaml
  - name: atmel,assigned-clocks.yaml

properties:
  reg:
    required: true

  clocks:
    required: true

  clock-names:
    required: true

  atmel,assigned-clocks:
    required: true

  atmel,assigned-clock-names:
    required: true

  reference:
    type: string
    description: Reference voltage source
    enum:
      - "intref"
      - "vddana"
      - "vrefa"

  "#io-channel-cells":
    const: 0
```

## dts/bindings/dac/atmel,samd5x-dac.yaml
```yaml
# Copyright (c) 2025 Daikin Comfort Technologies North America, Inc.
# SPDX-License-Identifier: Apache-2.0

description: |
  Atmel SAMD5x/E5x family DAC

  To enable the DAC peripheral, it must be enabled in the board dts, or in
  subsequent overlay file. In addition, each channel must be configured
  using the child-binding properties.

  &dac0 {
    status = "okay";
    reference = "intref";

    channel_0 {
      oversampling = <0>;
      refresh-period = <1>;
      current-control = <2>;
    };

    channel_1 {
      oversampling = <0>;
      refresh-period = <1>;
      current-control = <2>;
    };
  };

compatible: "atmel,samd5x-dac"

include:
  - name: dac-controller.yaml
  - name: pinctrl-device.yaml
  - name: atmel,assigned-clocks.yaml

properties:
  reg:
    required: true

  clocks:
    required: true

  clock-names:
    required: true

  atmel,assigned-clocks:
    required: true

  atmel,assigned-clock-names:
    required: true

  reference:
    type: string
    description: Reference voltage source
    enum:
      - "vrefau"
      - "vddana"
      - "vrefab"
      - "intref"

  differential-mode:
    type: boolean
    description: |
       Enable differential mode. When enabled, the DAC outputs the difference
       between channel 0 and channel 1 on the VOUT0 pin.

  "#io-channel-cells":
    const: 1

child-binding:
  description: |
    DAC Channel configuration. Each channel can be individually configured
    with the following properties:

  properties:
    oversampling:
      type: string
      description: |
        This field defines the oversampling ratio/interpolation depth:
        - 0: 1x oversampling (no interpolation)
        - 1: 2x oversampling
        - 2: 4x oversampling
        - 3: 8x oversampling
        - 4: 16x oversampling
        - 5: 32x oversampling
        Higher oversampling ratios provide better noise reduction but
        reduce the maximum update rate.
      enum:
        - "OSR_1"
        - "OSR_2"
        - "OSR_4"
        - "OSR_8"
        - "OSR_16"
        - "OSR_32"

    refresh-period:
      type: int
      description: |
        Defines the refresh period for the DAC output. Only work when the
        input data is not interpolated, i.e. the oversampling rate is zero.
        - 0: Refresh mode disabled
        - 1-15: Refresh period = REFRESH * 30µs

    run-in-standby:
      type: boolean
      description: |
        When enabled, the DAC channel continues to operate in standby mode.

    current-control:
      type: string
      description: |
        Select the output buffer current according to data rate, power
        consumption can be reduced by controlling the output buffer
        current, according to conversion rate.
        - 0: GCLK_DAC ≤ 1.2MHz (100kSPS)
        - 1: 1.2MHz < GCLK_DAC ≤ 6MHz (500kSPS)
        - 2: 6MHz < GCLK_DAC ≤ 12MHz (1MSPS)
      enum:
        - "CC100K"
        - "CC1M"
        - "CC12M"
```

## dts/bindings/dac/dac-controller.yaml
```yaml
# Copyright (c) 2020 Libre Solar Technologies GmbH
# SPDX-License-Identifier: Apache-2.0

# Common fields for DAC controllers

include: base.yaml

properties:
  "#io-channel-cells":
    type: int
    required: true

child-binding:
  description: |
    Channel configuration.

    All nodes using this binding must be named "channel", otherwise their
    data will not be accessible for the DAC API macros.

  properties:
    reg:
      type: array
      required: true
      description: Channel identifier.

    zephyr,resolution:
      type: int
      description: |
        DAC resolution to be used for the channel.

    zephyr,buffered:
      type: boolean
      description: |
        Enable output buffer for the channel.

    zephyr,internal:
      type: boolean
      description: |
        Enable internal output path for the channel.

    zephyr,vref-mv:
      type: int
      description: |
        This property can be used to specify the voltage (in millivolts)
        of the reference selected for this channel, so that applications
        can get that value if needed for some calculations.
```
