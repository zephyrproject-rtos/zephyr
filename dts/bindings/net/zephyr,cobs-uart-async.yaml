## dts/bindings/net/zephyr,cobs-uart-async.yaml
```yaml
# Copyright (c) 2025 Martin Schröder
# SPDX-License-Identifier: Apache-2.0

description: |
  COBS network interface using UART async API with COBS framing.

  This binding creates a network interface instance that uses a UART
  device for transport. Multiple instances can be created, each using
  a different UART.

  Example devicetree usage:

    cobs0: cobs@0 {
      compatible = "zephyr,cobs-uart-async";
      reg = <0>;
      uart = <&uart1>;
      status = "okay";
    };

    cobs1: cobs@1 {
      compatible = "zephyr,cobs-uart-async";
      reg = <1>;
      uart = <&uart2>;
      status = "okay";
    };

    &uart1 {
      status = "okay";
      current-speed = <115200>;
    };

    &uart2 {
      status = "okay";
      current-speed = <115200>;
    };

compatible: "zephyr,cobs-uart-async"

properties:
  reg:
    type: int
    required: true
    description: |
      Instance identifier. Must match the unit address.
      Parent node must have #size-cells = <0>.

  uart:
    type: phandle
    required: true
    description: |
      UART device to use for this COBS interface.
      The UART must support async API.

  label:
    type: string
    description: Human-readable label for the interface
```

## dts/bindings/neural_net/intel,gna.yaml
```yaml
# Copyright (c) 2021 Intel Corporation
#
# SPDX-License-Identifier: Apache-2.0

description: Intel Gaussian Mixture Model and Neural Network Accelerator (GNA)

compatible: "intel,gna"

include: [base.yaml]

properties:
  reg:
    required: true

  interrupts:
    required: true

  interrupt-parent:
    required: true
```

## dts/bindings/nfc/nfc,nt3h2x11.yaml
```yaml
#
# Copyright (c) 2023 Sendrato
#
# SPDX-License-Identifier: Apache-2.0
#

description: NXP NT3H2X11 IC

compatible: "nxp,nt3h2X11"

include: i2c-device.yaml

properties:
  irq-gpios:
    type: phandle-array
    description: |
      The INT signal configuration is active-low.
```

## dts/bindings/nfc/nxp,rc522.yaml
```yaml
# Copyright (c) 2026 Luke Bugbee <lbugbee@protonmail.com>
# SPDX-License-Identifier: Apache-2.0

description: RC522 NFC Driver

compatible: "nxp,rc522"

include: spi-device.yaml

properties:
  reset-gpios:
    required: true
    type: phandle-array
```

## dts/bindings/nvmem/bflb,efuse.yaml
```yaml
# Copyright (c) 2024-2025 MASSDRIVER EI (massdriver.space)
# SPDX-License-Identifier: Apache-2.0

title: Bouffalolab EFUSE (NVMEM provider)

description: |
  Bouffalolab EFUSE region exposed as an NVMEM provider. Treats EFUSE
  as read-only OTP memory; writes are not supported through the NVMEM API.

compatible: "bflb,efuse"

include:
  - nvmem-provider.yaml
  - base.yaml

properties:
  reg:
    required: true
```

## dts/bindings/nvmem/fixed-layout.yaml
```yaml
# Copyright (c) 2025 Basalte bv
# SPDX-License-Identifier: Apache-2.0

description: |
  Fixed layout for Non-Volatile memory.

compatible: "fixed-layout"

properties:
  "#address-cells":
    type: int
    const: 1
    description: |
      Number of cells required to represent a child node's
      reg property address.

  "#size-cells":
    type: int
    const: 1
    description: |
      Number of cells required to represent a child node's size.

child-binding:
  description: |
    Each child node of the NVMEM provider node represents
    an individual NVMEM cell. These should usually
    look like this:

      cell_nodelabel: cell@START_OFFSET {
              reg = <0xSTART_OFFSET 0xSIZE>;
              #nvmem-cell-cells = <0>;
      };

  properties:
    reg:
      type: array
      required: true
      description: |
        This should be in the format <OFFSET SIZE>, where OFFSET
        is the offset of the NVMEM cell relative to the base
        address of the parent memory, and SIZE is the size of
        the cell in bytes.

    read-only:
      type: boolean
      description: Set this property if the cell is read-only.
```

## dts/bindings/nvmem/infineon,fm25xxx.yaml
```yaml
# Copyright (c) 2025 Luna Pes <zephyr@orangemurker.com>
# SPDX-License-Identifier: Apache-2.0

title: Infineon FM25XXX SPI FRAM (NVMEM provider)

description: |
  Infineon FM25XXX family of SPI-attached FRAM devices exposed as
  an NVMEM provider. Uses the common NVMEM provider schema.

compatible: "infineon,fm25xxx"

include:
  - nvmem-provider.yaml
  - spi-device.yaml
```

## dts/bindings/nvmem/nvmem-consumer.yaml
```yaml
# Copyright (c) 2024, Andriy Gelman <andriy.gelman@gmail.com>
# Copyright (c) 2025 Basalte bv
# SPDX-License-Identifier: Apache-2.0

properties:
  nvmem-cell-names:
    type: string-array
    description:
      Names for each nvmem-cells specified.

  nvmem-cells:
    type: phandle-array
    description:
      List of phandles to the nvmem data cells.
```

## dts/bindings/nvmem/nvmem-provider.yaml
```yaml
# Copyright 2025 NXP
# SPDX-License-Identifier: Apache-2.0

title: NVMEM (Non-Volatile Memory) Provider

description: |
  Common constraints for NVMEM providers.

properties:
  size:
    type: int
    description: |
      Total NVMEM device size in bytes

  read-only:
    type: boolean
    description: |
      Indicates that the entire device is read-only. When set,
      the provider driver should report read_only at runtime
      and reject write attempts.
```

## dts/bindings/nvmem/nxp,lpc11u6x-eeprom.yaml
```yaml
# Copyright (c) 2020 Seagate Technology LLC
# SPDX-License-Identifier: Apache-2.0

description: |
  NXP LPC11U6X on-chip EEPROM node (NVMEM provider)

compatible: "nxp,lpc11u6x-eeprom"

include:
  - nvmem-provider.yaml
```

## dts/bindings/nvmem/nxp,ocotp.yaml
```yaml
# Copyright 2025 NXP
# SPDX-License-Identifier: Apache-2.0

description: |
  NXP OCOTP efuse provider backed by ROM API access.

compatible: "nxp,ocotp"

include:
  - nvmem-provider.yaml
  - fixed-layout.yaml

properties:
  rom-api-tree-addr:
    type: int
    required: true
    description: |
      Absolute address of the ROM API tree used to reach
      the OCOTP services.

  ocotp-driver-ptr-idx:
    type: int
    required: true
    description: |
      Index into the ROM API tree where the OCOTP driver
      pointer can be found.
```
