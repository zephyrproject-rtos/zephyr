## dts/bindings/led_strip/worldsemi,ws2812-spi.yaml
```yaml
# Copyright (c) 2019, Nordic Semiconductor ASA
# Copyright (c) 2025, Google LLC
#
# SPDX-License-Identifier: Apache-2.0

description: |
  Worldsemi WS2812 LED strip, SPI binding

  Driver bindings for controlling a WS2812 or compatible LED
  strip with a SPI master.

  The SPI driver should be usable as long as a zephyr SPI API driver
  is available for your board. Hardware specific tuning is required
  using these properties:

    - spi-max-frequency
    - spi-zero-frame
    - spi-one-frame
    - bits-per-symbol.

  The internal memory overhead is determined by 'bits-per-symbol'.
  For each bit of pixel data, the driver allocates N bits of RAM in
  its buffer, where N is the value of this property.

compatible: "worldsemi,ws2812-spi"

include: [spi-device.yaml, ws2812.yaml]

properties:
  spi-one-frame:
    type: int
    required: true
    description: |
      The pattern/symbol to represent a single '1' bit. The length is
      defined by 'bits-per-symbol'.

  spi-zero-frame:
    type: int
    required: true
    description: |
      The pattern/symbol to represent a single '0' bit. The length is
      defined by 'bits-per-symbol'.

  bits-per-symbol:
    type: int
    default: 8
    description: |
      The number of SPI bits used to represent a single data bit (a symbol).
      Must be between 3 and 8. The default value of 8 maintains backwards
      compatibility, as the driver originally mapped each data bit to a full
      8-bit SPI frame.
```

## dts/bindings/led_strip/worldsemi,ws2812-stm32-timer.yaml
```yaml
# Copyright (c) 2026 Peter Johanson
# SPDX-License-Identifier: Apache-2.0

description: |
  Worldsemi WS2812 LED strip, STM32 timer/PWM via DMA

  Driver bindings for controlling a WS2812 or compatible LED
  strip with an STM32 timer in PWM mode with DMA to load compare
  values for sending the correct data

compatible: "worldsemi,ws2812-stm32-timer"

include: [ws2812.yaml, base.yaml]

properties:
  pwms:
    type: phandle-array
    description: |
      Required PWM specifier. The period cell for the entry must be supplied
      with the value to use for the period for each bit to send to the WS2812
      chain.

      For example
         pwms = <&pwm1 1 PWM_NSEC(1250) PWM_POLARITY_NORMAL>;

  dmas:
    required: true
    description: |
      Required TX dma specifiers for loading the compare sequence. The flags are required to include
      at least 'STM32_DMA_PERIPH_TX | STM32_DMA_MEM_16BITS | STM32_DMA_PERIPH_16BITS', but may
      include additions like setting the DMA priority.

      For example
        dmas = <&dmamux1 2 35 (STM32_DMA_PERIPH_TX | STM32_DMA_MEM_16BITS |
                               STM32_DMA_PERIPH_16BITS | STM32_DMA_PRIORITY_HIGH)>;

  dma-names:
    required: true
    description: |
      This should be "tx" to match the dmas property.

      For example
         dma-names = "tx";

  reset-codes:
    type: int
    required: true
    description: Duration of a reset, as a multiple of the PWM period ns.

  zero-high-ns:
    type: int
    required: true
    description: Length of a 0 code high time in nanoseconds.

  one-high-ns:
    type: int
    required: true
    description: Length of a 1 code high time in nanoseconds.
```

## dts/bindings/led_strip/worldsemi,ws2812-uart.yaml
```yaml
# Copyright (c) 2025 Google LLC
# SPDX-License-Identifier: Apache-2.0

description: |
  Worldsemi WS2812 LED strip, UART binding

  Driver bindings for Worldsemi WS2812 and compatible LED strips using a UART
  peripheral.

  The driver encodes each WS2812 data bit into a multi-bit "symbol" that is
  transmitted via a UART. The signal timing is achieved through a combination
  of this node's properties:
    - one-symbol,
    - zero-symbol,
    - bits-per-symbol,
  and the parent UART's configuration:
    - current-speed (baudrate),
    - data-bits,
    - tx-invert (to produce the required idle-low signal),
    - stop-bits (must be "1" if set),
    - parity (must be "none" if set).

  The driver employs a UART frame-aware packing strategy, reusing the UART's
  hardware start and stop bits as part of the on-wire symbol. This packing
  scheme imposes a configuration constraint: the total number of bits in a
  UART frame must be an integer multiple of `bits-per-symbol`.

  Since the UART must be configured with one start bit, one stop bit, and no
  parity, this means the total frame size, `(2 + data-bits)`, must be evenly
  divisible by `bits-per-symbol`.

  To meet the timing requirements of the WS2812 protocol, the UART controller
  must support high-speed operation, typically 2.4 MHz or higher. The parent
  UART's `current-speed` (baudrate) property should be configured as close as
  possible to the ideal rate, calculated as `bits-per-symbol` times the
  WS2812's data rate (typically 800 kHz). For example, with a
  `bits-per-symbol` of 3, the target baudrate is 2.4 MHz.

  The internal memory buffer size is determined by `bits-per-symbol`. For
  each bit of pixel data, the driver generates a symbol of N bits (where N
  is the value of `bits-per-symbol`), which are then packed into the buffer.

  An example of an overlay:

  &uart1 {
      status = "okay";
      /* Target baudrate is 800kHz * 3 = 2.4MHz. 2.5MHz is a close value. */
      current-speed = <2500000>;
      /* Frame constraint: (1 start + 7 data + 1 stop) = 9 bits total. */
      data-bits = <7>;
      /* tx-invert is required to create an idle-low signal. */
      tx-invert;

      led_strip: ws2812-strip {
          compatible = "worldsemi,ws2812-uart";
          status = "okay";

          /* Timing based on 2.5MHz baudrate (400ns per bit):
           * T1H for '1' bit (2 high bits) = 2 * 400ns = 800ns.
           * T0H for '0' bit (1 high bit) = 1 * 400ns = 400ns.
           */
          one-symbol = <6>;   /* 0b110 */
          zero-symbol = <4>;  /* 0b100 */
          bits-per-symbol = <3>;

          chain-length = <8>;
          reset-delay = <50>;
          color-mapping = <LED_COLOR_ID_GREEN
                           LED_COLOR_ID_RED
                           LED_COLOR_ID_BLUE>;
      };
  };

compatible: "worldsemi,ws2812-uart"

include: [ws2812.yaml, uart-device.yaml]

on-bus: uart

properties:
  one-symbol:
    type: int
    required: true
    description: |
      The bit pattern that represents a single WS2812 '1' bit. The length of
      the pattern is defined by 'bits-per-symbol'. The pattern's MSB must be
      1 (to align with the UART start bit) and its LSB must be 0 (to align
      with the UART stop bit).

  zero-symbol:
    type: int
    required: true
    description: |
      The bit pattern that represents a single WS2812 '0' bit. The length of
      the pattern is defined by 'bits-per-symbol'. The pattern's MSB must be
      1 (to align with the UART start bit) and its LSB must be 0 (to align
      with the UART stop bit).

  bits-per-symbol:
    type: int
    required: true
    description: |
      The number of UART bits used to represent a single WS2812 data bit.
      The value must be between 3 and 10, inclusive.
```

## dts/bindings/led_strip/worldsemi,ws2812.yaml
```yaml
# Copyright (c) 2019, Linaro Limited
# SPDX-License-Identifier: Apache-2.0

description: Worldsemi WS2812 SPI LED strip

compatible: "worldsemi,ws2812"

include: spi-device.yaml
```

## dts/bindings/led_strip/ws2812-gpio.yaml
```yaml
# Copyright (c) 2024, TOKITA Hiroshi
# SPDX-License-Identifier: Apache-2.0

include: ws2812.yaml

description: |
  Common definition GPIO based WS2812 node

properties:
  gpios:
    type: phandle-array
    required: true
    description: |
      GPIO phandle and specifier for the pin connected to the
      led-strip. Exactly one pin should be given.
```

## dts/bindings/led_strip/ws2812.yaml
```yaml
# Copyright (c) 2019, Linaro Limited
# Copyright (c) 2019, Nordic Semiconductor ASA
#
# SPDX-License-Identifier: Apache-2.0

description: |
  Worldsemi WS2812 (and compatible) LED controller

  Driver bindings for daisy chains of WS2812 (and compatible devices
  like SK6812, or Everlight B1414) LED controllers.

  The PWM protocol is described here:
  https://wp.josh.com/2014/05/13/ws2812-neopixels-are-not-so-finicky-once-you-get-to-know-them/

  A 0 bit's pulse width is between 200 and 500 ns. A 1 bit's is
  at least 550 ns, with 700 ns or so typical. Pixel order is GRB.

  You can connect the device to either a GPIO on your SoC, or a SPI
  MOSI line. Use the worldsemi,ws2812-spi.yaml or
  worldsemi,ws2812-gpio.yaml bindings instead of this file after
  making your choice.

  Everlight B1414:

  The specification of the Everlight B1414 LED controller is slightly different.
  For the control signal (waveform) each bit is described with a 1.2 us pulse:

    0 bit: 300 ns high and 900 ns low.
    1 bit: 900 ns high and 300 ns low.

  There is a a +/- 80 ns tolerance for each timing.

  The latch/reset delay is 250 us and it must be set using the reset-delay
  property. The pixel order depends on the model and it can be configured
  using the color-mapping property.

properties:
  chain-length:
    type: int
    required: true
    description: |
      The number of devices in the daisy-chain.

  color-mapping:
    type: array
    required: true
    description: |
      Channel to color mapping (or pixel order).

      For example a GRB channel to color mapping would be

         color-mapping = <LED_COLOR_ID_GREEN
                          LED_COLOR_ID_RED
                          LED_COLOR_ID_BLUE>;

  reset-delay:
    type: int
    default: 8
    description: |
      Minimum delay to wait (in microseconds) to make sure that the strip has
      latched the signal. If omitted, a default value of 8 microseconds is used.
      This default is good for the WS2812 controllers. Note that despite the
      WS2812 datasheet states that a 50 microseconds delay is required, it seems
      6 microseconds is enough. The default is set to 8 microseconds just to be
      safe.
```

## dts/bindings/led_strip/zephyr,fake-led-strip.yaml
```yaml
# Copyright (c) 2025 Gielen De Maesschalck <gielen.de.maesschalck@gmail.com>
# SPDX-License-Identifier: Apache-2.0

description: |
    Fake led strip controller for use as either a stub or a mock in
    Zephyr testing.

compatible: "zephyr,fake-led-strip"

include: led-strip.yaml
```

## dts/bindings/lin/lin-controller.yaml
```yaml
# Common fields for LIN controllers

include: base.yaml

properties:
  bitrate:
    type: int
    description: |
      Initial bitrate in bit/s. If this is unset, the initial bitrate is set to
      CONFIG_LIN_DEFAULT_BITRATE.

  commander:
    type: boolean
    description: |
      Set to true if the LIN controller is commander mode. If this is unset, the LIN
      controller will be a responder.

  conflict-detection:
    type: boolean
    description: |
      Set to true to enable LIN bus conflict detection. If this is unset,
      conflict detection is disabled.

  auto-sync:
    type: boolean
    description: |
      Set to true to enable automatic synchronization of the LIN controller.

  break-len:
    type: int
    default: 13
    description: |
      Length of the break field in bits.

  break-delimiter:
    type: int
    enum: [1, 2]
    default: 1
    description: |
      Length of the break delimiter in bits.

  phys:
    type: phandle
    description: |
      Actively controlled LIN transceiver.

child-binding:
  description: |
    Passive LIN transceiver. The child node must be named "lin-transceiver".

    Example:
      &lin0 {
        status = "okay";

        lin-transceiver {
          max-bitrate = <200000>;
        };
      };

  properties:
    min-bitrate:
      type: int
      description: |
        Minimum bitrate in bit/s supported by the transceiver.

    max-bitrate:
      type: int
      description: |
        Maximum bitrate in bit/s supported by the transceiver.
```
