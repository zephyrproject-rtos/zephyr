## dts/bindings/led_strip/arduino,modulino-smartleds.yaml
```yaml
# Copyright (c) 2025 Google, LLC
# SPDX-License-Identifier: Apache-2.0

description: Arduino Modulino smart LEDs

compatible: "arduino,modulino-smartleds"

include: [led-strip.yaml, i2c-device.yaml]

properties:
  reg:
    required: true
```

## dts/bindings/led_strip/colorway,lpd8803.yaml
```yaml
# Copyright (c) 2019, Linaro Limited
# SPDX-License-Identifier: Apache-2.0

description: Colorway LPD8803 SPI LED strip

compatible: "colorway,lpd8803"

include: spi-device.yaml
```

## dts/bindings/led_strip/colorway,lpd8806.yaml
```yaml
# Copyright (c) 2019, Linaro Limited
# SPDX-License-Identifier: Apache-2.0

description: Colorway LPD8806 SPI LED strip

compatible: "colorway,lpd8806"

include: spi-device.yaml
```

## dts/bindings/led_strip/greeled,lpd8803.yaml
```yaml
# Copyright (c) 2019, Linaro Limited
# SPDX-License-Identifier: Apache-2.0

description: GreeLed LPD8803 SPI LED strip

compatible: "greeled,lpd8803"

include: [spi-device.yaml, led-strip.yaml]
```

## dts/bindings/led_strip/greeled,lpd8806.yaml
```yaml
# Copyright (c) 2019, Linaro Limited
# SPDX-License-Identifier: Apache-2.0

description: GreeLed LPD8806 SPI LED strip

compatible: "greeled,lpd8806"

include: [spi-device.yaml, led-strip.yaml]
```

## dts/bindings/led_strip/led-strip.yaml
```yaml
# Copyright (c) 2019, Linaro Limited
# Copyright (c) 2019, Nordic Semiconductor ASA
# SPDX-License-Identifier: Apache-2.0

# Common fields for LED strips

properties:
  chain-length:
    type: int
    required: true
    description: |
      The number of devices in the daisy-chain.

  color-mapping:
    type: array
    required: true
    description: |
      Channel to color mapping (or pixel order).

      For example a GRB channel to color mapping would be

         color-mapping = <LED_COLOR_ID_GREEN
                          LED_COLOR_ID_RED
                          LED_COLOR_ID_BLUE>;
```

## dts/bindings/led_strip/raspberrypi,pico-pio-ws2812-controller.yaml
```yaml
# Copyright (c) 2023, TOKITA Hiroshi
# SPDX-License-Identifier: Apache-2.0

description: |
  The ws2812 controller implemented by PIO.

compatible: "raspberrypi,pico-ws2812-controller-pio"

include: pinctrl-device.yaml

properties:
  bit-waveform:
    type: array
    description: |
      This property defines the waveform for sending 1-bit data.
      The program uses the first three elements of the array.
      The T0 is equal to T0H in the datasheet.
      The T2 is equal to T1L in the datasheet.
      The T1 is equal to (T1H-T0H) or (T0L-T1L) in the datasheet.

      Code-0
         +------+                 +---
         |      |                 |
         |  T0  |      T1+T2      |
         |      |                 |
      ---+      +-----------------+

      Code-1
         +---------------+        +---
         |               |        |
         |     T0+T1     |   T2   |
         |               |        |
      ---+               +--------+


      The frequency determines the wave period.
      The T0～T2 means ratio in one period.

      For example, T0=3, T1=3, T2=4 and the frequency is 800kHz case,
      T0H is
        (1 / 800kHz) * (3/10) = 375ns
      T0L is
        (1 / 800kHz) * ((4+3)/10) = 875ns
```

## dts/bindings/led_strip/ti,tlc59116.yaml
```yaml
# Copyright (c) 2025 Tridonic GmbH & Co KG
# SPDX-License-Identifier: Apache-2.0

description: |
  Texas Instruments TLC59116 LED controller

  Driver bindings for I2C TLC59116 devices using a single device tree node.
  Length of daisy chains in pixels is defined by the chain-length
  property. Note: chain-length must be a multiple of 16. A single TLC59116 device
  supports 16 LEDs.

  Example device tree node on I2C address 0x60:

    &i2c0 {
      led_strip_60: tlc59116@60 {
        status = "okay";
        compatible = "ti,tlc59116";
        reg = <0x60>;
        label = "led_strip_60";
        chain-length = <16>;
        color-mapping = <LED_COLOR_ID_WHITE>;
      };
    };

compatible: "ti,tlc59116"

include: [i2c-device.yaml, led-strip.yaml]
```

## dts/bindings/led_strip/ti,tlc5971.yaml
```yaml
# Copyright (c) 2021 Esco Medical ApS
# SPDX-License-Identifier: Apache-2.0

description: |
  Texas Instruments TLC5971 (and compatible) LED controller

  Driver bindings for daisy chains of a TLC5971 devices using a single device
  tree node. Length of daisy chains in pixels is defined by the chain-length
  property.

  The color order of the TLC5971 is BGR. Applications can provide custom mappings
  using the color-mapping property.

  Example device tree node w. 24 pixels (6 TLC5971 devices):

    &spi1 {
      led_controller: led_controller@0 {
        status = "okay";
        compatible = "ti,tlc59711", "ti,tlc5971";
        label = "led controller";
        spi-max-frequency = <DT_FREQ_M(1)>;
        reg = <0x0>;
        chain-length = <24>;
        color-mapping = <LED_COLOR_ID_BLUE>,
                        <LED_COLOR_ID_GREEN>,
                        <LED_COLOR_ID_RED>;
      };
    };

compatible: "ti,tlc5971"

include: spi-device.yaml

properties:
  chain-length:
    type: int
    required: true
    description: |
      The number of RGB LEDs in the daisy-chain.
      Must be multiple of 4. A single TLC5971 device supports 4 RGB LEDs.

  color-mapping:
    type: array
    required: true
    description: |
      Channel to color mapping (or pixel order).
      For example a BGR channel to color mapping would be

         color-mapping = <LED_COLOR_ID_BLUE
                          LED_COLOR_ID_GREEN
                          LED_COLOR_ID_RED>;
```

## dts/bindings/led_strip/ti,tlc59731.yaml
```yaml
# Copyright (c) 2024 Javad Rahimipetroudi <javad.rahimipetroudi@mind.be>
# SPDX-License-Identifier: Apache-2.0

compatible: "ti,tlc59731"
description: TLC59731 RGB LED Controller
include: [led-strip.yaml]

properties:
  gpios:
    required: true
    type: phandle-array
    description: |
      GPIO to send command data to the controller.
```

## dts/bindings/led_strip/worldsemi,ws2812-bflb-wo.yaml
```yaml
# Copyright (c) 2026 MASSDRIVER EI (massdriver.space)
# SPDX-License-Identifier: Apache-2.0

title: WS2812 and similar on BFLB GPIO FIFO / WO

description: |
  Use the Bouffalolab GPIO FIFO / Wire Out to drive addressable RGB leds by producing
  specifications-accurate pulse widths bits.

compatible: "worldsemi,ws2812-bflb-wo"

include: ["bflb,bflb-wo-device.yaml", ws2812-gpio.yaml]

properties:
  time-t0h:
    default: 400
    description: |
      How long the output signal has to stay high to signify a 0 bit.
      The default is the time for WS2812B (0.4us +/- 150ns).

  time-t1h:
    default: 800
    description: |
      How long the output signal has to stay high to signify a 1 bit.
      The default is the time for WS2812B (0.8us +/- 150ns).

  time-total:
    default: 1250
    description: |
      How long a bit, a pulse containing a high and a low part, should be.
      The default is the time for WS2812B (1.25us +/- 600ns).
```

## dts/bindings/led_strip/worldsemi,ws2812-bl61x-wo.yaml
```yaml
# Copyright (c) 2026 MASSDRIVER EI (massdriver.space)
# SPDX-License-Identifier: Apache-2.0

title: WS2812 and similar on BFLB GPIO FIFO / WO

description: |
  Use the Bouffalolab GPIO FIFO / Wire Out to drive addressable RGB leds by producing
  specifications-accurate pulse widths bits.

compatible: "worldsemi,ws2812-bl61x-wo"

include: ["bflb,bl61x-wo-device.yaml", ws2812-gpio.yaml]

properties:
  time-t0h:
    default: 400
    description: |
      WS2812B high timing from WS2812B datasheet for a 0 (0.4us +/- 150ns).

  time-t1h:
    default: 800
    description: |
      WS2812B high timing from WS2812B datasheet for a 1 (0.8us +/- 150ns).

  time-total:
    default: 1250
    description: |
      WS2812B total time from WS2812B datasheet for a bit (1.25us +/- 600ns).
```

## dts/bindings/led_strip/worldsemi,ws2812-espressif-rmt.yaml
```yaml
# SPDX-FileCopyrightText: Copyright The Zephyr Project Contributors
# SPDX-License-Identifier: Apache-2.0

description: |
  Worldsemi WS2812 LED strip, Espressif RMT binding

  Driver bindings for controlling a WS2812 or compatible LED
  strip with Espressif RMT GPIO.

  Here is an example ESP32 configuration with a RMT device:

  &pinctrl {
    rmt_default: rmt_default {
      group1 {
        pinmux = <RMT_OUT3_GPIO48>;
      };
    };
  };

  &rmt {
    status = "okay";
    pinctrl-0 = <&rmt_default>;
    pinctrl-names = "default";
    dmas = <&dma 9>;
    dma-names = "tx";

    led_strip: ws2812@0 {
      compatible = "worldsemi,ws2812-espressif-rmt";
      reg = <0>;
      chain-length = <1>;
      color-mapping = <LED_COLOR_ID_GREEN
        LED_COLOR_ID_RED
        LED_COLOR_ID_BLUE>;
      reset-delay = <500>;
    };
  };

compatible: "worldsemi,ws2812-espressif-rmt"

include: ["espressif,esp32-rmt-device.yaml", ws2812.yaml]
```

## dts/bindings/led_strip/worldsemi,ws2812-gpio.yaml
```yaml
# Copyright (c) 2019, Nordic Semiconductor ASA
# SPDX-License-Identifier: Apache-2.0

description: |
  Worldsemi WS2812 LED strip, GPIO binding

  Driver bindings for bit-banging a WS2812 or compatible LED strip.

  The CPU driver uses inline assembly, and isn't available for all
  boards. The timing is automatically derived from the CPU clock frequency,
  or can be provided by setting the delay-txx properties in the device
  tree, or can be manually provided by the Kconfig settings DELAY_Txx.

  The four delays provided (calculated based on the clock frequency,
  provided by a dts, or Kconfig file) determine the delays as depicted
  below. The exact timings of the LED strip data line might vary on the
  type of LEDs used, consult the data-sheet for the precise timings.

  0 code
     +-------+                 +---
     |       |                 |
     |  T0H  |       T0L       |
     |       |                 |
  ---+       +-----------------+

  1 code
     +---------------+         +---
     |               |         |
     |      T1H      |   T1L   |
     |               |         |
  ---+               +---------+


  Example dts file:
  / {
        cpus {
            cpu@0 {
                clock-frequency = <64000000>;
            };
        };

        rgb_led: ws2812 {
            compatible = "worldsemi,ws2812-gpio";
            chain-length = <1>;
            color-mapping = <LED_COLOR_ID_GREEN
                             LED_COLOR_ID_RED
                             LED_COLOR_ID_BLUE>;
            gpios = <&gpio0 16 0>;
        };
  };

  Example dts file:
  / {
        chosen {
            zephyr,led-strip = &rgb_led;
        };

        rgb_led: ws2812 {
            compatible = "worldsemi,ws2812-gpio";
            chain-length = <1>;
            color-mapping = <LED_COLOR_ID_GREEN
                             LED_COLOR_ID_RED
                             LED_COLOR_ID_BLUE>;
            reset-delay = <50>;
            gpios = <&gpio0 16 0>;
            delay-t1h = <48>;
            delay-t1l = <32>;
            delay-t0h = <16>;
            delay-t0l = <32>;
        };
  };

compatible: "worldsemi,ws2812-gpio"

include: [base.yaml, ws2812-gpio.yaml]

properties:
  delay-t1h:
    type: int
    description: |
      Number of NOP assembly operations to create a delay for a 1 bit, high
      voltage period (default 700 nsec)

  delay-t1l:
    type: int
    description: |
      Number of NOP assembly operations to create a delay for a 1 bit, low
      voltage period (default 600 nsec)

  delay-t0h:
    type: int
    description: |
      Number of NOP assembly operations to create a delay for a 0 bit, high
      voltage period (default 350 nsec)

  delay-t0l:
    type: int
    description: |
      Number of NOP assembly operations to create a delay for a 0 bit, low
      voltage period (default 800 nsec)
```

## dts/bindings/led_strip/worldsemi,ws2812-i2s.yaml
```yaml
# Copyright (c) 2022 Jonathan Rico
# SPDX-License-Identifier: Apache-2.0

description: |
  Worldsemi WS2812 LED strip, I2S binding

  Driver bindings for controlling a WS2812 or compatible LED
  strip with an I2S master.

compatible: "worldsemi,ws2812-i2s"

include: [i2s-device.yaml, ws2812.yaml]

properties:

  out-active-low:
    type: boolean
    description: True if the output pin is active low.

  nibble-one:
    type: int
    default: 0x0E
    description: 4-bit value to shift out for a 1 pulse.

  nibble-zero:
    type: int
    default: 0x08
    description: 4-bit value to shift out for a 0 pulse.

  lrck-period:
    type: int
    default: 10
    description: LRCK (left/right clock) period in microseconds.

  extra-wait-time:
    type: int
    default: 300
    description: Extra microseconds to wait for the driver to flush its I2S queue.
```

## dts/bindings/led_strip/worldsemi,ws2812-pio.yaml
```yaml
# Copyright (c) 2023, Christian Bach
# SPDX-License-Identifier: Apache-2.0

description: |
  Worldsemi WS2812 LED strip, PIO binding

  Driver bindings for controlling a WS2812 or compatible LED
  strip with a PIO Interface in the RP2040 processor.

  The PIO driver should be usable as long as a zephyr PIO API driver
  is available for your board.

compatible: "worldsemi,ws2812-pio"

include: [ws2812.yaml, "raspberrypi,pico-pio-device.yaml"]
```

## dts/bindings/led_strip/worldsemi,ws2812-rpi_pico-pio.yaml
```yaml
# Copyright (c) 2023, TOKITA Hiroshi
# SPDX-License-Identifier: Apache-2.0

description: |
  The pio node configured for ws2812.

compatible: "worldsemi,ws2812-rpi_pico-pio"

include: pinctrl-device.yaml

properties:
  bit-waveform:
    type: array
    description: |
      This property defines the waveform for sending 1-bit data.
      The program uses the first three elements of the array.
      The T0 is equal to T0H in the datasheet.
      The T2 is equal to T1L in the datasheet.
      The T1 is equal to (T1H-T0H) or (T0L-T1L) in the datasheet.

      Code-0
         +------+                 +---
         |      |                 |
         |  T0  |      T1+T2      |
         |      |                 |
      ---+      +-----------------+

      Code-1
         +---------------+        +---
         |               |        |
         |     T0+T1     |   T2   |
         |               |        |
      ---+               +--------+


      The frequency determines the wave period.
      The T0～T2 means ratio in one period.

      For example, T0=3, T1=3, T2=4 and the frequency is 800kHz case,
      T0H is
        (1 / 800kHz) * (3/10) = 375ns
      T0L is
        (1 / 800kHz) * ((4+3)/10) = 875ns

child-binding:
  description: |
    Worldsemi WS2812 or compatible LED strip driver based on Raspberry Pi Pico's PIO
    The LED strip node can put up to 4 instances under a single PIO node.

  include: ws2812-gpio.yaml

  properties:
    gpios:
      description: |
        Inherited from ws2812-gpio.yaml.

        Note: This driver does not configure the output pin.
        You need to configure the pin with pinctrl that is in the parent node configuration
        for use by PIO. This property only uses the GPIO pin number and ignores flags.

    frequency:
      type: int
      description: |
        Specify the number of times a waveform representing 1 bit is
        transmitted per second. It is same meaning as bit-per-seconds.
        WS2812 works with 800000. Set the value 400000 if use with WS2811.
```
