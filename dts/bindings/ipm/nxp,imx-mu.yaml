## dts/bindings/kscan/holtek,ht16k33-keyscan.yaml
```yaml
description: Holtek HT16K33 keyscan

compatible: "holtek,ht16k33-keyscan"

include: base.yaml

on-bus: ht16k33
```

## dts/bindings/kscan/hynitron-cst816s.yaml
```yaml
# Copyright (c) 2021 Qingsong Gou <gouqs@hotmail.com>
# SPDX-License-Identifier: Apache-2.0

description: Hynitron CST816S touchscreen sensor

compatible: "hynitron-cst816s"

include: i2c-device.yaml

properties:
    irq-gpios:
      type: phandle-array
      required: false

    rst-gpios:
      type: phandle-array
      required: false
```

## dts/bindings/kscan/ite,it8xxx2-kscan.yaml
```yaml
# Copyright (c) 2021 ITE Corporation. All Rights Reserved.
# SPDX-License-Identifier: Apache-2.0

description: ITE it8xxx2 keyboard matrix controller

compatible: "ite,it8xxx2-kscan"

include: [kscan.yaml, pinctrl-device.yaml]

properties:
    reg:
      required: true

    interrupts:
      required: true

    wucctrl:
      type: phandles
      description: |
        Configure wakeup controller, this controller is used to set that
        when the interrupt is triggered in EC low power mode, it can wakeup
        EC or not. Via this controller, we set the wakeup trigger edge,
        enable, disable, and clear wakeup status for the specific pin which
        may be gpio pins or alternate pins.

    kso16-gpios:
      type: phandle-array
      required: true
      description: |
        The KSO16 pin for the selected port.

    kso17-gpios:
      type: phandle-array
      required: true
      description: |
        The KSO17 pin for the selected port.

    pinctrl-0:
      required: true

    pinctrl-names:
      required: true
```

## dts/bindings/kscan/ite,it8xxx2-pinctrl-kscan-kbs.yaml
```yaml
# Copyright (c) 2022 ITE Corporation. All Rights Reserved.
# SPDX-License-Identifier: Apache-2.0

description: ITE IT8XXX2 kscan pin controller kbs function node

compatible: "ite,it8xxx2-pinctrl-kscan-kbs"

include: base.yaml

properties:
  reg:
    required: true

  pushpull-od-mask:
    type: int
    required: true
    description: |
      KSI[7:0] does not support push-pull and open-drain mode.
      If KSO[17:0] is in KBS mode, setting 1 selects open-drain mode,
      setting 0 selects push-pull mode.
      If KSO[15:0] is in GPIO mode, then this bit is always disabled.

  pullup-mask:
    type: int
    required: true
    description:  |
      If KSI[7:0]/KSO[15:0] is in KBS mode , setting 1 enables the internal
      pull-up (KSO[17:16] setting internal pull-up by GPIO port GPCR register).
      If KSI[7:0]/KSO[15:0] is in GPIO mode, then this bit is always disabled.

pinmux-cells:
  - pin
```

## dts/bindings/kscan/ite,it8xxx2-pinctrl-kscan.yaml
```yaml
# Copyright (c) 2022 ITE Corporation. All Rights Reserved.
# SPDX-License-Identifier: Apache-2.0

description: |
    The ITE IT8XXX2 kscan pin controller is a node responsible for controlling
    keyboard scan pin kbs function. For example, you can use this node to
    route KSI[7:0] and KSO[15:0] setting the kbs function on the pin.

    The node has the 'pinctrlkscan' node label set in your SoC's devicetree,
    so you can modify it like this:

      &pinctrlkscan {
              /* your modifications go here */
      };

    All device pin configurations should be placed in child nodes of the
    'pinctrlkscan' node, as shown in this example:

      /* You can put this in places like a board-pinctrl.dtsi file in
       * your board directory, or a devicetree overlay in your application.
       */

      &pinctrlkscan {
        /* configuration for KSI[1:0] kbs */
        kscan_ksi_0_kbs: kscan_ksi_0_kbs {
                pinmuxs = <&pinctrlksi 0>;
        };
        kscan_ksi_1_kbs: kscan_ksi_1_kbs {
                pinmuxs = <&pinctrlksi 1>;
        };
        /* configuration for KSO[1:0] kbs */
        kscan_kso_0_kbs: kscan_kso_0_kbs {
                pinmuxs = <&pinctrlksol 0>;
        };
        kscan_kso_1_kbs: kscan_kso_1_kbs {
                pinmuxs = <&pinctrlksol 1>;
        };
      };

    The 'kscan_ksi_0_kbs' child node encodes the pin configurations
    for kbs function of a device.

    To link pin configurations with a device, use a pinctrl-kscan property,
    like this example you could place in your board's DTS file:

      #include "board-pinctrl.dtsi"

      &kscan0 {
        pinctrl-kscan = <&kscan_ksi_0_kbs &kscan_kso_0_kbs>;
      };

compatible: "ite,it8xxx2-pinctrl-kscan"

include: base.yaml

child-binding:
    description: |
        This binding gives a base representation of the ITE IT8XXX2 kscan pins configration.

    include:
      - name: pincfg-node.yaml
        property-allowlist:
          - drive-push-pull
          - drive-open-drain
          - bias-pull-up

    properties:
        pinmuxs:
          required: true
          type: phandle-array
          description: |
              ITE IT8XXX2 kscan pin's configuration (kscan pinctrl node, pin).
```

## dts/bindings/kscan/ite-it8xxx2-pinctrl-kscan-kbs-device.yaml
```yaml
# Copyright (c) 2022 ITE Corporation. All Rights Reserved.
# SPDX-License-Identifier: Apache-2.0

description: |
  This file needs to be included by devices that need to specify a set of pin
  controller.

  The bindings file for each pin controller driver implementation should provide
  more information on what is the expected pin configuration format.

properties:
  pinctrl-kscan:
    type: phandles
    description: |
      Kscan pin configuration/s for the keyboard scan function. Content is
      specific to the selected pin controller driver implementation.
```

## dts/bindings/kscan/kscan.yaml
```yaml
# Copyright (c) 2019, Intel Corporation
# SPDX-License-Identifier: Apache-2.0

# Common properties for keyboard matrix devices

include: base.yaml

bus: kscan

properties:
    label:
      required: true
```

## dts/bindings/kscan/microchip,cap1203.yaml
```yaml
# Copyright (c) 2022 Keiya Nobuta
# SPDX-License-Identifier: Apache-2.0

description: CAP1203 3-channel capacitive touch sensor

compatible: "microchip,cap1203"

include: [kscan.yaml, i2c-device.yaml]

properties:
  int-gpios:
    type: phandle-array
```

## dts/bindings/kscan/microchip,xec-kscan.yaml
```yaml
# Copyright (c) 2019, Intel Corporation
# Copyright (c) 2021, Microchip Technology Inc.
# SPDX-License-Identifier: Apache-2.0

description: Microchip XEC keyboard matrix controller

compatible: "microchip,xec-kscan"

include: [kscan.yaml, pinctrl-device.yaml]

properties:
    "#address-cells":
      required: true
      const: 1
    "#size-cells":
      type: int
      const: 0
    reg:
      required: true

    pinctrl-0:
      required: false

    pinctrl-names:
      required: false

    interrupts:
      required: true

    girqs:
      type: array
      required: true
      description: Array of pairs of GIRQ number and bit position

    pcrs:
      type: array
      required: true
      description: ADC PCR register index and bit position

girq-cells:
    - girqnum
    - bitpos

pcr-cells:
    - regidx
    - bitpos
```
