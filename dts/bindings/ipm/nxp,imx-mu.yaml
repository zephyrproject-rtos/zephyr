## dts/bindings/ipm/nxp,imx-mu.yaml
```yaml
# Copyright 2018, 2024 NXP
# SPDX-License-Identifier: Apache-2.0

description: i.MX Messaging Unit

compatible: "nxp,imx-mu"

include: [base.yaml, "nxp,rdc-policy.yaml"]

properties:
  reg:
    required: true

  interrupts:
    required: true
```

## dts/bindings/ipm/nxp,lpc-mailbox.yaml
```yaml
# Copyright (c) 2017, NXP
# SPDX-License-Identifier: Apache-2.0

description: LPC MAILBOX

compatible: "nxp,lpc-mailbox"

include: base.yaml

properties:
  reg:
      required: true

  interrupts:
      required: true

  label:
      required: true
```

## dts/bindings/ipm/raspberrypi,pico-sio-fifo.yaml
```yaml
# Copyright (c) 2025 Dmitrii Sharshakov <d3dx12.xx@gmail.com>
# SPDX-License-Identifier: Apache-2.0

description: RP2 SIO FIFO mailbox driver

compatible: "raspberrypi,pico-sio-fifo"

include: base.yaml

properties:
  interrupts:
    required: true

  reg:
    required: true
```

## dts/bindings/ipm/renesas,rz-mhu.yaml
```yaml
# Copyright (c) 2024 EPAM Systems
# Copyright (c) 2024 Renesas Electronics Corporation
# SPDX-License-Identifier: Apache-2.0

description: Renesas MHU (Message Handling Unit)

compatible: "renesas,rz-mhu"

include: [base.yaml, reset-device.yaml]

properties:
  channel:
    type: int
    required: true

  reg:
    required: true

  interrupts:
    required: true

  shared-memory:
    type: phandle
    description: |
      Reference to the shared memory region that is going
      to be used for the buffer communication between
      MHU units. No data will be transmitted if not set.
```

## dts/bindings/ipm/st,stm32-hsem-mailbox.yaml
```yaml
# Copyright (c) 2021 BrainCo Inc.
# SPDX-License-Identifier: Apache-2.0

description: STM32 HSEM MAILBOX

compatible: "st,stm32-hsem-mailbox"

include: base.yaml

properties:
  clocks:
    required: true

  interrupts:
    required: true

  "#mbox-cells":
    type: int
    description: |
      Dummy property for device tree compatibility with MBOX driver.

mbox-cells:
  - channel
```

## dts/bindings/ipm/st,stm32-ipcc-mailbox.yaml
```yaml
# Copyright (c) 2019, STMicroelectronics
# SPDX-License-Identifier: Apache-2.0

description: STM32 IPCC MAILBOX

compatible: "st,stm32-ipcc-mailbox"

include: base.yaml

properties:
  clocks:
    required: true
```

## dts/bindings/ipm/xlnx,zynqmp-ipi-mailbox.yaml
```yaml
# SPDX-License-Identifier: Apache-2.0

description: |
  The Xilinx IPI(Inter Processor Interrupt) mailbox controller is to manage
  messaging between two Xilinx Zynq UltraScale+ MPSoC IPI agents. Each IPI
  agent owns registers used for notification and buffers for message.

compatible: "xlnx,zynqmp-ipi-mailbox"

include: base.yaml

properties:

  reg:
    type: array
    description: IPI control and status register space

  reg-names:
    type: string-array
    description: host_ipi_reg

  local-ipi-id:
    type: int
    description: Host Xilinx IPI agent ID of which the mailbox is connected to.
    required: true

child-binding:
  description: Xilinx IPI agent child node

  properties:
    reg:
      type: array
      description: register space for IPI message buffers
      required: true

    reg-names:
      type: string-array
      description: name of each register space
      required: true

    remote-ipi-id:
      type: int
      description:
        Remote Xilinx IPI agent ID of which the mailbox is connected to.
      required: true
```

## dts/bindings/ipm/zephyr,ipm-console.yaml
```yaml
# Copyright (c) 2020 Intel Corporation
# SPDX-License-Identifier: Apache-2.0

description: IPM console

compatible: "zephyr,ipm-console"

include: uart-device.yaml

properties:
  label:
    required: true
```

## dts/bindings/ipm/zephyr,mbox-ipm.yaml
```yaml
# Copyright (c) 2024 Texas Instruments Incorporated
#      Andrew Davis <afd@ti.com>
# SPDX-License-Identifier: Apache-2.0

description: Inter-Processor-Message to Mailbox adaptor driver

compatible: "zephyr,mbox-ipm"

include: base.yaml

properties:
  mboxes:
    description: phandle to the MBOX controller (TX and RX are required)
    required: true

  mbox-names:
    description: MBOX channel names (must be called "tx" and "rx")
    required: true
```

## dts/bindings/jdi/ambiq,jdi.yaml
```yaml
# Copyright (c) 2025 Ambiq Micro Inc.
# SPDX-License-Identifier: Apache-2.0

description: Ambiq JDI (Japan Display Interface) Host

compatible: "ambiq,jdi"

include: [jdi-host.yaml, pinctrl-device.yaml]

properties:
  xrst-intb-delay:
    type: int
    required: true
    description: |
      Delay inserted prior of XRST or INTB in multiples of format_clk.

  xrst-intb-width:
    type: int
    required: true
    description: |
      Width of High state of XRST or INTB in multiples of format_clk.

  vst-gsp-delay:
    type: int
    required: true
    description: |
      Delay inserted prior of VST or GSP in multiples of format_clk.

  vst-gsp-width:
    type: int
    required: true
    description: |
      Width of High state of VST or GSP in multiples of format_clk.

  vck-gck-delay:
    type: int
    required: true
    description: |
      Delay inserted prior of VCK or GCK in multiples of format_clk.

  vck-gck-width:
    type: int
    required: true
    description: |
      Width of High state of VCK or GCK in multiples of format_clk.

  vck-gck-closing-pulses:
    type: int
    required: true
    description: |
      Number of VCK or GCK pulses without ENB or GEN signal at the end of frame.

  hst-bsp-delay:
    type: int
    required: true
    description: |
      Delay inserted prior of HST or BSP in multiples of format_clk.

  hst-bsp-width:
    type: int
    required: true
    description: |
      Width of High state of HST or BSP in multiples of format_clk.

  hck-bck-data-start:
    type: int
    required: true
    description: |
      The HCK or BCK cycle the pixel data should start at.

  enb-gen-delay:
    type: int
    required: true
    description: |
      Delay inserted prior of ENB or GEN in multiples of format_clk.

  enb-gen-width:
    type: int
    required: true
    description: |
      Width of High state of ENB or GEN in multiples of format_clk.
```

## dts/bindings/jdi/jdi-host.yaml
```yaml
# Copyright (c) 2025 Ambiq Micro Inc.
# SPDX-License-Identifier: Apache-2.0

# Common fields for JDI hosts

include: base.yaml

bus: jdi

properties:
  "#address-cells":
    required: true
    const: 1

  "#size-cells":
    required: true
    const: 0

  hck-bck-max-freq:
    type: int
    required: true
    description: |
      Maximum frequency for HCK/BCK signals in Hz

  vck-gck-max-freq:
    type: int
    required: true
    description: |
      Maximum frequency for VCK/GCK signals in Hz
```

## dts/bindings/kscan/atmosic,kscan.yaml
```yaml
# Copyright (c) Atmosic 2022
# SPDX-License-Identifier: Apache-2.0

description: Atmosic keyboard matrix controller

compatible: "atmosic,kscan"

include: kscan.yaml

properties:
    reg:
      required: true

    interrupts:
      required: true

    row0-pin:
        type: int
        required: false
        description: configure row0 pin

    row0-ksi:
        type: int
        required: false
        description: configure row0 ksi

    row1-pin:
        type: int
        required: false
        description: configure row1 pin

    row1-ksi:
        type: int
        required: false
        description: configure row1 ksi

    row2-pin:
        type: int
        required: false
        description: configure row2 pin

    row2-ksi:
        type: int
        required: false
        description: configure row2 ksi

    row3-pin:
        type: int
        required: false
        description: configure row3 pin

    row3-ksi:
        type: int
        required: false
        description: configure row3 ksi

    row4-pin:
        type: int
        required: false
        description: configure row4 pin

    row4-ksi:
        type: int
        required: false
        description: configure row4 ksi

    row5-pin:
        type: int
        required: false
        description: configure row5 pin

    row5-ksi:
        type: int
        required: false
        description: configure row5 ksi

    row6-pin:
        type: int
        required: false
        description: configure row6 pin

    row6-ksi:
        type: int
        required: false
        description: configure row6 ksi

    row7-pin:
        type: int
        required: false
        description: configure row7 pin

    row7-ksi:
        type: int
        required: false
        description: configure row7 ksi

    row8-pin:
        type: int
        required: false
        description: configure row8 pin

    row8-ksi:
        type: int
        required: false
        description: configure row8 ksi

    row9-pin:
        type: int
        required: false
        description: configure row9 pin

    row9-ksi:
        type: int
        required: false
        description: configure row9 ksi

    row10-pin:
        type: int
        required: false
        description: configure row10 pin

    row10-ksi:
        type: int
        required: false
        description: configure row10 ksi

    row11-pin:
        type: int
        required: false
        description: configure row11 pin

    row11-ksi:
        type: int
        required: false
        description: configure row11 ksi

    row12-pin:
        type: int
        required: false
        description: configure row12 pin

    row12-ksi:
        type: int
        required: false
        description: configure row12 ksi

    row13-pin:
        type: int
        required: false
        description: configure row13 pin

    row13-ksi:
        type: int
        required: false
        description: configure row13 ksi

    row14-pin:
        type: int
        required: false
        description: configure row14 pin

    row14-ksi:
        type: int
        required: false
        description: configure row14 ksi

    row15-pin:
        type: int
        required: false
        description: configure row15 pin

    row15-ksi:
        type: int
        required: false
        description: configure row15 ksi

    row16-pin:
        type: int
        required: false
        description: configure row16 pin

    row16-ksi:
        type: int
        required: false
        description: configure row16 ksi

    row17-pin:
        type: int
        required: false
        description: configure row17 pin

    row17-ksi:
        type: int
        required: false
        description: configure row17 ksi

    row18-pin:
        type: int
        required: false
        description: configure row18 pin

    row18-ksi:
        type: int
        required: false
        description: configure row18 ksi

    col0-pin:
        type: int
        required: false
        description: configure col0 pin

    col0-kso:
        type: int
        required: false
        description: configure col0 kso

    col1-pin:
        type: int
        required: false
        description: configure col1 pin

    col1-kso:
        type: int
        required: false
        description: configure col1 kso

    col2-pin:
        type: int
        required: false
        description: configure col2 pin

    col2-kso:
        type: int
        required: false
        description: configure col2 kso

    col3-pin:
        type: int
        required: false
        description: configure col3 pin

    col3-kso:
        type: int
        required: false
        description: configure col3 kso

    col4-pin:
        type: int
        required: false
        description: configure col4 pin

    col4-kso:
        type: int
        required: false
        description: configure col4 kso

    col5-pin:
        type: int
        required: false
        description: configure col5 pin

    col5-kso:
        type: int
        required: false
        description: configure col5 kso

    col6-pin:
        type: int
        required: false
        description: configure col6 pin

    col6-kso:
        type: int
        required: false
        description: configure col6 kso

    col7-pin:
        type: int
        required: false
        description: configure col7 pin

    col7-kso:
        type: int
        required: false
        description: configure col7 kso

    col8-pin:
        type: int
        required: false
        description: configure col8 pin

    col8-kso:
        type: int
        required: false
        description: configure col8 kso

    col9-pin:
        type: int
        required: false
        description: configure col9 pin

    col9-kso:
        type: int
        required: false
        description: configure col9 kso

    col10-pin:
        type: int
        required: false
        description: configure col10 pin

    col10-kso:
        type: int
        required: false
        description: configure col10 kso

    col11-pin:
        type: int
        required: false
        description: configure col11 pin

    col11-kso:
        type: int
        required: false
        description: configure col11 kso

    col12-pin:
        type: int
        required: false
        description: configure col12 pin

    col12-kso:
        type: int
        required: false
        description: configure col12 kso

    col13-pin:
        type: int
        required: false
        description: configure col13 pin

    col13-kso:
        type: int
        required: false
        description: configure col13 kso

    col14-pin:
        type: int
        required: false
        description: configure col14 pin

    col14-kso:
        type: int
        required: false
        description: configure col14 kso

    col15-pin:
        type: int
        required: false
        description: configure col15 pin

    col15-kso:
        type: int
        required: false
        description: configure col15 kso

    col16-pin:
        type: int
        required: false
        description: configure col16 pin

    col16-kso:
        type: int
        required: false
        description: configure col16 kso

    col17-pin:
        type: int
        required: false
        description: configure col17 pin

    col17-kso:
        type: int
        required: false
        description: configure col17 kso

    col18-pin:
        type: int
        required: false
        description: configure col18 pin

    col18-kso:
        type: int
        required: false
        description: configure col18 kso

    col19-pin:
        type: int
        required: false
        description: configure col19 pin

    col19-kso:
        type: int
        required: false
        description: configure col19 kso
```

## dts/bindings/kscan/focaltech,ft5336.yaml
```yaml
# Copyright (c) 2020 NXP
# SPDX-License-Identifier: Apache-2.0

description: FT5XX6/FT6XX6 capacitive touch panels

compatible: "focaltech,ft5336"

include: [kscan.yaml, i2c-device.yaml]

properties:
    int-gpios:
      type: phandle-array
      required: false
```

## dts/bindings/kscan/goodix,gt911.yaml
```yaml
# Copyright (c) 2020 NXP
# SPDX-License-Identifier: Apache-2.0

description: GT9xx / GT9xxx capacitive touch panels

compatible: "goodix,gt911"

include: [kscan.yaml, i2c-device.yaml]

properties:
    irq-gpios:
      type: phandle-array
      required: false
    reset-gpios:
      type: phandle-array
      required: false
```

## dts/bindings/kscan/gpio-kscan.yaml
```yaml
# Copyright (c) 2020, Pete Johanson
# SPDX-License-Identifier: Apache-2.0

description: GPIO keyboard matrix controller

compatible: "gpio-kscan"

include: kscan.yaml

properties:
    row-gpios:
        type: phandle-array
        required: true
    col-gpios:
        type: phandle-array
        required: true
    debounce-period:
        type: int
        default: 5
    diode-direction:
        type: string
        default: row2col
        enum:
          - row2col
          - col2row
```
