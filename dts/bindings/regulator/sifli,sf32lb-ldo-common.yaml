## dts/bindings/regulator/sifli,sf32lb-ldo-common.yaml
```yaml
# Copyright (c) 2025 SiFli Technologies(Nanjing) Co., Ltd
# SPDX-License-Identifier: Apache-2.0

description: |
  Common base for SiFli SF32LB LDO regulators.

  These regulators are child nodes of the PMUC (Power Management Unit Controller).
  All LDOs share the same PERI_LDO register at offset 0x5c within PMUC.

include:
  - name: base.yaml
  - name: regulator.yaml
    property-allowlist:
      - regulator-name
      - regulator-always-on
      - regulator-boot-on
      - regulator-min-microvolt
      - regulator-max-microvolt
```

## dts/bindings/regulator/sifli,sf32lb-ldo18.yaml
```yaml
# Copyright (c) 2025 SiFli Technologies(Nanjing) Co., Ltd
# SPDX-License-Identifier: Apache-2.0

description: SiFli SF32LB LDO18 - 1.8V LDO for PSRAM (VDDSIP).

compatible: "sifli,sf32lb-ldo18"

include: sifli,sf32lb-ldo-common.yaml
```

## dts/bindings/regulator/sifli,sf32lb-ldo2-3v3.yaml
```yaml
# Copyright (c) 2025 SiFli Technologies(Nanjing) Co., Ltd
# SPDX-License-Identifier: Apache-2.0

description: SiFli SF32LB LDO2 3V3 - 3.3V LDO2 for peripherals.

compatible: "sifli,sf32lb-ldo2-3v3"

include: sifli,sf32lb-ldo-common.yaml
```

## dts/bindings/regulator/sifli,sf32lb-ldo3-3v3.yaml
```yaml
# Copyright (c) 2025 SiFli Technologies(Nanjing) Co., Ltd
# SPDX-License-Identifier: Apache-2.0

description: SiFli SF32LB LDO3 3V3 - 3.3V LDO3 for peripherals.

compatible: "sifli,sf32lb-ldo3-3v3"

include: sifli,sf32lb-ldo-common.yaml
```

## dts/bindings/regulator/sifli,sf32lb-peri-ldo.yaml
```yaml
# Copyright (c) 2025 SiFli Technologies(Nanjing) Co., Ltd
# SPDX-License-Identifier: Apache-2.0

description: |
  SiFli SF32LB52x Peripheral LDO Regulators.

  This node provides access to internal LDOs in the PMUC (Power Management Unit Controller):
  - ldo18: 1.8V LDO for PSRAM (VDDSIP)
  - ldo2-3v3: 3.3V LDO2 for peripherals
  - ldo3-3v3: 3.3V LDO3 for peripherals

  Example:
    peri_ldo: peri-ldo@500ca05c {
      compatible = "sifli,sf32lb-peri-ldo";
      reg = <0x500ca05c 0x4>;
      #address-cells = <1>;
      #size-cells = <0>;

      ldo18: ldo18@0 {
        reg = <0>;
        regulator-min-microvolt = <1800000>;
        regulator-max-microvolt = <1800000>;
        regulator-boot-on;
      };
    };

compatible: "sifli,sf32lb-peri-ldo"

include: base.yaml

properties:
  reg:
    required: true
    description: |
      Address of the PERI_LDO register in PMUC.

  "#address-cells":
    const: 1

  "#size-cells":
    const: 0

child-binding:
  include:
    - name: regulator.yaml
      property-allowlist:
        - regulator-name
        - regulator-always-on
        - regulator-boot-on
        - regulator-min-microvolt
        - regulator-max-microvolt

  properties:
    reg:
      type: int
      required: true
      enum:
        - 0  # SF32LB_PERI_LDO18
        - 1  # SF32LB_PERI_LDO2_3V3
        - 2  # SF32LB_PERI_LDO3_3V3
      description: |
        LDO index, use values from dt-bindings/regulator/sf32lb.h:
        - SF32LB_PERI_LDO18 (0): 1.8V LDO for PSRAM
        - SF32LB_PERI_LDO2_3V3 (1): 3.3V LDO2
        - SF32LB_PERI_LDO3_3V3 (2): 3.3V LDO3
```

## dts/bindings/regulator/sifli,sf32lb52x-ldo.yaml
```yaml
# Copyright (c) 2025 SiFli Technologies(Nanjing) Co., Ltd
# SPDX-License-Identifier: Apache-2.0

title: SiFli SF32LB52x Peripheral LDO Regulators

description: |
  This node is a child of the PMUC (Power Management Unit Controller) and
  provides access to the internal peripheral LDOs controlled by the PERI_LDO
  register (offset 0x5c in PMUC).

examples:
  - |
    #include <zephyr/dt-bindings/regulator/sf32lb52x-ldo.h>

    pmuc: syscon@500ca000 {
      compatible = "sifli,sf32lb52x-pmuc", "syscon";
      reg = <0x500ca000 0x1000>;

      regulators {
        compatible = "sifli,sf32lb52x-ldo";

        ldo1_1v8: LDO1_1V8 {
          regulator-min-microvolt = <1800000>;
          regulator-max-microvolt = <1800000>;
          regulator-boot-on;
        };

        ldo2_3v3: LDO2_3V3 {
          regulator-min-microvolt = <3300000>;
          regulator-max-microvolt = <3300000>;
        };

        ldo3_3v3: LDO3_3V3 {
          regulator-min-microvolt = <3300000>;
          regulator-max-microvolt = <3300000>;
        };
      };
    };

compatible: "sifli,sf32lb52x-ldo"

include: base.yaml

child-binding:
  include:
    - name: regulator.yaml
      property-allowlist:
        - regulator-name
        - regulator-always-on
        - regulator-boot-on
        - regulator-min-microvolt
        - regulator-max-microvolt
```

## dts/bindings/regulator/silabs,series2-dcdc.yaml
```yaml
# Copyright (c) 2024 Silicon Laboratories Inc.
# SPDX-License-Identifier: Apache-2.0

description: |
  Silicon Labs Series 2 DC-DC converter.

  Include the bindings header file <zephyr/dt-bindings/regulator/silabs_dcdc.h> to get
  access to relevant symbols for configuration.

  The following standard properties are supported:

  `regulator-boot-on`
    Enable DC-DC converter at boot. If not set, the DC-DC converter is powered off.
  `regulator-allow-bypass`
    Enable bypass mode. If combined with `regulator-boot-on`, the DC-DC converter
    is initialized to bypass mode.
  `regulator-initial-mode`
    DCDC operating mode. One of `SILABS_DCDC_MODE_BUCK` or `SILABS_DCDC_MODE_BOOST`.
  `regulator-init-microvolt`
    Output voltage for boost mode. Not used in buck mode.

compatible: "silabs,series2-dcdc"

include:
  - name: base.yaml
  - name: regulator.yaml
    property-allowlist:
      - regulator-boot-on
      - regulator-allow-bypass
      - regulator-initial-mode
      - regulator-init-microvolt

properties:
  reg:
    required: true

  regulator-initial-mode:
    enum: [0, 1]

  regulator-init-microvolt:
    enum:
      - 1800000
      - 1900000
      - 2000000
      - 2100000
      - 2200000
      - 2300000
      - 2400000

  silabs,pfmx-peak-current-milliamp:
    type: int
    description: Peak current draw in PFMX mode (CCM, continuous conduction mode).
    enum:
      - 50
      - 65
      - 73
      - 80
      - 86
      - 93
      - 100
      - 106
      - 113
      - 120
```

## dts/bindings/regulator/st,stm32-vrefbuf.yaml
```yaml
# Copyright 2025 CodeWrights GmbH
# SPDX-License-Identifier: Apache-2.0

description: STM32 VREFBUF regulator

compatible: "st,stm32-vrefbuf"

include:
  - name: base.yaml
  - name: reset-device.yaml
  - name: regulator.yaml
    property-allowlist:
      - regulator-name
      - regulator-init-microvolt
      - regulator-min-microvolt
      - regulator-max-microvolt
      - regulator-boot-on
      - regulator-always-on

properties:
  reg:
    required: true

  clocks:
    required: true

  resets:
    required: true

  ref-voltages:
    type: array
    required: true
    description: |
      Reference voltages supported by the VREFBUF regulator.

      Each entry contains the VREFBUF output voltage when the corresponding
      voltage scale is selected. For example, the first array entry (index 0)
      corresponds to the output voltage when Scale 0 is selected.

      Internally, "Scale <x>" is mapped to LL_VREFBUF_VOLTAGE_SCALE<x> which
      should correspond to the voltage called VREFBUF<x> in Reference Manual.
      Refer to your product's Reference Manual, Datasheet and LL headers for
      more details and to obtain the corresponding voltage value.

      For example:
        ref-voltages = <2500000>, <2048000>, <1800000>;
      indicates that 3 reference voltages are supported:
        - SCALE0: 2.5V
        - SCALE1: 2.048V
        - SCALE2: 1.8V

  vrefp-output-enable:
    type: boolean
    description: |
      Enables the VREF+ output pin. VREF+ pin is in high-impedance state
      otherwise.
```

## dts/bindings/regulator/ti,mspm0-vref.yaml
```yaml
# Copyright 2026 Linumiz
#
# SPDX-License-Identifier: Apache-2.0

description: Texas Instruments MSPM0 Voltage Reference (VREF) Regulator

compatible: "ti,mspm0-vref"

include:
  - name: regulator.yaml
  - name: base.yaml
  - name: pinctrl-device.yaml

properties:
  reg:
    required: true

  clocks:
    required: true

  regulator-uv:
    type: int
    required: true
    enum:
      - 1400000
      - 2500000
    description: |
      Minimum supported output, usually 1400000 (1.4V)
      Maximum supported output, usually 2500000 (2.5V)

  ti,sample-hold-enable:
    type: boolean
    description: Enable sample & hold mode

  ti,sample-cycles:
    type: int
    description: Number of sample cycles for sample & hold mode
    default: 8

  ti,hold-cycles:
    type: int
    description: Number of hold cycles for sample & hold mode
    default: 64

  ti,clk-div:
    type: int
    default: 1
    enum:
      - 1
      - 2
      - 4
      - 6
      - 8
```

## dts/bindings/regulator/ti,tps55287.yaml
```yaml
# SPDX-FileCopyrightText: Copyright The Zephyr Project Contributors
# SPDX-License-Identifier: Apache-2.0

description: TPS55287 regulator

compatible: "ti,tps55287"

include:
  - name: i2c-device.yaml
  - name: regulator.yaml

properties:
  en-gpios:
    type: phandle-array
    description: |
      GPIOs connected to the EN/UVLO signal, used to reset the device at
      initialization.

  cdc:
    type: int
    default: 0
    description: |
      Cable droop compensation:
      0 = disabled (default)
      1 = 0.1V output voltage raise with 50mV at Visp - Visn
      2 = 0.2V output voltage raise with 50mV at Visp - Visn
      3 = 0.3V output voltage raise with 50mV at Visp - Visn
      4 = 0.4V output voltage raise with 50mV at Visp - Visn
      5 = 0.5V output voltage raise with 50mV at Visp - Visn
      6 = 0.6V output voltage raise with 50mV at Visp - Visn
      7 = 0.7V output voltage raise with 50mV at Visp - Visn
    enum: [0, 1, 2, 3, 4, 5, 6, 7]

  r-is-milliohm:
    type: int
    description: |
      Value of the current sense shunt resistor in milliohm, required for
      current limit APIs.
```

## dts/bindings/regulator/x-powers,axp192-regulator.yaml
```yaml
# Copyright (c), 2021 NXP
# Copyright (c), 2023 Martin Kiepfer <mrmarteng@teleschirm.org>
# SPDX -License-Identifier: Apache-2.0

description: |
  AXP192 PMIC

  The PMIC has three DCDC converters and two LDOs (LDO1 cannot be disabled).
  All need to be defined as children nodes.
  For example:

  i2c {
    pmic@34 {
      reg = <0x34>;
      ...
      regulators {
        compatible = "x-powers,axp192-regulator";

        DCDC1 {
          /* all properties for DCDC1 */
        };
        DCDC2 {
          /* all properties for DCDC2 */
        };
        DCDC3 {
          /* all properties for DCDC3 */
        };
        LDOIO0 {
          /* all properties for LDOIO0 */
        };
        LDO2 {
          /* all properties for LDO2 */
        };
        LDO3 {
          /* all properties for LDO3 */
        };
      };
    };
  };

compatible: "x-powers,axp192-regulator"

include: base.yaml

child-binding:
  include:
    - name: regulator.yaml
      property-allowlist:
        - regulator-init-microvolt
        - regulator-min-microvolt
        - regulator-max-microvolt
        - regulator-always-on
        - regulator-boot-on
        - regulator-initial-mode
        - regulator-allowed-modes

  properties:
    regulator-initial-mode:
      type: int
      default: 0
      enum:
        - 0
        - 1
      description: |
        Initial operating mode. AXP192 supports 2 different power modes:
        AXP192_DCDC_MODE_AUTO: Auto (0, default)
        AXP192_DCDC_MODE_PWM:  PWM
```

## dts/bindings/regulator/x-powers,axp2101-regulator.yaml
```yaml
# Copyright (c), 2021 NXP
# Copyright (c), 2024 Lothar Felten <lothar.felten@gmail.com>
# SPDX -License-Identifier: Apache-2.0

description: |
  AXP2101 PMIC

  The PMIC has five DCDC converters and nine LDOs.
  All need to be defined as children nodes.
  For example:

  i2c {
    axp2101@34 {
      compatible = "x-powers,axp2101";
      reg = <0x34>;
      ...
      regulators {
        compatible = "x-powers,axp2101-regulator";

        DCDC1 {
          /* all properties for DCDC1 */
        };
        DCDC2 {
          /* all properties for DCDC2 */
        };
        DCDC3 {
          /* all properties for DCDC3 */
        };
        DCDC4 {
          /* all properties for DCDC4 */
        };
        DCDC5 {
          /* all properties for DCDC5 */
        };
        LDOA1 {
          /* all properties for LDOA1 */
        };
        LDOA2 {
          /* all properties for LDOA2 */
        };
        LDOA3 {
          /* all properties for LDOA3 */
        };
        LDOA4 {
          /* all properties for LDOA4 */
        };
        LDOB1 {
          /* all properties for LDOB1 */
        };
        LDOB2 {
          /* all properties for LDOB2 */
        };
        LDOC {
          /* all properties for LDOC */
        };
        LDOD1 {
          /* all properties for LDOD1 */
        };
        LDOD2 {
          /* all properties for LDOD2 */
        };
      };
    };
  };

compatible: "x-powers,axp2101-regulator"

include: base.yaml

on-bus: axp2101

child-binding:
  include:
    - name: regulator.yaml
      property-allowlist:
        - regulator-init-microvolt
        - regulator-min-microvolt
        - regulator-max-microvolt
        - regulator-always-on
        - regulator-boot-on
        - regulator-boot-off
        - regulator-initial-mode
        - regulator-allowed-modes

  properties:
    regulator-initial-mode:
      type: int
      default: 0
      enum: [0, 1]
      description: |
        Initial operating mode. AXP2101 supports 2 different power modes:
        AXP2101_DCDC_MODE_AUTO: Auto (0, default)
        AXP2101_DCDC_MODE_PWM:  PWM
```

## dts/bindings/regulator/xpowers.axp192-regulator.yaml
```yaml
# Copyright (c), 2023 M5Stack
# SPDX -License-Identifier: Apache-2.0

description: |
  X-Powers AXP192 PMIC

  The PMIC has 3 buck converters and 3 LDOs.
  The regulators need to be defined as child nodes, strictly following the
  BUCK1,2,3 LDO2,3 node names. For example:

  pmic@34 {
    reg = <0x34>;
    ...
    regulators {
      compatible = "xpowers,axp192-regulator";

      BUCK1 {
        /* all properties for BUCK1 */
      };
      BUCK2 {
        /* all properties for BUCK2 */
      };
      BUCK3 {
        /* all properties for BUCK3 */
      };
      LDO1 {
        /* all properties for LDO1 */
      };
      LDO2 {
        /* all properties for LDO2 */
      };
      LDO3 {
        /* all properties for LDO3 */
      };
      LDOIO0 {
        /* all properties for LDOIO0 */
      };
    };
  };

compatible: "xpowers,axp192-regulator"

include: base.yaml

child-binding:
  include:
    - name: regulator.yaml
      property-allowlist:
        - regulator-always-on
        - regulator-boot-on
        - regulator-min-microvolt
        - regulator-max-microvolt
        - regulator-init-microvolt
        - regulator-min-microamp
        - regulator-max-microamp
```

## dts/bindings/regulator/zephyr,fake-regulator.yaml
```yaml
# Copyright (c) 2022 Nordic Semiconductor ASA
# SPDX-License-Identifier: Apache-2.0

description: |
  Fake regulator, to be used as a mock or stub in tests.

  An arbitrary number of children can be defined.

compatible: "zephyr,fake-regulator"

child-binding:
  include: regulator.yaml
```

## dts/bindings/remoteproc/openamp,remoteproc.yaml
```yaml
# Copyright (c) 2024 Maurer Systems GmbH
# SPDX-License-Identifier: Apache-2.0

description: |
  This binding is used to describe the remoteproc in the OpenAMP resource table

compatible: "openamp,remoteproc"

properties:
  carveouts:
    type: phandles
    required: true
    description: carveout for the shared memory
```
