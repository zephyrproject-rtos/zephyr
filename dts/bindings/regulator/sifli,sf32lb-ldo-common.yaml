## dts/bindings/remoteproc/openamp,resource-table.yaml
```yaml
# Copyright (c) 2024 Maurer Systems GmbH
# SPDX-License-Identifier: Apache-2.0

description: |
  Binding for describing the remoteproc resource table used by OpenAMP.

  The resource table defines shared memory regions and virtio devices
  required for inter-processor communication.

compatible: "openamp,resource-table"

properties:
  carveouts:
    type: phandles
    required: true
    description: |
      Phandles to memory regions reserved as carveouts for shared memory
      used by OpenAMP.

  vdevs:
    type: phandles
    required: true
    description: |
      Phandles to virtio device nodes associated with the OpenAMP
      resource table.
```

## dts/bindings/remoteproc/openamp,rpmsg-endpoint.yaml
```yaml
# Copyright (c) 2024 Maurer Systems GmbH
# SPDX-License-Identifier: Apache-2.0

description: |
  Binding for an OpenAMP RPMsg endpoint.

  This node represents an RPMsg endpoint used for communication between
  processors. It defines the local and remote endpoint addresses and
  the service type associated with the endpoint.

compatible: "openamp,rpmsg-endpoint"

include: base.yaml

on-bus: rpmsg

properties:
  reg:
    required: true
    description: |
      Endpoint addresses in the form <src dst>, where:
        - src: local endpoint address
        - dst: remote endpoint address

  type:
    type: string
    required: true
    description: |
      RPMsg service name associated with the endpoint.

      Common values include:
        - "rpmsg-tty"
        - "rpmsg-raw"

      These names may be used by the remote system (e.g. Linux)
      to bind the appropriate RPMsg driver.
```

## dts/bindings/remoteproc/openamp,rpmsg-virtio-device.yaml
```yaml
# Copyright (c) 2024 Maurer Systems GmbH
# SPDX-License-Identifier: Apache-2.0

description: |
  Binding for an OpenAMP RPMsg VirtIO device.

  This node represents a VirtIO device implementing the RPMsg protocol
  over OpenAMP. It defines the shared memory used for RPMsg buffers and
  configuration parameters for the associated worker thread.

compatible: "openamp,rpmsg-virtio-device"

include: openamp,virtio-device.yaml

bus: rpmsg

properties:
  device-id:
    default: 7
    description: |
      VirtIO device identifier. Defaults to 7 (VIRTIO_ID_RPMSG)
      as defined by the VirtIO specification.

  memory-region:
    type: phandle
    required: true
    description: |
      Phandle to the shared memory region used for RPMsg buffers.

  zephyr,priority:
    type: array
    description: |
      Workqueue thread priority for this RPMsg instance.

      The value is an array consisting of:
        - priority level
        - priority type

      The priority type must be one of:
        - PRIO_COOP     (cooperative priority)
        - PRIO_PREEMPT  (preemptive priority)

      Examples:
        K_PRIO_COOP(1)     -> <1 PRIO_COOP>
        K_PRIO_PREEMPT(2)  -> <2 PRIO_PREEMPT>

      If not specified, a default priority of <0 PRIO_PREEMPT> is used.
```

## dts/bindings/remoteproc/openamp,vdev.yaml
```yaml
# Copyright (c) 2024 Maurer Systems GmbH
# SPDX-License-Identifier: Apache-2.0

description: OpenAMP RemoteProc vdev

compatible: "openamp,vdev"

include: base.yaml

bus: rpmsg

properties:

  vring0-io:
    type: phandle
    required: true
    description: I/O region for the vring0, usually a carvout region

  vring1-io:
    type: phandle
    required: true
    description: I/O region for the vring1, usually a carvout region

  buffer-io:
    type: phandle
    required: true
    description: I/O region for the RPMSG buffer, usually a carvout region

  num-tx-buffers:
    type: int
    required: true
    description: Timer width in bits of IP version

  num-rx-buffers:
    type: int
    required: true
    description: Timer width in bits of IP version

  mboxes:
    description: phandle to the MBOX controller (TX and RX are required)
    required: true

  mbox-names:
    description: MBOX channel names (must be called "tx" and "rx")
    required: true

  zephyr,priority:
    type: array
    description: |
      WQ priority for the instance. This property is an array composed by the
      priority level and the type of priority (PRIO_COOP for cooperative or
      PRIO_PREEMPT for preemptive).

      For example for a thread priority K_PRIO_COOP(1) in DT we have
        priority = <1 PRIO_COOP>;
      or for K_PRIO_PREEMPT(2)
        priority = <2 PRIO_PREEMPT>;

      When this property is missing a default priority of <0 PRIO_PREEMPT> is
      assumed.
```

## dts/bindings/remoteproc/openamp,virtio-device.yaml
```yaml
# Copyright (c) 2024 Maurer Systems GmbH
# SPDX-License-Identifier: Apache-2.0

description: |
  Binding for a generic OpenAMP VirtIO device.

  This node represents a VirtIO device backed by OpenAMP. It references
  one or more vrings (virtqueues) used for communication between
  processors.

compatible: "openamp,virtio-device"

include: base.yaml

properties:
  device-id:
    type: int
    description: |
      VirtIO device identifier as defined by the VirtIO specification.

  vrings:
    type: phandle-array
    required: true
    description: |
      Phandle array referencing the vring nodes associated with this
      VirtIO device.

  vring-names:
    type: string-array
    required: true
    description: |
      Names corresponding to each entry in the "vrings" property.
      These names identify the role of each vring.

  "#vring-cells":
    type: int
    const: 0
    description: |
      Number of cells in a vring specifier. Must be 0 since vrings
      do not require additional specifier data.
```

## dts/bindings/remoteproc/openamp,vring.yaml
```yaml
# Copyright (c) 2024 Maurer Systems GmbH
# SPDX-License-Identifier: Apache-2.0

description: |
  Binding for an OpenAMP virtio vring.

  A vring represents a virtqueue used for communication between processors.
  It defines the shared memory region, notification mechanism, and buffer
  configuration used by OpenAMP.

compatible: "openamp,vring"

include: base.yaml

properties:
  notify-id:
    type: int
    required: true
    description: |
      Identifier used for notifications (e.g. mailbox or interrupt ID)
      associated with this vring.

  device-address:
    type: int
    default: -1
    description: |
      Device address of the vring in the remote processor address space.
      A value of -1 indicates that the address is assigned dynamically.

  memory-region:
    type: phandle
    required: true
    description: |
      Phandle to the shared memory region used to store the vring
      descriptors, available ring, and used ring.

  num-buffers:
    type: int
    required: true
    description: |
      Number of buffers (descriptors) in the vring.
```

## dts/bindings/reserved-memory/memory-region.yaml
```yaml
# Copyright (c) 2022 Nordic Semiconductor ASA
# SPDX-License-Identifier: Apache-2.0

# Memory region nodes may be referenced by other device nodes
# by adding a memory-region property to the device node.

properties:
  memory-regions:
    type: phandle-array
    description: List of memory region phandles

  memory-region-names:
    type: string-array
    description: A list of names, one for each corresponding phandle in memory-region
```

## dts/bindings/reserved-memory/nordic,owned-memory.yaml
```yaml
# Copyright (c) 2024 Nordic Semiconductor ASA
# SPDX-License-Identifier: Apache-2.0

description: |
  Nordic Owned Memory

  Memory region with permission attributes. Each enabled region of this kind
  will be recorded in the UICR of the compiled domain. Memory ownership and
  access is then configured for the domain at boot time, based on the UICR.

  Example:

    reserved-memory {
        memory@2fc00000 {
            compatible = "nordic,owned-memory";
            reg = <0x2fc00000 0x1000>;
            status = "okay";
            nordic,access = <NRF_OWNER_ID_APPLICATION NRF_PERM_R>,
                            <NRF_OWNER_ID_RADIOCORE NRF_PERM_W>;
        };
    };

  A single local domain can request a memory region to be reserved on behalf of
  multiple access owners. A single memory region shall be reserved by at most
  one domain, by setting status "okay" on the associated node. For example, if
  the region defined above is enabled by Application on behalf of Radiocore,
  then the Radiocore's devicetree must set status "disabled" on that node.

  Each of the different owners may have a different set of permissions granted,
  as also shown above.

  Note: one domain can also reserve memory for another domain and not itself.
  Whichever domain has status "okay" set on the node does not need to be listed
  as one of the access owners.

compatible: "nordic,owned-memory"

include: [base.yaml, "zephyr,memory-common.yaml"]

properties:
  reg:
    required: true

  nordic,access:
    type: array
    description: |
      Array of (owner-id, permission-flags) pairs, where:

      - Owner ID represents the domain that will have access to this memory.
        Valid values can be found in dts/common/nordic/<soc>.dtsi,
        where they are defined as NRF_OWNER_ID_*

      - Permissions are encoded as a 32-bit bitfield, using the flags found in
        include/zephyr/dt-bindings/reserved-memory/nordic-owned-memory.h,
        where they are defined as NRF_PERM_*

        The same file defines all possible permission flag combinations.
        For example, one can use:
          <NRF_OWNER_ID_APPLICATION NRF_PERM_RWX>

        as a shorthand for:
          <NRF_OWNER_ID_APPLICATION (NRF_PERM_R | NRF_PERM_W | NRF_PERM_X)>

  owner-id:
    type: int
    deprecated: true
    description: |
      Deprecated, applies only if 'nordic,access' is not defined.
      Owner ID of the domain that will own this memory region. If not defined,
      the ownership will default to the domain being compiled.

      Note: owner ID is not the same as domain ID; see the product specification
      for details.

  perm-read:
    type: boolean
    deprecated: true
    description: |
      Deprecated, applies only if 'nordic,access' is not defined.
      Owner has read access to the region.

  perm-write:
    type: boolean
    deprecated: true
    description: |
      Deprecated, applies only if 'nordic,access' is not defined.
      Owner has write access to the region.

  perm-execute:
    type: boolean
    deprecated: true
    description: |
      Deprecated, applies only if 'nordic,access' is not defined.
      Owner can execute code from the region.

  perm-secure:
    type: boolean
    deprecated: true
    description: |
      Deprecated, applies only if 'nordic,access' is not defined.
      Owner has secure-only access to the region.

  non-secure-callable:
    type: boolean
    deprecated: true
    description: |
      Deprecated, applies only if 'nordic,access' is not defined.
      Memory region is used for non-secure-callable code.
```

## dts/bindings/reserved-memory/renesas,ofs-memory.yaml
```yaml
# Copyright (c) 2025 Renesas Electronics Corporation
# SPDX-License-Identifier: Apache-2.0

description: |
  Renesas Option-Setting Memory

  The option-setting memory determines the state of the MCU after a reset.
  The option-setting memory is allocated to the configuration setting area
  of the flash memory.

compatible: "renesas,ofs-memory"

include: [base.yaml]

properties:
  reg:
    required: true
```

## dts/bindings/reserved-memory/reserved-memory.yaml
```yaml
description: |
  Reserved memory - Each child of the reserved-memory node specifies one or
  more regions of reserved memory. Regions in the /reserved-memory node may be
  referenced by other device nodes by adding a memory-region property to the
  device node.

compatible: "reserved-memory"

include:
  - name: base.yaml
    property-allowlist: ['#address-cells', '#size-cells']

child-binding:
    description: Regions
    properties:
       label:
          type: string
          required: false
          description: Human readable string describing the device (used as device_get_binding() argument)
       reg:
          type: array
          description: register space
          required: true
```
