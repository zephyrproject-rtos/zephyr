## dts/bindings/regulator/nxp,pca9422-regulator.yaml
```yaml
# Copyright 2025 NXP
# SPDX-License-Identifier: Apache-2.0

description: |
  NXP PCA9422 PMIC

  The PMIC has three buck converters, one buck-boost converter and four LDOs.
  All need to be defined as children nodes, strictly following the BUCK1, BUCK2,
  BUCK3, BUCKBOOST, LDO1, LDO2, LDO3 and LDO4 node names.
  For example:

  pmic@61 {
    reg = <0x61>;
    ...
    regulators {
      compatible = "nxp,pca9422-regulator";
      BUCK1 {
        /* all properties for BUCK1 */
      };
      BUCK2 {
        /* all properties for BUCK2 */
      };
      BUCK3 {
        /* all properties for BUCK2 */
      };
      BUCKBOOST {
        /* all properties for BUCKBOOST */
      };
      LDO1 {
        /* all properties for LDO1 */
      };
      LDO2 {
        /* all properties for LDO2 */
      };
      LDO3 {
        /* all properties for LDO3 */
      };
      LDO4 {
        /* all properties for LDO4 */
      };
    };
  }

compatible: "nxp,pca9422-regulator"

include: base.yaml

properties:
  nxp,enable-modesel-pins:
    type: boolean
    description:
      When enabled, the PMIC will be configured to allow mode transition by using
      the SLEEP_MODE0/STBY_MODE1 pins.

  nxp,vsys-uvlo-sel-millivolt:
    type: int
    default: 2700
    enum:
      - 2600
      - 2700
      - 2800
    description: |
      VSYS UVLO (under voltage lock out) threshold, in millivolts. Defaults to
      2700mV to match the IC default value.

child-binding:
  include:
    - name: regulator.yaml
      property-allowlist:
        - regulator-always-on
        - regulator-boot-on
        - regulator-min-microvolt
        - regulator-max-microvolt

  description: Voltage output of PMIC controller regulator
  properties:
    low-power-mode:
      type: string
      default: "Normal"
      enum:
        - "Normal"
        - "LPM1"
        - "LPM2"
        - "FLPM"
      description: |
        Regulator low power mode setting.

        - Normal mode ("Normal")
        - Low power mode at STANDBY mode and DPSTANDBY mode ("LPM1")
        - Low power mode at DPSTANDBY mode ("LPM2")
        - Forced low power mode ("FLPM")

    enable-mode:
      type: string
      default: "All"
      enum:
        - "All"
        - "Active/Sleep/Standby"
        - "Active/Sleep"
        - "Active"
      description: |
        Regulator enable mode setting.

        - ON at ACTIVE, SLEEP, STANDBY and DPSTANDBY mode ("All")
        - ON at ACTIVE, SLEEP and STANDBY modes, OFF at DPSTANDBY mode
          ("Active/Sleep/Standby")
        - ON at ACTIVE and SLEEP modes, OFF at STANDBY and DPSTANDBY mode
          ("Active/Sleep")
        - ON at ACTIVE mode, OFF at SLEEP, STANDBY and DPSTANDBY mode
          ("Active")

    nxp,active-microvolt:
      type: int
      description: |
        The voltage level to be configured for active mode, in microvolts.

    nxp,sleep-microvolt:
      type: int
      description: |
        The voltage level to be configured for sleep mode, in microvolts.

    nxp,standby-microvolt:
      type: int
      description: |
        The voltage level to be configured for standby and dpstandby modes,
        in microvolts.
```

## dts/bindings/regulator/nxp,pca9422.yaml
```yaml
# SPDX -License-Identifier: Apache-2.0

description: |
  NXP PCA9422 PMIC

  The PMIC has one buck-boost converter, three buck converters, and four LDOs.
  All need to be defined as children nodes, strictly following the BUCK-BOOST,
  BUCK1, BUCK2, BUCK3, LDO1, LDO2, LDO3, and LDO4 node names.
  For example:

  pmic@61 {
    reg = <0x61>;
    ...
    BUCK1 {
      /* all properties for BUCK1 */
    };
    BUCK2 {
      /* all properties for BUCK2 */
    };
    BUCK3 {
      /* all properties for BUCK3 */
    };
    BUCKBOOST {
      /* all properties for BUCKBOOST */
    };
    LDO1 {
      /* all properties for LDO1 */
    };
    LDO2 {
      /* all properties for LDO2 */
    };
    LDO3 {
      /* all properties for LDO3 */
    };
    LDO4 {
      /* all properties for LDO4 */
    };
  };


compatible: "nxp,pca9422"

include: base.yaml

properties:
  nxp,vin-ilim-microamp:
    type: int
    default: 470000
    enum:
      - 45000
      - 70000
      - 95000
      - 120000
      - 145000
      - 170000
      - 195000
      - 220000
      - 245000
      - 270000
      - 295000
      - 320000
      - 345000
      - 370000
      - 395000
      - 420000
      - 445000
      - 470000
      - 495000
      - 520000
      - 545000
      - 570000
      - 595000
      - 620000
      - 645000
      - 670000
      - 695000
      - 795000
      - 895000
      - 995000
      - 1095000
      - 1195000
    description: |
      VIN input current limit, in microamperes. Value reflects typical value,
      with accuraccy at +/-10%.

      Defaults to 470mA, the IC default value.

  nxp,vsys-uvlo-sel-millivolt:
    type: int
    default: 2700
    enum:
      - 2600
      - 2700
      - 2800
    description: |
      VSYS UVLO (under voltage lock out) threshold, in millivolts. Defaults to
      2700mV to match the IC default value.

child-binding:
  include:
    - name: regulator.yaml
      property-allowlist:
        - regulator-always-on
        - regulator-boot-on
        - regulator-min-microvolt
        - regulator-max-microvolt

  description: Voltage output of PMIC controller regulator
  properties:
    enable-inverted:
      type: boolean
      description: |
        If the enable bit should be zero to turn the regulator on, add this
        property.

    nxp,mode0-microvolt:
      type: int
      description: |
        The voltage level to be configured for mode 0, in microvolts. Setting
        this value to zero will disable the source in mode 0.

    nxp,mode1-microvolt:
      type: int
      description: |
        The voltage level to be configured for mode 1, in microvolts. Setting
        this value to zero will disable the source in mode 1.

    nxp,mode2-microvolt:
      type: int
      description: |
        The voltage level to be configured for mode 2, in microvolts. Setting
        this value to zero will disable the source in mode 2.

    nxp,mode3-microvolt:
      type: int
      description: |
        The voltage level to be configured for mode 3, in microvolts. Setting
        this value to zero will disable the source in mode 3.

    nxp,lpmode:
      type: int
      required: true
      enum:
        - 0
        - 1
        - 2
        - 3
      description: |
        The low power mode. Meaning depends whether the child is a buck
        or an ldo.

        For buck (default is 0):
        0 - buck runs in normal mode in ACTIVE, SLEEP, STANDBY, DPSTANDBY
        1 - buck operates in normal mode in ACTIVE and SLEEP, low
            power mode in STANDBY and DPSTANDBY
        2 - buck operates in low power mode only in DPSTANDBY
        3 - buck operates forced in low power mode in ACTIVE, SLEEP, STANDBY, DPSTANDBY

        For ldo (default is 3):
        0 - ldo operates forced in low power mode in ACTIVE, SLEEP, STANDBY, DPSTANDBY
        1 - ldo operates in normal mode in ACTIVE and SLEEP, low
            power mode in STANDBY and DPSTANDBY
        2 - ldo operates in low power mode only in DPSTANDBY
        3 - ldo runs in normal mode in ACTIVE, SLEEP, STANBDY, DPSTANDBY
        Note: LDO1 and LDO4 are always 3 and are not modifiable.
```

## dts/bindings/regulator/nxp,pf1550-regulator.yaml
```yaml
# Copyright (c), 2024 Arduino SA
# SPDX-License-Identifier: Apache-2.0

description: |
  NXP PF1550 PMIC

  The PMIC has two buck converters and three LDOs. All need to be defined as
  children nodes, strictly following the BUCK1..3, LDO1..3 node names. For
  example:

  pmic@8 {
    reg = <0x8>;
    ...
    regulators {
      compatible = nxp,pf1550-regulator";

      BUCK1 {
        /* all properties for BUCK1 */
      };
      BUCK2 {
        /* all properties for BUCK2 */
      };
      BUCK3 {
        /* all properties for BUCK3 */
      };
      LDO1 {
        /* all properties for LDO1 */
      };
      LDO2 {
        /* all properties for LDO2 */
      };
      LDO3 {
        /* all properties for LDO3 */
      };
    };
  };

compatible: "nxp,pf1550-regulator"

include: base.yaml

child-binding:
  include:
    - name: regulator.yaml
      property-allowlist:
        - regulator-init-microvolt
        - regulator-min-microvolt
        - regulator-max-microvolt
        - regulator-init-microamp
        - regulator-max-microamp
        - regulator-always-on
        - regulator-boot-on
        - regulator-initial-mode
        - regulator-allowed-modes
```

## dts/bindings/regulator/nxp,vref.yaml
```yaml
# Copyright 2023-2025 NXP
# SPDX-License-Identifier: Apache-2.0

description: NXP VREF SOC peripheral

compatible: "nxp,vref"

include:
  - name: base.yaml
  - name: regulator.yaml
    property-allowlist:
      - regulator-name
      - regulator-init-microvolt
      - regulator-min-microvolt
      - regulator-max-microvolt
      - regulator-initial-mode
      - regulator-allowed-modes

properties:
  reg:
    required: true

  nxp,buffer-startup-delay-us:
    type: int
    required: true
    description: |
      Buffer startup delay as specified in the
      appropriate device data sheet, in microseconds.

  nxp,bandgap-startup-time-us:
    type: int
    required: true
    description: |
      Maximum bandgap startup time as specified in the
      appropriate device data sheet, in microseconds.

  nxp,current-compensation-en:
    type: boolean
    description: |
      Enable second-order curvature compensation.
      This must be enabled to achieve the performance stated in the datasheet.
      However, the reset value of the peripheral has it disabled.

  nxp,internal-voltage-regulator-en:
    type: boolean
    description: |
      Enables the internal regulator to produce a constant internal voltage
      supply to reduce the sensitivity to external supply noise and variation.

  nxp,chop-oscillator-en:
    type: boolean
    description: |
      Enables the chop oscillator. When set, the internal chopping operation
      is enabled and the internal analog offset is minimized. When using the
      internal voltage regulator, you must also enable the chop oscillator.

  "#nxp,reference-cells":
    type: int
    const: 1
    description: Number of items to expect in a vref specifier.

nxp,reference-cells:
  - vref_mv
```

## dts/bindings/regulator/nxp,vrefv1.yaml
```yaml
# Copyright 2025 NXP
# SPDX-License-Identifier: Apache-2.0

description: NXP VREF SOC peripheral

compatible: "nxp,vrefv1"

include:
  - name: base.yaml
  - name: regulator.yaml
    property-allowlist:
      - regulator-init-microvolt
      - regulator-min-microvolt
      - regulator-max-microvolt
      - regulator-initial-mode
      - regulator-allowed-modes

properties:
  reg:
    required: true

  bandgap-startup-time-us:
    type: int
    required: true
    description: |
      Maximum bandgap startup time as specified in the appropriate device
      data sheet, in microseconds.

  buffer-startup-delay-us:
    type: int
    required: true
    description: |
      Buffer startup delay as specified in the appropriate device data sheet,
      in microseconds.

  chop-oscillator-en:
    type: boolean
    description: |
      Enables the chop oscillator. When set, the internal chopping operation
      is enabled and the internal analog offset is minimized. When using the
      internal voltage regulator, you must also enable the chop oscillator.
      If the chop oscillator is to be used in very low power modes, the system
      (bandgap) voltage reference must also be enabled.

  current-compensation-en:
    type: boolean
    description: |
      Enable second-order curvature compensation.
      This must be enabled to achieve the performance stated in the datasheet.
      However, the reset value of the peripheral has it disabled.

  internal-voltage-regulator-en:
    type: boolean
    description: |
      Enables the internal 1.75V regulator to produce a constant internal voltage
      supply to reduce the sensitivity to external supply noise and variation.
```

## dts/bindings/regulator/raspberrypi,core-supply-regulator.yaml
```yaml
# Copyright (c), 2023 TOKITA Hiroshi <tokita.hiroshi@fujitsu.com>
# SPDX-License-Identifier: Apache-2.0

description: |
  Raspberry Pi Pico core supply regurator

compatible: "raspberrypi,core-supply-regulator"

include:
  - name: base.yaml
  - name: regulator.yaml
    property-allowlist:
      - regulator-always-on
      - regulator-boot-on
      - regulator-min-microvolt
      - regulator-max-microvolt
      - regulator-allowed-modes
      - regulator-initial-mode

properties:
  raspberrypi,brown-out-detection:
    type: boolean
    description:
      Enable brown-out detection

  raspberrypi,brown-out-threshold:
    type: int
    default: 860000
    enum:
      - 473000
      - 516000
      - 559000
      - 602000
      - 645000
      - 688000
      - 731000
      - 774000
      - 817000
      - 860000
      - 903000
      - 946000
      - 989000
      - 1032000
      - 1075000
      - 1118000
    description: |
      Reset if the core voltage drops below this threshold for a particular time
      (determined by the 'brown-out detection assertion delay').
```

## dts/bindings/regulator/realtek,rts5817-regulator.yaml
```yaml
# Copyright (c) 2026 Realtek Semiconductor, Inc.
# SPDX-License-Identifier: Apache-2.0

description: |
  Realtek RTS5817 core and fingerprint sensor power supply regulator.

compatible: "realtek,rts5817-regulator"

include: base.yaml

properties:
  syscon-ldo:
    type: phandle
    required: true
    description: |
      phandle to dlink_ldo node.
  syscon-sys:
    type: phandle
    required: true
    description: |
      phandle to dlink_sys node.

child-binding:
  include:
    - name: regulator.yaml
      property-allowlist:
        - regulator-always-on
        - regulator-boot-on
        - regulator-init-microvolt
        - regulator-min-microvolt
        - regulator-max-microvolt
        - startup-delay-us
  properties:
    ocp-enable:
      type: boolean
      description: svio & sva ldo over current protect.
```

## dts/bindings/regulator/regulator-fixed.yaml
```yaml
# Copyright 2019-2020 Peter Bigot Consulting, LLC
# Copyright 2023 EPAM Systems
# SPDX-License-Identifier: Apache-2.0

description: Fixed voltage regulators

include:
  - name: base.yaml
  - name: regulator.yaml
    property-allowlist:
      - regulator-name
      - regulator-boot-on
      - regulator-always-on
      - regulator-min-microvolt
      - regulator-max-microvolt
      - startup-delay-us
      - off-on-delay-us

compatible: "regulator-fixed"

properties:
  regulator-name:
    required: true

  enable-gpios:
    type: phandle-array
    description: |
      GPIO to use to enable/disable the regulator.

      Unlike the gpio property in the Linux bindings this array must
      provide the GPIO polarity and open-drain status in the phandle
      selector.  The Linux enable-active-high and gpio-open-drain
      properties are not valid for Zephyr devicetree files.
```
