## dts/bindings/regulator/nordic,npm1100.yaml
```yaml
# Copyright (c), 2023 Nordic Semiconductor ASA
# SPDX-License-Identifier: Apache-2.0

description: |
  Nordic nPM1100 PMIC

  The PMIC has one buck converter. It needs to be defined as a child node,
  strictly following the BUCK node name. For example:

  pmic {
    compatible = "nordic,npm1100";

    BUCK {
      /* all properties for BUCK */
    };
  };

  Note that only mode can be controlled (via GPIO pin MODE).

compatible: "nordic,npm1100"

include: base.yaml

properties:
  nordic,iset-gpios:
    type: phandle-array
    description: |
      ISET control pin.

child-binding:
  properties:
    nordic,mode-gpios:
      type: phandle-array
      description: |
        MODE control pin.

  include:
    - name: regulator.yaml
      property-allowlist:
        - regulator-allowed-modes
        - regulator-initial-mode
```

## dts/bindings/regulator/nordic,npm1300-regulator.yaml
```yaml
# Copyright (c), 2023 Nordic Semiconductor ASA
# SPDX-License-Identifier: Apache-2.0

description: |
  Nordic nPM1300 PMIC

  The PMIC has two buck converters and two LDOs.
  The regulators need to be defined as child nodes, strictly following the
  BUCK1,2 LDO1..2, node names. For
  example:

  pmic@6b {
    reg = <0x6b>;
    ...
    regulators {
      compatible = "nordic,npm1300-regulator";

      BUCK1 {
        /* all properties for BUCK1 */
      };
      BUCK2 {
        /* all properties for BUCK2 */
      };
      LDO1 {
        /* all properties for LDO1 */
      };
      LDO2 {
        /* all properties for LDO2 */
      };
    };
  };

compatible: "nordic,npm1300-regulator"

include: "nordic,npm13xx-regulator-common.yaml"
```

## dts/bindings/regulator/nordic,npm13xx-regulator-common.yaml
```yaml
# Copyright (c) 2025 Nordic Semiconductor ASA
# SPDX-License-Identifier: Apache-2.0

description: Nordic nPM13xx PMIC regulators common properties

include: base.yaml

properties:
  dvs-gpios:
    type: phandle-array
    description: |
      List of SOC GPIOs connected to PMIC GPIOs.
      Set_dvs_mode will drive these pins as follows:
        DVS mode 1 will enable the first pin
        DVS mode 2 will enable the second pin
        DVS mode 3 will drive the first and second pins
        etc.
      The effect of the mode change is defined by the enable-gpios
      and pwm_gpios fields for each of the regulator blocks.

child-binding:
  include:
    - name: regulator.yaml
      property-allowlist:
        - regulator-always-on
        - regulator-boot-on
        - regulator-boot-off
        - regulator-min-microvolt
        - regulator-max-microvolt
        - regulator-init-microvolt
        - regulator-allowed-modes
        - regulator-initial-mode
        - regulator-min-microamp
        - regulator-max-microamp
        - startup-delay-us
        - off-on-delay-us

  properties:
    retention-microvolt:
      type: int
      description: |
        Retention mode voltage in microvolts.

    enable-gpio-config:
      type: array
      description: |
        Regulator enable controlled by specified GPIO pin <idx flags>.
        When set regulator must be enabled/disabled using set_dvs_mode.

    pwm-gpio-config:
      type: array
      description: |
        Regulator enable controlled by specified GPIO pin <idx flags>.
        When set regulator must be enabled/disabled using set_dvs_mode.

    retention-gpio-config:
      type: array
      description: |
        Retention mode controlled by specified GPIO pin <idx flags>.

    soft-start-microamp:
      type: int
      enum:
        - 25000
        - 50000
        - 75000
        - 100000
      description: |
        Soft start current limit in microamps.

    active-discharge:
      type: boolean
      description: |
        Enable active-discharge on the BUCK/LDO/LDSW output when disabled.

    nordic,anomaly38-disable-workaround:
      type: boolean
      description: |
        Disable the SW workaround for nPM13xx anomaly #38.
        When nPM13xx is in ULP mode, LDO is supplied from VSYS and
        then LDO is enabled, it can take long time until the LDO
        output has reached its target voltage. To avoid this, an i2c
        read is performed shortly after an LDO is enabled.
        See nPM13xx Errata manual for more details.
```

## dts/bindings/regulator/nordic,npm2100-regulator.yaml
```yaml
# Copyright (c), 2024 Nordic Semiconductor ASA
# SPDX-License-Identifier: Apache-2.0

description: |
  Nordic nPM2100 PMIC

  The PMIC has one boost converter and one LDO/LDSW.
  The regulators need to be defined as child nodes,
  strictly following the BOOST, LDOSW node names.
  For example:

  pmic@74 {
    reg = <0x74>;
    ...
    regulators {
      compatible = "nordic,npm2100-regulator";

      BOOST {
        /* all properties for BOOST */
      };
      LDOSW {
        /* all properties for LDOSW */
      };
    };
  };

compatible: "nordic,npm2100-regulator"

include: base.yaml

properties:
  dvs-gpios:
    type: phandle-array
    description: |
      List of SOC GPIOs connected to PMIC GPIOs.
      Set_dvs_mode will drive these pins as follows:
        DVS mode 1 will enable the first pin
        DVS mode 2 will enable the second pin
      The effect of the mode change is defined by the mode-gpios
      fields for each of the regulator blocks.

child-binding:
  include:
    - name: regulator.yaml
      property-allowlist:
        - regulator-always-on
        - regulator-boot-on
        - regulator-min-microvolt
        - regulator-max-microvolt
        - regulator-init-microvolt
        - regulator-allowed-modes
        - regulator-initial-mode
        - regulator-min-microamp
        - regulator-max-microamp
        - regulator-init-microamp

  properties:
    mode-gpios:
      type: phandle-array
      description: |
        Regulator mode controlled by specified regulator GPIO pin.

    ldosw-wd-reset:
      type: boolean
      description: |
        LDOSW turned off by watchdog reset.

    dps-timer-us:
      type: int
      description: |
        Interval between DPS refresh cycles in microseconds.
      enum:
        - 100
        - 200
        - 400
        - 800

    dps-pulse-limit:
      type: int
      description: |
        DPS coil pulse limit per refresh cycle.
```

## dts/bindings/regulator/nordic,npm6001-regulator.yaml
```yaml
# Copyright (c), 2022 Nordic Semiconductor ASA
# SPDX -License-Identifier: Apache-2.0

description: |
  Nordic nPM6001 PMIC

  The PMIC has four buck converters and two LDOs. All need to be defined as
  children nodes, strictly following the BUCK0..3, LDO0..1 node names. For
  example:

  pmic@70 {
    reg = <0x70>;
    ...
    regulators {
      compatible = "nordic,npm6001-regulator";

      BUCK0 {
        /* all properties for BUCK0 */
      };
      BUCK1 {
        /* all properties for BUCK1 */
      };
      BUCK2 {
        /* all properties for BUCK2 */
      };
      BUCK3 {
        /* all properties for BUCK3 */
      };
      LDO0 {
        /* all properties for LDO0 */
      };
      LDO1 {
        /* all properties for LDO1 */
      };
    };
  };

compatible: "nordic,npm6001-regulator"

include: base.yaml

child-binding:
  include:
    - name: regulator.yaml
      property-allowlist:
        - regulator-always-on
        - regulator-boot-on
        - regulator-boot-off
        - regulator-max-microamp
        - regulator-min-microvolt
        - regulator-max-microvolt
        - regulator-allowed-modes
        - regulator-initial-mode
```

## dts/bindings/regulator/nordic,nrf52x-regulator-hv.yaml
```yaml
# Copyright (c), 2024 Nordic Semiconductor ASA
# SPDX-License-Identifier: Apache-2.0

description: |
  Nordic nRF52X regulator (high voltage stage of the main supply)

compatible: "nordic,nrf52x-regulator-hv"

include:
  - name: base.yaml
  - name: regulator.yaml
    property-allowlist:
      - regulator-name

properties:
  reg:
    required: true

  regulator-name:
    required: true
```

## dts/bindings/regulator/nordic,nrf53x-regulator-hv.yaml
```yaml
# Copyright (c), 2024 Nordic Semiconductor ASA
# SPDX-License-Identifier: Apache-2.0

description: |
  Nordic nRF53X regulator (high voltage stage of the main supply)

compatible: "nordic,nrf53x-regulator-hv"

include:
  - name: base.yaml
  - name: regulator.yaml
    property-allowlist:
      - regulator-name

properties:
  reg:
    required: true

  regulator-name:
    required: true
```

## dts/bindings/regulator/nordic,nrf53x-regulators.yaml
```yaml
# Copyright (c) 2024 Nordic Semiconductor ASA
# SPDX-License-Identifier: Apache-2.0

description: Nordic REGULATORS (voltage regulators control module) on nRF53X.

compatible: "nordic,nrf53x-regulators"

include: base.yaml

properties:
  reg:
    required: true
```

## dts/bindings/regulator/nordic,nrf54l-regulators.yaml
```yaml
# Copyright (c) 2024 Nordic Semiconductor ASA
# SPDX-License-Identifier: Apache-2.0

description: Nordic REGULATORS (voltage regulators control module) on nRF54L.

compatible: "nordic,nrf54l-regulators"

include: base.yaml

properties:
  reg:
    required: true
```

## dts/bindings/regulator/nordic,nrf5x-regulator.yaml
```yaml
# Copyright (c), 2024 Nordic Semiconductor ASA
# SPDX-License-Identifier: Apache-2.0

description: |
  Nordic nRF5X regulator (fixed stage of the core supply)

compatible: "nordic,nrf5x-regulator"

include:
  - name: base.yaml
  - name: regulator.yaml
    property-allowlist:
      - regulator-name
      - regulator-initial-mode

properties:
  reg:
    required: true

  regulator-name:
    required: true

  regulator-initial-mode:
    required: true
```

## dts/bindings/regulator/nordic,nrf91x-regulators.yaml
```yaml
# Copyright (c) 2024 Nordic Semiconductor ASA
# SPDX-License-Identifier: Apache-2.0

description: Nordic REGULATORS (voltage regulators control module) on nRF91X.

compatible: "nordic,nrf91x-regulators"

include: base.yaml

properties:
  reg:
    required: true
```

## dts/bindings/regulator/nordic,vregusb-regulator.yaml
```yaml
# Copyright Nordic Semiconductor ASA
# SPDX-License-Identifier: Apache-2.0

description: |
  Nordic VBUS regulator for USB peripheral

compatible: "nordic,vregusb-regulator"

include:
  - name: base.yaml
  - name: regulator.yaml
    property-allowlist:
      - regulator-name

properties:
  reg:
    required: true

  regulator-name:
    required: true
```

## dts/bindings/regulator/nxp,pca9420.yaml
```yaml
# Copyright (c), 2021 NXP
# SPDX -License-Identifier: Apache-2.0

description: |
  NXP PCA9420 PMIC

  The PMIC has two buck converters and two LDOs. All need to be defined as
  children nodes, strictly following the BUCK1, BUCK2, LDO1 and LDO2 node names.
  For example:

  pmic@61 {
    reg = <0x61>;
    ...
    BUCK1 {
      /* all properties for BUCK1 */
    };
    BUCK2 {
      /* all properties for BUCK2 */
    };
    LDO1 {
      /* all properties for LDO1 */
    };
    LDO2 {
      /* all properties for LDO2 */
    };
  };


compatible: "nxp,pca9420"

include: base.yaml

properties:
  nxp,enable-modesel-pins:
    type: boolean
    description:
      When enabled, the PMIC will be configured to allow mode selection using
      the MODESEL0/1 inputs.

  nxp,vin-ilim-microamp:
    type: int
    default: 425000
    enum:
      - 85000
      - 255000
      - 425000
      - 595000
      - 765000
      - 935000
      - 1105000
    description: |
      VIN input current limit, in microamperes. Value reflects typical value,
      below you can find min/typical/max values:

      - 74 mA/85 mA/98 mA
      - 222 mA/255 mA/293 mA
      - 370 mA/425 mA/489 mA
      - 517 mA/595 mA/684 mA
      - 665 mA/765 mA/880 mA
      - 813 mA/935 mA/1075 mA
      - 961 mA/1105 mA/1271 mA

      To disable current limit, set property to zero. Defaults to 425mA, the IC
      default value.

  nxp,asys-uvlo-sel-millivolt:
    type: int
    default: 2700
    enum:
      - 2400
      - 2500
      - 2600
      - 2700
    description: |
      ASYS UVLO (under voltage lock out) threshold, in millivolts. Defaults to
      2700mV to match the IC default value.

child-binding:
  include:
    - name: regulator.yaml
      property-allowlist:
        - regulator-always-on
        - regulator-boot-on
        - regulator-min-microvolt
        - regulator-max-microvolt

  description: Voltage output of PMIC controller regulator
  properties:
    enable-inverted:
      type: boolean
      description: |
        If the enable bit should be zero to turn the regulator on, add this
        property.

    nxp,mode0-microvolt:
      type: int
      description: |
        The voltage level to be configured for mode 0, in microvolts. Setting
        this value to zero will disable the source in mode 0.

    nxp,mode1-microvolt:
      type: int
      description: |
        The voltage level to be configured for mode 1, in microvolts. Setting
        this value to zero will disable the source in mode 1.

    nxp,mode2-microvolt:
      type: int
      description: |
        The voltage level to be configured for mode 2, in microvolts. Setting
        this value to zero will disable the source in mode 2.

    nxp,mode3-microvolt:
      type: int
      description: |
        The voltage level to be configured for mode 3, in microvolts. Setting
        this value to zero will disable the source in mode 3.
```
