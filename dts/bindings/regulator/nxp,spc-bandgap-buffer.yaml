## dts/bindings/regulator/nxp,spc-bandgap-buffer.yaml
```yaml
# SPDX-FileCopyrightText: Copyright 2026 NXP
# SPDX-License-Identifier: Apache-2.0

description: NXP SPC buffered bandgap output

compatible: "nxp,spc-bandgap-buffer"

include:
  - name: regulator.yaml
    property-allowlist:
      - regulator-always-on
      - regulator-boot-on
```

## dts/bindings/regulator/silergy,sy6970-regulator.yaml
```yaml
# SPDX-FileCopyrightText: Copyright The Zephyr Project Contributors
# SPDX-License-Identifier: Apache-2.0

title: Silergy SY6970 USB OTG boost regulator

description: |
  USB OTG boost regulator of the Silergy SY6970, described as a child node
  of the "silergy,sy6970" node. The current limits are 0.5 A, 0.75 A,
  1.2 A, 1.4 A, 1.65 A, 1.875 A, 2.15 A and 2.45 A.

  Boost mode also needs the OTG pin of the device to be high.

compatible: "silergy,sy6970-regulator"

include: ti,bq2589x-regulator-common.yaml

examples:
  - |
    sy6970@6a {
      compatible = "silergy,sy6970";
      reg = <0x6a>;

      usb_otg_vbus: regulator {
        compatible = "silergy,sy6970-regulator";
        regulator-init-microvolt = <4998000>;
        regulator-init-microamp = <500000>;
      };
    };
```

## dts/bindings/regulator/st,stpmic1.yaml
```yaml
# Copyright (c) 2026 STMicroelectronics
# SPDX-License-Identifier: Apache-2.0

description: |
  STMicroelectronics STPMIC1 power management IC

  The outputs are defined as children nodes, named after the STPMIC1 outputs:
  buck1 to buck4, ldo1 to ldo6, vref_ddr, boost, pwr_sw1 and pwr_sw2.

  Only the output voltage and the enable state are handled, plus the active
  discharge of pwr_sw1 and pwr_sw2. vref_ddr, boost, pwr_sw1 and pwr_sw2 have no
  selectable voltage.

  The driver waits for the output ramp time after enabling an output or
  changing its voltage.

compatible: "st,stpmic1"

include: [base.yaml, i2c-device.yaml]

child-binding:
  include:
    - name: regulator.yaml
      property-allowlist:
        - regulator-name
        - regulator-always-on
        - regulator-boot-on
        - regulator-boot-off
        - regulator-min-microvolt
        - regulator-max-microvolt
        - regulator-init-microvolt
        - regulator-active-discharge

examples:
  - |
    pmic@33 {
      compatible = "st,stpmic1";
      reg = <0x33>;

      buck1 {
        regulator-name = "vddcpu";
        regulator-min-microvolt = <1250000>;
        regulator-max-microvolt = <1350000>;
        regulator-always-on;
      };

      ldo6 {
        regulator-name = "v1v8_periph";
        regulator-min-microvolt = <1800000>;
        regulator-max-microvolt = <1800000>;
        regulator-boot-on;
      };
    };
```

## dts/bindings/regulator/ti,bq25896-regulator.yaml
```yaml
# SPDX-FileCopyrightText: Copyright The Zephyr Project Contributors
# SPDX-License-Identifier: Apache-2.0

title: TI BQ25896 USB OTG boost regulator

description: |
  USB OTG boost regulator of the TI BQ25896, described as a child node of
  the "ti,bq25896" node. The current limits are 0.5 A, 0.75 A, 1.2 A,
  1.4 A, 1.65 A, 1.875 A and 2.15 A.

  Boost mode also needs the OTG pin of the device to be high.

compatible: "ti,bq25896-regulator"

include: ti,bq2589x-regulator-common.yaml

examples:
  - |
    bq25896@6b {
      compatible = "ti,bq25896";
      reg = <0x6b>;

      usb_otg_vbus: regulator {
        compatible = "ti,bq25896-regulator";
        regulator-init-microvolt = <4998000>;
        regulator-init-microamp = <500000>;
      };
    };
```

## dts/bindings/regulator/ti,bq2589x-regulator-common.yaml
```yaml
# SPDX-FileCopyrightText: Copyright The Zephyr Project Contributors
# SPDX-License-Identifier: Apache-2.0

description: |
  Common properties of the TI BQ2589X family USB OTG boost regulator.

  The boost converter supplies VBUS from the battery. Its output voltage
  range is 4.55 V to 5.51 V in 64 mV steps.

include:
  - name: regulator.yaml
    property-allowlist:
      - regulator-name
      - regulator-init-microvolt
      - regulator-min-microvolt
      - regulator-max-microvolt
      - regulator-init-microamp
      - regulator-min-microamp
      - regulator-max-microamp
      - regulator-always-on
      - regulator-boot-on
      - regulator-boot-off
      - startup-delay-us
      - off-on-delay-us
```

## dts/bindings/regulator/ti,tps6287x.yaml
```yaml
# Copyright (c) 2026 Carl Zeiss Meditec AG
# SPDX-License-Identifier: Apache-2.0

description: TPS6287x regulator

compatible: "ti,tps6287x"

include:
  - name: i2c-device.yaml
  - name: regulator.yaml
    property-allowlist:
      - regulator-init-microvolt
      - regulator-min-microvolt
      - regulator-max-microvolt
      - regulator-ramp-delay
      - regulator-always-on
      - regulator-boot-on
      - regulator-initial-mode
      - regulator-allowed-modes
      - regulator-active-discharge

properties:
  input-voltage-microvolt:
    type: int
    min: 2700000
    max: 6000000
    required: true
    description: |
      Provide the input voltage to the device in order to calculate the
      maximum output voltage. For proper operation, the input voltage
      needs to be at least 1.4V above the selected output voltage

  regulator-init-microvolt:
    required: true

  # Keep the order of the enums, the driver relies on it!
  regulator-ramp-delay:
    type: int
    default: 1250
    enum:
      - 10000
      - 5000
      - 1250
      - 500

  enable-ssc:
    type: boolean
    description: |
      Enable the spread spectrum clocking function that can reduce
      electromagnetic interference

  enable-hiccup-mode:
    type: boolean
    description: |
      Enable hiccup mode (overcurrent protection)
```

## dts/bindings/relay/zephyr,gpio-relay.yaml
```yaml
# Copyright (c) 2026 Siemens AG
# SPDX-License-Identifier: Apache-2.0

description: |
  GPIO-driven relay.

  A relay switched by a single GPIO, implementing the relay on/off API. The
  coil's active level comes from the flags in the "gpios" specifier. A board
  with several relays instantiates one node per relay.

compatible: "zephyr,gpio-relay"

include: base.yaml

properties:
  gpios:
    type: phandle-array
    required: true
    description: |
      The GPIO driving the relay coil. The active level is taken from the
      specifier flags (GPIO_ACTIVE_HIGH / GPIO_ACTIVE_LOW).
```

## dts/bindings/relay/zephyr,pwm-relay.yaml
```yaml
# Copyright (c) 2026 Siemens AG
# SPDX-License-Identifier: Apache-2.0

description: |
  PWM-driven relay.

  Hardware-agnostic relay backed by a single standard Zephyr PWM channel. It
  owns the relay semantics - on/off state and an optional pull-in/hold current
  profile - and drives the coil through the PWM channel referenced by the
  standard "pwms" property.

  By default the coil is driven at full duty and held there. The pull-in and
  refresh stages are opt-in: set "pull-in-time-ms" to give a stronger pull-in
  pulse before dropping to "hold-duty-percent", and set "refresh-interval-ms"
  to periodically re-pulse the coil. A stage set to 0 is skipped.

  A board with several relays instantiates one node per relay. The PWM carrier
  period and polarity/inversion flags come from the specifier cells of the
  referenced backend.

compatible: "zephyr,pwm-relay"

include: base.yaml

properties:
  pwms:
    type: phandle-array
    required: true
    description: |
      The PWM channel specifier driving the relay coil. The PWM carrier period
      and polarity/inversion flags are taken from the specifier cells of the
      referenced backend.

  pull-in-time-ms:
    type: int
    default: 0
    description: |
      Time in milliseconds the coil is driven at "pull-in-duty-percent" after
      switching on before dropping to the hold duty. 0 disables the pull-in
      pulse and drives the hold duty directly.

  pull-in-duty-percent:
    type: int
    default: 100
    description: |
      PWM duty cycle (0-100 %) applied to pull in (and refresh) the relay coil.

  refresh-interval-ms:
    type: int
    default: 0
    description: |
      Time in milliseconds between refresh pulses for a switched-on relay.
      A refresh pulse re-applies the pull-in duty to keep the coil energized.
      0 disables refreshing and holds the coil indefinitely.

  hold-duty-percent:
    type: int
    default: 100
    description: |
      PWM duty cycle (0-100 %) applied to hold the relay coil after the optional
      pull-in pulse. Set below "pull-in-duty-percent" to reduce holding current.
```

## dts/bindings/reset/puya,py32-rcc-rctl.yaml
```yaml
# SPDX-FileCopyrightText: Copyright The Zephyr Project Contributors
# SPDX-License-Identifier: Apache-2.0

description: Puya PY32 RCC peripheral reset controller

compatible: "puya,py32-rcc-rctl"

include: reset-controller.yaml

properties:
  "#reset-cells":
    const: 1

reset-cells:
  - id
```

## dts/bindings/reset/renesas,rh850-sys-reset.yaml
```yaml
# Copyright (c) 2026 Renesas Electronics Corporation
# SPDX-License-Identifier: Apache-2.0

description: Renesas RH850 system reset controller

compatible: "renesas,rh850-sys-reset"

include: [base.yaml]

properties:
  reg:
    required: true
```

## dts/bindings/reset/rockchip,rk3588-cru-rst.yaml
```yaml
# SPDX-FileCopyrightText: Copyright (c) 2026 KylinSoft Corporation
# SPDX-License-Identifier: Apache-2.0

title: Rockchip RK3588 CRU Reset Controller

description: |
  Reset controller for the Rockchip RK3588 CRU. Reset IDs are defined in
  include/zephyr/dt-bindings/reset/rk3588-cru-reset.h and encoded as
  (SOFTRST_CON register index * 16) + bit within that register.

compatible: "rockchip,rk3588-cru-rst"

include: [reset-controller.yaml, base.yaml]

properties:
  "#reset-cells":
    const: 1

reset-cells:
  - id
```

## dts/bindings/reset/wch,ch32-rcc-rctl.yaml
```yaml
# Copyright (c) 2026 Fiona Behrens
# SPDX-License-Identifier: Apache-2.0

description: |
  CH32 Reset and Clock Control (RCC) Reset Controller.

  This node is in charge of reset control for peripherals.

  Use the standard resets property to set the reset line of a peripheral, e.g.:

    usart1: serial@xxx {
      ...
      /* Cell contains information about Reset register offset and bit */
      resets = <&rctl CH32_RESET(APB2, 14)>;
      ...
    };

compatible: "wch,ch32-rcc-rctl"

include: [reset-controller.yaml, base.yaml]

properties:
  "#reset-cells":
    const: 1

reset-cells:
  - id
```

## dts/bindings/retained_mem/zephyr,retained-reg.yaml
```yaml
# Copyright (c) 2023 Nordic Semiconductor ASA
# Copyright (c) 2023 Bjarki Arge Andreasen
# SPDX-License-Identifier: Apache-2.0

description: Retained register based retained memory area.

compatible: "zephyr,retained-reg"

include: base.yaml

properties:
  "#address-cells":
    const: 1

  "#size-cells":
    const: 1

  reg:
    required: true

  reg-io-width:
    type: int
    default: 1
    enum:
      - 1
      - 4
      - 8
    description: |
      Width in bytes of each access to the register block. When width is greater than 1,
      the base address and size must be multiples of it.
      Reads and writes that do not cover whole words are read-modify-write,
      this is not atomic over multiple CPUs and in ISRs,
      and over multiple threads when not using retained_mem mutexes.
      A width of 8 is only supported on 64-bit targets.
```

## dts/bindings/rfid/nxp,mfrc522.yaml
```yaml
# Copyright (c) 2026 Luke Bugbee <lbugbee@protonmail.com>
# SPDX-License-Identifier: Apache-2.0

description: MFRC522 RFID Driver

compatible: "nxp,mfrc522"

include: spi-device.yaml

properties:
  reset-gpios:
    required: true
    type: phandle-array

  bit-rate:
    type: int
    default: 0
    description: |
          Transmission bit rate.
    enum:
      - 0 # BIT_RATE_106K
      - 1 # BIT_RATE_212K
      - 2 # BIT_RATE_424K
      - 3 # BIT_RATE_848K

  timer-prescaler:
    type: int
    default: 169
    min: 0
    max: 4095

  timer-reload:
    type: int
    default: 1000
    min: 0
    max: 65535

  miller-mod-width:
    type: int
    default: 38
    description: |
          Defines the width of miller modulation as multiples
          of the carrier frequency.
    min: 1
    max: 255

  rx-timeout-ms:
    type: int
    default: 36
    description: |
          Max time to wait for response from tag.
```

## dts/bindings/rng/aesc,prng.yaml
```yaml
#
# SPDX-FileCopyrightText: 2026 Aesc Silicon
#
# SPDX-License-Identifier: Apache-2.0
#

title: Aesc Silicon PRNG (Pseudo-Random Number Generator)

description: |
  The PRNG IP core is a 32-bit Galois LFSR with maximum-period taps
  (x^32 + x^30 + x^26 + x^25 + 1) that advances once per clock cycle while
  enabled. It does not provide true entropy and must not be used as a source
  for cryptographic keys.

compatible: "aesc,prng"

include: base.yaml

properties:
  reg:
    required: true
```

## dts/bindings/rng/microchip,atecc608a-trng.yaml
```yaml
# Copyright (c) 2026 RAKwireless Technology Limited
# SPDX-License-Identifier: Apache-2.0

description: |
  Microchip ATECC608A true random number generator.

  This is a child of a "microchip,atecc608a" node and uses the on-chip Random
  command as a Zephyr entropy source. The device configuration zone must be
  locked; an unlocked part returns a fixed test pattern instead of entropy.

    atecc608a: atecc608a@60 {
            compatible = "microchip,atecc608a";
            reg = <0x60>;

            atecc608a_trng: atecc608a_trng {
                    compatible = "microchip,atecc608a-trng";
            };
    };

compatible: "microchip,atecc608a-trng"

include: base.yaml
```

## dts/bindings/rng/raspberrypi,rp2040-rosc-rng.yaml
```yaml
# SPDX-FileCopyrightText: Copyright The Zephyr Project Contributors
# SPDX-License-Identifier: Apache-2.0

description: |
  RP2040 ring-oscillator random-bit source. This source is unsuitable for
  cryptographic use. The system clock must be independent of the ring oscillator.
  Oscillator configuration remains under the clock controller's ownership.

compatible: "raspberrypi,rp2040-rosc-rng"

include: base.yaml

properties:
  reg:
    required: true

  raspberrypi,clock-controller:
    type: phandle
    required: true
    description: |
      RP2040 clock controller containing the "clocks" register bank. The driver
      reads clock selection registers to reject sampling from a ROSC-based
      system clock. It does not change the clock configuration.
```

## dts/bindings/rng/realtek,rts5817-trng.yaml
```yaml
# Copyright (c) 2026 Realtek Semiconductor, Inc.
# SPDX-License-Identifier: Apache-2.0

description: Realtek RTS5817 RNG

compatible: "realtek,rts5817-trng"

include: base.yaml

properties:
  reg:
    required: true
```

## dts/bindings/rng/ti,cc23x0-rng.yaml
```yaml
# Copyright (c) 2025 Texas Instruments Incorporated
#
# SPDX-License-Identifier: Apache-2.0

description: TI SimpleLink CC23X0 RNG node

compatible: "ti,cc23x0-rng"

include: [base.yaml]
```

## dts/bindings/rng/ti,cc27xx-rng.yaml
```yaml
# Copyright (c) 2025 Texas Instruments Incorporated
#
# SPDX-License-Identifier: Apache-2.0

description: TI SimpleLink CC27XX RNG node

compatible: "ti,cc27xx-rng"

include: [base.yaml]
```

## dts/bindings/rng/ti,cc35xx-hsm.yaml
```yaml
# Copyright (c) 2025 Conclusive Engineering Sp. z o.o.
# SPDX-License-Identifier: Apache-2.0

description: TI SimpleLink CC35xxE HSM (Hardware Security Module)

compatible: "ti,cc35xx-hsm"

include: base.yaml
```

## dts/bindings/rng/ti,mspm0-trng.yaml
```yaml
# Copyright 2025 Linumiz GmbH
# SPDX-License-Identifier: Apache-2.0

description: |
  Texas Instruments MSPM0 Series True Random Number Generator (TRNG).
  This peripheral provides a hardware-based source of entropy with built-in
  health tests.

compatible: "ti,mspm0-trng"

include: base.yaml
properties:
  reg:
    required: true

  interrupts:
    required: true

  clocks:
    required: true
    description: MCLK clock source phandle
```
