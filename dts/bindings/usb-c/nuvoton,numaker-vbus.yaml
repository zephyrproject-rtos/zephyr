## dts/bindings/usb/bflb,udc-1.yaml
```yaml
# SPDX-FileCopyrightText: Copyright The Zephyr Project Contributors
# SPDX-License-Identifier: Apache-2.0

description: Bouffalo Lab USB 1.1 Full-Speed device controller (v1 block)

compatible: "bflb,udc-1"

include: [usb-controller.yaml, pinctrl-device.yaml]

properties:
  reg:
    required: true
    description: USB controller registers

  interrupts:
    required: true
```

## dts/bindings/usb/brcm,bcm2835-usb.yaml
```yaml
# Copyright (c) 2026 Muhammad Waleed Badar
# SPDX-License-Identifier: Apache-2.0
#
description: Broadcom BCM2835 USB-OTG (DWC2 compatible controller)

compatible: "brcm,bcm2835-usb"

include: ["snps,dwc2.yaml"]
```

## dts/bindings/usb/cdns,usb3.yaml
```yaml
# Copyright 2026 Texas Instruments
# SPDX-License-Identifier: Apache-2.0

description: Cadence CDNS3 USB Device Controller

compatible: "cdns,usb3"

include: [usb-ep.yaml, pinctrl-device.yaml]

properties:
  reg:
    required: true

  interrupts:
    required: true

  num-in-endpoints:
    required: true

  num-out-endpoints:
    required: true

  maximum-speed:
    required: true
```

## dts/bindings/usb/diodes,pi3usb9201.yaml
```yaml
# Copyright (c) 2022 Google LLC
# SPDX-License-Identifier: Apache-2.0

description: Diodes PI3USB9201, Dual-Role USB Charging-Type Detector

compatible: "diodes,pi3usb9201"

include: [i2c-device.yaml, usb-bc12.yaml]

properties:
  intb-gpios:
    type: phandle-array
    required: true
    description: |
      GPIO input connected to the active low interrupt INTB pin on the PI3USB9201.
```

## dts/bindings/usb/elan,elandev-usbd.yaml
```yaml
# Copyright (c) 2025 ELAN Microelectronics Corp.
# SPDX-License-Identifier: Apache-2.0

description: ELAN E967 USB device controller

compatible: "elan,elandev-usbd"

include: [usb-ep.yaml]

properties:
  reg:
    required: true
```

## dts/bindings/usb/espressif,esp32-usb-otg-fs.yaml
```yaml
# Copyright (c) 2026 Espressif Systems (Shanghai) Co., Ltd.
# SPDX-License-Identifier: Apache-2.0
#
description: |
  Espressif USB-OTG full-speed controller (DWC2 compatible) with the internal
  FS/LS PHY. The PHY D+/D- lines are routed to GPIO pads that the driver must
  configure, so the pad numbers are provided by the phy-dp-pin and phy-dm-pin
  properties.

compatible: "espressif,esp32-usb-otg-fs"

include: ["snps,dwc2.yaml"]

properties:
  clocks:
    required: true

  phy-dp-pin:
    type: int
    required: true
    description: GPIO number of the internal FS/LS PHY D+ pad.

  phy-dm-pin:
    type: int
    required: true
    description: GPIO number of the internal FS/LS PHY D- pad.
```

## dts/bindings/usb/espressif,esp32-usb-otg-hs.yaml
```yaml
# Copyright (c) 2026 Espressif Systems (Shanghai) Co., Ltd.
# SPDX-License-Identifier: Apache-2.0
#
description: |
  Espressif USB-OTG high-speed controller (DWC2 compatible) with the internal
  UTMI PHY. The high-speed PHY uses dedicated pins that are not mapped to the
  GPIO peripheral, so no pad configuration is required.

compatible: "espressif,esp32-usb-otg-hs"

include: ["snps,dwc2.yaml"]

properties:
  clocks:
    required: true
```

## dts/bindings/usb/espressif,esp32-usb-otg.yaml
```yaml
# Copyright (c) 2025 Espressif Systems (Shanghai) Co., Ltd.
# SPDX-License-Identifier: Apache-2.0
#
description: ESP32 USB-OTG (DWC2 compatible controller)

compatible: "espressif,esp32-usb-otg"

include: ["snps,dwc2.yaml"]

properties:
  clocks:
    required: true
```

## dts/bindings/usb/gd,gd32-otgfs.yaml
```yaml
# Copyright (c) 2017, I-SENSE group of ICCS
# SPDX-License-Identifier: Apache-2.0

description: GD32 OTGFS controller

compatible: "gd,gd32-otgfs"

include: [usb-ep.yaml, pinctrl-device.yaml, reset-device.yaml]

properties:
  reg:
    required: true

  interrupts:
    required: true

  pinctrl-0:
    required: true

  pinctrl-names:
    required: true

  ram-size:
    type: int
    required: true
    description: |
      Size of USB dedicated RAM. GD32 SOC's reference
      manual defines a shared FIFO size.

  phys:
    type: phandle
    description: PHY provider specifier

  clocks:
    required: true
```

## dts/bindings/usb/infineon,usbhs.yaml
```yaml
# Copyright (c) 2026 Infineon Technologies AG,
# or an affiliate of Infineon Technologies AG.
#
# SPDX-License-Identifier: Apache-2.0

description: |
  Infineon USBHS.  This binding describes additional information required to
  use the Synopsys DesignWare OTG USB 2.0 controller IP on Infineon boards.  In
  the case of this IP, the Peri MMIO group information is required.

compatible: "infineon,usbhs"

include: ["snps,dwc2.yaml"]

properties:
  mmio-peri-inst:
    type: int
    required: true
    description: |
      Peri MMIO instance number that clocks the USB

  mmio-peri-group:
    type: int
    required: true
    description: |
      Peri MMIO group number that clocks the USB

  mmio-reg-bit-pos:
    type: int
    required: true
    description: |
      The USB's bit position in the Peri group register

  mmio-peri-hf-src:
    type: int
    required: true
    description: |
      The Peri MMIO group's root CLK_HF

  mmio-peri-div:
    type: int
    required: true
    description: |
      The Peri MMIO clock divider value

examples:
  - |
    /* The below example shows using Peri 1 MMIO 3, sourced from CLK_HF1 and using
     * a divider of 3.  Peri MMIO dividers also require a specific target interconnect
     * bit mask, a bit whose position is stored in mmio-peri-bit-pos.  This bit value
     * must come from some Infineon documentation, e.g. a TRM or through working with
     * the Infineon Device Configurator tool.
     * The only mmio-peri value that can be configured is mmio-peri-div.  The other
     * four values are hardwired on the device.
     */

    zephyr_udc0: usbhs@cccccccc {
      compatible = "infineon,usbhs", "snps,dwc2";
      reg = <0xcccccccc 0x40100>;
      interrupts = <174 4>, <175 4>;
      num-in-eps = <9>;
      num-out-eps = <9>;
      ghwcfg1 = <0x00000000>;
      ghwcfg2 = <0x228fe052>;
      ghwcfg4 = <0xe2103a20>;
      mmio-peri-inst = <1>;
      mmio-peri-group = <3>;
      mmio-reg-bit-pos = <5>;
      mmio-peri-hf-src = <1>;
      mmio-peri-div = <3>;
      status = "okay";
    };
```

## dts/bindings/usb/infineon,xmc4xxx-usb.yaml
```yaml
# SPDX-FileCopyrightText: Copyright The Zephyr Project Contributors
# SPDX-License-Identifier: Apache-2.0

description: |
  Infineon XMC4xxx DWC2 compatible controller. This is a full-speed only
  Synopsys DesignWare OTG core with an integrated transceiver, present on the
  XMC4500/XMC4700/XMC4800 SoC family.

compatible: "infineon,xmc4xxx-usb"

include: ["snps,dwc2.yaml"]
```
