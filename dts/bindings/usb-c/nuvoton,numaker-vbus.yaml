## dts/bindings/usb-c/nuvoton,numaker-vbus.yaml
```yaml
# Copyright (c) 2024 Nuvoton Technology Corporation
# SPDX-License-Identifier: Apache-2.0

description: Nuvoton NuMaker USB Type-C VBUS controller

compatible: "nuvoton,numaker-vbus"

include: [base.yaml]
```

## dts/bindings/usb-c/usb-c-connector.yaml
```yaml
# Copyright 2022 The Chromium OS Authors
# SPDX-License-Identifier: Apache-2.0

description: |
    A USB Type-C connector node represents a physical USB Type-C connector.
    It should be a child of a USB-C interface controller or a separate node
    when it is attached to both MUX and USB-C interface controller.

    This is based on Linux, documentation:
      https://git.kernel.org/pub/scm/linux/kernel/git/torvalds/linux.git/tree/Documentation/devicetree/bindings/connector/usb-connector.yaml?h=v5.19&id=3d7cb6b04c3f3115719235cc6866b10326de34cd

    Example:

    USB-C connector attached to a STM32 UCPD typec port controller, which has
    power delivery support and enables SINK.

    vbus1: vbus {
        compatible = "zephyr,usb-c-vbus-adc";
        io-channels = <&adc2 8>;
        output-ohms = <49900>;
        full-ohms = <(330000 + 49900)>;
    };

    ports {
        #address-cells = <1>;
        #size-cells = <0>;
        port1: usb-c-port@1 {
            compatible = "usb-c-connector";
            reg = <1>;
            tcpc = <&ucpd1>;
            vbus = <&vbus1>;
            power-role = "sink";
            sink-pdos = <PDO_FIXED(5000, 2000, PDO_FIXED_USB_COMM)
                         PDO_VAR(5000, 12000, 2000)>;
            op-sink-microwatt = <10000000>;
        };
    };


compatible: "usb-c-connector"

include: base.yaml

properties:
  tcpc:
    type: phandle
    required: true
    description: |
        Type-C Port Controller for this port.

  vbus:
    type: phandle
    required: true
    description: |
        VBUS measurement and control for this port.

  ppc:
    type: phandle
    description: |
        Power path controller for this port

  power-role:
    type: string
    required: true
    enum:
      - "sink"
      - "source"
      - "dual"
    description: |
      The Port power role. "dual" for Dual Role Port.

  try-power-role:
    type: string
    enum:
      - "sink"
      - "source"
      - "dual"
    description: |
      Preferred power role.

  data-role:
    type: string
    enum:
      - "host"
      - "device"
      - "dual"
    description: |
      The Port data role.
        * "host" for Downstream Facing Port (DFP)
        * "device" for Upstream Facing Port (UFP)
        * "dual" for Dual Role Data

  typec-power-opmode:
    type: string
    enum:
      - "default"
      - "1.5A"
      - "3.0A"
    description: |
      Initial Type C advertised power, determined by the Rp when
      operating as a Source.
      * "default" corresponds to default USB voltage and current
        defined by the  USB 2.0 and USB 3.2 specifications.
          * 5V@500mA for USB 2.0
          * 5V@900mA for USB 3.2 single-lane
          * 5V@1500mA for USB 3.2 dual-lane
      * "1.5A" and "3.0A", 5V@1.5A and 5V@3.0A.

  pd-disable:
    type: boolean
    description: |
      Disables power delivery when true

  source-pdos:
    type: array
    description: |
      An array of source Power Data Objects (PDOs).
      Use the following macros to define the PDOs, defined in
      dt-bindings/usb-c/pd.h.
        * PDO_FIXED
        * PDO_BATT
        * PDO_VAR
        * PDO_PPS_APDO
      Valid range: 1 - 7

  sink-pdos:
    type: array
    description: |
      An array of sink Power Data Objects (PDOs).
      Use the following macros to define the PDOs, defined in
      dt-bindings/usb-c/pd.h.
        * PDO_FIXED
        * PDO_BATT
        * PDO_VAR
        * PDO_PPS_APDO
      Valid range: 1 - 7

  sink-vdos:
    type: array
    description: |
      An array of sink Vendor Defined Objects (VDOs).
      Use the following macros to define the VDOs, defined in
      dt-bindings/usb-c/pd.h.
        * VDO_IDH
        * VDO_CERT
        * VDO_PRODUCT
        * VDO_UFP
        * VDO_DFP
        * VDO_PCABLE
        * VDO_ACABLE
        * VDO_VPD
      Valid range: 3 - 6

  sink-vdos-v1:
    type: array
    description: |
      An array of sink Vendor Defined Objects (VDOs).
      Use the following macros to define the VDOs, defined in
      dt-bindings/usb-c/pd.h.
        * VDO_IDH
        * VDO_CERT
        * VDO_PRODUCT
        * VDO_CABLE
        * VDO_AMA
      Valid range: 3 - 6

  op-sink-microwatt:
    type: int
    description: |
      Minimum power, in microwatts, needed by the sink. A Capability
      Mismatch is sent to the Source if the power can't be met.
```

## dts/bindings/usb-c/vif.yaml
```yaml
# Copyright 2022 The Chromium OS Authors
# SPDX-License-Identifier: Apache-2.0

description: |
    A VIF node is a root element that describes the Qualifying Product in VIF
    specification. It contains introductory material followed by an optional
    product-level field element, zero or more Components, and zero or more
    Optional Content elements.
    This is based on VIF XML file schema in:
      https://compliance.usb.org/cv/VendorInfoFile/Schemas/Current/VendorInfoFile.xsd

compatible: "vif"

include: base.yaml

properties:

    vendor-name:
        type: string
        required: false
        description: |
            To be provided by the Vendor. If the Qualifying Product has a Vendor Name
            entry in USB4 DROM, then this field should be identical to that entry

    model-part-number:
        type: string
        required: false
        description: |
            To be provided by the Vendor. This field should match what appears in the
            USB-IF Product Registration form
            If the Qualifying Product has a Model Name entry in USB4 DROM, then this
            field should be identical to that entry
            The USB-IF uses this field and /VIF/Product_Revision to generate the
            product name in the USB Integrator’s List

    product-revision:
        type: string
        required: false
        description: |
            To be provided by the Vendor. This field should match what appears in the
            USB-IF Product Registration form
            The USB-IF uses this field and /VIF/Model_Part_Number to generate the
            product name in the USB Integrator’s List

    tid:
        type: string
        required: false
        description: |
            Provided by the USB-IF

    vif-product-type:
        type: int
        required: false
        description: |
            The highest-level category into which the Component being tested falls.
            Valid options are:
                0 - Port Product (contains one or more ports)
                1 - Cable
                2 - Repeater
            This feild is required for defining any/all of the members below i.e,
            /VIF/Certification_Type
            /VIF/Product
            /VIF/Component
            /VIF/OptionalContent

    certification-type:
        type: int
        required: false
        description: |
            What is the USB-IF certification category under which the Qualifying
            Product is to be submitted? This field shall be set to the same value as
            the one on the USB-IF Product Registration form.
            If /VIF/VIF_Product_Type is set to 0 (Port Product), then valid options
            are:
                0 - End Product
                1 - Reference Platform
                2 - Silicon
            If /VIF/VIF_Product_Type is set to 1 (Cable), then valid options are:
                0 - End Product
                2 - Silicon
            If /VIF/VIF_Product_Type is set to 2 (Repeater), then this field shall be
            set to 2 (Silicon).
            If /VIF/VIF_Product_Type is not present, then this shall not be present

    component:
        type: phandles
        required: false
        description: |
            0 or more components that fully describe a component of the Qualifying
            Product. If vif-product-type is not present, then the number of
            components shall be 0.

    # EXAMPLE:
    #
    #
    # vif {
    #    address-cells = <1>;
    #    size-cells = <0>;
    #    usbcvif1: usbcvif@1 {
    #       compatible = "vif";
    #       reg = <1>;
    #       vendor-name = "Zephyr";
    #       model-part-number = "b_g474e_dpow1";
    #       product-revision= "1";
    #       tid= "0";
    #       vif-product-type= <0>;
    #       certification-type= <0>;
    #       component =<&port1>;
    #     };
    # };
    #
```

## dts/bindings/usb-c/zephyr,usb-c-pwrctrl.yaml
```yaml
# Copyright (c) Qualcomm Technologies, Inc. and/or its subsidiaries.
# SPDX-License-Identifier: Apache-2.0

description: |
    This device manages USB-C VBUS and VCONN power rails.
    Uses GPIOs to enable/disable power paths and an optional PWM channel to
    adjust the VBUS source voltage.

compatible: "zephyr,usb-c-pwrctrl"

include: base.yaml

properties:
  source-en-gpios:
    type: phandle-array
    required: true
    description: GPIO to enable VBUS source output.

  vconn1-en-gpios:
    type: phandle-array
    required: true
    description: GPIO to enable VCONN on CC1.

  vconn2-en-gpios:
    type: phandle-array
    required: true
    description: GPIO to enable VCONN on CC2.

  dcdc-en-gpios:
    type: phandle-array
    description: GPIO to enable DCDC converter for VBUS source voltage regulation.

  pwms:
    type: phandle-array
    description: PWM for VBUS source voltage selection.
```

## dts/bindings/usb-c/zephyr,usb-c-vbus-adc.yaml
```yaml
# Copyright 2022 The Chromium OS Authors
# SPDX-License-Identifier: Apache-2.0

description: |
    This device is used to measure VBUS on a Type-C Port and to
    discharge VBUS when needed.

compatible: "zephyr,usb-c-vbus-adc"

include: [base.yaml, voltage-divider.yaml]

properties:
  discharge-gpios:
    type: phandle-array
```

## dts/bindings/usb-c/zephyr,usb-c-vbus-i2c.yaml
```yaml
# Copyright (c) 2023, ithinx GmbH
# Copyright (c) 2023, Tonies GmbH
#
# SPDX-License-Identifier: Apache-2.0

description: |
    This device is used to measure VBUS on a Type-C Port and to
    discharge VBUS when needed.

compatible: "zephyr,usb-c-vbus-i2c"

include: [base.yaml, i2c-device.yaml]
```

## dts/bindings/usb-c/zephyr,usb-c-vbus-tcpci.yaml
```yaml
# Copyright 2024 Google LLC
# SPDX-License-Identifier: Apache-2.0

description: |
    This device is used to measure VBUS on a Type-C Port and to
    discharge VBUS when needed.
    It should be used as a child node for a specific TCPCI compliant device. The I2C address is
    taken from the parent of this node.

compatible: "zephyr,usb-c-vbus-tcpci"

include: [base.yaml]
```

## dts/bindings/usb/adi,max32-usbhs.yaml
```yaml
# Copyright (c) 2025 Analog Devices, Inc.
# SPDX-License-Identifier: Apache-2.0

description: ADI MAX32 USBHS

compatible: "adi,max32-usbhs"

include: [usb-ep.yaml, pinctrl-device.yaml]

properties:
  reg:
    required: true

  clocks:
    required: true

  interrupts:
    required: true
```

## dts/bindings/usb/ambiq,usb.yaml
```yaml
# Copyright (c) 2023 Antmicro <www.antmicro.com>
# SPDX-License-Identifier: Apache-2.0

description: Ambiq USB

compatible: "ambiq,usb"

include: [usb-ep.yaml, pinctrl-device.yaml, ambiq-pwrcfg.yaml]

properties:
  reg:
    required: true

  interrupts:
    required: true

  ambiq,pwrcfg:
    required: true

  vddusb33-gpios:
    type: phandle-array
    description: |
      Control VDDUSB33 via GPIO pin.

  vddusb0p9-gpios:
    type: phandle-array
    description: |
      Control VDDUSB0P9 via GPIO pin.
```

## dts/bindings/usb/atmel,sam-udp.yaml
```yaml
# Copyright (c) 2026 Gerson Fernando Budke <nandojve@gmail.com>
# SPDX-License-Identifier: Apache-2.0

description: |
  Atmel SAM USB Device Port (UDP) Controller

  The UDP is a full-speed USB 2.0 device controller with the following features:
  - 8 hardware endpoints (EP0-EP7)
  - On-chip transceiver with 1.5kΩ pull-up on DDP
  - 2668 bytes total FIFO memory
  - Dual-bank support for EP1,2,4,5,6,7
  - Full-speed operation (12 Mbps)

  Endpoint allocation (odd=IN, even=OUT):
  - EP0: Control endpoint
  - EP1, EP3, EP5, EP7: IN endpoints
  - EP2, EP4, EP6: OUT endpoints

  This binding is compatible with SAM4S, SAM4E, SAM3S devices.

examples:
  - |
    Example devicetree configuration:

      &pinctrl {
        udp_default: udp_default {
          group1 {
            pinmux = <PB10S_UDP_DDM>,
                     <PB11S_UDP_DDP>;
          };
        };
      };

      zephyr_udc0: &udp {
          status = "okay";

          pinctrl-0 = <&udp_default>;
          pinctrl-names = "default";
      };

compatible: "atmel,sam-udp"

include:
  - name: usb-ep.yaml
  - name: pinctrl-device.yaml

properties:
  reg:
    required: true

  interrupts:
    required: true

  clocks:
    required: true
```

## dts/bindings/usb/atmel,sam-usbc.yaml
```yaml
# Copyright (c) 2018 Aurelien Jarno
# Copyright (c) 2020*2023 Gerson Fernando Budke <nandojve@gmail.com>
# SPDX-License-Identifier: Apache-2.0

description: |
    Atmel SAM Family USB (USBC) in device mode

compatible: "atmel,sam-usbc"

include:
  - name: usb-ep.yaml
  - name: pinctrl-device.yaml

properties:
  reg:
    required: true

  interrupts:
    required: true

  clocks:
    required: true
```

## dts/bindings/usb/atmel,sam-usbhs.yaml
```yaml
# Copyright (c) 2018 Aurelien Jarno
# Copyright (c) 2026 Gerson Fernando Budke <nandojve@gmail.com>
# SPDX-License-Identifier: Apache-2.0

description: |
    Atmel SAM Family USB (USBHS) in device mode

    The USBHS controller has two memory regions:
    - "core": USBHS register block
    - "fifo": Dual-Port RAM (DPRAM) for endpoint FIFOs

    The SAM USBHS has 10 hardware endpoints (EP0-EP9). EP0 is the
    bidirectional control endpoint. The remaining endpoints are
    direction-constrained by hardware:
    - Odd endpoints (1, 3, 5, 7, 9): IN direction only
    - Even endpoints (2, 4, 6, 8): OUT direction only

compatible: "atmel,sam-usbhs"

include:
  - name: usb-ep.yaml
  - name: pinctrl-device.yaml

properties:
  reg:
    required: true
    description: |
      Register regions for the USBHS controller.
      Contain two entries in order:
        - core registers
        - fifo DPRAM

  reg-names:
    required: true
    description: |
      Names for the register regions. Must be "core" and "fifo".

  interrupts:
    required: true

  clocks:
    required: true

  num-bidir-endpoints:
    const: 1
    description: |
      Number of bidirectional endpoints. For SAM USBHS, only EP0 is truly
      bidirectional. Non-EP0 endpoints are direction-constrained by hardware.

  num-in-endpoints:
    required: true
    description: |
      Number of IN endpoints including EP0 IN. For SAM USBHS:
        - 6 (EP0 IN + EP1, EP3, EP5, EP7, EP9)

  num-out-endpoints:
    required: true
    description: |
      Number of OUT endpoints including EP0 OUT. For SAM USBHS:
        - 5 (EP0 OUT + EP2, EP4, EP6, EP8)
```

## dts/bindings/usb/atmel,sam0-usb.yaml
```yaml
description: |
    Atmel SAM0 USB in device mode

compatible: "atmel,sam0-usb"

include:
  - name: usb-ep.yaml
  - name: pinctrl-device.yaml

properties:
  reg:
    required: true

  interrupts:
    required: true
```

## dts/bindings/usb/bflb,bl61x-udc.yaml
```yaml
# Copyright (c) 2024-2025 MASSDRIVER EI (massdriver.space)
# SPDX-License-Identifier: Apache-2.0

description: |
  Bouffalolab BL61x USB controller in device mode
  It is similar to FOTG210

compatible: "bflb,bl61x-udc"

include: usb-ep.yaml

properties:
  reg:
    required: true

  interrupts:
    required: true
```
