## dts/bindings/otp/zephyr,gpio-straps.yaml
```yaml
# SPDX-License-Identifier: Apache-2.0
# SPDX-FileCopyrightText: Copyright The Zephyr Project Contributors

description: |
  An identity value strapped on GPIO pins, presented as read-only OTP memory.

  Strap resistors are populated when the board is assembled and cannot change
  afterwards.

  Bit N of the value comes from the gpios entry at index N, least significant
  bit first, packed into bytes: byte 0 holds entries 0 to 7, byte 1 entries 8
  to 15, and so on. A trailing partial byte is zero padded.

  Name the fields with nvmem cells when the application wants them by name.

compatible: "zephyr,gpio-straps"

include: base.yaml

properties:
  gpios:
    type: phandle-array
    required: true
    min-len: 1
    description: |
      Strap pins, least significant bit first. Bit N of the identity value is
      taken from the entry at index N.

examples:
  - |
    board_straps: board-straps {
            compatible = "zephyr,gpio-straps";
            gpios = <&gpio0 3 (GPIO_ACTIVE_HIGH | GPIO_PULL_UP)>,
                    <&gpio0 4 (GPIO_ACTIVE_HIGH | GPIO_PULL_UP)>,
                    <&gpio0 5 (GPIO_ACTIVE_HIGH | GPIO_PULL_UP)>;

            nvmem-layout {
                    compatible = "fixed-layout";
                    #address-cells = <1>;
                    #size-cells = <1>;

                    board_revision: revision@0 {
                            reg = <0x0 0x1>;
                            read-only;
                            #nvmem-cell-cells = <0>;
                    };
            };
    };
```

## dts/bindings/p_state/nxp,imx9-pstate.yaml
```yaml
# Copyright 2026 NXP
#
# SPDX-License-Identifier: Apache-2.0

description: |
  NXP i.MX9 performance state (P-state) for the Cortex-A application cores.

  This binding is shared by the i.MX9 family (i.MX91, i.MX93, i.MX95, i.MX943
  and derivatives). Each P-state selects a core clock frequency that the SoC
  P-state driver applies when the state is entered. The set of usable
  frequencies is SoC specific: only the frequencies the SoC driver implements
  may be requested, and any other value is rejected at build time.

  A SoC driver may change the core clock alone and leave the supply voltage at
  the level set by the boot loader. Where that is the case, all frequencies
  listed in devicetree must be usable at that voltage. Where the cores of a
  cluster share the clock source, a P-state applies to the whole cluster and the
  SoC driver requires an SMP build.

  Example configuration:

  performance-states {
          pstate_0: pstate-0 {
                  compatible = "nxp,imx9-pstate";
                  load-threshold = <60>;
                  clock-frequency = <DT_FREQ_M(1692)>;
          };
          pstate_1: pstate-1 {
                  compatible = "nxp,imx9-pstate";
                  load-threshold = <0>;
                  clock-frequency = <DT_FREQ_M(900)>;
          };
  };

compatible: "nxp,imx9-pstate"

include: "zephyr,pstate.yaml"

properties:
  load-threshold:
    required: true

  clock-frequency:
    type: int
    required: true
    description: |
      Core clock frequency, in Hz, applied when this performance state is
      selected. The accepted values are defined by the SoC P-state driver.
```

## dts/bindings/p_state/nxp,rt2k-pmu-pstate.yaml
```yaml
# SPDX-FileCopyrightText: Copyright 2026 NXP
# SPDX-License-Identifier: Apache-2.0

description: |
  NXP RT2K PMU performance state (pstate): one of the run modes the PMU and the
  power controller switch between.

compatible: "nxp,rt2k-pmu-pstate"

include:
  - "zephyr,pstate.yaml"

properties:
  load-threshold:
    required: true

  cpu-frequency-level:
    type: string
    required: true
    enum:
      - low-leakage-run
      - normal-run
      - high-performance-run
    description: |
      Run mode of this performance state: Low Leakage Run, Normal Run or
      High Performance Run.
```

## dts/bindings/p_state/st,stm32n6-pstate.yaml
```yaml
# SPDX-FileCopyrightText: Copyright The Zephyr Project Contributors
# SPDX-License-Identifier: Apache-2.0

description: |
  STM32N6 CPU performance state using the IC1 divider. The PLL and boot
  voltage remain fixed. Each frequency must be an exact integer division
  of the IC1 parent clock by a divider from 1 through 256, and must not
  exceed the boot CPU frequency or 800 MHz.

compatible: "st,stm32n6-pstate"

include: zephyr,pstate.yaml

properties:
  clock-frequency:
    type: int
    required: true
    description: CPU frequency in Hz.

  load-threshold:
    required: true
```

## dts/bindings/pcie/controller/brcm,brcmstb-pcie.yaml
```yaml
# Copyright (c) 2024 Junho Lee <junho@tsnlab.com>
# SPDX-License-Identifier: Apache-2.0

description: BRCMSTB PCIe controller

compatible: "brcm,brcmstb-pcie"

include: [base.yaml, pcie-controller.yaml]

properties:
  reg:
    required: true

  msi-parent:
    type: phandle
    description: BCM2712 MSI interrupt proxy receiving endpoint MSI writes.
```

## dts/bindings/pcie/controller/rockchip,rk3588-pcie.yaml
```yaml
# Copyright (c) 2026 Process Mission
# SPDX-License-Identifier: Apache-2.0

description: Rockchip RK3588 DesignWare PCIe Root Complex

compatible: "rockchip,rk3588-pcie"

include: [base.yaml, pcie-controller.yaml, reset-device.yaml]

properties:
  reg:
    required: true
    description: |
      Register windows named pcie_apb (RK3588 PCIe client registers),
      pcie_dbi (DesignWare DBI), config (outbound configuration space),
      pipe_phy_grf (ComboPHY PIPE PHY GRF), combphy (ComboPHY analog
      registers), gpio (PERST# GPIO bank) and ioc (IOMUX registers).

  reg-names:
    required: true

  clocks:
    required: true
    description: |
      All clocks of the controller in parent-before-child order. The driver
      enables every entry, so the list must be complete.

  clock-names:
    required: true
    description: |
      Must contain the "top", "gpio" and "ref" entries in addition to the
      controller clock gates. "ref" is the ComboPHY reference clock, whose
      rate is set to 100 MHz.

  resets:
    required: true

  reset-names:
    required: true
    description: |
      Controller power, PIPE, PHY and PHY APB resets, named "pwr", "pipe",
      "phy" and "phy-apb".

  msi-parent:
    type: phandle
    required: true
    description: GICv3 ITS receiving the endpoint MSI writes

  ranges:
    required: true
    description: |
      CPU-to-PCI I/O and memory translation ranges, one per outbound iATU
      window. The I/O range, the 32-bit memory range and the 64-bit memory
      range are each optional, but at least one is required.

  bus-range:
    type: array
    required: true
    description: |
      First and last bus number of the hierarchy behind this root complex.
      Both cells are required.

  num-lanes:
    type: int
    required: true
    description: Number of PCIe lanes of the link
    enum:
      - 1
      - 2
      - 4
      - 8

  max-link-speed:
    type: int
    default: 2
    description: Maximum PCIe link speed in generations
    enum:
      - 1
      - 2
      - 3
      - 4

  rockchip,firmware-initialized:
    type: boolean
    description: |
      The platform firmware already supplies clocks, PHY setup, reset
      sequencing, PERST# and a usable link. The driver still configures the
      root complex, iATU windows and PCI bus.

  rockchip,perst-inactive-ms:
    type: int
    default: 200
    description: |
      Delay between enabling the LTSSM and releasing PERST#, in
      milliseconds. Must not exceed 1000.

  rockchip,link-timeout-ms:
    type: int
    default: 2000
    description: |
      Maximum time to wait for the PCIe data link, in milliseconds. Must not
      exceed 60000.
```

## dts/bindings/pcie/endpoint/zephyr,pcie-ep-emul.yaml
```yaml
# SPDX-FileCopyrightText: Copyright (c) 2026 Process Mission
# SPDX-License-Identifier: Apache-2.0

title: Emulated PCIe Endpoint device

description: |
  This binding describes a process-local PCIe endpoint emulator. It
  implements the Zephyr PCIe EP driver API purely in software, within the
  same process as the emulation host (for example native_sim). The
  emulated endpoint is NOT externally PCIe-enumerable: it does not appear
  on any physical or virtual PCIe bus and cannot be discovered by an
  external host. It is intended for testing PCIe endpoint applications on
  POSIX/native targets.

compatible: "zephyr,pcie-ep-emul"

include: base.yaml

properties:
  vendor-id:
    type: int
    required: true
    description: |
      16-bit PCI vendor ID exposed in the emulated configuration space.
      The range is enforced by a build-time assertion in the driver.

  device-id:
    type: int
    required: true
    description: |
      16-bit PCI device ID exposed in the emulated configuration space.
      The range is enforced by a build-time assertion in the driver.

  class-code:
    type: int
    required: true
    description: |
      24-bit PCI class code (base class, sub-class and programming
      interface) exposed in the emulated configuration space. The range
      is enforced by a build-time assertion in the driver.

  revision-id:
    type: int
    required: true
    description: |
      8-bit PCI revision ID exposed in the emulated configuration space.
      The range is enforced by a build-time assertion in the driver.

  bar-sizes:
    type: array
    required: true
    description: |
      Size in bytes of each of the 6 emulated Base Address Registers.
      Exactly 6 cells are required, one per BAR. A zero entry disables the
      corresponding BAR. Non-zero entries must be a power of two and at
      least 4096 (the minimum PCIe BAR alignment); this is validated at
      build time by the driver.

  msi-vectors:
    type: int
    required: true
    description: |
      Number of MSI vectors the emulated endpoint supports. Must be zero
      or a power of two up to 32 (validated at build time by the driver).
      A non-zero value models an MSI capability in the emulated
      configuration space; zero means no MSI capability is present and
      MSI interrupts are rejected by pcie_ep_raise_irq().

  msix-vectors:
    type: int
    required: true
    description: |
      Number of MSI-X vectors the emulated endpoint supports. Must be at
      most 2048 (validated at build time by the driver). A non-zero value
      models an MSI-X capability in the emulated configuration space and
      requires at least one enabled BAR large enough to hold the MSI-X
      table and PBA (validated at build time by the driver); zero means no MSI-X capability
      is present and MSI-X interrupts are rejected by pcie_ep_raise_irq().

  legacy-irq:
    type: boolean
    description: |
      Present if the emulated endpoint supports legacy (INTx) interrupts.
      When absent, legacy interrupts are rejected by pcie_ep_raise_irq().

  dmas:
    description: |
      Optional pair of DMA channel specifiers used for host-memory data
      transfers. Omit both dmas and dma-names to use the endpoint without
      DMA. When either property is provided, both must be present with
      exactly two entries, ordered host-to-device first and device-to-host
      second.
      Each specified channel must be dedicated to one endpoint instance
      and one direction. Specified channels must not be shared between
      directions or endpoint instances.
      Each specified channel is claimed by its exact devicetree
      channel number at driver init and held for the device lifetime, so
      channel selection does not depend on endpoint instance init order.
      The DMA controller must initialize before the endpoint. At
      POST_KERNEL, its DMA_INIT_PRIORITY must be no greater than
      KERNEL_INIT_PRIORITY_DEVICE, which the endpoint uses. The default
      DMA priority is KERNEL_INIT_PRIORITY_DEFAULT (40), below the
      endpoint's default priority (50). With CHECK_INIT_PRIORITIES
      enabled, a build fails if the actual initialization order places
      an endpoint before its DMA controller. Equal priorities are valid
      only when the controller is ordered first within that priority.
      The driver also requires DMA_EMUL when dmas is present and checks
      the DMA priority at compile time, even with CHECK_INIT_PRIORITIES
      disabled. Runtime controller readiness checks and channel-claim
      rollback still apply.
      If a named channel is already claimed by another user, the
      offending endpoint releases any channels it already claimed
      and fails to initialize.
      The DMA API does not standardize the channel-filter parameter used
      for exact claims, so the referenced controllers must implement the
      zephyr,dma-emul filter convention (uint32_t channel number passed
      by address); this is enforced by a build-time assertion in the
      driver.

  dma-names:
    description: |
      Names for the optional DMA channels. Omit this property together
      with dmas to use the endpoint without DMA. When provided, dmas must
      also be present, and each property must contain exactly two entries:
        dma-names = "host-to-device", "device-to-host";
      Each named channel must be dedicated to this endpoint and direction,
      as required by dmas.
    enum:
      - "host-to-device"
      - "device-to-host"
```

## dts/bindings/pcie/host/pcie-device.yaml
```yaml
# Copyright (c) 2022 Intel Corporation
# SPDX-License-Identifier: Apache-2.0

# Common fields for PCIe devices

properties:
  pcie-controller:
    type: phandle
    description: |
      Owning PCIe host controller. Required when the endpoint is not a direct
      child of its controller, such as below a bridge or a simple-bus node.
      Direct children use their parent when this property is absent.
  vendor-id:
    type: int
    description: Vendor ID of the device
  device-id:
    type: int
    description: Device ID of the device
  class-rev:
    type: int
    description: Optional class/revision register filter
  class-rev-mask:
    type: int
    description: Class/revision register mask
```

## dts/bindings/phy/can-transceiver.yaml
```yaml
# Copyright (c) 2022-2026 Vestas Wind Systems A/S
# SPDX-License-Identifier: Apache-2.0

# Common fields for CAN transceivers

include: phy-controller.yaml

class: can_transceiver

properties:
  min-bitrate:
    type: int
    description: |
      The minimum bitrate supported by the CAN transceiver in bits/s.

  max-bitrate:
    type: int
    required: true
    description: |
      The maximum bitrate supported by the CAN transceiver in bits/s.

  "#phy-cells":
    const: 0
```

## dts/bindings/phy/infineon,tle927x-can.yaml
```yaml
# SPDX-FileCopyrightText: Copyright (c) 2026 Deere & Company
# SPDX-FileCopyrightText: Copyright (c) 2026 Linumiz
# SPDX-License-Identifier: Apache-2.0

description: Infineon TLE927x SBC HS-CAN transceiver

compatible: "infineon,tle927x-can"

include: can-transceiver.yaml

on-bus: tle927x
```

## dts/bindings/phy/st,stm32-usbphyc.yaml
```yaml
# Copyright (c) 2018, Yannis Damigos
# SPDX-License-Identifier: Apache-2.0

title: STM32 USB HS PHY controller (USBPHYC)

description: |
  USB High-Speed PHY controller as found in various STM32 series.

  Control registers are implemented directly in the RCC MMIO interface.

compatible: "st,stm32-usbphyc"

include: phy-controller.yaml

properties:
  clocks:
    required: true

  clock-names:
    required: true
    enum:
      - "gate"
      - "mux"
      - "fsel"
    description: |
      Up to three clock cells are accepted:
      - "gate": clock gate in front of the USBPHYC PLL clock input
      - "mux": clock mux selecting source used as USBPHYC PLL clock
      - "fsel": USBPHYC PLL clock frequency selection
                (applicable only when this is configured at RCC level)

      Refer to the Reference Manual applicable for your product to find
      which cells should be provided for proper operation.

  "#phy-cells":
    const: 0
```
