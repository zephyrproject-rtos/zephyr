## dts/bindings/phy/st,stm32f7-usbphyc.yaml
```yaml
# SPDX-FileCopyrightText: Copyright (c) 2026 STMicroelectronics
# SPDX-License-Identifier: Apache-2.0

title: STM32F7 USB HS PHY controller (USBPHYC)

description: |
  USB High-Speed PHY control interface as found in STM32F7 series.
  This control interface is located in a dedicated MMIO region.

  NOTE: this compatible must NOT be used alongside "st,stm32-usbphyc"
        as it indicates a completely separate programming model.

compatible: "st,stm32f7-usbphyc"

include: "st,stm32-usbphyc.yaml"

properties:
  reg:
    required: true
```
