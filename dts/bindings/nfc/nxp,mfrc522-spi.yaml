## dts/bindings/nfc/nxp,mfrc522-spi.yaml
```yaml
# Copyright (c) 2026 RAKwireless Technology Limited
# SPDX-License-Identifier: Apache-2.0

title: NXP MFRC522

description: ISO/IEC 14443 Type A reader on SPI.

compatible: "nxp,mfrc522"

include: [nfc-controller.yaml, spi-device.yaml]

on-bus: spi

properties:
  reset-gpios:
    type: phandle-array
    description: NRSTPD reset / power-down line (active low).

  irq-gpios:
    type: phandle-array
    description: |
      IRQ line the reader asserts on transceive completion. Optional; the
      driver falls back to polling the interrupt status register.
```

## dts/bindings/nfc/nxp,pn53x-i2c.yaml
```yaml
# Copyright (c) 2026 RAKwireless Technology Limited
# SPDX-License-Identifier: Apache-2.0

title: NXP PN53x (PN531/PN532/PN533)

description: NFC controller on I2C, resolving and activating targets in firmware.

compatible: "nxp,pn53x"

include: [nfc-controller.yaml, i2c-device.yaml]

on-bus: i2c

properties:
  reset-gpios:
    type: phandle-array
    description: RSTPD_N reset / power-down line (active low).

  irq-gpios:
    type: phandle-array
    description: |
      IRQ line the controller asserts when a response is ready. Optional; the
      I2C backend falls back to polling the readiness status byte.
```

## dts/bindings/nfc/zephyr,nfc-emul.yaml
```yaml
# Copyright (c) 2026 RAKwireless Technology Limited
# SPDX-License-Identifier: Apache-2.0

title: Emulated NFC Controller

description: |
  Has no hardware behind it. It exists so the NFC driver-class API can be
  exercised on a host build; see include/zephyr/drivers/nfc/nfc_emul.h.

compatible: "zephyr,nfc-emul"

include: nfc-controller.yaml

properties:
  backend:
    type: string
    required: true
    enum:
      - "offload"
      - "initiator"
      - "target"
    description: |
      Class of controller this instance impersonates. It selects the subset of
      the driver API the instance implements, so that each class is represented
      by a device that really does lack the other classes' operations.

      offload:   resolves and activates targets in firmware
      initiator: host-driven reader
      target:    host-driven card emulation
```

## dts/bindings/nvmem/zephyr,nvmem-psa-common.yaml
```yaml
# SPDX-FileCopyrightText: Copyright The Zephyr Project Contributors
# SPDX-FileCopyrightText: Copyright (c) 2026 Basalte bv
# SPDX-License-Identifier: Apache-2.0

# Common properties for PSA Secure Storage NVMEM providers.

properties:
  uid-base:
    type: array
    default: [0, 0]
    min-len: 2
    max-len: 2
    description: |
      64-bit base added to each cell's reg address to form the PSA storage
      UID, as <HIGH32 LOW32>. With the default of 0 the cell's reg address
      is the UID itself.

      UID 0 is invalid in PSA Secure Storage, so the base and the cell
      addresses must not both be zero.
```

## dts/bindings/nvmem/zephyr,nvmem-psa-its.yaml
```yaml
# SPDX-FileCopyrightText: Copyright The Zephyr Project Contributors
# SPDX-FileCopyrightText: Copyright (c) 2026 Basalte bv
# SPDX-License-Identifier: Apache-2.0

description: |
  NVMEM provider backed by PSA Internal Trusted Storage (ITS).

  Each NVMEM cell in the child nvmem-layout node maps to one ITS entry whose
  UID is the cell's reg address plus the optional uid-base property. This
  allows entries that already exist, for example ones written by another
  component or during provisioning, to be consumed as NVMEM cells. A cell is
  a window over the start of its entry; the entry may be larger than the
  cell.

  The read-only cell property is enforced by the NVMEM API only; entries are
  never created with PSA_STORAGE_FLAG_WRITE_ONCE, which would be
  irreversible. See the NVMEM subsystem documentation for the access
  semantics.

compatible: "zephyr,nvmem-psa-its"

include: zephyr,nvmem-psa-common.yaml

examples:
  - |
    psa_its: nvmem-psa-its {
        compatible = "zephyr,nvmem-psa-its";

        nvmem-layout {
            compatible = "fixed-layout";
            #address-cells = <1>;
            #size-cells = <1>;

            /* Pre-shared key at ITS UID 0x2b001000, provisioned elsewhere */
            device_psk: device-psk@2b001000 {
                reg = <0x2b001000 16>;
                read-only;
                #nvmem-cell-cells = <0>;
            };
        };
    };
```

## dts/bindings/nvmem/zephyr,nvmem-psa-ps.yaml
```yaml
# SPDX-FileCopyrightText: Copyright The Zephyr Project Contributors
# SPDX-FileCopyrightText: Copyright (c) 2026 Basalte bv
# SPDX-License-Identifier: Apache-2.0

description: |
  NVMEM provider backed by PSA Protected Storage (PS).

  Each NVMEM cell in the child nvmem-layout node maps to one PS entry whose
  UID is the cell's reg address plus the optional uid-base property. This
  allows entries that already exist, for example ones written by another
  component or during provisioning, to be consumed as NVMEM cells.

  The semantics are identical to the zephyr,nvmem-psa-its binding, except
  entries are accessed through the PSA Protected Storage API.

compatible: "zephyr,nvmem-psa-ps"

include: zephyr,nvmem-psa-common.yaml

examples:
  - |
    psa_ps: nvmem-psa-ps {
        compatible = "zephyr,nvmem-psa-ps";
        /* entries live at UID 0xC2E00000_00000000 + the cell address */
        uid-base = <0xC2E00000 0x0>;

        nvmem-layout {
            compatible = "fixed-layout";
            #address-cells = <1>;
            #size-cells = <1>;

            cred0: cred@5 {
                reg = <0x5 0x100>;
                #nvmem-cell-cells = <0>;
            };
        };
    };
```

## dts/bindings/opamp/ti,mspm0-opa.yaml
```yaml
# TI MSPM0 Family

# SPDX-FileCopyrightText: Copyright (c) 2026 Linumiz
# SPDX-License-Identifier: Apache-2.0

description: |
  Texas Instruments MSPM0 zero-drift, chopper-stabilized Operational Amplifier (OPA).
compatible: "ti,mspm0-opa"

include:
  - opamp-controller.yaml

properties:
  reg:
    required: true

  ti,psel:
    type: string
    default: "open"
    enum: ["open", "in0p", "in1p", "dac12out", "dac8out", "vref",
           "prev-opa-rtop", "gpamp-out", "vss"]
    description: |
      Selects non inverting terminals input via OPA's internal P-MUX.

  ti,nsel:
    type: string
    default: "open"
    enum: ["open", "in0n", "in1n", "prev-opa-rbot", "rtap", "rtop"]
    description: |
      Selects inverting terminals input via OPA's internal N-MUX.

  ti,msel:
    type: string
    default: "open"
    enum: ["open", "in1n", "gnd", "dac12out", "prev-opa-rtop"]
    description: |
       Selects the input for OPA's internal M-MUX which is connected to the
       programmable gain stage resister ladder.

  ti,chop-mode:
    type: string
    default: "disabled"
    enum: ["disabled", "standard", "adc-assisted"]
    description: |
      Selects the OPA's chopping mode.

  ti,outpin-enable:
    type: boolean
    description: |
      Enables the opa output on the external OPAx_OUT package pin.

  ti,power-mode:
    type: string
    default: "lp"
    enum: ["lp", "std"]
    description: |
      Selects the opa power mode.
      LP mode sets the GBW value as 1MHz,
      STD mode sets the GBW value as 6MHz.

  ti,rri-enable:
    type: boolean
    description: |
      Selects rail-to-rail input mode.

  vref:
    type: phandle
    description: |
      Selects vref as the input for non-inverting terminal.
```

## dts/bindings/opamp/ti,mspm0-opamp.yaml
```yaml
# TI MSPM0 Family

# Copyright (c) 2026, Linumiz
# SPDX-License-Identifier: Apache-2.0

description: |
  Texas Instruments MSPM0 zero-drift, chopper-stabilized Operational Amplifier (OPA).
compatible: "ti,mspm0-opamp"

include:
  - opamp-controller.yaml

properties:
  reg:
    required: true

  ti,psel:
    type: string
    default: "open"
    enum: ["open", "in0p", "in1p", "dac12out", "dac8out", "vref",
           "prev-opa-rtop", "gpamp-out", "vss"]
    description: |
      Selects non inverting terminals input via OPA's internal P-MUX.

  ti,nsel:
    type: string
    default: "open"
    enum: ["open", "in0n", "in1n", "prev-opa-rbot", "rtap", "rtop"]
    description: |
      Selects inverting terminals input via OPA's internal N-MUX.

  ti,msel:
    type: string
    default: "open"
    enum: ["open", "in1n", "gnd", "dac12out", "prev-opa-rtop"]
    description: |
       Selects the input for OPA's internal M-MUX which is connected to the
       programmable gain stage resister ladder.

  ti,chop-mode:
    type: string
    default: "disabled"
    enum: ["disabled", "standard", "adc-assisted"]
    description: |
      Selects the OPAMP's chopping mode.

  ti,gain:
    type: int
    default: 0
    description: |
      Initial value for the gain, set once at boot.
      This is live-changeable afterwards through the driver's gain
      API
        -inverting     - 0=invalid 1=-1x 2=-3x 3=-7x 4=-15x 5=-31x
        -non-inverting - 0=1x 1=2x 2=4x 3=8x 4=16x 5=32x

  ti,outpin-enable:
    type: boolean
    description: |
      When set, the amplifier's output is also driven onto the
      external OPAx_OUT package pin, in addition to staying
      available internally to the ADC/COMP/paired OPA. Leave unset
      for a purely internal signal chain (e.g. buffering a
      reference into the ADC) to save the pin for other uses.

  ti,power-mode:
    type: string
    default: "lp"
    enum: ["lp", "std"]
    description: |
      Selects the opamp power mode.
      LP mode sets the GBW value as 1MHz,
      STD mode sets the GBW value as 6MHz.

  vref:
    type: phandle
    description: |
      Selects vref as the input for non-inverting terminal.
```

## dts/bindings/otp/adi,axi-sysid.yaml
```yaml
# Copyright (c) 2026 Analog Devices, Inc.
# SPDX-License-Identifier: Apache-2.0

description: |
  Analog Devices AXI System ID core.

  Exposes an FPGA build-information ROM (board / product / git data) through
  the standard read-only OTP API. The ROM size is auto-detected from the
  core at init.

compatible: "adi,axi-sysid"

include: base.yaml

properties:
  reg:
    required: true
```

## dts/bindings/otp/microchip,otpc-g1-otp.yaml
```yaml
# Copyright (c) 2026 Microchip Technology Inc.
# SPDX-License-Identifier: Apache-2.0

title: Microchip OTPC G1 Driver

description: |
  Binding for the Microchip OTPC driver supporting Group G1 peripherals.

  Group G1 OTPC driver supports the following hardware peripheral:
    - module name="OTPC" id="44105" version="150"

examples:
  - |
    Example devicetree configuration:

      &otpc {
        status = "okay";
      };

compatible: "microchip,otpc-g1-otp"

include: base.yaml

properties:
  reg:
    required: true
    description: |
      Register base address and size for the OTPC peripheral.

  interrupts:
    required: true
    description: |
      Interrupt specifier for the OTPC peripheral.

  otp-memory-size:
    type: int
    required: true
    description: |
      OTP user area memory size of OTPC, in bytes.

  emul-sram-size:
    type: int
    required: true
    description: |
      Emulation mode sram size of OTPC, in bytes.
```

## dts/bindings/otp/nordic,npm10xx-uicr.yaml
```yaml
# Copyright (c) 2026 Nordic Semiconductor ASA
# SPDX-License-Identifier: Apache-2.0

description: |
  Nordic nPM10xx UICR (User information configuration registers).

  UICR is the User OTP memory of the nPM10xx PMIC. It holds non-volatile bits that set the
  reset/default values for various PMIC configuration registers. Consult the datasheet for the
  complete UICR reference.

  The memory is exposed as a packed bit-array: UICR bit address N is bit (N % 8) of byte (N / 8).

compatible: "nordic,npm10xx-uicr"

include: base.yaml

properties:
  margin-mode:
    type: string
    enum:
      - "default"
      - "ref+"
      - "ref-"
    default: "default"
    description: |
      Configure margin mode for UICR read-back. The available values are:
        - "default": no change to the read reference
        - "ref+": increase the read reference to detect weak 1's; useful to detect the bits that
          were programmed less reliably and might require re-programming
        - "ref-": decrease the read reference to detect weak 0's; those would indicate manufacturing
          defects, normally they should not appear

examples:
  - |
    pmic@6a {
      reg = <0x6a>;
      compatible = "nordic,npm10xx";

      uicr {
        compatible = "nordic,npm10xx-uicr";
        margin-mode = "ref+";
      };
    };
```

## dts/bindings/otp/nxp,fsb.yaml
```yaml
# Copyright 2026 NXP
# SPDX-License-Identifier: Apache-2.0

title: NXP FSB (Fuse Sense Block) OTP

description: |
  NXP Fuse Sense Block found on i.MX RT266x SoCs. It exposes the fuse
  array as read-only 32-bit words.

  The reg property describes the fuse value register array only (FSB base
  offset 0x8000). The OTP driver API uses byte addressing: byte offset N maps
  to fuse word N / 4.

compatible: "nxp,fsb"

include: base.yaml

properties:
  reg:
    required: true

examples:
  - |
    fsb: otp@40608000 {
            compatible = "nxp,fsb";
            reg = <0x40608000 0x8000>;

            nvmem-layout {
                    compatible = "fixed-layout";
                    #address-cells = <1>;
                    #size-cells = <1>;

                    /* Fuse words 477 and 478 (byte offset 0x774), 6 bytes wide */
                    mac_address: mac-address@774 {
                            reg = <0x774 0x6>;
                            #nvmem-cell-cells = <0>;
                            read-only;
                    };
            };
    };
```

## dts/bindings/otp/nxp,rw6xx-ocotp.yaml
```yaml
# SPDX-FileCopyrightText: Copyright 2026 NXP
# SPDX-License-Identifier: Apache-2.0

title: NXP RW6xx OCOTP

description: |
  NXP On-Chip OTP (One-Time Programmable) controller for RW610/RW612 SoCs.

  The OCOTP module provides access to on-chip fuse memory used to store
  configuration data, security keys, unique device IDs, and other
  device-specific information.

  The OTP driver API uses byte addressing. The driver handles conversion
  between byte addresses and 32-bit fuse word indices internally.

  The reg property size field specifies the accessible fuse space in bytes.

compatible: "nxp,rw6xx-ocotp"

include: base.yaml

properties:
  reg:
    required: true
    description: |
      Base address and size of the accessible OTP fuse space. The size field
      specifies the accessible fuse space in bytes (must be a multiple of 4).
      The RW610/RW612 OCOTP has 420 shadow registers (0x690 bytes).

  clocks:
    required: true
    description: |
      Clock feeding the OCOTP controller. Fuse access timing depends on its
      rate.
```
