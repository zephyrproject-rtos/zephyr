## dts/bindings/power-domain/power-domain-state-change-deviceonoff.yaml
```yaml
# Copyright 2024 NXP
# SPDX-License-Identifier: Apache-2.0

description: |
  This power domain will Turn On and Off devices when transitioning
  in and out a specified Power State. Power States that trigger this
  action is specified via the onoff-power-states property.

compatible: "power-domain-state-change-deviceonoff"

include: power-domain.yaml

properties:
  onoff-power-states:
    type: phandles
    description: |
      List of power management states.
      The registered devices will be turned off before the PM subsystem
      enters these PM states. The devices will be turned on after the
      PM subsystem exits these PM states.
```

## dts/bindings/power-domain/power-domain.yaml
```yaml
# Copyright (c) 2021, Intel Corporation
# SPDX-License-Identifier: Apache-2.0

description: Properties for power domains

compatible: "power-domain"

include: base.yaml

properties:
  "#power-domain-cells":
    const: 0
```

## dts/bindings/power-domain/raspberrypi,bcm283x-power.yaml
```yaml
# Copyright (c) 2026 Muhammad Waleed Badar
# SPDX-License-Identifier: Apache-2.0

description: Raspberry Pi BCM283x power domain

compatible: "raspberrypi,bcm283x-power"

include: power-domain.yaml

properties:
  firmware:
    required: true
    type: phandle

  power-domain-id:
    required: true
    type: int
    description: Raspberry Pi BCM283x power domain ID
```

## dts/bindings/power-domain/silabs,siwx91x-power-domain.yaml
```yaml
description: Silabs siwx91x soc power domain

compatible: "silabs,siwx91x-power-domain"

include: power-domain.yaml
```

## dts/bindings/power-domain/ti,cc13xx-cc26xx-power-domain.yaml
```yaml
# Copyright (c) 2021, Intel Corporation
# SPDX-License-Identifier: Apache-2.0

description: TI SimpleLink CC13xx / CC26xx power domain

compatible: "ti,cc13xx-cc26xx-power-domain"

include: power-domain.yaml

properties:
    resource-id:
      type: int
      required: true
      description:
        Power domain resource ID as defined in prcm.h (TI HAL).
```

## dts/bindings/power-domain/ti,sci-pm-domain.yaml
```yaml
# Copyright 2025 Texas Instruments Incorporated
# SPDX-License-Identifier: Apache-2.0

description: TISCI-managed power domain

compatible: "ti,sci-pm-domain"

include: base.yaml

properties:
  tisci,device-id:
    type: int
    required: true
    description: |
      The device ID of the power domain as defined in the TISCI documentation.
  tisci,device-mode:
    type: string
    required: true
    enum:
      - "SHARED"
      - "EXCLUSIVE"
    description: |
      The device mode of the power domain as defined in the TISCI documentation.
  "#power-domain-cells":
    const: 0
```

## dts/bindings/power/ambiq,pwrctrl.yaml
```yaml
# Copyright (c) 2023 Antmicro <www.antmicro.com>
# SPDX-License-Identifier: Apache-2.0

description: Ambiq power control

compatible: "ambiq,pwrctrl"

include: base.yaml

properties:
  reg:
    required: true

  "#pwrcfg-cells":
    type: int
    required: true
    const: 2
    description: Number of items to expect in a power configuration

pwrcfg-cells:
  - offset
  - mask
```

## dts/bindings/power/ambiq-pwrcfg.yaml
```yaml
# Copyright (c) 2023 Antmicro <www.antmicro.com>
# SPDX-License-Identifier: Apache-2.0

description: Ambiq peripheral power configuration

properties:

  ambiq,pwrcfg:
    type: phandle-array
    specifier-space: pwrcfg
    description: Power configuration
```
