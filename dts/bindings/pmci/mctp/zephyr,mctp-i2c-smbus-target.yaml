## dts/bindings/pmci/mctp/zephyr,mctp-i2c-smbus-target.yaml
```yaml
# Copyright 2026 NXP
# SPDX-License-Identifier: Apache-2.0

description: |
  A configuration for MCTP binding over SMBus/I2C using Zephyr I2C target RX
  and transient controller-mode transfers for TX.

compatible: "zephyr,mctp-i2c-smbus-target"

properties:
  i2c:
    type: phandle
    required: true
    description: |
      I2C peripheral that is used as an MCTP bus with the target mode API.

  i2c-addr:
    type: int
    required: true
    description: |
      7-bit I2C target address of this endpoint.

  endpoint-id:
    type: int
    required: true
    description: |
      MCTP endpoint ID of this endpoint.

  remote-i2c-addr:
    type: int
    required: true
    description: |
      I2C address of the remote device used for transmit traffic.
```

## dts/bindings/pmci/mctp/zephyr,mctp-i3c-controller.yaml
```yaml
# Copyright (c) 2025 Intel Corporation
# SPDX-License-Identifier: Apache-2.0

description: |
  A configuration for MCTP bindings to an I3C controller.

compatible: "zephyr,mctp-i3c-controller"

properties:
  endpoints:
    type: phandles
    description: |
      I3C devices to use as endpoints

  endpoint-ids:
    type: array
    description: |
      Endpoint IDs to assign to each I3C device endpoint
```

## dts/bindings/pmci/mctp/zephyr,mctp-i3c-endpoint.yaml
```yaml
# Copyright (c) 2025 Intel Corporation
# SPDX-License-Identifier: Apache-2.0

include: [i3c-device.yaml]

description: |
  A configuration for MCTP endpoint connected to an I3C bus acting as a controller.

compatible: "zephyr,mctp-i3c-endpoint"

properties:
  controller:
    type: phandle
    description: |
      Reference to the MCTP controller (binding) managing this MCTP endpoint.
```

## dts/bindings/pmci/mctp/zephyr,mctp-i3c-target.yaml
```yaml
# Copyright (c) 2025 Intel Corporation
# SPDX-License-Identifier: Apache-2.0

description: |
  A configuration for MCTP bindings to an I3C target.

compatible: "zephyr,mctp-i3c-target"

properties:
  i3c:
    type: phandle
    description: |
      I3C peripheral that is used as an MCTP bus with the target mode API.

  endpoint-id:
    type: int
    description: |
      MCTP endpoint id
```

## dts/bindings/pmic/maxim,max170xx.yaml
```yaml
#
# Copyright (c) 2018, Makaio GmbH
#
# SPDX-License-Identifier: Apache-2.0
#
---
title: Maxim Integrated MAX170XX Fuel Gauge representation
version: 0.1

description: >
  This binding gives a base representation of  MAX170XX Fuel Gauge

inherits:
  !include [i2c-device.yaml, pmic-device.yaml]

properties:
  compatible:
    constraint: "maxim,max170xx"
  alert-gpios:
    type: compound
    category: optional
    description: ALERT pin
    generation: define, use-prop-name

...
```

## dts/bindings/pmic/pmic-device.yaml
```yaml
#
# Copyright (c) 2018, Makaio GmbH
#
# SPDX-License-Identifier: Apache-2.0
#
---
title: PMIC Device Base Structure
version: 0.1

description: >
  This binding gives the base structures for all PMIC devices

properties:
  boost:
    type: int
    generation: define
    category: optional
    description: Boost API enabled
  charger:
    type: int
    generation: define
    category: optional
    description: Charger API enabled
  fuelgauge:
    type: int
    generation: define
    category: optional
    description: Fuelgauge API enabled
...
```

## dts/bindings/power-domain/arm,scmi-power-domain.yaml
```yaml
# Copyright 2026 NXP
# SPDX-License-Identifier: Apache-2.0

description: SCMI (System Control and Management Interface) power domain

compatible: "arm,scmi-power-domain"

include: power-domain.yaml

properties:
  reg:
    required: true
    description: SCMI power domain ID
```

## dts/bindings/power-domain/intel,adsp-power-domain.yaml
```yaml
# Copyright (c) 2022 Intel Corporation
#
# SPDX-License-Identifier: Apache-2.0

description: Power domains for intel ADSP

compatible: "intel,adsp-power-domain"

include: power-domain.yaml

properties:
  bit-position:
    type: int
    required: true
    description: |
      Position of the bit to set in write_address (PWRCTL) or read in
      read_address (PWRSTS) to set power active or confirm power active
      for a desired domain.
      Same for write and read addresses

  "#power-domain-cells":
    const: 0
```

## dts/bindings/power-domain/nordic,nrfs-gdpwr.yaml
```yaml
# Copyright 2025 Nordic Semiconductor ASA
# SPDX-License-Identifier: Apache-2.0

description: |
  Nordic NRFS Global Domain Power Request

  The NRFS Global Domain Power Request service manages
  global power domains using NRFS.

  Each child node represents a global power domain, mapped
  by name. The fast-active-0 child node is mapped to the
  FAST_ACTIVE_0 global power domain. The nodelabel of each
  child node is the node name prepended with "gdpwr",
  using underscores.

  Example layout:

    gdpwr {
          compatible = "nordic,nrfs-gdpwr";
          status = "disabled";

          gdpwr_fast_active_0: fast-active-0 {
                  #power-domain-cells = <0>;
          };

          gdpwr_fast_active_1: fast-active-1 {
                  #power-domain-cells = <0>;
          };

          gdpwr_fast_main: fast-main {
                  #power-domain-cells = <0>;
          };

          gdpwr_slow_active: slow-active {
                  #power-domain-cells = <0>;
          };

          gdpwr_slow_main: slow-main {
                  #power-domain-cells = <0>;
          };
  };

  Example usage:

    uart120: uart@8e6000 {
            compatible = "nordic,nrf-uarte";
            reg = <0x8e6000 0x1000>;
            status = "disabled";
            power-domains = <&gdpwr_fast_active_1>;
    };

compatible: "nordic,nrfs-gdpwr"

include: base.yaml

child-binding:
  description: Nordic NRFS Global Power Domain

  properties:
    "#power-domain-cells":
      type: int
      const: 0

    zephyr,pm-device-runtime-auto:
      type: boolean
```

## dts/bindings/power-domain/nordic,nrfs-swext.yaml
```yaml
# Copyright 2025 Nordic Semiconductor
# SPDX-License-Identifier: Apache-2.0

description: Nordic NRFS SWEXT power domain

compatible: "nordic,nrfs-swext"

include: power-domain.yaml

properties:
  "#power-domain-cells":
    const: 0

  max-current-ua:
    type: int
    description: Maxmimum supported current in microamps.
    required: true

  current-limit-ua:
    type: int
    description: Maxmimum allowed current in microamps.
    required: true

  power-down-clamp:
    type: boolean
    description: Enable ground clamp on output when powered down.
```

## dts/bindings/power-domain/nxp,imx8mp-media-blk-ctrl-domain.yaml
```yaml
# Copyright (C) 2026, Savoir-faire Linux
# SPDX-License-Identifier: Apache-2.0

description: |
  A single media sub-domain gated by the NXP i.MX8MP MEDIA_BLK_CTRL. Each
  instance is a power-domain device that a media peripheral (LCDIF, MIPI-DSI,
  MIPI-CSI, ISI, ISP, DWE) references through its "power-domains" property.

  On RESUME, the driver asserts the sub-domain's soft reset (write 0 to the
  SFT_RSTN bitmask — active-low), enables the block clock gates (CLK_EN), waits
  approximately 5 µs for reset to propagate, then deasserts reset (write 1).
  For MIPI sub-domains, the D-PHY reset (MIPI_RESET_DIV, active-low) is also
  asserted and deasserted around the sequence.

examples:
  - |
    mbc_mipi_dsi1: power-domain@0 {
        compatible = "nxp,imx8mp-media-blk-ctrl-domain";
        reg = <IMX8MP_MEDIABLK_PD_MIPI_DSI_1>;
        nxp,rst-mask = <0x3>;
        nxp,clk-mask = <0x3>;
        nxp,mipi-phy-rst-mask = <0x20000>;
        #power-domain-cells = <0>;
        status = "okay";
    };

compatible: "nxp,imx8mp-media-blk-ctrl-domain"

include: [power-domain.yaml]

properties:
  reg:
    required: true
    description: |
      Sub-domain index. See dt-bindings/power/imx8mp_media_blk_ctrl.h
      (IMX8MP_MEDIABLK_PD_*).

  "#power-domain-cells":
    const: 0

  nxp,rst-mask:
    type: int
    required: true
    description: |
      Bitmask in SFT_RSTN (offset 0x00) for this sub-domain.
      Active-low: write 0 to assert (enable) reset, write 1 to deassert (release).

  nxp,clk-mask:
    type: int
    required: true
    description: |
      Bitmask in CLK_EN (offset 0x04) to enable for this sub-domain.
      Active-high: write 1 to enable, write 0 to disable.

  nxp,mipi-phy-rst-mask:
    type: int
    description: |
      Optional bitmask in MIPI_RESET_DIV (offset 0x08) for this sub-domain's
      D-PHY reset. Active-low: write 0 to assert, write 1 to deassert.
      Present for MIPI-DSI and MIPI-CSI sub-domains only.
      Bit 17 = DSI1 master PHY (GPR_MIPI_M_RESETN).
      Bit 16 = CSI1 slave PHY (GPR_MIPI_S_RESETN).
      Bit 29 = DSI2 master PHY (GPR_MIPI_M2_RESETN).
      Bit 30 = CSI2 slave PHY (GPR_MIPI_S2_RESETN).
```

## dts/bindings/power-domain/nxp,imx8mp-media-blk-ctrl.yaml
```yaml
# Copyright (C) 2026, Savoir-faire Linux
# SPDX-License-Identifier: Apache-2.0

description: |
  NXP i.MX8M Plus Media Block Control (MEDIA_BLK_CTRL).

  Top-level MEDIAMIX controller at 0x32ec0000 that gates clocks, asserts and
  releases active-low soft resets (SFT_RSTN, offset 0x00), releases MIPI D-PHY
  resets (MIPI_RESET_DIV, offset 0x08), and programs the LCDIF1 read-hurry
  priority (LCDIF_ARCACHE_CTRL 0x4c, bits 12:10) for the i.MX8MP media
  subsystem (LCDIF, MIPI-DSI/CSI, ISI, ISP, DWE).

  Programs the NIC-301 Media NOC AXI arbiter to give LCDIF1 the BSP-canonical
  bus priority by default. Boards with tighter display-under-load margins can
  raise the LCDIF1 NOC priority through devicetree.

  Acts as a Zephyr power-domain provider: each media sub-domain is represented as
  a child node (compatible "nxp,imx8mp-media-blk-ctrl-domain") that media
  peripherals reference through the standard "power-domains" property.

  The parent brings up the always-on "bus" sub-domain (CLK_EN/SFT_RSTN bit 8)
  and programs QoS at initialization.

examples:
  - |
    media_blk_ctrl: media-blk-ctrl@32ec0000 {
        compatible = "nxp,imx8mp-media-blk-ctrl";
        reg = <0x32ec0000 0x10000>, <0x32700000 0x10000>;
        reg-names = "ctrl", "noc";
        #address-cells = <1>;
        #size-cells = <0>;
        status = "okay";

        mbc_mipi_dsi1: power-domain@0 {
            compatible = "nxp,imx8mp-media-blk-ctrl-domain";
            reg = <IMX8MP_MEDIABLK_PD_MIPI_DSI_1>;
            nxp,rst-mask = <0x3>;
            nxp,clk-mask = <0x3>;
            nxp,mipi-phy-rst-mask = <0x20000>;
            #power-domain-cells = <0>;
            status = "okay";
        };
    };

compatible: "nxp,imx8mp-media-blk-ctrl"

include: [base.yaml]

properties:
  reg:
    required: true
    description: |
      MEDIA_BLK_CTRL register block and NIC-301 Media NOC register block.

  reg-names:
    required: true
    description: Must contain "ctrl" and "noc", in that order.

  "#address-cells":
    required: true
    const: 1

  "#size-cells":
    required: true
    const: 0

  nxp,lcdif-rd-hurry:
    type: int
    enum: [0, 1, 2, 3, 4, 5, 6, 7]
    default: 7
    description: |
      LCDIF1 read-hurry priority level written to LCDIF_ARCACHE_CTRL bits 12:10
      (i.MX8MP RM §13.2.2, §13.2.3). Range 0-7; level 7 gives maximum urgency
      signalling to the NoC.

  nxp,lcdif-noc-priority:
    type: int
    default: 0x80000202
    description: |
      LCDIF1 read/write NIC-301 priority value written to the LCDIF1 RD/WR QoS
      priority registers. The default is the BSP-canonical i.MX8MP value used by
      Arm TF-A and Linux imx8m-blk-ctrl. Boards that observe LCDIF starvation
      under heavy DDR load may raise this value, for example to 0x80000f0f.
```

## dts/bindings/power-domain/nxp,scu-pd.yaml
```yaml
# Copyright 2024 NXP
# SPDX-License-Identifier: Apache-2.0

description: NXP SCU-managed power domain

compatible: "nxp,scu-pd"

include: power-domain.yaml

properties:
  nxp,resource-id:
    type: int
    required: true
    description:
      Number used by the firmware running on the SCU to identify
      the resource on which the PD-related operations are to be
      performed.
```

## dts/bindings/power-domain/power-domain-gpio-monitor.yaml
```yaml
# Copyright (c) 2023 Google LLC
# SPDX-License-Identifier: Apache-2.0

description: |
  Simple monitorig power domain

  This power domain monitors the state of a GPIO pin to detect whether a power
  rail is on/off. Therefore, performing resume/suspend on power domain won't
  change physical state of power rails and that action won't be triggered on
  child nodes. Additionally, due to the asynchronous nature of monitoring, a
  pending transaction won't be interrupted by power state change.

compatible: "power-domain-gpio-monitor"

include: power-domain.yaml

properties:
  gpios:
    type: phandle-array
    required: true
    description: |
      GPIO to use to sense if rail is powered on.
```

## dts/bindings/power-domain/power-domain-gpio.yaml
```yaml
# Copyright (c) 2022, CSIRO
# SPDX-License-Identifier: Apache-2.0

description: Simple GPIO controlled power domain

compatible: "power-domain-gpio"

include: power-domain.yaml

properties:
  enable-gpios:
    type: phandle-array
    required: true
    description: |
      GPIO to use to enable/disable the regulator.

      Unlike the gpio property in the Linux bindings this array must
      provide the GPIO polarity and open-drain status in the phandle
      selector.  The Linux enable-active-high and gpio-open-drain
      properties are not valid for Zephyr devicetree files.

  raw-follower-gpios:
    type: phandle-array
    description: |
      Extra list of GPIOs that 'follow' the state of the power domain.
      These GPIOs are set to physical level '0' when the domain transitions
      to SUSPENDED, and set to physical level '1' when the domain transitions
      to ACTIVE. The logical levels (ACTIVE_HIGH/ACTIVE_LOW) are not modified
      by this action (through gpio_pin_configure).

      This behaviour is intended to be used when an SPI device is on a power
      domain and the CS pin is explicitly driven high and low by the SoC,
      instead of having an external pull-up to the voltage rail. The idle
      state of the CS pin needs to be high, but when the power domain goes down
      the CS pin needs to go low to avoid back-powering the device.

      This property is NOT needed when the CS pins have an external pullup
      to the voltage rail that is being switched.

  startup-delay-us:
    type: int
    default: 0
    description: Startup time, in microseconds

  off-on-delay-us:
    type: int
    default: 0
    description: Off delay time, in microseconds
```

## dts/bindings/power-domain/power-domain-regulator.yaml
```yaml
# Copyright (c) 2023 T-Mobile USA, Inc.
# SPDX-License-Identifier: Apache-2.0

description: Regulator controlled power domain

compatible: "power-domain-regulator"

include: power-domain.yaml

properties:
  regulator:
    type: phandle
    required: true
    description: |
      Regulator node name.

  startup-delay-us:
    type: int
    default: 0
    description: Startup time, in microseconds

  off-on-delay-us:
    type: int
    default: 0
    description: Off delay time, in microseconds
```

## dts/bindings/power-domain/power-domain-soc-state-change.yaml
```yaml
# Copyright 2024-25 NXP
# SPDX-License-Identifier: Apache-2.0

description: |
  This power domain will Turn On and Off devices when transitioning
  in and out a specified Power State. Power States that trigger this
  action is specified via the onoff-power-states property.

compatible: "power-domain-soc-state-change"

include: power-domain.yaml

properties:
  onoff-power-states:
    type: phandles
    description: |
      List of power management states.
      The registered devices will be turned off before the PM subsystem
      enters these PM states. The devices will be turned on after the
      PM subsystem exits these PM states.

  "#power-domain-cells":
    const: 0
```
