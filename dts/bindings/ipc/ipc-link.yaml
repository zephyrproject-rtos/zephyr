## dts/bindings/led/ti,lp5569.yaml
```yaml
description: TI LP5569 LED

compatible: "ti,lp5569"

include: i2c-device.yaml

properties:
  enable-gpios:
    type: phandle-array
    description: |
      GPIO used to enable the lp5569.

  charge-pump-mode:
    type: string
    default: "disabled"
    enum:
      - "disabled"
      - "1x"
      - "1x5"
      - "auto"
    description: |
      If provided, configures the internal charge-pump mode in the MISC
      register. This can be useful to supply a higher voltage to the LEDs, than
      what the lp5569 is being supplied.
      The default corresponds to the reset value of the register.

  int-clk-en:
    type: boolean
    description: |
      Internal 32kHz clock-enable select. Default disabled on reset.
      Disabled: External 32-kHz clock is used from CLK input pin
      Enabled:  Internal 32-kHz oscillator is enabled

  en-clk-out:
    type: boolean
    description: |
      clk pin is configured as output. Default disabled on reset.
      Disabled: CLK pin is an input
      Enabled: CLK pin is an output driven by the internal 32-kHz oscillator

  cp-return-1x:
    type: boolean
    description: |
      Charge-pump return to 1× mode select. Default disabled on reset.
      Disabled: Charge-pump mode is not affected during shutdown or power-save entry
      Enabled:  Charge-pump mode is forced to 1x mode during shutdown or power-save entry

  powersave-en:
    type: boolean
    description: |
      Power-save mode enable select. Default disabled on reset.
```

## dts/bindings/led/ti,lp5814.yaml
```yaml
# SPDX-FileCopyrightText: Copyright The Zephyr Project Contributors
# SPDX-License-Identifier: Apache-2.0

description: |
  Texas Instruments LP5814 four-channel I2C LED controller.

  Each child describes one physical output. The LED API indexes children
  in devicetree order; write_channels addresses physical outputs directly.
  The driver supports manual PWM brightness with per-output current limits.
  Autonomous animation and fading are not supported.

compatible: "ti,lp5814"

include: [i2c-device.yaml, led-controller.yaml]

child-binding:
  description: LED connected to a constant-current output
  properties:
    index:
      required: true
      enum: [0, 1, 2, 3]
      description: Physical output number (OUT0 through OUT3).

    led-max-microamp:
      type: int
      required: true
      description: |
        Maximum current through this LED in microamperes, from 0 to 51000.
        The controller uses 100 microampere steps when all outputs are at
        most 25500 microamperes, otherwise 200 microampere steps. Values
        are rounded down to the nearest supported current.
```

## dts/bindings/led/zephyr,led-strip-cache.yaml
```yaml
# Copyright (c) 2026 Simon Guinot <simon.guinot@sequanux.org>
# SPDX-License-Identifier: Apache-2.0

title: LED strip cache.

description: |
  A virtual LED device composed of one or more LED strip devices.

  The LED strip devices are concatenated in the order specified by `led-strips`.

compatible: "zephyr,led-strip-cache"

properties:
  led-strips:
    required: true
    type: phandles
    min-len: 1
    description: |
      References to LED strip nodes.

examples:
  - |
    / {
            led_strip_0: led-strip-0 {
                    compatible = "vnd,led-strip-0";
                    chain-length = <8>;
                    color-mapping = <LED_COLOR_ID_RED
                                     LED_COLOR_ID_GREEN
                                     LED_COLOR_ID_BLUE>;
            };

            led_strip_1: led-strip-1 {
                    compatible = "vnd,led-strip-1";
                    chain-length = <10>;
                    color-mapping = <LED_COLOR_ID_BLUE
                                     LED_COLOR_ID_GREEN
                                     LED_COLOR_ID_RED>;
            };

            leds {
                    compatible = "zephyr,led-strip-cache";
                    led-strips = <&led_strip_0>, <&led_strip_1>;
            };
    };
```

## dts/bindings/led_strip/realtek,ameba-ledc.yaml
```yaml
# Copyright (c) 2026 Realtek Semiconductor Corp.
# SPDX-License-Identifier: Apache-2.0

description: Ameba Ledc

compatible: "realtek,ameba-ledc"

include: [base.yaml, pinctrl-device.yaml, led-strip.yaml]

# The timing properties below are raw LEDC register counts of the 40 MHz
# LEDC clock (25 ns per count), not nanoseconds.

properties:

  pinctrl-0:
    required: true

  pinctrl-names:
    required: true

  output-rgb-mode:
    type: int
    required: true
    description: |
      LEDC output byte order selector (LED_RGB_MODE register field). Keep this
      at 0 (identity); the on-wire color order is set with color-mapping.

  wait-data-timeout:
    type: int
    required: true
    description: |
      Time the LEDC waits for new FIFO data before raising a wait-data
      timeout. Wait time = 25 ns * (N + 1), N in 0..0x7fff.

  data-tx-time0h:
    type: int
    required: true
    description: High time of a 0 code. Time = 25 ns * N, N > 0.

  data-tx-time0l:
    type: int
    required: true
    description: Low time of a 0 code. Time = 25 ns * N, N > 0.

  data-tx-time1h:
    type: int
    required: true
    description: High time of a 1 code. Time = 25 ns * N, N > 0.

  data-tx-time1l:
    type: int
    required: true
    description: Low time of a 1 code. Time = 25 ns * N, N > 0.

  refresh-time:
    type: int
    required: true
    description: |
      Reset (latch) low time sent after a frame.
      Reset time = 25 ns * (N + 1), N in 0..0x3fff.
```

## dts/bindings/led_strip/worldsemi,ws2812-nrf-pwm.yaml
```yaml
# Copyright (c) 2026 The Zephyr Project Contributors
# Copyright (c) 2026 Dev It Wise
# SPDX-License-Identifier: Apache-2.0

description: |
  WS2812-family addressable LED strip driven by the nRF PWM peripheral with
  EasyDMA. The strip is its own node; it takes one nRF PWM instance through the
  'generator' phandle and drives it directly, the way nordic,nrf-sw-pwm takes a
  TIMER or RTC instance. That instance must be left disabled so that Zephyr's
  own PWM driver does not bind it, and its pinctrl states select the output pin
  that carries the WS2812 data line.

compatible: "worldsemi,ws2812-nrf-pwm"

include: ws2812.yaml

properties:
  generator:
    type: phandle
    required: true
    description: |
      The nRF PWM instance this strip drives. The driver claims it outright:
      it takes the nrfx instance from the referenced node's register address,
      connects that node's interrupt, and applies that node's pinctrl default
      state. Leave the referenced node disabled - Zephyr's PWM driver must not
      bind the same instance.

  time-t0h:
    type: int
    default: 400
    description: |
      How long the output signal stays high to signify a 0 bit, in
      nanoseconds. The default is the time for WS2812B (0.4us +/- 150ns).

  time-t1h:
    type: int
    default: 800
    description: |
      How long the output signal stays high to signify a 1 bit, in
      nanoseconds. The default is the time for WS2812B (0.8us +/- 150ns).

  time-total:
    type: int
    default: 1250
    description: |
      How long one bit, a pulse containing a high and a low part, lasts, in
      nanoseconds. The default is the time for WS2812B (1.25us +/- 600ns).
      Slower WS2812 clones that lose the chain partway down need a longer
      period - e.g. 2000 ns, which matches the relaxed timing many "WS2812"
      parts actually require.
```

## dts/bindings/led_strip/worldsemi,ws2812-pulse-io.yaml
```yaml
# Copyright (c) 2026 Espressif Systems (Shanghai) Co., Ltd.
# SPDX-License-Identifier: Apache-2.0

description: |
  Worldsemi WS2812 LED strip, pulse_io binding

  Drives a WS2812 (or compatible) LED strip through a pulse_io
  controller channel in CELL mode.

compatible: "worldsemi,ws2812-pulse-io"

include: ws2812.yaml

properties:
  pulse-ios:
    type: phandle-array
    required: true
    description: |
      pulse_io controller and transmit channel driving the strip
      data line. The pin is routed through the controller pinctrl
      state.

examples:
  - |
    / {
          led_strip: ws2812 {
              compatible = "worldsemi,ws2812-pulse-io";
              pulse-ios = <&rmt 0>;
              chain-length = <1>;
              color-mapping = <LED_COLOR_ID_GREEN
                               LED_COLOR_ID_RED
                               LED_COLOR_ID_BLUE>;
          };
    };
```

## dts/bindings/lora/rakwireless,rui3.yaml
```yaml
# SPDX-FileCopyrightText: Copyright (c) 2026 RAKwireless Technology Limited
# SPDX-License-Identifier: Apache-2.0

description: |
  RAKwireless module running the RUI3 firmware, driven over its AT command
  interface in LoRa P2P mode.

  RUI3 is the firmware RAKwireless ships on its WisDuo modules, among them the
  RAK3172, RAK4630 and RAK11720. It answers AT commands on a UART and works
  either as a LoRaWAN end device or as a raw LoRa transceiver. This driver uses
  the latter and switches the module to P2P with AT+NWM=0 when it is not
  already there.

  The module keeps part of its configuration in flash, so the driver sends a
  command only for a value that differs from the one it last applied, and a
  change of network work mode costs a reboot.

  The RUI3 version the driver expects is a Kconfig option, not a devicetree
  property: the firmware runs on the module and is flashed independently, so
  the driver queries it at init.

compatible: "rakwireless,rui3"

include: uart-device.yaml

properties:
  reset-gpios:
    type: phandle-array
    description: |
      Reset line of the module, active low. Modules whose reset pin is not
      wired to the host leave this out, and the driver then resets the module
      with ATZ instead.
```

## dts/bindings/lora/semtech,lr2012.yaml
```yaml
# Copyright (c) 2026 MASSDRIVER EI (massdriver.space)
# SPDX-License-Identifier: Apache-2.0

title: Semtech LR2012 LoRa Modem

description: |
  Semtech LR2012 LoRa Modem.
  It supports 150-960MHz sub-GHz ISM bands only.
  On top of this, LR2012 loses FLRC, O-QPSK, Z-Wave and BLE support compared to LR2021.

compatible: "semtech,lr2012"

include: semtech,lr20xx-base.yaml

properties:
  reset-gpios:
    required: true
  busy-gpios:
    required: true
  irq-gpios:
    required: true
  dio-functions:
    required: true
  dio-sleep-pulls:
    required: true
```

## dts/bindings/lora/semtech,lr2022.yaml
```yaml
# Copyright (c) 2026 MASSDRIVER EI (massdriver.space)
# SPDX-License-Identifier: Apache-2.0

title: Semtech LR2022 LoRa Modem

description: |
  Semtech LR2022 LoRa Modem.
  It supports 150-960MHz sub-GHz ISM bands, 1.9-2.1GHz Satellite bands, and the 2.4GHz ISM band.
  It has continuous spectrum coverage over 150-960MHz and 1500-2500MHz ranges.
  LR2022 loses FLRC, O-QPSK, and Z-Wave support compared to LR2021.

compatible: "semtech,lr2022"

include: semtech,lr20xx-base.yaml

properties:
  reset-gpios:
    required: true
  busy-gpios:
    required: true
  irq-gpios:
    required: true
  dio-functions:
    required: true
  dio-sleep-pulls:
    required: true
```

## dts/bindings/lora/semtech,lr20xx-base.yaml
```yaml
# Copyright (c) 2026 MASSDRIVER EI (massdriver.space)
# SPDX-License-Identifier: Apache-2.0

include: spi-device.yaml

properties:
  reset-gpios:
    type: phandle-array
    description: |
      Pin connected to the modem's typically active-low RESET signal.

  busy-gpios:
    type: phandle-array
    description: |
      Pin connected to the modem's typically active-high BUSY signal.

  irq-gpios:
    type: phandle-array
    description: |
      Pin connected to the modem's typically active-high IRQ Pin.

  dio-functions:
    type: string-array
    min-len: 7
    max-len: 7
    enum:
      - "NONE"
      - "IRQ"
      - "RFSW"
      - "RESERVED_0"
      - "RESERVED_1"
      - "GPIO_LOW"
      - "GPIO_HIGH"
      - "HF_OUT"
      - "LF_OUT"
      - "TX_TRIGGER"
      - "RX_TRIGGER"
    description: |
      Function to use for DIOs, from DIO5 to DIO11.
      - NONE: No function, Hi-Z.
      - IRQ: Use as IRQ pin. Only one of these must be used for this driver.
      - RFSW: Use as a RF Switch pin.
      - RESERVED_0: Unused pin function ID.
      - RESERVED_1: Unused pin function ID.
      - GPIO_LOW: Set pin low.
      - GPIO_HIGH: Set pin high.
      - HF_OUT: Output the HF clock on this pin.
      - LF_OUT: Output the LF clock on this pin. Only DIO7 to 11 support this.
      - TX_TRIGGER: Triggers SetTx with the default timeout when switched high.
      - RX_TRIGGER: Triggers SetRx with the default timeout when switched high.

  dio-sleep-pulls:
    type: string-array
    min-len: 7
    max-len: 7
    enum:
      - "NONE"
      - "DOWN"
      - "UP"
      - "AUTO"
    description: |
      The pull applied to each pin when entering sleep, from DIO5 to DIO11.
      DIO5 only supports UP.

  tcxo-voltage:
    type: int
    default: 0
    enum:
      - 1600
      - 1700
      - 1800
      - 2200
      - 2400
      - 2700
      - 3000
      - 3300
      - 0
    description: |
      TCXO voltage in mV, except 0 where TCXO is disabled.
      The default is no TCXO is used.

  lf-clk:
    type: string
    default: "RC"
    enum:
      - "RC"
      - "RESERVED"
      - "DIO11"
    description: |
      Low frequency clock source for the radio.
      - RC: 32.768KHz RC Oscillator.
      - RESERVED: Unused ID.
      - DIO11: 32.768KHz Signal on DIO11.
      Using the RC is by far the most common so it is default.

  tcxo-power-startup-delay-ms:
    type: int
    default: 5
    min: 1
    max: 1500
    description: |
      Startup delay to let the TCXO stabilize after TCXO power on. 5 ms is usually sufficient.

  rfsw-standby:
    type: int
    default: 0
    description: |
      RF switch state in standby mode.
      - A[0]: DIO5
      - A[1]: DIO6
      - A[2]: DIO7
      - A[3]: DIO8
      - A[4]: DIO9
      - A[5]: DIO10
      - A[6]: DIO11
      Defines which RFSW GPIOs are set high (bit set) or low (bit unset) in the mode.
      Pins used in any mode must be configured as RFSW in dio-functions.

  rfsw-rx-lf:
    type: int
    default: 0
    description: RF switch state in sub-GHz RX mode. See rfsw-standby.

  rfsw-tx-lf:
    type: int
    default: 0
    description: RF switch state in sub-GHz TX mode. See rfsw-standby.

  rfsw-rx-hf:
    type: int
    default: 0
    description: RF switch state in high-frequency, RX mode. See rfsw-standby.

  rfsw-tx-hf:
    type: int
    default: 0
    description: RF switch state in high-frequency TX mode. See rfsw-standby.

  use-simo:
    type: boolean
    description: Use SIMO regulator instead of LDO (RegMode = 2, SIMO_NORMAL).

  force-ldro:
    type: boolean
    description: |
      Force usage of Low Data Rate Optimization even in cases where the symbol time is shorter than
      16.38ms. Useful for designs using no TCXO or with bad heat dissipation.

  rx-boosted:
    type: boolean
    description: |
      Enable RX boosted mode, which increases the power consumption of
      RX mode by ~1.2mA in exchange for ~0.5 to ~1dB sensitivity improvement.
```
