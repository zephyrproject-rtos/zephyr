## dts/bindings/ipc/ipc-link.yaml
```yaml
# SPDX-FileCopyrightText: Copyright (c) 2026 Basalte bv
# SPDX-License-Identifier: Apache-2.0

# Common properties of the IPC link backend transports

include: base.yaml

properties:
  retransmit-timeout-ms:
    type: int
    default: 100
    description: |
      Time without acknowledgment after which a payload is sent again, in milliseconds. Also the
      interval of the boot announcements while the peer does not answer, and of the polls for
      credits. Longer than the time a frame takes on the wire, both ways.
```

## dts/bindings/ipc/zephyr,ipc-spi-peripheral.yaml
```yaml
# SPDX-FileCopyrightText: Copyright (c) 2026 Basalte bv
# SPDX-License-Identifier: Apache-2.0

description: |
  IPC service instance over an SPI bus, the IPC link backend's SPI transport in the peripheral
  role. A child node of the SPI controller, in peripheral mode, connected to the peer, which runs
  the controller role. The driver needs the asynchronous SPI API. The RDY and IRQ lines are
  outputs here.

compatible: "zephyr,ipc-spi-peripheral"

include: ipc-link-spi.yaml
```

## dts/bindings/ipc/zephyr,ipc-spi.yaml
```yaml
# SPDX-FileCopyrightText: Copyright (c) 2026 Basalte bv
# SPDX-License-Identifier: Apache-2.0

description: |
  IPC service instance over an SPI bus, the IPC link backend's SPI transport in the controller
  role. A child node of the SPI controller connected to the peer, which runs the peripheral role.

compatible: "zephyr,ipc-spi"

examples:
  - |
    #include <zephyr/dt-bindings/gpio/gpio.h>

    &spi1 {
        ipc0: ipc-spi@0 {
            compatible = "zephyr,ipc-spi";
            reg = <0>;
            spi-max-frequency = <8000000>;
            rdy-gpios = <&gpio0 10 GPIO_ACTIVE_HIGH>;
            irq-gpios = <&gpio0 11 GPIO_ACTIVE_HIGH>;
        };
    };

include: ipc-link-spi.yaml
```

## dts/bindings/ipc/zephyr,ipc-uart.yaml
```yaml
# SPDX-FileCopyrightText: Copyright (c) 2026 Basalte bv
# SPDX-License-Identifier: Apache-2.0

description: |
  IPC service instance over a UART, the IPC link backend's UART transport. A child node of the
  UART controller connected to the peer, which runs the same transport.

compatible: "zephyr,ipc-uart"

examples:
  - |
    &uart1 {
        ipc0: ipc-uart {
            compatible = "zephyr,ipc-uart";
        };
    };

include: [uart-device.yaml, ipc-link.yaml]

properties:
  mtu:
    type: int
    default: 256
    description: |
      Frame size in bytes, a multiple of 4, the same on both sides: the header carries it, and a
      peer with another size is reported and never connects. A frame holds a 12 byte header, the
      messages, each with a 4 byte header, and a 2 byte CRC.
```

## dts/bindings/ipm/ti,k3-rproc-ipm.yaml
```yaml
# Copyright (c) 2026 Chrispine Tinega <dev@chrispinetinega.com>
# SPDX-License-Identifier: Apache-2.0

description: |
  Remoteproc control messages for a TI K3 remote core.

  TI's Linux kernel stops a K3 remote core by sending RP_MBOX_SHUTDOWN over
  the mailbox and waiting for RP_MBOX_SHUTDOWN_ACK. This IPM device sits in
  front of the IPM device that carries the mailbox. It answers the request
  and halts the core for the host to reset, and passes every other message
  through. Point zephyr,ipc at it, and the application needs no change:

    chosen {
      zephyr,ipc = &rproc_ipm;
    };

    rproc_ipm: rproc-ipm {
      compatible = "ti,k3-rproc-ipm";
      ipm-node = <&ipc0>;
    };

    ipc0: ipc {
      compatible = "zephyr,mbox-ipm";
      mboxes = <&mbox0 0>, <&mbox0 1>;
      mbox-names = "tx", "rx";
    };

compatible: "ti,k3-rproc-ipm"

include: base.yaml

properties:
  ipm-node:
    type: phandle
    required: true
    description: The IPM device that carries the mailbox.
```

## dts/bindings/jdi/sifli,sf32lb-jdi.yaml
```yaml
# Copyright (c) 2026 Qingsong Gou <gouqs@hotmail.com>
# SPDX-License-Identifier: Apache-2.0

include:
  - jdi-device.yaml
  - pinctrl-device.yaml

description: Sifli sf32lb JDI LCD Bus Controller

compatible: "sifli,sf32lb-jdi"

properties:
  pinctrl-0:
    required: true

  pinctrl-names:
    required: true
```

## dts/bindings/knx/onnn,ncn5130.yaml
```yaml
# Copyright (c) 2026 Fabien Proriol
# SPDX-License-Identifier: Apache-2.0

description: |
  ON Semiconductor NCN5130 KNX TP1 transceiver.

  The NCN5130 is attached to a UART controller (38400 bps, 9 data bits, no
  hardware parity) and is represented as a child node of that controller,
  not as a sibling referencing it by phandle.

compatible: "onnn,ncn5130"

include: uart-device.yaml

examples:
  - |
    &lpuart1 {
        current-speed = <38400>;
        status = "okay";

        ncn5130: ncn5130 {
            compatible = "onnn,ncn5130";
            status = "okay";
        };
    };
```

## dts/bindings/led/awinic,aw9523b-led.yaml
```yaml
# Copyright (c) 2026 Smartbox Assistive Technlogy Ltd.
# SPDX-License-Identifier: Apache-2.0

description: AW9523B LED Controller

compatible: "awinic,aw9523b-led"

on-bus: aw9523b

include: ["base.yaml", "led-controller.yaml"]

properties:
  i-max-microamp:
    type: int
    description: Global LED Max Current
    enum: [37000, 27750, 18500, 9250]
    default: 37000

child-binding:
  properties:
    port:
      type: int
      required: true
      description: AW9523B LED port number (0..1)
      enum: [0, 1]
    pin:
      type: int
      required: true
      description: AW9523B LED pin/channel number (0..7)
      enum: [0, 1, 2, 3, 4, 5, 6, 7]
```

## dts/bindings/led/diodes,al5887.yaml
```yaml
# Copyright (c) 2026 Mission Embedded GmbH
# SPDX-License-Identifier: Apache-2.0

title: Diodes AL5887 36-channel I2C LED controller

description: |
  The AL5887 drives 36 constant-current outputs, organised as 12 RGB modules.
  Its register map is compatible with the TI LP5036, so it uses the LP50xx
  driver. LED n is driven by OUT(3n), OUT(3n+1) and OUT(3n+2), in the order
  given by its color-mapping property.

  The output current limit is
    I_MAX = K_IREF * 0.7 V / R_SET * (Max_Current_Option / 4 + 3 / 4)
  where K_IREF is set by the global-dimming property.

compatible: "diodes,al5887"

include: ti,lp50xx.yaml

properties:
  max-curr-opt:
    type: boolean
    description: |
      Sets Max_Current_Option. If enabled, the maximum output current is
      39 mA, otherwise 29.25 mA, with R_SET = 2.1 kOhm and global-dimming
      at its default value. Unlike the chip's reset value, where this option
      is enabled, it is cleared unless this property is given.

  phase-shift-disable:
    type: boolean
    description: |
      Disables PWM phase shifting. By default the PWM pulses of the outputs are
      delayed in three phases to reduce the peak supply current.

  global-dimming:
    type: int
    default: 0
    description: |
      Value of the 6-bit LED_GLOBAL_DIMMING register (G5:G0), which sets the
      current multiplication factor K_IREF = 117 + 3 * N, where N is G5:G0 as a
      two's complement number. The default corresponds to the register's power-on
      reset value. With R_SET = 2.1 kOhm and max-curr-opt enabled:
      0 (default) gives 39 mA, 31 gives the maximum of 70 mA, 32 gives the
      minimum of 7 mA, 63 gives 38 mA.
    min: 0
    max: 63
```

## dts/bindings/led/hzgrow,r502a-led.yaml
```yaml
# SPDX-FileCopyrightText: Copyright (c) 2026 Silicon Laboratories Inc.
# SPDX-License-Identifier: Apache-2.0

title: HZ-Grow R502A fingerprint sensor LED

description: |
  The built-in LED ring of an HZ-Grow R502A fingerprint sensor.

  The driver controls the LED through the hzgrow,r502a sensor with the same
  instance number, so the node takes no properties.

compatible: "hzgrow,r502a-led"

class: led

examples:
  - |
    &uart2 {
            led {
                    compatible = "hzgrow,r502a-led";
            };
    };
```

## dts/bindings/led/issi,is31fl3195.yaml
```yaml
# SPDX-FileCopyrightText: Copyright The Zephyr Project Contributors
# SPDX-License-Identifier: Apache-2.0

description: |
  IS31FL3195 4-channel LED driver with programmable pattern sequencing

compatible: "issi,is31fl3195"

include: ["i2c-device.yaml", "led-controller.yaml"]

child-binding:
  properties:
    label:
      required: true

    color-mapping:
      required: true

    current-limit:
      type: int
      enum:
        - 10
        - 20
        - 30
        - 40
      required: true
      description: |
        The current limit for the LED in mA.

examples:
  - |
    /* Single RGB LED */
    is31fl3195@54 {
      compatible = "issi,is31fl3195";
      reg = <0x54>;

      led_0 {
        label = "RGB LED";
        color-mapping =
          <LED_COLOR_ID_RED>,
          <LED_COLOR_ID_GREEN>,
          <LED_COLOR_ID_BLUE>;
        current-limit = <20>;
      };
    };
```

## dts/bindings/led/issi,is31fl3743b.yaml
```yaml
# Copyright (c) 2026 Open Device Partnership and Contributors
#
# SPDX-License-Identifier: Apache-2.0

description: |
  ISSI IS31FL3743B LED Matrix Driver.

  The IS31FL3743B is an 11x18 LED Matrix controlled via SPI.

  The maximum output current per sink is set by an external R_ISET resistor,
  scaled by the global current control register (see the current-limit
  property). The device also supports display blanking via software shutdown,
  and clock synchronization (see sync-mode).

  LED indexes used with the LED API enumerate the matrix as follows:
  index = (SW - 1) * 18 + (CS - 1).

  `CS` numbers between `CS1-CS18`, and `SW` numbers between `SW1-SW11`. So,
  you can think of `SW1-SW11` as the matrix columns, and `CS1-CS18` as the matrix
  rows. In that case, you could use:
  index = (col - 1) * 18 + (row - 1).

compatible: "issi,is31fl3743b"

include: "spi-device.yaml"

properties:
  sdb-gpios:
    type: phandle-array
    description: |
      Hardware shutdown pin. If routed on the board, this property must be
      present. Set to a logical 1 at boot to exit the device from hardware
      shutdown.

  current-limit:
    type: int
    default: 0xFF
    min: 0
    max: 0xFF
    description: |
      Global current limit. Sets the global current control (GCC) register of
      the LED driver. Limits the global output current based on the following
      formula: (343/R_ISET) * (current-limit/256). Defaults to the max value
      of 0xFF, so LED output is still enabled if the property is not provided.

  sync-mode:
    type: string
    default: "none"
    enum:
      - "none"
      - "source"
      - "receiver"
    description: |
      This property configures the device to generate the synchronization clock
      as a source or accept an external synchronization clock as a receiver.
      This can synchronize the output of multiple LED controllers sharing a
      SYNC line. See the SYNC bits in the spread spectrum register for more
      information.
```

## dts/bindings/led/kinetic,ktd2052.yaml
```yaml
# SPDX-License-Identifier: Apache-2.0
# SPDX-FileCopyrightText: Copyright (c) 2026 sevenlab engineering GmbH

description: |
  Kinetic KTD2052 RGB LED driver: a 4 x RGB LED current sink controlled over I2C.

  The KTD2052 drives four RGB modules, each with three channels in the order red, green,
  blue. Child nodes are optional. Without them, LEDs 0 to 3 of the LED API are modules 0 to 3.
  With them, LED n of the LED API is the n-th child node, its index selects the module, and
  the child describes the LED for led_get_info().

compatible: "kinetic,ktd2052"

include: ["i2c-device.yaml", "led-controller.yaml"]

child-binding:
  properties:
    label:
      required: true

    index:
      required: true
      description: RGB module of the KTD2052 that this LED is wired to, 0 to 3.

    color-mapping:
      required: true

examples:
  - |
    #include <zephyr/dt-bindings/led/led.h>

    ktd2052@74 {
      compatible = "kinetic,ktd2052";
      reg = <0x74>;

      led_0 {
        label = "RGB LED 0";
        index = <0>;
        color-mapping = <LED_COLOR_ID_RED>,
                        <LED_COLOR_ID_GREEN>,
                        <LED_COLOR_ID_BLUE>;
      };
    };
```

## dts/bindings/led/led-matrix.yaml
```yaml
# Copyright (c) 2026, Hubert Miś
# SPDX-License-Identifier: Apache-2.0
include: base.yaml

title: LED matrix with rows and columns managed by separate LED drivers.

description: |
  Rows are responsible for controlling the power sources or sinks for the LEDs, while columns
  handle the complementary power control.

  The configuration requires one LED driver to manage the rows and another to manage the columns.
  Each row is treated as a single channel by its respective driver, and the same applies to each
  column.

  The driver operates by cycling through the rows: it deactivates the currently active row, updates
  the column states for the next row, activates the next row, and then pauses for the specified
  refresh time before repeating the process.

  Child nodes describe individual LEDs. The LED API index is the child's order among siblings
  (0 for the first child). Each child maps that index to a matrix position via its row and col
  properties. Positions must be unique and within num-rows / num-cols.

compatible: "led-matrix"

properties:
  rows:
    required: true
    type: phandle
    description: |
      Reference to the LED driver controlling the rows.

      Each row is controlled as one channel by the referred driver.

  columns:
    required: true
    type: phandle
    description: |
      Reference to the LED driver controlling the columns.

      Each column is controlled as one channel by the referred driver.

  num-rows:
    required: true
    type: int
    description: |
      Number of rows available in this LED matrix.

  num-cols:
    required: true
    type: int
    description: |
      Number of columns available in this LED matrix.

  refresh-rate-ms:
    required: true
    type: int
    description: |
      Refresh rate of the LED matrix in milliseconds.

      This defines the pause duration before cycling to the next row.

child-binding:
  description: |
    Single LED in the matrix.

    The LED API uses the child's sibling index (0-based order in the parent) as the LED number
    passed to led_on() / led_off() / led_set_brightness(). row and col select where that LED sits
    in the scanned framebuffer.

  properties:
    row:
      required: true
      type: int
      description: Zero-based row index of this LED in the matrix.

    col:
      required: true
      type: int
      description: Zero-based column index of this LED in the matrix.

examples:
  - |
    / {
            led_matrix {
                    compatible = "led-matrix";

                    rows = <&leds>;
                    num-rows = <2>;
                    columns = <&pwm_leds>;
                    num-cols = <2>;

                    refresh-rate-ms = <5>;

                    led_0 {
                            row = <0>;
                            col = <0>;
                    };

                    led_1 {
                            row = <1>;
                            col = <0>;
                    };

                    led_2 {
                            row = <0>;
                            col = <1>;
                    };
            };
    };
```

## dts/bindings/led/nxp,pca9533.yaml
```yaml
# SPDX-FileCopyrightText: Copyright The Zephyr Project Contributors
# SPDX-License-Identifier: Apache-2.0

description: NXP PCA9533 4-bit LED dimmer

compatible: "nxp,pca9533"

include: nxp,pca953x.yaml
```
