## dts/bindings/gnss/quectel,lc76g.yaml
```yaml
# Copyright (c) 2023 Trackunit Corporation
# Copyright (c) 2023 Bjarki Arge Andreasen
# SPDX-License-Identifier: Apache-2.0

description: Quectel LC76G GNSS modem

compatible: "quectel,lc76g"

include:
  - uart-device.yaml
  - gnss-pps.yaml
```

## dts/bindings/gnss/quectel,lc86g.yaml
```yaml
# Copyright (c) 2023 Trackunit Corporation
# Copyright (c) 2023 Bjarki Arge Andreasen
# SPDX-License-Identifier: Apache-2.0

description: Quectel LC86G GNSS modem

compatible: "quectel,lc86g"

include:
  - uart-device.yaml
  - gnss-pps.yaml
```

## dts/bindings/gnss/u-blox,f9p.yaml
```yaml
# Copyright (c) 2025 Croxel Inc.
# Copyright (c) 2025 CogniPilot Foundation
# SPDX-License-Identifier: Apache-2.0

description: U-BLOX F9P High Precision GNSS Module

compatible: "u-blox,f9p"

include:
  - uart-device.yaml
  - u-blox,common.yaml
```

## dts/bindings/gnss/u-blox,m10.yaml
```yaml
# Copyright (c) 2026 CampOS
# SPDX-License-Identifier: Apache-2.0

description: U-BLOX M10 GNSS Module

compatible: "u-blox,m10"

include:
  - uart-device.yaml
  - u-blox,common.yaml
```

## dts/bindings/gnss/u-blox,m8.yaml
```yaml
# Copyright 2024 NXP
# SPDX-License-Identifier: Apache-2.0

description: U-BLOX M8 GNSS Module

compatible: "u-blox,m8"

include:
  - uart-device.yaml
  - u-blox,common.yaml
```

## dts/bindings/gnss/ublox,neom8.yaml
```yaml
# Copyright (c) 2022 Abel Sensors
# SPDX-License-Identifier: Apache-2.0

description: U-blox NEO-M8 GNSS Module

compatible: "u-blox,neom8"

include: i2c-device.yaml
```

## dts/bindings/gnss/zephyr,gnss-emul.yaml
```yaml
# Copyright (c) 2024 Trackunit Corporation
# SPDX-License-Identifier: Apache-2.0

description: Zephyr emulated GNSS device

compatible: "zephyr,gnss-emul"
```

## dts/bindings/gpio/96boards-lscon-1v8.yaml
```yaml
# Copyright (c) 2019 Linaro Ltd.
# SPDX-License-Identifier: Apache-2.0

title: 96BOARDS 1.8V LOW SPEED CONNECTOR

description: >
    This is a representation of GPIO pin nodes exposed on the 96Boards 1.8v low speed header

compatible: "96b-lscon-1v8"

include: [gpio-nexus.yaml, base.yaml]
```

## dts/bindings/gpio/96boards-lscon-3v3.yaml
```yaml
# Copyright (c) 2019 Linaro Ltd.
# SPDX-License-Identifier: Apache-2.0

title: 96BOARDS 3.3V LOW SPEED CONNECTOR

description: >
    This is a representation of GPIO pin nodes exposed on the 96Boards 3.3v low speed header

compatible: "96b-lscon-3v3"

include: [gpio-nexus.yaml, base.yaml]
```

## dts/bindings/gpio/adafruit-feather-header.yaml
```yaml
# Copyright (c) 2020 Richard Osterloh
# SPDX-License-Identifier: Apache-2.0

description: |
    GPIO pins exposed on Adafruit Feather headers.

    The Feather layout provides two headers, one each along
    opposite edges of the board.
    Proceeding counter-clockwise:
    * A 16-pin header.  12 pins on this header are exposed
      by this binding.
    * A 12-pin header.  9 pins on this header are exposed
      by this binding.

    This binding provides a nexus mapping for 21 pins where parent pins 0
    through 5 correspond to A0 through A5, and parent pins 6 through 20
    correspond as depicted below:

        - RESET
        - 3V3
        - 3V3
        - GND
        0 A0                     - VBAT
        1 A1                     - EN
        2 A2                     - VBUS
        3 A3                     D13  20
        4 A4                     D12  19
        5 A5                     D11  18
        6 SCK                    D10  17
        7 MOSI                   D9   16
        8 MISO                   D6   15
        9 RX                     D5   14
       10 TX                     SCL  13
       11 D4                     SDA  12


compatible: "adafruit-feather-header"

include: [gpio-nexus.yaml, base.yaml]
```

## dts/bindings/gpio/adi,ad5592-gpio.yaml
```yaml
# Copyright (c) 2023 Grinn
# SPDX-License-Identifier: Apache-2.0

description: AD5592 GPIO Controller

compatible: "adi,ad5592-gpio"

include: gpio-controller.yaml

gpio-cells:
  - pin
  - flags
```

## dts/bindings/gpio/adi,ad559x-gpio.yaml
```yaml
# Copyright (c) 2023 Grinn
# SPDX-License-Identifier: Apache-2.0

description: AD559x GPIO Controller

compatible: "adi,ad559x-gpio"

include: gpio-controller.yaml

gpio-cells:
  - pin
  - flags
```

## dts/bindings/gpio/adi,adp5585-gpio.yaml
```yaml
# Copyright 2024 NXP
# SPDX-License-Identifier: Apache-2.0

description: ADP5585 GPIO Controller

compatible: "adi,adp5585-gpio"

include: gpio-controller.yaml

properties:
  "#gpio-cells":
    const: 2

  ngpios:
    const: 13
    description: |
      Number of GPIOs available on port expander.

  gpio-reserved-ranges:
    required: true
    const: [5, 3]
    description: |
      Ranges of GPIOs reserved unavailable on port expander.
      The ADP5585 has 10 GPIO lines divided in 2 groups. GPIO number
      5, 6, 7 is reserved. That's to say, GPIO R0~R4 occupy line
      number 0~4, GPIO C0~C4 occupy line number 8~12.

gpio-cells:
  - pin
  - flags
```

## dts/bindings/gpio/adi,max14906-gpio.yaml
```yaml
# Copyright (c) 2024 Analog Devices Inc.
# Copyright (c) 2024 BayLibre SAS
# SPDX-License-Identifier: Apache-2.0

description: ADI MAX14906 quad industrial Input/Output with advanced diagnostics

compatible: "adi,max14906-gpio"

properties:
  "#gpio-cells":
    const: 2
  ngpios:
    type: int
    required: true
    const: 4
    description: Number of gpios supported
  drdy-gpios:
    description: |
      High-Side Open-Drain Output. READY is passive low when the internal
      logic supply is higher than the UVLO threshold, indicating that the
      registers have adequate supply voltage.
    type: phandle-array
  fault-gpios:
    description: |
      Fault pin indicates when there is Fault state in either FAULT1 or FAULT2
      bothe of which are cleaned on read once problem is not persistent.
    type: phandle-array
  sync-gpios:
    description: |
      Latch the data so it could be read (partially duplicate CS).
    type: phandle-array
  en-gpios:
    description: |
      DOI Enable Pin. Drive the EN pin high to enable the DOI_ outputs.
      Drive EN low to disable/three-state all DOI_ outputs.
    type: phandle-array
  crc-en:
    description: |
      Notify driver if crc pin is enabled.
    type: boolean
  spi-addr:
    type: int
    default: 0
    required: true
    enum:
      - 0
      - 1
      - 2
      - 3
    description: |
      On MAX14906PMB module default address is 0 (A0-LOW, A1-LOW)
      Selectable device address, configurable from A0 and A1
  ow-en:
    type: array
    default: [0, 0, 0, 0]
    description: |
      Default values are from documentation.
      Enable or disable open-wire functionality per channel.
      - 0 mean disable
      - 1 mean enable
      channels indentation start from CH0...CH3
  vdd-ov-en:
    type: array
    default: [0, 0, 0, 0]
    description: |
      Default values are from documentation.
      VDDOVEN
      Enable or disable open-wire functionality per channel.
      - 0 mean disable
      - 1 mean enable
      channels indentation start from CH0...CH3
  gdrv-en:
    type: array
    default: [0, 0, 0, 0]
    description: |
      Default values are from documentation.
      GDrvEn - Gate drive enabl disable for power eff
      Enable or disable open-wire functionality per channel.
      - 0 mean disable
      - 1 mean enable
      channels indentation start from CH0...CH3
  sh-vdd-en:
    type: array
    default: [0, 0, 0, 0]
    description: |
      Default values are from documentation.
      ShVddEN - Short to VDD enable
      Enable or disable short to VDD functionality per channel.
      - 0 mean disable
      - 1 mean enable
      channels indentation start from CH0...CH3
  fled-set:
    type: boolean
    description: |
      Internal fault diagnostics include (if enabled): SafeDemagF_, SHVDD_,
      VDDOV_, OWOff_, AboveVDD_, CL_, OVL_, VDDOKFault_.
  sled-set:
    type: boolean
    description: |
      Enable status LEDs
  fled-stretch:
    type: int
    default: 0
    enum:
      - 0
      - 1
      - 2
      - 3
    description: |
      Default values are from documentation.
      Set minimum on time for FLEDs in case of fault
      0 - Disable minimum fault LED (FLED) on-time
      1 - Minimum fault LED (FLED) on-time = 1s (typ)
      2 - Minimum fault LED (FLED) on-time = 2s (typ)
      3 - Minimum fault LED (FLED) on-time = 3s (typ)
  ffilter-en:
    type: boolean
    description: |
      When the fault LEDs (FLEDs) are controlled internally (FLEDSet = 0), open-
      wire and short-to-V DD diagnostics always use filtering and cannot be disabled
      by the FFilterEn bit.
  filter-long:
    type: boolean
    description: |
      false: To select regular blanking time (4ms, typ) for diagnostic fault bits, OWOff_
             and SHVDD_
      true:  To select long blanking time (8ms, typ) for diagnostic fault bits, OWOff_
             and SHVDD_
  flatch-en:
    type: boolean
    description: |
      false: Disable latching of diagnostic fault bits in the OvrLdChF, OpnWirChF, and
             ShtVDDChF registers
      true:  Enable latching of diagnostic fault bits in the OvrLdChF, OpnWirChF, and
             ShtVDDChF registers
  led-cur-lim:
    type: boolean
    description: |
      false: Disable fault LEDs (FLEDs) signaling current limit
      true:  Enable fault LEDs (FLEDs) signaling current limit
  vdd-on-thr:
    type: boolean
    description: |
      Enable higher voltage thresholds for VDD and VDD_ undervoltage monitoring
  synch-wd-en:
    type: boolean
    description: |
      The SYNCH watchdog timeout is defined by the WDTo[1:0] bits if the SPI
      watchdog is enabled. When WDTo[1:0] = 00 (SPI watchdog disabled), the
      SYNCH watchdog timeout is 600ms (typ) if enabled.
  sht-vdd-thr:
    type: int
    default: 0
    enum:
      - 0
      - 1
      - 2
      - 3
    description: |
      Default values are from documentation.
      Set threshold voltage for short-to-V DD detection
      0: Set threshold voltage for short-to-VDD detection to 9V (typ)
      1: Set threshold voltage for short-to-VDD detection to 10V (typ)
      2: Set threshold voltage for short-to-VDD detection to 12V (typ)
      3: Set threshold voltage for short-to-VDD detection to 14V (typ)
  ow-off-cs:
    type: int
    default: 0
    enum:
      - 0
      - 1
      - 2
      - 3
    description: |
      Default values are from documentation.
      Set the pullup current for open-wire and short-to-VDD detection
      0: Set open-wire and short-to-VDD detection current to 60μA (typ)
      1: Set open-wire and short-to-VDD detection current to 100μA (typ)
      2: Set open-wire and short-to-VDD detection current to 300μA (typ)
      3: Set open-wire and short-to-VDD detection current to 600μA (typ)
  wd-to:
    type: int
    default: 0
    enum:
      - 0
      - 1
      - 2
      - 3
    description: |
      Default values are from documentation.
      SPI Watchdog Status, set SPI and SYNCH Watchdog Timeout
      0: Disable SPI Watchdog Status and SPI Watchdog Timeout
      1: Enable SPI Watchdog Status, set SPI and SYNCH Watchdog Timeout to 200ms (typ)
      2: Enable SPI Watchdog Status, set SPI and SYNCH Watchdog Timeout to 600ms (typ)
      3: Enable SPI Watchdog Status, set SPI and SYNCH Watchdog Timeout to 1.2s (typ)

gpio-cells:
  - pin
  - flags

include: [gpio-controller.yaml, spi-device.yaml]
```

## dts/bindings/gpio/adi,max14915-gpio.yaml
```yaml
# Copyright (c) 2025 Analog Devices Inc.
# SPDX-License-Identifier: Apache-2.0

description: |
  ADI MAX14915 compact industrial octal high-side switch with
  diagnostics

  https://www.analog.com/media/en/technical-documentation/data-sheets/MAX14915.pdf

  Example:

  max14915: max14915@0 {
      compatible = "adi,max14915-gpio";
      status = "okay";
      reg = <0x00>;
      fault-gpios = <&gpiof 13 (GPIO_PULL_UP | GPIO_ACTIVE_LOW)>;
      sync-gpios = <&gpioc 7 GPIO_ACTIVE_LOW>;
      en-gpios = <&gpiob 5 GPIO_ACTIVE_LOW>;
      drdy-gpios = <&gpioa 15 GPIO_ACTIVE_LOW>;
      spi-max-frequency = <10000000>;
      gpio-controller;
      #gpio-cells = <2>;
      ngpios = <8>;
      crc-en;
      spi-addr = <0>;
      ow-on-en = <0 0 0 0 0 0 0 0>;
      ow-off-en = <0 0 0 0 0 0 0 0>;
      sh-vdd-en = <0 0 0 0 0 0 0 0>;
      /* Config Reg 1 */
      fled-set;
      sled-set;
      fled-stretch = <3>;
      ffilter-en;
      filter-long;
      flatch-en;
      led-cur-lim;
      /* Config Reg 2 */
      vdd-on-thr;
      synch-wd-en;
      sht-vdd-thr = <3>;
      ow-off-cs = <3>;
      wd-to = <0>;
    };

compatible: "adi,max14915-gpio"

properties:
  wd-to:
    type: int
    default: 0
    enum:
      - 0
      - 1
      - 2
      - 3
    description: |
      Default value according to documentation.
      Set SPI and SYNCH Watchdog Timeout
      0: Disable SPI Watchdog and set SYNCH Watchdog Timeout to 600ms (typ)
      1: Set SPI and SYNCH Watchdog Timeout to 200ms (typ)
      2: Set SPI and SYNCH Watchdog Timeout to 600ms (typ)
      3: Set SPI and SYNCH Watchdog Timeout to 1.2s (typ)

include: adi,max14916-gpio.yaml
```

## dts/bindings/gpio/adi,max14916-gpio.yaml
```yaml
# Copyright (c) 2024 Analog Devices Inc.
# Copyright (c) 2024 BayLibre SAS
# SPDX-License-Identifier: Apache-2.0

description: ADI  MAX14916 is octal industrial output with advanced diagnostics

compatible: "adi,max14916-gpio"

properties:
  "#gpio-cells":
    const: 2
  ngpios:
    type: int
    required: true
    const: 8
    description: Number of gpios supported
  drdy-gpios:
    description: Ready pin which show when chip is ready
    type: phandle-array
  fault-gpios:
    description: |
      Fault pin indicates when there is Fault state in either FAULT1 or FAULT2
      bothe of which are cleaned on read once problem is not persistent
    type: phandle-array
  sync-gpios:
    description: |
      Latch the data so it could be read (partially duplicate CS)
    type: phandle-array
  en-gpios:
    description: |
      Latch the data so it could be read (partially duplicate CS)
    type: phandle-array
  crc-en:
    description: to notify driver if crc pin is enabled
    type: boolean
  spi-addr:
    type: int
    default: 0
    required: true
    description: |
      selectable device address, configurable from A0 and A1
      enum:
        - 0
        - 1
        - 2
        - 3
  ow-on-en:
    type: array
    default: [0, 0, 0, 0, 0, 0, 0, 0]
    description: |
      Enable or disable open-wire-on functionality per channel.
      - 0 mean enable
      - 1 mean disable
      channels indentation start from CH0...CH7
  ow-off-en:
    type: array
    default: [0, 0, 0, 0, 0, 0, 0, 0]
    description: |
      Enable or disable open-wire-off functionality per channel.
      - 0 mean enable
      - 1 mean disable
      channels indentation start from CH0...CH7
  sh-vdd-en:
    type: array
    default: [0, 0, 0, 0, 0, 0, 0, 0]
    description: |
      ShVddEN - Short to VDD enable
      Enable or disable short to VDD functionality per channel.
      - 0 mean enable
      - 1 mean disable
      channels indentation start from CH0...CH3


gpio-cells:
  - pin
  - flags

include: [gpio-controller.yaml, spi-device.yaml]
```
