## dts/bindings/gpio/adi,max14917-gpio.yaml
```yaml
# Copyright (c) 2025 Analog Devices Inc.
# SPDX-License-Identifier: Apache-2.0

description: ADI  MAX14917 is octal industrial output

compatible: "adi,max14917-gpio"

properties:
  "#gpio-cells":
    const: 2
  ngpios:
    type: int
    required: true
    const: 8
    description: Number of gpios supported
  vddok-gpios:
    description: |
      High-Side Open-Drain Output. VDDOK is passive low when the internal
      logic supply is higher than the UVLO threshold, indicating that the
      registers have adequate supply voltage.
    type: phandle-array
  ready-gpios:
    description: |
      Ready pin indicates when the device is ready to be used.
    type: phandle-array
  comerr-gpios:
    description: |
      Communication Error pin indicates when there is a communication error
      on the SPI bus.
    type: phandle-array
  fault-gpios:
    description: |
      Fault pin indicates cases of overload or undervoltage conditions
    type: phandle-array
  en-gpios:
    description: |
      Enable Pin. Drive the EN pin high to enable the outputs.
      Drive EN low to disable/three-state all outputs.
    type: phandle-array
  sync-gpios:
    description: |
      All eight output switches are updated simultaneously on the rising edge
      of SYNCH, as determined by the content of the SPI command
    type: phandle-array
  crcen-gpios:
    description: |
      Drive CRCEN high to enable CRC generation and error detection on the
      serial data.
    type: phandle-array
  crc-en:
    description: |
      Notify driver if crc pin is enabled.
    type: boolean

gpio-cells:
  - pin
  - flags

include: [gpio-controller.yaml, spi-device.yaml]
```

## dts/bindings/gpio/adi,max22017-gpio.yaml
```yaml
# Copyright (c) 2024 Analog Devices Inc.
# Copyright (c) 2024 BayLibre SAS
# SPDX-License-Identifier: Apache-2.0

description: MAX22017 GPIO

compatible: "adi,max22017-gpio"

include: gpio-controller.yaml

properties:
  "#gpio-cells":
    const: 2

gpio-cells:
  - pin
  - flags
```

## dts/bindings/gpio/adi,max22190-gpio.yaml
```yaml
# Copyright (c) 2024 Analog Devices Inc.
# Copyright (c) 2024 BayLibre SAS
# SPDX-License-Identifier: Apache-2.0

description: |
  ADI MAX22190 octal industrial Input with advanced diagnostic
  capabilities like Wire break and over/under volatage.
  Fiter configuration could be done on per channel bases, which
  mean WB functionality and filters could be set. Reffering to:
  filter-wbes = <CH0 CH1 CH2 ... CH7 >  for wire break
  To enable wire break set 1 else 0. Same principle is followed for:
  filter-fbps and filter-delays.
  Sample binding
  &sdp_spi {
    status = "okay";
    pinctrl-names = "default";
    max22190_gpio0: max22190_gpio@0 {
      compatible = "adi,max22190-gpio";
      reg = <0>;

      spi-max-frequency = <1000000>;
      status = "okay";

      gpio-controller;
      #gpio-cells = <2>;
      ngpios = <8>;
      status = "okay";

      max22190-mode = <1>; // modes range from 0-4

      drdy-gpios = <&gpioj 12 GPIO_ACTIVE_LOW>; /* SDP-GPIO5 - PMOD-PIN8 */
      fault-gpios = <&gpioc 11 GPIO_ACTIVE_LOW>; /* SDP-SERIAL_INT - PMOD-PIN7 */
      latch-gpios = <&gpioj 13 GPIO_ACTIVE_LOW>; /* SDP-GPIO6 - PMOD-PIN9 */

      filter-wbes = <1 0 0 0  0 0 0 0>; // wirebreak WBEx
      filter-fbps = <0 0 0 0  0 0 0 0>; // programmable filter INx
      filter-delays = <50 100 400 800 1600 3200 12800 20000>; // 1000 us == 1ms
    };
  };

compatible: "adi,max22190-gpio"

properties:
  "#gpio-cells":
    const: 2
  ngpios:
    type: int
    required: true
    const: 8
    description: Number of gpios supported
  drdy-gpios:
    description: Ready pin which show when chip is ready
    type: phandle-array
  fault-gpios:
    description: |
      Fault pin indicates when there is Fault state in either FAULT1 or FAULT2
      bothe of which are cleaned on read once problem is not persistent
    type: phandle-array
  latch-gpios:
    description: |
      Latch the data so it could be read (partially duplicate CS)
    type: phandle-array
  max22190-mode:
    type: int
    required: true
    enum:
      - 0
      - 1
      - 2
      - 3
    description: |
      Default mode set to 1, because in MAX22190PMB devkit this is hardwired
      mode set by manufacturer.
      max22190 mode is configured from M0 and M1 pins with
      pull up or down resistors.
      MODE| M1| M0| FRAME  | CRC | DAISY CHAIN
      ----+---+---+--------+-----+------------
        0 | 0 | 0 | 24-bit | yes | no
        1 | 0 | 1 | 16-bit | no  | no
        2 | 1 | 0 | 24-bit | yes | yes
        3 | 1 | 1 | 16-bit | no  | yes
  filter-wbes:
    type: array
    default: [0, 0, 0, 0, 0, 0, 0, 0]
    description: |
      The default value corresponds to the default value of the hardware.
      Wire break is disabled in all channels.
      WBE bit in all Filter registers stand for wire break enable on each
      channel, so to enable WB functionality set 1.
      If WB on specific channel is disabled , FAULT will not be rised in case
      wire is cut.
      - 1 wire break enable
      - 0 wire break disable
      channels indentation start from CH0...CH7
  filter-fbps:
    type: array
    default: [1, 1, 1, 1, 1, 1, 1, 1]
    description: |
      The default value corresponds to the default value of the hardware.
      All channels are in bypass.
      Enable or disable filter
      - 1 mean bypass
      - 0 mean filter is used
      channels indentation start from CH0...CH7
  filter-delays:
    type: array
    default: [50, 50, 50, 50, 50, 50, 50, 50]
    description: |
      The default value corresponds to the default value of the hardware.
      Used to setup filter delay. Values are set in us. Default value is 50 = 50 us.
      Value : 50, 100, 400, 800, 1600, 3200, 12800, 20000
      channels indentation start from CH0...CH7

gpio-cells:
  - pin
  - flags

include: [gpio-controller.yaml, spi-device.yaml]
```

## dts/bindings/gpio/adi,max22199-gpio.yaml
```yaml
# Copyright (c) 2024 Analog Devices Inc.
# Copyright (c) 2024 BayLibre SAS
# SPDX-License-Identifier: Apache-2.0

description: |
  The MAX22199 is an IEC 61131-2 compliant industrial digital input device.
  The MAX22199 translates eight 24V current-sinking industrial inputs to a
  serialized SPI-compatible output that interfaces with 3V to 5.5V logic.
  It can operate as eight Type 1/Type 3 digital inputs or four Type 2 digital
  inputs. The device provides diagnostic functions, including thermal shutdown,
  24V under voltage alarm, 24V missing voltage alarm, and SPI and CRC
  communication error detection.

  Sample binding
  &sdp_spi {
    status = "okay";
    pinctrl-names = "default";
    max22199_gpio0: max22199_gpio@0 {
      compatible = "adi,max22199-gpio";
      reg = <0>;

      spi-max-frequency = <1000000>;
      status = "okay";

      gpio-controller;
      #gpio-cells = <2>;
      ngpios = <8>;
      status = "okay";

      max22199-mode = <1>; // modes range from 0-4

      drdy-gpios = <&gpioj 12 GPIO_ACTIVE_LOW>; /* SDP-GPIO5 - PMOD-PIN8 */
      fault-gpios = <&gpioc 11 GPIO_ACTIVE_LOW>; /* SDP-SERIAL_INT - PMOD-PIN7 */
      latch-gpios = <&gpioj 13 GPIO_ACTIVE_LOW>; /* SDP-GPIO6 - PMOD-PIN9 */

      filter-fbps = <0 0 0 0  0 0 0 0>; // programmable filter INx
      filter-delays = <50 100 400 800 1600 3200 12800 20000>; // 1000 us == 1ms
    };
  };

compatible: "adi,max22199-gpio"

gpio-cells:
  - pin
  - flags

include: adi,max2219x-base-gpio.yaml
```

## dts/bindings/gpio/adi,max2219x-base-gpio.yaml
```yaml
# Copyright (c) 2024 Analog Devices Inc.
# Copyright (c) 2024 BayLibre SAS
# SPDX-License-Identifier: Apache-2.0

include: [gpio-controller.yaml, spi-device.yaml]

properties:
  "#gpio-cells":
    const: 2
  ngpios:
    type: int
    required: true
    const: 8
    description: Number of gpios supported
  drdy-gpios:
    description: Ready pin which show when chip is ready
    type: phandle-array
  fault-gpios:
    description: |
      Fault pin indicates when there is Fault state in either FAULT1 or FAULT2
      bothe of which are cleaned on read once problem is not persistent
    type: phandle-array
  latch-gpios:
    description: |
      Latch the data so it could be read (partially duplicate CS)
    type: phandle-array
  max22190-mode:
    type: int
    required: true
    enum:
      - 0
      - 1
      - 2
      - 3
    description: |
      Default mode set to 1, because in MAX22190PMB devkit this is hardwired
      mode set by manufacturer.
      max22190 mode is configured from M0 and M1 pins with
      pull up or down resistors.
      MODE| M1| M0| FRAME  | CRC | DAISY CHAIN
      ----+---+---+--------+-----+------------
        0 | 0 | 0 | 24-bit | yes | no
        1 | 0 | 1 | 16-bit | no  | no
        2 | 1 | 0 | 24-bit | yes | yes
        3 | 1 | 1 | 16-bit | no  | yes
  filter-wbes:
    type: array
    default: [0, 0, 0, 0, 0, 0, 0, 0]
    description: |
      The default value corresponds to the default value of the hardware.
      Wire break is disabled in all channels.
      WBE bit in all Filter registers stand for wire break enable on each
      channel, so to enable WB functionality set 1.
      If WB on specific channel is disabled , FAULT will not be rised in case
      wire is cut.
      - 1 wire break enable
      - 0 wire break disable
      channels indentation start from CH0...CH7
  filter-fbps:
    type: array
    default: [1, 1, 1, 1, 1, 1, 1, 1]
    description: |
      The default value corresponds to the default value of the hardware.
      All channels are in bypass.
      Enable or disable filter
      - 1 mean bypass
      - 0 mean filter is used
      channels indentation start from CH0...CH7
  filter-delays:
    type: array
    default: [50, 50, 50, 50, 50, 50, 50, 50]
    description: |
      The default value corresponds to the default value of the hardware.
      Used to setup filter delay. Values are set in us. Default value is 50 = 50 us.
      Value : 50, 100, 400, 800, 1600, 3200, 12800, 20000
      channels indentation start from CH0...CH7
```

## dts/bindings/gpio/adi,max32-gpio.yaml
```yaml
# Copyright (c) 2023-2024 Analog Devices, Inc.
# SPDX-License-Identifier: Apache-2.0

description: MAX32 GPIO

compatible: "adi,max32-gpio"

include: [gpio-controller.yaml, base.yaml]

properties:
  reg:
    required: true

  "#gpio-cells":
    const: 2

gpio-cells:
  - pin
  - flags
```

## dts/bindings/gpio/adi,sdp-120.yaml
```yaml
# Copyright (c) 2024 Analog Devices Inc.
# Copyright (c) 2024 Baylibre, SAS

# SPDX-License-Identifier: Apache-2.0

description: |
    GPIO pins exposed on a Analog devices SDP interface.

    120-pin SDP interface:

         1  VIN                                NC  120
         2  NC                                 NC  119
         3  GND                               GND  118
         4  GND                               GND  117
         5  USB_VBUS                          VIO  116
         6  GND                               GND  115
         7  PAR_D23                       PAR_D22  114
         8  PAR_D21                       PAR_D20  113
         9  PAR_D19                       PAR_D18  112
        10  PAR_D17                       PAR_D16  111
        11  GND                           PAR_D15  110
        12  PAR_D14                           GND  109
        13  PAR_D13                       PAR_D12  108
        14  PAR_D11                       PAR_D10  107
        15  PAR_D9                         PAR_D8  106
        16  PAR_D7                         PAR_D6  105
        17  GND                               GND  104
        18  PAR_D5                         PAR_D4  103
        19  PAR_D3                         PAR_D2  102
        20  PAR_D1                         PAR_D0  101
        21  PAR_RD_N                     PAR_WR_N  100
        22  PAR_CS_N                      PAR_INT  99
        23  GND                               GND  98
        24  PAR_A3                         PAR_A2  97
        25  PAR_A1                         PAR_A0  96
        26  PAR_FS3                       PAR_FS2  95
        27  PAR_FS1                       PAR_CLK  94
        28  GND                               GND  93
        29  SPORT_TDV0                SPORT_RSCLK  92
        30  SPORT_TDV1                  SPORT_DR0  91
        31  SPORT_DR1                   SPORT_RFS  90
        32  SPORT_DT1                   SPORT_TFS  89
        33  SPI_D2                      SPORT_DT0  88
        34  SPI_D3                    SPORT_TSCLK  87
        35  SERIAL_INT                        GND  86
        36  GND                       SPI_SEL_A_N  85
        37  SPI_SEL_B_N                  SPI_MOSI  84
        38  SPI_SEL_C_N                  SPI_MISO  83
        39  SPI_SEL1/SPI_SS_N             SPI_CLK  82
        40  GND                               GND  81
        41  SDA_1                           SDA_0  80
        42  SCL_1                           SCL_0  79
        43  GPIO0                           GPIO1  78
        44  GPIO2                           GPIO3  77
        45  GPIO4                           GPIO5  76
        46  GND                               GND  75
        47  GPIO6                           GPIO7  74
        48  TMR_A                           TMR_B  73
        49  TMR_C                           TMR_D  72
        50  NC                             CLKOUT  71
        51  NC                                 NC  70
        52  GND                               GND  69
        53  NC                                 NC  68
        54  NC                                 NC  67
        55  NC                                 NC  66
        56  EEPROM_A0                      WAKE_N  65
        57  RESET_OUT_N                   SLEEP_N  64
        58  GND                               GND  63
        59  UART_RX                       UART_TX  62
        60  RESET_IN_N                     BMODE1  61

compatible: "adi,sdp-120"

include: [gpio-nexus.yaml, base.yaml]
```

## dts/bindings/gpio/aesc,gpio.yaml
```yaml
#
# Copyright (c) 2025 Aesc Silicon
#
# SPDX-License-Identifier: Apache-2.0
#

title: Aesc Silicon GPIO (General Purpose Input/Output)

description: |
  The GPIO (General-Purpose Input/Output) IP Core with tri-state pins is a digital interface
  that allows each pin to be configured as either an input or an output, with additional control
  for setting the direction of data flow.

compatible: "aesc,gpio"

include: [gpio-controller.yaml, base.yaml]

properties:
  reg:
    required: true

  "#gpio-cells":
    const: 2

gpio-cells:
  - pin
  - flags
```

## dts/bindings/gpio/allwinner,sun50i-h618-gpio.yaml
```yaml
# Copyright (c) 2026 Khai Do
# SPDX-License-Identifier: Apache-2.0

description: Allwinner sun50i-h618 GPIO controller

compatible: "allwinner,sun50i-h618-gpio"

include: allwinner,sunxi-gpio.yaml
```
