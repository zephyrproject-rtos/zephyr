## dts/bindings/pinctrl/renesas,rafw-pinctrl.yaml
```yaml
# SPDX-FileCopyrightText: 2026 Renesas Electronics Corporation
# SPDX-License-Identifier: Apache-2.0

description: |
    The RA wireless pin controller is a singleton node responsible for controlling
    pin function selection and pin properties, such as routing a UART RX to pin
    P1.8 and enabling the pullup resistor on that pin.

    The node has the 'pinctrl' node label set in your SoC's devicetree,
    so you can modify it like this:

      &pinctrl {
              /* your modifications go here */
      };

    All device pin configurations should be placed in child nodes of the
    'pinctrl' node, as shown in this example:

      /* You can put this in places like a board-pinctrl.dtsi file in
       * your board directory, or a devicetree overlay in your application.
       */

     /* include definitions and utility macros for the SoC used by the board */
     #include <dt-bindings/pinctrl/ra6b1-pinctrl.h>

      &pinctrl {
        /* configuration for uart device, default state */
        uart_default: uart_default {
          /* group 1 */
          group1 {
            /* route UART TX to P0.9 */
            pinmux = <RAFW_PINMUX(UART_TX, 0, 9)>;
          };
          /* group 2 */
          group2 {
            /* route UART RX to P0.8 and enable pull-up */
            pinmux = <RAFW_PINMUX(UART_RX, 0, 8)>;
            bias-pull-up;
          };
        };
      };

    The 'uart0_default' child node encodes the pin configurations for a
    particular state of a device; in this case, the default (that is, active)
    state.

    As shown, pin configurations are organized in groups within each child node.
    Each group can specify a list of pin function selections in the 'pinmux'
    property. Note that 'pinmux' property is an array so you can configure multiple
    pins at once there. The RAFW_PINMUX macro is used to create pinmux value.

    A group can also specify shared pin properties common to all the specified
    pins, such as the 'bias-pull-up' property in group 2. Here is a list of
    supported standard pin properties:

    - bias-pull-up: Enable pull-up resistor.
    - bias-pull-down: Enable pull-down resistor.

    Note that bias options are mutually exclusive.

    To link this pin configuration with a device, use a pinctrl-N property
    for some number N, like this example you could place in your board's DTS
    file:

       #include "board-pinctrl.dtsi"

       &uart {
             pinctrl-0 = <&uart_default>;
             pinctrl-names = "default";
       };

      Note1: The low-power-enable property is valid only for pins on port P1.
             Pins of a group that is marked with that property should operate
             at a lower voltage (e.g. 1.8V instead of 3.3V). Following is a
             code excerpt showing how to enable low-power mode for pins P1.0 and P1.1:

              &pinctrl {
                      group1 {
                              pinmux = <RAFW_PINMUX(GPIO, 1, 0)>,
                                       <RAFW_PINMUX(GPIO, 1, 1)>;
                              low-power-enable;
                      };
              };

      Note2: The sleep-hardware-state property can be used to specify that a group
             of pins should be locked in their active state during sleep,
             instead of being put in input pull-down state. This is useful for peripherals
             that need to maintain their pin state during sleep, such as a UART that needs
             to keep its TX pin high. Following is a code excerpt showing how to use this
             property:

              &pinctrl {
                      group1 {
                              pinmux = <RAFW_PINMUX(UART_TX, 0, 9)>;
                              sleep-hardware-state;
                      };
              };

compatible: "renesas,rafw-pinctrl"

include: base.yaml

child-binding:
  description: |
    Definitions for a pinctrl state.
  child-binding:

    include:
      - name: pincfg-node.yaml
        property-allowlist:
          - bias-pull-down
          - bias-pull-up
          - output-enable
          - input-enable
          - sleep-hardware-state
          - low-power-enable

    properties:
      pinmux:
        required: true
        type: array
        description: |
          An array of pins sharing the same group properties. The pins should
          be defined using the RAFW_PINMUX utility macro that encodes the port,
          pin and function.
```

## dts/bindings/pinctrl/ti,cc35xx-pinctrl.yaml
```yaml
# SPDX-License-Identifier: Apache-2.0

description: |
    The TI CC35XX pin controller is a singleton node responsible for controlling
    pin function selection and pin properties. For example, you can
    use this node to route UART0 RX to pin 55 and enable the pull-up resistor
    on the pin.

compatible: "ti,cc35xx-pinctrl"

include: base.yaml

child-binding:
  child-binding:
    include:
      - name: pincfg-node.yaml
        property-allowlist:
          - drive-push-pull
          - drive-open-drain
          - bias-disable
          - bias-pull-down
          - bias-pull-up
          - drive-strength

    properties:
      pinmux:
        required: true
        type: array
        description: |
          An array of pins sharing the same group properties. The pins should
          be defined using pre-defined macros or, alternatively, using the
          TI_CC35XX_PINMUX helper macro.
```

## dts/bindings/power/atmel,sam-supc.yaml
```yaml
# Copyright (c) 2023 Bjarki Arge Andreasen
# SPDX-License-Identifier: Apache-2.0

description: |
  Atmel SAM SUPC (Supply-Controller) controller

  The supply controller manages the voltage reference, power supply and supply
  monitoring of the device. It have a special feature that it can wake-up the
  device from a low-power state using special peripherals as wake-up sources.

  The dedicated peripherals that can wake-up the core supply domain are: RTC,
  RTT, Supply Monitor and GPIOs. In the first three peripherals it is necessary
  inform the wakeup-ctrls property on their respective nodes.

    rtc: rtc@xxx {
      ...
      wakeup-ctrls = <&supc SUPC_WAKEUP_SOURCE_RTC>;
      ...
    };

  The wakeup-source-id property is the deprecated spelling of the same
  relationship and is described by "#wakeup-source-id-cells" below. It is kept
  for out-of-tree users only and will be removed in a future release.

  The special peripheral will wake-up the device only when the standard property
  wakeup-source is defined, e.g.:

    &rtc {
      ...
      wakeup-source;
      ...
    };

  The SUPC wakeup source ids that can be enabled are defined in the
  zephyr/include/zephyr/dt-bindings/power/atmel_sam_supc.h header file.

compatible: "atmel,sam-supc"

include:
  - name: base.yaml

properties:
  reg:
    required: true

  "#wakeup-source-id-cells":
    type: int
    const: 1
    description: |
      Deprecated. Superseded by "#wakeup-ctrl-cells", which describes the same
      phandle-plus-identifier relationship using the property name the rest of
      the tree uses. Kept so out-of-tree nodes with a "wakeup-source-id"
      property keep resolving; it will be removed in a future release.

      This property cannot be marked "deprecated: true": every atmel,sam-supc
      node in tree sets it, and a set deprecated property is an error under
      gen_edt.py --edtlib-Werror, which twister passes by default.

  "#wakeup-ctrl-cells":
    type: int
    const: 1
    description: |
      Number of cells in the wakeup-ctrls property of a wake-up source that
      names this controller. There must be a cell named "id".

wakeup-source-id-cells:
  - wakeup-source-id

wakeup-ctrl-cells:
  - id
```

## dts/bindings/power/infineon,hibernate-wakeup.yaml
```yaml
# SPDX-FileCopyrightText: Copyright (c) 2026 Infineon Technologies AG,
# SPDX-FileCopyrightText: or an affiliate of Infineon Technologies AG. All rights reserved.
#
# SPDX-License-Identifier: Apache-2.0

description: |
  Infineon hibernate / hibernate-RAM wakeup source configuration.

  Infineon SoCs provide a set of dedicated hardware sources that can wake the
  device from the hibernate (and, where supported, hibernate-RAM) power modes.
  The set of available sources and the pin-to-pad mapping are fixed in silicon
  and differ per device; consult the SoC datasheet or the SoC devicetree for
  the mapping.  A device implements only a subset of the properties below
  - set only the ones the target SoC supports.

  Typical availability:
    PIN0, PIN1, LPCOMP0, LPCOMP1, WDT, RTC alarm

  Each pin and LPCOMP source can be independently enabled and configured to wake
  on a high or low logic level.

  Example (wake on the first dedicated pin, active low):

    hibernate_wakeup: hibernate-wakeup {
        compatible = "infineon,hibernate-wakeup";
        wakeup-pin0-trigger = "low";
    };

compatible: "infineon,hibernate-wakeup"

properties:
  wakeup-pin0-trigger:
    type: string
    enum:
      - "low"
      - "high"
    description: |
      Enable dedicated wake PIN0 as a hibernate wakeup source.  The physical pad
      is device-specific (see the SoC devicetree/datasheet).  Set to "low" to
      wake on a low logic level, "high" for a high level.  Omit to disable PIN0.

  wakeup-pin1-trigger:
    type: string
    enum:
      - "low"
      - "high"
    description: |
      Enable dedicated wake PIN1 as a hibernate wakeup source.  The physical pad
      is device-specific (see the SoC devicetree/datasheet).  Set to "low" to
      wake on a low logic level, "high" for a high level.  Omit to disable PIN1.

  wakeup-pin2-trigger:
    type: string
    enum:
      - "low"
      - "high"
    description: |
      Enable dedicated wake PIN2 as a hibernate wakeup source (device-specific;
      for example PSB3).  The physical pad is device-specific.  Set to "low" to
      wake on a low logic level, "high" for a high level.  Omit to disable PIN2.

  wakeup-pin3-trigger:
    type: string
    enum:
      - "low"
      - "high"
    description: |
      Enable dedicated wake PIN3 as a hibernate wakeup source (device-specific;
      for example PSB3).  The physical pad is device-specific.  Set to "low" to
      wake on a low logic level, "high" for a high level.  Omit to disable PIN3.

  wakeup-lpcomp0-trigger:
    type: string
    enum:
      - "low"
      - "high"
    description: |
      Enable low-power comparator 0 (LPCOMP0) as a hibernate wakeup source.
      Set to "low" to wake on a low output level, "high" for a high level.
      Omit to disable LPCOMP0.

  wakeup-lpcomp1-trigger:
    type: string
    enum:
      - "low"
      - "high"
    description: |
      Enable low-power comparator 1 (LPCOMP1) as a hibernate wakeup source.
      Set to "low" to wake on a low output level, "high" for a high level.
      Omit to disable LPCOMP1.

  wakeup-wdt:
    type: boolean
    description: |
      Enable the watchdog timer as a hibernate wakeup source.  Use on
      single-watchdog devices.

  wakeup-wdt0:
    type: boolean
    description: |
      Enable WDT0 as a hibernate wakeup source.  Use on dual-watchdog devices.

  wakeup-wdt1:
    type: boolean
    description: |
      Enable WDT1 as a hibernate wakeup source.  Use on dual-watchdog devices.

  wakeup-rtc-alarm:
    type: boolean
    description: Enable RTC alarm as a hibernate wakeup source.
```

## dts/bindings/power/microchip,supc-g1.yaml
```yaml
# Copyright (c) 2026 Microchip Technology Inc.
# SPDX-License-Identifier: Apache-2.0

title: Microchip G1 SUPC

description: |
  Microchip G1 SUPC peripherals.

  Group G1 SUPC includes the following hardware peripherals:
    - module name="SUPC" id="U2117" version="2.1.1"

compatible: "microchip,supc-g1"

include:
  - name: base.yaml

properties:
  reg:
    required: true

  standby-regulator-sel:
    type: int
    default: 0
    enum:
      - 0
      - 1
    description: |
     Voltage regulator selection in standby mode.

     When 0, the voltage regulator switches to Low-Power
     mode whenever the device enters Standby Sleep mode.
     when 1, the voltage regulator remains in Normal
     mode during Standby Sleep mode. Low-power mode is
     configured as default value.

  vref-on-demand:
    type: int
    default: 0
    enum:
      - 0
      - 1
    description: |
      Voltage reference on demand comtrol.

      when 0, The voltage reference remains enabled whenever
      it is configured to be enabled. when 1, The voltage reference
      is enabled only when a peripheral requests it and is
      automatically disabled when no peripheral is using it.

  vref-standby-mode:
    type: int
    default: 0
    enum:
      - 0
      - 1
    description: |
      Voltage reference standby configuration.

      The voltage reference is halted during standby sleep mode upon 0.
      when 1, The voltage reference is not stopped in standby sleep mode.
      If vref-on-demand = 1, the voltage reference will be running when a
      peripheral is requesting it. If 0, the voltage reference will always be
      running in standby sleep mode.

examples:
  - |
    supc: supc@40001800 {
      compatible = "microchip,supc-g1";
      reg = <0x40001800 0x20>;
      vref-standby-mode = <1>;
      status = "disabled";
    };
```

## dts/bindings/power/nordic,nrf-reset-reason.yaml
```yaml
# Copyright (c) 2018 Nordic Semiconductor ASA
# SPDX-License-Identifier: Apache-2.0

description: Nordic nRF reset reason node

compatible: "nordic,nrf-reset-reason"

properties:
  reset-reason-available:
    type: boolean
```

## dts/bindings/power/nuvoton,npcx-power-state.yaml
```yaml
# Copyright (c) 2026 Nuvoton Technology Corporation.
# SPDX-License-Identifier: Apache-2.0

description: |
  NPCX power management idle state. Extends the generic power state with the
  NPCX specific properties of the deep sleep sub-states.

compatible: "nuvoton,npcx-power-state"

include: zephyr,power-state.yaml

properties:
  unlimited-instant-wakeup:
    type: boolean
    description: |
      The instant wake-up path stays valid for an unlimited residency in deep
      sleep. When omitted, instant wake-up is only guaranteed for a residency
      shorter than 200 ms and the standard wake-up sub-state must be used
      beyond that. Only supported since the NPCX4 series, earlier series have
      no such control bit and ignore the property.
```

## dts/bindings/power/nxp,cmc.yaml
```yaml
# Copyright 2025-2026 NXP
# SPDX-License-Identifier: Apache-2.0

description: NXP Core Mode Controller (CMC)

compatible: "nxp,cmc"

include: base.yaml

properties:
  reg:
    required: true

  sram-banks:
    type: array
    description: |
      Flat list describing each CMC-controllable SRAM power partition, three
      cells per bank: <start-address size cmc-disable-bit>. cmc-disable-bit is
      the SRAMDIS/SRAMRET / kCMC_SRAMBank<n> index for that partition. Banks may
      be listed in any order and from any memory aperture (Code-TCM and
      System-TCM banks are described identically). Banks that must never be
      power-gated (for example the VBAT-retained top bank) are simply omitted
      from the list.
```
