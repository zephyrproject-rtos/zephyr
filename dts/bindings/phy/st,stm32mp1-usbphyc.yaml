## dts/bindings/pinctrl/infineon,mxs22-ioss-pinctrl.yaml
```yaml
# SPDX-FileCopyrightText: Copyright (c) 2026 Infineon Technologies AG
# SPDX-FileCopyrightText: Copyright (c) 2026 Linumiz
# SPDX-License-Identifier: Apache-2.0

description: |
  Infineon MXS22IOSS pin controller

  Variant of the IOSS pin controller found on PSOC Edge devices. The
  slew rate and drive strength of each pin are set in the CFG_SLEW_EXT
  and CFG_DRIVE_EXT registers, and all eight drive strength levels are
  supported. A high impedance pin also has its CFG_OUT3 drive mode
  cleared.

  The HSIOM and GPIO regions of the SMIF GPIO ports are described as
  "smif0_hsiom", "smif0_gpio", "smif1_hsiom" and "smif1_gpio". Their
  pins use the port numbers IFX_SMIF0_PORT0 to IFX_SMIF1_PORT2.

    pinctrl: pinctrl@42800000 {
        compatible = "infineon,mxs22-ioss-pinctrl", "infineon,ioss-pinctrl";
        reg = <0x42800000 0x4000>, <0x42810000 0x10000>,
              <0x44464000 0x4000>, <0x44470000 0x10000>,
              <0x444a4000 0x4000>, <0x444b0000 0x10000>;
        reg-names = "hsiom", "gpio",
                    "smif0_hsiom", "smif0_gpio",
                    "smif1_hsiom", "smif1_gpio";
    };

compatible: "infineon,mxs22-ioss-pinctrl"

include: "infineon,ioss-pinctrl.yaml"
```

## dts/bindings/pinctrl/infineon,mxs40s-ioss-pinctrl.yaml
```yaml
# SPDX-FileCopyrightText: Copyright (c) 2026 Infineon Technologies AG
# SPDX-FileCopyrightText: Copyright (c) 2026 Linumiz
# SPDX-License-Identifier: Apache-2.0

description: |
  Infineon MXS40SIOSS pin controller

  Variant of the IOSS pin controller found on PSOC Control C3 devices.
  The slew rate and drive strength of each pin are set in the
  CFG_SLEW_EXT and CFG_DRIVE_EXT registers. The supported drive
  strength levels are full, half, one-fourth and one-eighth.

    pinctrl: pinctrl@42400000 {
        compatible = "infineon,mxs40s-ioss-pinctrl", "infineon,ioss-pinctrl";
        reg = <0x42400000 0x4000>, <0x42410000 0x10000>;
        reg-names = "hsiom", "gpio";
    };

compatible: "infineon,mxs40s-ioss-pinctrl"

include: "infineon,ioss-pinctrl.yaml"
```

## dts/bindings/pinctrl/mediatek,mt8188-pinctrl.yaml
```yaml
# Copyright (c) 2026 MediaTek Inc.
# SPDX-License-Identifier: Apache-2.0

description: |
  MediaTek MT8188 pin controller.

  A pin configuration state is described by a grandchild node holding a 'pinmux'
  array.  Each entry encodes a pin number and the function selected on it, and is
  built with the PINMUX_PIN_<n>__FUNC_<f> macros from
  <zephyr/dt-bindings/pinctrl/mt8188-pinctrl.h>.

  For example:

    &pinctrl {
            uart1_default: uart1_default {
                    group1 {
                            pinmux = <PINMUX_PIN_33__FUNC_O_UTXD1>,
                                     <PINMUX_PIN_34__FUNC_I1_URXD1>;
                    };
            };
    };

compatible: "mediatek,mt8188-pinctrl"

include: [base.yaml, pinctrl-device.yaml]

properties:
  reg:
    required: true

child-binding:
  child-binding:
    description: MT8188 pin configuration state.

    properties:
      pinmux:
        type: array
        required: true
        description: Encoded pin and function pairs to apply for this state.
```

## dts/bindings/pinctrl/nuvoton,npcm-pinctrl.yaml
```yaml
# Copyright (c) 2024 Nuvoton Technology Corporation.
# SPDX-License-Identifier: Apache-2.0

description: |
  Nuvoton NPCM pin controller.

  Pin multiplexing, pull-up/down enables, and low-voltage selects are all bits in the System
  Configuration (SCFG) block. The nuvoton,npcm-pinfunc node lists the bits of every pin
  function; this controller writes the ones a pin group selects.

  Each child is a pin group, and each of its children configures one pin by selecting a pin
  function with pinmux. The SoC devicetree provides a group for every peripheral port, so a
  board only adds per-pin settings. Example, I2C6B with SDA pulled up at 1.8 V:

    &i2c6b_scl_sda_gpio16_17 {
      sda {
        bias-pull-up;
        nuvoton,voltage-level-mv = <1800>;
      };
    };

    &i2c6b {
      pinctrl-0 = <&i2c6b_scl_sda_gpio16_17>;
      pinctrl-names = "default";
    };

  A multiplexed pin is returned to GPIO by selecting its pin_gpioNN_gpio function.

compatible: "nuvoton,npcm-pinctrl"

include: base.yaml

properties:
  nuvoton,scfg:
    type: phandle
    required: true
    description: SCFG register block.

child-binding:
  description: A pin group.

  child-binding:
    description: |
      One pin of a group.

      The bias and voltage properties need the selected function to have the matching SCFG
      control (nuvoton,pull-up-reg, nuvoton,pull-down-reg, or nuvoton,low-voltage-reg);
      otherwise applying the state fails with -ENOTSUP. Without them, the pin's current
      setting is kept.

    include:
      - name: pincfg-node.yaml
        property-allowlist:
          - bias-disable
          - bias-pull-up
          - bias-pull-down

    properties:
      pinmux:
        type: phandle
        required: true
        description: Pin function to select, a child of the nuvoton,npcm-pinfunc node.

      nuvoton,voltage-level-mv:
        type: int
        enum: [1800, 3300]
        description: |
          Input voltage level of the pin. The low-voltage selects reset to 1.8 V, so a pin
          used at 3.3 V needs <3300>.

      nuvoton,device-control:
        type: array
        description: |
          An extra SCFG bit written with this pin, as <register bit value>, for per-port
          controls such as tri-state or write protect. One bit per pin node.
```

## dts/bindings/pinctrl/nuvoton,npcm-pinfunc.yaml
```yaml
# Copyright (c) 2024 Nuvoton Technology Corporation.
# SPDX-License-Identifier: Apache-2.0

description: |
  Nuvoton NPCM pin function table.

  Each pin's function is chosen by a selection table of SCFG DEVALTx bits. For example,
  DEVALT7[6], DEVALTB[6], and DEVALT6D[7] select the function of GPIO17: 1xx is CLKOUT,
  01x is RIA, 001 is I2C6B_SDA, and 000 is GPIO17.

  Each child is one row of such a table, plus the function's pull and low-voltage controls
  when it has them. The SoC devicetree provides the table in npcm<n>-pinfunc.dtsi. Example,
  two of the GPIO17 rows:

    &pinfunc {
      pin_gpio17_gpio: pin-gpio17-gpio {
        nuvoton,alts = <NPCM_SCFG_DEVALT6D 7 0>,
                       <NPCM_SCFG_DEVALTB 6 0>,
                       <NPCM_SCFG_DEVALT7 6 0>;
      };
      pin_gpio17_sda6b: pin-gpio17-sda6b {
        nuvoton,alts = <NPCM_SCFG_DEVALT6D 7 1>,
                       <NPCM_SCFG_DEVALTB 6 0>,
                       <NPCM_SCFG_DEVALT7 6 0>;
        nuvoton,pull-up-reg = <NPCM_SCFG_DEVPD1 4>;
        nuvoton,low-voltage-reg = <NPCM_SCFG_LV_CTL3 7>;
      };
    };

compatible: "nuvoton,npcm-pinfunc"

include: base.yaml

child-binding:
  description: One function of one pin.

  properties:
    nuvoton,alts:
      type: array
      description: |
        <register bit value> triplets for every selector bit in the pin's table row,
        including the zeros, so that writing them selects exactly this function. Registers
        are SCFG offsets (NPCM_SCFG_*). Absent on functions selected by a strap.

    nuvoton,pull-up-reg:
      type: array
      description: <register bit> of the function's SCFG pull-up enable.

    nuvoton,pull-down-reg:
      type: array
      description: <register bit> of the function's SCFG pull-down enable.

    nuvoton,low-voltage-reg:
      type: array
      description: <register bit> of the function's SCFG 1.8 V select.
```

## dts/bindings/pinctrl/nxp,imx-modcon.yaml
```yaml
#
# SPDX-FileCopyrightText: Copyright 2026 NXP
#
# SPDX-License-Identifier: Apache-2.0
#

description: |
  i.MX RT Module Control (MODCON) block.

  One instance per power domain, holding per-peripheral configuration
  registers. Exposed as a pinmux specifier space so a peripheral node can
  point at the register field controlling one of its own signals, such as
  the dynamic gate on a SAI's MCLK pad output.

compatible: "nxp,imx-modcon"

include: base.yaml

properties:
  reg:
    required: true

pinmux-cells:
  - offset
  - mask
```

## dts/bindings/pinctrl/nxp,mcux-rt266x-pinctrl.yaml
```yaml
# SPDX-FileCopyrightText: Copyright 2026 NXP
#
# SPDX-License-Identifier: Apache-2.0

description: |
  The node has the 'pinctrl' node label set in an MCUX RT266x SoC's devicetree.

  Unlike the RT10xx/RT11xx/RT118x parts (which expose separate SW_MUX_CTL and
  SW_PAD_CTL registers), every RT266x pad is controlled by a single combined
  IOMUXC PIO register. This binding therefore describes the RT266x PIO pad
  fields directly, and is shared by every part in the RT266x series (RT2661/
  RT2662/RT2663 and future dies built on the same IOMUXC).

  The mux, mode, input, daisy, and cfg fields in a group select the pins to be
  configured, and the remaining devicetree properties set configuration values
  for those pins. For example, here is a group configuring LPUART0 pins:

  group0 {
      pinmux = <&main__iomuxc_pio3_30_hsp_lpuart0_txd>,
          <&main__iomuxc_pio3_31_hsp_lpuart0_rxd>;
      drive-strength = "50-ohm";
      slew-rate = "fast";
  };

  These are the effects of each property on the IOMUXC PIO register:
  drive-open-drain: ODENA=1 (PIO0..PIO4 only; PIO5/6/7 have no ODENA)
  input-enable:     IBENA=1 (input buffer / receiver enable)
  bias-pull-down:   PULLENA=0b01
  bias-pull-up:     PULLENA=0b10
  bias-disable:     PULLENA=0b00
  slew-rate:        SLEWRATE=<enum index>
  drive-strength:   DRIVE=<enum index>

  If only the required properties are supplied, the pad will have PULLENA=0b00
  (pull disabled), IBENA=0, ODENA=0, SLEWRATE=0b00 (low) and DRIVE=0b00
  (100 ohm).

compatible: "nxp,mcux-rt266x-pinctrl"

include: base.yaml

child-binding:
  description: MCUX RT266x pin controller pin group
  child-binding:
    description: |
      MCUX RT266x pin controller pin configuration node.

    include:
      - name: pincfg-node.yaml
        property-allowlist:
          - drive-open-drain
          - input-enable
          - bias-disable
          - bias-pull-down
          - bias-pull-up

    properties:
      pinmux:
        required: true
        type: phandles
        description: |
          Pin mux selections for this group. See the soc level iomuxc DTSI file
          for a defined list of these options.
      drive-strength:
        type: string
        enum:
          - "100-ohm"
          - "66-ohm"
          - "50-ohm"
          - "33-ohm"
        description: |
          Output driver impedance. Sets the DRIVE field in the IOMUXC PIO
          register. The listed values map to the register encoding in order:
          100 ohm (0b00, default), 66 ohm (0b01), 50 ohm (0b10), 33 ohm (0b11) --
          the encoding the SDK header documents for IOMUXC_PIO_DRIVE. Lower
          impedance yields a stronger drive.

          A string enum rather than an integer, matching slew-rate here and every
          other NXP pinctrl binding: the value is consumed by DT_ENUM_IDX, which
          reads its position in this list and never the number itself, so an
          integer would advertise arithmetic that does not happen.

          Deliberately no default. Omitting the property leaves DRIVE at its reset
          value, which is 100 ohm, so a default would only be redundant -- and it
          would defeat the build-time check that rejects this property on the
          PIO0..PIO4 pads, which have no DRIVE field: a binding default is
          materialized for every group, making "the user asked for this"
          indistinguishable from "the binding filled it in".

          Only the PIO5, PIO6 and PIO7 pads have a DRIVE field. On the PIO0
          (VBAT), PIO1 (WAKE) and PIO2/PIO3/PIO4 (MAIN) pads this property
          has no effect and is not written.
      slew-rate:
        type: string
        default: "low"
        enum:
          - "low"
          - "medium"
          - "fast"
          - "high"
        description: |
          Pad slew rate. Sets the SLEWRATE field in the IOMUXC PIO register.
          The listed values map to the register encoding in order:
          low (0b00, default), medium (0b01), fast (0b10), high (0b11).

          SLEWRATE is 2 bits wide only on the PIO5, PIO6 and PIO7 pads. On
          the PIO0, PIO1 and PIO2/PIO3/PIO4 pads it is a single bit, so any
          value above "low" selects that pad's one fast setting.
```

## dts/bindings/pinctrl/nxp,port-pinmux.yaml
```yaml
description: NXP PORT Pin Controller

compatible: "nxp,port-pinmux"

include: [base.yaml, reset-device.yaml]

properties:
  reg:
    required: true

  clocks:
    required: true

child-binding:
  include: pincfg-node.yaml
```
