## dts/bindings/phy/st,stm32mp1-usbphyc.yaml
```yaml
# SPDX-FileCopyrightText: Copyright The Zephyr Project Contributors
# SPDX-License-Identifier: Apache-2.0

description: |
  STM32MP1 USB HS PHY controller (USBPHYC), as found in the STM32MP13 and
  STM32MP15 series.

  The controller hosts a PLL that generates the 480 MHz PHY clock and the
  48 MHz clock of the USB host block, and two UTMI+ ports:

  - port 0 is always routed to port 1 of the USBH host block
    (EHCI/OHCI).
  - port 1 is routed to the USB OTG controller by default, or to port 2 of
    the USBH host block when it is referenced by a host controller node
    ("generic-ohci" or "generic-ehci").

  The PHY analog domain is supplied by the internal 1.1 V and 1.8 V
  regulators of the PWR block and by the external 3.3 V USB supply
  (VDD3V3_USBHS). USB controllers reference a port with their phys
  property.

  Example:

    usbphyc: usbphyc@5a006000 {
      compatible = "st,stm32mp1-usbphyc";
      reg = <0x5a006000 0x1000>;
      clocks = <&rcc STM32_CLOCK(APB4, 16)>,
               <&rcc STM32_SRC_HSE USBPHY_SEL(0)>;
      clock-names = "gate", "mux";
      resets = <&rctl STM32_RESET(APB4, 16)>;
      #address-cells = <1>;
      #size-cells = <0>;

      usbphyc_port0: usb-phy@0 {
        reg = <0>;
        #phy-cells = <0>;
      };

      usbphyc_port1: usb-phy@1 {
        reg = <1>;
        #phy-cells = <0>;
      };
    };

compatible: "st,stm32mp1-usbphyc"

include: [base.yaml, reset-device.yaml]

properties:
  reg:
    required: true

  clocks:
    required: true

  clock-names:
    required: true
    description: |
      Two clock cells are expected:
      - "gate": USBPHYC peripheral clock gate (RCC USBPHY)
      - "mux": USBPHYC PLL reference clock selection (RCC USBPHYSRC).
        The reference clock must be between 19.2 MHz and 38.4 MHz.

  resets:
    required: true

  "#address-cells":
    const: 1

  "#size-cells":
    const: 0

child-binding:
  description: USBPHYC UTMI+ port

  properties:
    reg:
      type: array
      required: true
      description: Port index, 0 or 1

    "#phy-cells":
      type: int
      required: true
      const: 0

    st,current-boost-microamp:
      type: int
      enum: [1000, 2000]
      description: Current boost, in microamperes

    st,no-lsfs-fb-cap:
      type: boolean
      description: Disable the LS/FS feedback capacitor

    st,decrease-hs-slew-rate:
      type: boolean
      description: Decrease the HS driver slew rate

    st,tune-hs-dc-level:
      type: int
      enum: [0, 1, 2, 3]
      description: |
        HS driver DC level:
        0: normal level
        1: increase the level by 5 to 7 mV
        2: increase the level by 10 to 14 mV
        3: decrease the level by 5 to 7 mV

    st,enable-fs-rftime-tuning:
      type: boolean
      description: Enable the FS rise/fall time tuning

    st,enable-hs-rftime-reduction:
      type: boolean
      description: Enable the HS rise/fall time reduction

    st,trim-hs-current:
      type: int
      description: HS driver current trimming, 0 to 15

    st,trim-hs-impedance:
      type: int
      description: HS driver impedance trimming, 0 to 3

    st,tune-squelch-level:
      type: int
      description: Squelch level, 0 to 3

    st,enable-hs-rx-gain-eq:
      type: boolean
      description: Enable the HS receiver gain equalizer

    st,tune-hs-rx-offset:
      type: int
      description: HS receiver offset, 0 to 3

    st,no-hs-ftime-ctrl:
      type: boolean
      description: Disable the HS fall time control of the single ended signals

    st,no-lsfs-sc:
      type: boolean
      description: Disable the short circuit protection of the LS/FS driver

    st,enable-hs-tx-staggering:
      type: boolean
      description: Enable the HS transmitter staggering
```

## dts/bindings/pinctrl/abov,abov32-pinctrl.yaml
```yaml
# Copyright (c) 2026 ABOV Semiconductor Co., Ltd.
# SPDX-License-Identifier: Apache-2.0

description: |
  ABOV32 Port Control Unit (PCU) pin controller.

  Pin state child nodes use the pinmux property, encoded with the
  ABOV_PINMUX(port, pin, alt) macro from
  include/zephyr/dt-bindings/pinctrl/abov32-pinctrl.h, e.g.:

    uart0_default: uart0_default {
        group1 {
            pinmux = <ABOV_PINMUX(5, 0, 4)>, /* PF0 - UART0_TX (ALT4) */
                     <ABOV_PINMUX(5, 1, 4)>; /* PF1 - UART0_RX (ALT4) */
        };
    };

compatible: "abov,abov32-pinctrl"

include: base.yaml

properties:
  reg:
    required: true

child-binding:
  description: ABOV32 pin group configuration.

  child-binding:
    description: ABOV32 pin configuration.

    include:
      - name: pincfg-node.yaml
        property-allowlist:
          - bias-pull-up
          - bias-pull-down
          - drive-open-drain

    properties:
      pinmux:
        required: true
        type: array
        description: |
          Pin encoded with the ABOV_PINMUX(port, pin, alt) macro.
```

## dts/bindings/pinctrl/arm,v2m_musca_b1-pinctrl.yaml
```yaml
# Copyright 2026 Arm Limited and/or its affiliates <open-source-office@arm.com>
# SPDX-License-Identifier: Apache-2.0

description: |
    The Arm Musca-B1 pin controller manages the selection of pin functions/properties.

    The relevant node has the 'pinctrl' node label set, and can thus be modified as follows:

      &pinctrl {
              /* your modifications here */
      };

    Device pin configurations are placed in child nodes, as seen below:
      &pinctrl {
        uart0_default: uart0_default {
            group1 {
                pinmux = <UART0_TXD_EXP>;
            };

            group2 {
                pinmux = <UART0_RXD_EXP>;
                input-enable;
        };
      };

compatible: "arm,v2m_musca_b1-pinctrl"
include: base.yaml

child-binding:
  description: |
    Definitions for a pinctrl state

  child-binding:
    include:
      - name: pincfg-node.yaml

    properties:
      pinmux:
        required: true
        type: array
        description: |
          An array of pins sharing the same group properties. Each
          element of the array is an integer constructed from the
          pin number and the alternative function of the pin.
```

## dts/bindings/pinctrl/beken,bk7258-pinctrl.yaml
```yaml
# Copyright The Zephyr Project Contributors
# SPDX-License-Identifier: Apache-2.0

title: Beken BK7258 pin controller

description: |
  Singleton node selecting the peripheral function and pull resistors of
  each of the BK7258's 56 pads.

  Each child node configures one pad:

    #include <zephyr/dt-bindings/pinctrl/beken-bk7258-pinctrl.h>

    &pinctrl {
      uart0_rx_p10: uart0_rx_p10 {
        pinmux = <BK7258_PINMUX(10, FUNC0)>;
        bias-pull-up;
      };

      uart0_tx_p11: uart0_tx_p11 {
        pinmux = <BK7258_PINMUX(11, FUNC0)>;
        bias-pull-up;
      };
    };

    &uart0 {
      pinctrl-0 = <&uart0_tx_p11 &uart0_rx_p10>;
      pinctrl-names = "default";
    };

  The signal behind each FUNCn is given per pad, FUNC0 first, by the
  GPIO_DEV_MAP table of the vendor SDK:
  https://github.com/bekencorp/bk_idk/blob/release/v2.0.1/middleware/soc/bk7258/soc/gpio_map.h
  The table numbers UART and I2S instances from one, so its UART1 is uart0.

compatible: "beken,bk7258-pinctrl"

include: base.yaml

properties:
  reg:
    required: true

  reg-names:
    required: true

child-binding:
  description: BK7258 pad configuration.

  include:
    - name: pincfg-node.yaml
      property-allowlist:
        - bias-disable
        - bias-pull-down
        - bias-pull-up

  properties:
    pinmux:
      required: true
      type: int
      description: Pad and function, encoded with BK7258_PINMUX(pad, FUNCn).
```

## dts/bindings/pinctrl/hpmicro,hpm-pinctrl.yaml
```yaml
# Copyright (c) 2022-2025 HPMicro
# Copyright (c) 2026 Cody Gu <gujiaqi@iscas.ac.cn>
# SPDX-License-Identifier: Apache-2.0

description: |
  HPMicro IOC and PIOC pin controller.

  Pin configurations are grouped below a state node. Each group contains one
  or more pinmux entries encoded with HPMICRO_PINMUX() and optional pad
  properties shared by all pins in the group. For example:

    #include <zephyr/dt-bindings/pinctrl/hpmicro-pinctrl-common.h>

    &pinctrl {
      uart0_default: uart0_default {
        group0 {
          pinmux = <HPMICRO_PINMUX(HPMICRO_PIN(HPMICRO_PORTA, 0),
                                   IOC_TYPE_IOC, 0, 2)>,
                   <HPMICRO_PINMUX(HPMICRO_PIN(HPMICRO_PORTA, 1),
                                   IOC_TYPE_IOC, 0, 2)>;
        };
      };
    };

  A consumer then references the state with pinctrl-0 and pinctrl-names.

compatible: "hpmicro,hpm-pinctrl"

include: base.yaml

properties:
  reg:
    required: true

child-binding:
  description: HPMicro pin controller state.
  child-binding:
    description: HPMicro pin controller configuration group.
    include:
      - name: pincfg-node.yaml
        property-allowlist:
          - bias-disable
          - bias-pull-down
          - bias-pull-up
          - drive-open-drain
          - input-enable
          - input-schmitt-enable

    properties:
      pinmux:
        type: array
        required: true
        description: |
          Pin mux entries constructed with HPMICRO_PINMUX(). The arguments
          select the pad number, IOC controller type, analog mode and
          alternate function.

      drive-strength:
        type: string
        default: "r000"
        enum:
          - "r000"
          - "r001"
          - "r010"
          - "r011"
          - "r100"
          - "r101"
          - "r110"
          - "r111"
        description: |
          Pad drive strength, written directly to the IOC DS field. The
          resulting resistance depends on the selected IO supply voltage.

      slew-rate:
        type: string
        default: "slow"
        enum:
          - "slow"
          - "fast"
        description: Pad output slew rate.

      hpmicro,slew-pd:
        type: string
        default: "50M"
        enum:
          - "50M"
          - "100M"
          - "150M"
          - "200M"
        description: Pad slew rate frequency range selection.

      hpmicro,pull-resistance:
        type: string
        default: "100KOhm"
        enum:
          - "100KOhm"
          - "47KOhm"
          - "22KOhm"
        description: Internal pull resistor selection.

      hpmicro,keeper-disable:
        type: boolean
        description: |
          Disable the pad keeper. The keeper is enabled when this property is
          absent.
```

## dts/bindings/pinctrl/infineon,aurix-pinctrl.yaml
```yaml
# SPDX-FileCopyrightText: Copyright (c) 2024 Infineon Technologies AG,
# SPDX-FileCopyrightText: or an affiliate of Infineon Technologies AG. All rights reserved.
# SPDX-FileCopyrightText: Copyright (c) 2026 Linumiz
#
# SPDX-License-Identifier: Apache-2.0

description: |
  Infineon AURIX pin controller.

  The node covers the register blocks of all ports. Each child node without
  a compatible configures one pin. The SoC pinctrl dtsi files provide these
  nodes for the pin functions of a device, and boards reference them:

    #include <zephyr/dt-bindings/pinctrl/infineon-aurix-pinctrl.h>

    &pinctrl {
      asclin0_tx_p14_0: asclin0_tx_p14_0 {
        pinmux = <AURIX_PINMUX(14, 0, 2)>;
        output-enable;
      };

      asclin0_rx_p14_1: asclin0_rx_p14_1 {
        pinmux = <AURIX_PINMUX(14, 1, 0)>;
      };
    };

    &asclin0 {
      pinctrl-0 = <&asclin0_tx_p14_0 &asclin0_rx_p14_1>;
      pinctrl-names = "default";
    };

  A pin with output-enable drives the alternate output function of its
  pinmux cell (0 selects GPIO); push-pull unless drive-open-drain is set.
  Any other pin is an input, tri-state unless a bias property is set. The
  peripheral selects which input pin it uses.

compatible: "infineon,aurix-pinctrl"

include: base.yaml

properties:
  reg:
    required: true

child-binding:
  description: Configuration of one pin.

  include:
    - name: pincfg-node.yaml
      property-allowlist:
        - bias-disable
        - bias-pull-down
        - bias-pull-up
        - drive-push-pull
        - drive-open-drain
        - output-enable

  properties:
    pinmux:
      required: true
      type: int
      description: |
        Pin and function, encoded with AURIX_PINMUX() of
        zephyr/dt-bindings/pinctrl/infineon-aurix-pinctrl.h.
```

## dts/bindings/pinctrl/infineon,aurix-tc3x-pinctrl.yaml
```yaml
# SPDX-FileCopyrightText: Copyright (c) 2024 Infineon Technologies AG,
# SPDX-FileCopyrightText: or an affiliate of Infineon Technologies AG. All rights reserved.
# SPDX-FileCopyrightText: Copyright (c) 2026 Linumiz
#
# SPDX-License-Identifier: Apache-2.0

description: Infineon AURIX TC3X pin controller.

compatible: "infineon,aurix-tc3x-pinctrl"

include: infineon,aurix-pinctrl.yaml
```

## dts/bindings/pinctrl/infineon,ioss-pinctrl.yaml
```yaml
# SPDX-FileCopyrightText: Copyright (c) 2026 Infineon Technologies AG
# SPDX-FileCopyrightText: Copyright (c) 2026 Linumiz
# SPDX-License-Identifier: Apache-2.0

description: |
  Infineon IOSS pin controller

  The IOSS block consists of the HSIOM, which selects the peripheral
  function of each pin, and the GPIO ports, which hold the drive mode
  and input buffer configuration of each pin.

  The node must describe both register regions, named "hsiom" and
  "gpio":

    pinctrl: pinctrl@40300000 {
        compatible = "infineon,ioss-pinctrl";
        reg = <0x40300000 0x4000>, <0x40310000 0x10000>;
        reg-names = "hsiom", "gpio";
    };

  On devices with SMIF GPIO ports, the HSIOM and GPIO regions of the
  SMIF blocks are described as "smif0_hsiom", "smif0_gpio",
  "smif1_hsiom" and "smif1_gpio". Their pins use the port numbers
  IFX_SMIF0_PORT0 to IFX_SMIF1_PORT2.

  Pin configuration nodes set the pin and its HSIOM function with
  DT_CAT1_PINMUX(port, pin, hsiom):

    &pinctrl {
        p9_1_scb7_uart_tx: p9_1_scb7_uart_tx {
            pinmux = <DT_CAT1_PINMUX(9, 1, HSIOM_SEL_ACT_14)>;
            drive-push-pull;
        };
    };

compatible: "infineon,ioss-pinctrl"

include: base.yaml

properties:
  reg:
    required: true

  reg-names:
    required: true

child-binding:
  description: Infineon IOSS pin configuration node

  include:
    - name: pincfg-node.yaml
      property-allowlist:
        - bias-high-impedance
        - bias-pull-down
        - bias-pull-up
        - drive-open-drain
        - drive-open-source
        - drive-push-pull
        - input-enable

  properties:
    pinmux:
      type: int
      required: true
      description: |
        Port, pin and HSIOM function, encoded with
        DT_CAT1_PINMUX(port, pin, hsiom).

    slew-rate:
      type: string
      enum:
        - "fast"
        - "slow"
      description: |
        Output slew rate. The current slew rate setting of the pin is
        kept when the property is omitted.

    drive-strength:
      type: string
      enum:
        - "full"
        - "seven-eighths"
        - "three-fourths"
        - "five-eighths"
        - "half"
        - "three-eighths"
        - "one-fourth"
        - "one-eighth"
      description: |
        Output drive strength as a fraction of the full drive strength.
        The supported levels depend on the device, and an unsupported
        level is rejected. When omitted, PSOC Edge devices use half and
        other devices keep the current setting.
```
