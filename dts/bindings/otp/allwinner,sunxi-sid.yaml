## dts/bindings/otp/allwinner,sunxi-sid.yaml
```yaml
# SPDX-FileCopyrightText: Copyright The Zephyr Project Contributors
# SPDX-FileCopyrightText: Copyright (c) 2026 Khai Do
# SPDX-License-Identifier: Apache-2.0

description: Allwinner Security ID (SID) eFuse Controller

compatible: "allwinner,sunxi-sid"

include: base.yaml

properties:
  reg:
    required: true

  size:
    type: int
    required: true
    description: Size of efuse storage (bytes)
```

## dts/bindings/otp/bflb,efuse.yaml
```yaml
# Copyright (c) 2024-2026 MASSDRIVER EI (massdriver.space)
# SPDX-License-Identifier: Apache-2.0

description: BouffaloLab Efuse

compatible: "bflb,efuse"

include: base.yaml

properties:
  reg:
    required: true

  size:
    required: true
    type: int
    description: Size of efuse storage (bytes)
```

## dts/bindings/otp/egis,et171-otp.yaml
```yaml
# Copyright (c) 2026 Egis Technology Inc.
# SPDX-License-Identifier: Apache-2.0

description: Egis ET171 OTP memory controller

compatible: "egis,et171-otp"

include: base.yaml

properties:
  reg:
    required: true
    description: |
      Start address and size of OTP control registers
```

## dts/bindings/otp/nxp,ocotp.yaml
```yaml
# Copyright (c) 2026 Basalte bv
# SPDX-License-Identifier: Apache-2.0

title: NXP OCOTP

description: |
  NXP On-Chip OTP (One-Time Programmable) controller.

  This binding represents the OCOTP peripheral found on NXP i.MX RT series
  and similar SoCs. The OCOTP module provides access to on-chip fuse memory
  used to store configuration data, security keys, MAC addresses, and other
  device-specific information.

  The driver integrates with the NVMEM subsystem, allowing individual fuse
  values to be accessed through nvmem-layout child nodes that define specific
  memory regions.

  Note: The OTP driver API uses byte addressing, while the OCOTP peripheral
  has 32-bit wide registers. When specifying the 'reg' property in nvmem-layout
  child nodes, use byte offsets. The driver handles the conversion between byte
  addresses and register indices internally.

compatible: "nxp,ocotp"

include: base.yaml

examples:
  - |
    ocotp: ocotp@401f4000 {
            compatible = "nxp,ocotp";
            reg = <0x401f4000 0x4000>;
            status = "okay";
            clocks = <&ccm IMX_CCM_OCOTP_CLK 0 0>;

            nvmem-layout {
                    compatible = "fixed-layout";
                    #address-cells = <1>;
                    #size-cells = <1>;

                    mac_address0: mac-address@88 {
                            reg = <0x88 0x6>;
                            #nvmem-cell-cells = <0>;
                    };

                    mac_address1: mac-address@8e {
                            reg = <0x8e 0x6>;
                            #nvmem-cell-cells = <0>;
                    };
            };
    };
```

## dts/bindings/otp/nxp,otpc.yaml
```yaml
# SPDX-FileCopyrightText: Copyright 2026 NXP
# SPDX-License-Identifier: Apache-2.0

title: NXP OTPC eFuse controller

description: |
  NXP OTPC On-Chip OTP (One-Time Programmable) eFuse controller.

  Fuse values can be exposed through nvmem-layout child nodes. The OTP API is
  byte addressed while the controller reads 32-bit words; the driver handles
  unaligned nvmem-layout child 'reg' offsets and read offsets/lengths
  internally, so 4-byte alignment is not required.

compatible: "nxp,otpc"

include: base.yaml

examples:
  - |
    otpc: otpc@c9000 {
            compatible = "nxp,otpc";
            reg = <0xc9000 0x1000>;
            status = "okay";

            nvmem-layout {
                    compatible = "fixed-layout";
                    #address-cells = <1>;
                    #size-cells = <1>;

                    uuid: uuid@40 {
                            reg = <0x40 0x10>;
                            #nvmem-cell-cells = <0>;
                    };
            };
    };
```

## dts/bindings/otp/nxp,rt7xx-ocotp.yaml
```yaml
# Copyright (c) 2026 NXP
# SPDX-License-Identifier: Apache-2.0

title: NXP RT7xx OCOTP

description: |
  NXP RT7xx On-Chip OTP (One-Time Programmable) controller.

  This binding represents the OCOTP peripheral found on NXP i.MX RT7xx
  series SoCs. The OCOTP module provides access to on-chip fuse memory
  via memory-mapped shadow registers.

  The OTP driver API uses byte addressing, while the OCOTP peripheral
  has 32-bit wide shadow registers. The reg property size determines
  the accessible OTP memory range. The driver handles the conversion
  between byte addresses and register indices internally.

compatible: "nxp,rt7xx-ocotp"

include: base.yaml

properties:
  reg:
    required: true

examples:
  - |
    ocotp: ocotp@18000 {
            compatible = "nxp,rt7xx-ocotp";
            reg = <0x18000 0x7a0>;
            status = "okay";

            nvmem-layout {
                    compatible = "fixed-layout";
                    #address-cells = <1>;
                    #size-cells = <1>;

                    /* Cell at byte offset 0x134 (shadow register index 0x4d), 4 bytes wide */
                    tsens_cal: tsens-cal@134 {
                            reg = <0x134 0x4>;
                            #nvmem-cell-cells = <0>;
                            read-only;
                    };
            };
    };
```

## dts/bindings/otp/realtek,rts5817-ocotp.yaml
```yaml
# Copyright (c) 2026 Realtek Semiconductor, Inc.
# SPDX-License-Identifier: Apache-2.0

description: |
  RTS5817 On-Chip OTP (One-Time Programmable) controller.

compatible: "realtek,rts5817-ocotp"

include: [base.yaml, reset-device.yaml]

properties:
  reg:
    required: true

  clocks:
    required: true

  resets:
    required: true

  otp-size:
    type: int
    required: true
    description: OTP Memory size in bytes

  syscon-ldo:
    type: phandle
    required: true
    description: |
      phandle to dlink_ldo node.
```

## dts/bindings/otp/sifli,sf32lb-efuse.yaml
```yaml
# Copyright (c) 2026 SiFli Technologies(Nanjing) Co., Ltd.
# SPDX-License-Identifier: Apache-2.0

description: SiFli SF32LB series eFuse OTP memory controller

compatible: "sifli,sf32lb-efuse"

include: base.yaml

properties:
  reg:
    required: true

  sifli,pmuc:
    type: phandle
    required: true
    description: |
      Reference to the PMUC syscon node. Required for adjusting LDO voltage
      before reading eFuse.

  sifli,bank-size:
    type: int
    default: 32
    description: |
      Size of each eFuse bank in bytes.

  sifli,bank-offsets:
    type: array
    required: true
    description: |
      Register offsets for each bank's data registers. The number of elements
      determines the number of banks. Each offset points to the first data
      register (e.g., BANK0_DATA0) of the corresponding bank.
```

## dts/bindings/otp/st,stm32-bsec.yaml
```yaml
# Copyright (c) 2026 STMicroelectronics
# SPDX-License-Identifier: Apache-2.0

title: STM32 Boot and security control (BSEC)

description: |
  The boot and security control (BSEC) peripheral manages the accesses to an
  embedded one time programmable (OTP) array of fuses. Those fuses are used to
  store on-chip, non-volatile data like boot and security parameters.
  Embedded non-volatile secrets are stored in BSEC upper area that is only
  accessible while BSEC is operating in its BSEC-closed state. When the BSEC
  state is BSEC-open, those non-volatile secrets are permanently hidden.

  Configuration example at SoC level:

  bsec: efuse@56009000 {
    compatible = "st,stm32-bsec";
    reg = <0x56009000 0x1000>;
    st,upper-fuse-limit = <256>;

    nvmem-layout {
      compatible = "fixed-layout";
      #address-cells = <1>;
      #size-cells = <1>;

      bootrom_cfg1: bootrom-cfg1@20 {
        reg = <0x20 0x4>;
        #nvmem-cell-cells = <0>;
      };

      mac_address0: mac-address@2a4 {
        reg = <0x2a4 0x6>;
        #nvmem-cell-cells = <0>;
      };
    };
  };

  Configuration example at board level:

  &bsec {
    nvmem-layout {
      mac_address2: mac-address@2fc {
        reg = <0x2fc 0x6>;
        #nvmem-cell-cells = <0>;
      };
    };
  };

compatible: "st,stm32-bsec"

include: base.yaml

properties:
  st,upper-fuse-limit:
    type: int
    required: true
    description: |
      Start fuse (32bit OTP word) index of the upper fuse region of the BSEC.
      This region requires a particular SoC state to be accessed.
```

## dts/bindings/otp/st,stm32-nvm-otp.yaml
```yaml
# SPDX-FileCopyrightText: Copyright (c) 2026 STMicroelectronics
# SPDX-License-Identifier: Apache-2.0

title: STM32 embedded NVM OTP

description: |
  The NVM embedded in STM32 SoCs contains One-Time-Programmable regions
  in addition to the "regular" region which can be programmed at will.
  The OTP regions are usually provisioned by STMicroelectronics during
  manufacturing (which makes them read-only areas). Some products also
  provide an "OTP for user data" area which can be written in the field.

  Refer to your product's Reference Manual and Data Sheet for more details.

compatible: "st,stm32-nvm-otp"

include: base.yaml

properties:
  reg:
    required: true
    description: |
      Start address and size of NVM OTP area

      Note: for User OTP area nodes, "locking bits" that may be found at the end
      of the OTP area must not be included in the `size` part of this property.
```

## dts/bindings/otp/st,stm32-otp.yaml
```yaml
# Copyright (c) 2026 James Walmsley <james@fullfat-fs.co.uk>
# SPDX-License-Identifier: Apache-2.0

title: STM32 Flash OTP memory

description: |
  STM32 MCUs can expose a one-time programmable (OTP) area inside the embedded
  Flash. This binding represents that memory region and allows using the Zephyr
  OTP driver API and nvmem fixed layout cells.

examples: |
  otp: otp@1fff7800 {
    compatible = "st,stm32-otp";
    reg = <0x1fff7800 0x210>;
    flash = <&flash>;

    nvmem-layout {
      compatible = "fixed-layout";
      #address-cells = <1>;
      #size-cells = <1>;

      boot_flags: boot-flags@0 {
        reg = <0x0 0x4>;
        #nvmem-cell-cells = <0>;
      };
    };
  };

compatible: "st,stm32-otp"

include: base.yaml

properties:
  reg:
    required: true
    description: OTP memory base address and size.

  flash:
    type: phandle
    required: true
    description: |
      Phandle to the STM32 flash controller device used for OTP programming.
```

## dts/bindings/otp/zephyr,otp-emul.yaml
```yaml
# Copyright (c) 2025 STMicroelectronics
# SPDX-License-Identifier: Apache-2.0

description: Zephyr OTP memory emulation peripheral

compatible: "zephyr,otp-emul"

include: base.yaml

properties:
  size:
    type: int
    required: true
    description: OTP Memory size in bytes
```

## dts/bindings/p_state/adi,max32-pstate.yaml
```yaml
# Copyright (c) 2025 Analog Devices, Inc.
#
# SPDX-License-Identifier: Apache-2.0

description: Max32 custom properties for performance state (pstate)

compatible: "adi,max32-pstate"

include: "zephyr,pstate.yaml"

properties:
  pstate-id:
    type: int
    required: true
    description: |
      Identifier of performance state which maps to a divider setting.
```

## dts/bindings/p_state/ambiq,pstate.yaml
```yaml
# Copyright (c) 2025 Ambiq Micro Inc.
# SPDX-License-Identifier: Apache-2.0

description: Ambiq CPU performance state

compatible: "ambiq,pstate"

include: zephyr,pstate.yaml

properties:
  ambiq,perf-mode:
    type: int
    required: true
    description: |
      MCU performance mode to use in this P-state. Use one of the
      macros defined in ``dt-bindings/power/ambiq_power.h``.
```

## dts/bindings/p_state/arm,scmi-perf-pstate.yaml
```yaml
# Copyright 2026 NXP
#
# SPDX-License-Identifier: Apache-2.0

description: |
  Generic CPU performance state backed by the SCMI Performance Domain
  Protocol.

  Example (NXP i.MX95 M7, SCMI domain 3):

    performance-states {
            pstate_odv: pstate-odv {
                    compatible = "arm,scmi-perf-pstate";
                    load-threshold = <70>;
                    scmi-perf-domain = <3>;
                    scmi-perf-level-khz = <800000>;
            };
            pstate_nom: pstate-nom {
                    compatible = "arm,scmi-perf-pstate";
                    load-threshold = <40>;
                    scmi-perf-domain = <3>;
                    scmi-perf-level-khz = <666667>;
            };
            pstate_low: pstate-low {
                    compatible = "arm,scmi-perf-pstate";
                    load-threshold = <10>;
                    scmi-perf-domain = <3>;
                    scmi-perf-level-khz = <400000>;
            };
            pstate_prk: pstate-prk {
                    compatible = "arm,scmi-perf-pstate";
                    load-threshold = <0>;
                    scmi-perf-domain = <3>;
                    scmi-perf-level-khz = <24000>;
            };
    };

compatible: "arm,scmi-perf-pstate"

include:
  - "zephyr,pstate.yaml"

properties:
  scmi-perf-domain:
    type: int
    required: true
    description: |
      SCMI performance domain index for this CPU.

  scmi-perf-level-khz:
    type: int
    required: true
    description: |
      Target CPU frequency in kHz for this P-state.
```

## dts/bindings/p_state/nordic,nrf54h-pstate.yaml
```yaml
# Copyright (c) 2025 Nordic Semiconductor ASA
# SPDX-License-Identifier: Apache-2.0

description: Nordic nRF54H series P-State

compatible: "nordic,nrf54h-pstate"

include: zephyr,pstate.yaml

properties:
  cpu-clock:
    type: phandle
    description: CPU clock to clamp frequency of.

  cpu-min-frequency:
    type: int
    description: Minimum frequency to clamp the clock to.
```

## dts/bindings/p_state/nxp,mcxn.yaml
```yaml
# Copyright 2025 NXP
#
# SPDX-License-Identifier: Apache-2.0

description: |
  NXP MCXN series implementation of custom properties for performance state (pstate)

compatible: "nxp,mcxn-pstate"

include:
  - "zephyr,pstate.yaml"

properties:
  cpu-frequency-level:
    type: string
    enum:
      - low
      - medium
      - high
    description: |
      CPU frequency level associated with this performance state. The frequency
      level correspond to predefined CPU frequency levels supported by the SoC.
```

## dts/bindings/p_state/zephyr,generic-pstate.yaml
```yaml
# Copyright (c) 2025 Analog Devices, Inc.
#
# SPDX-License-Identifier: Apache-2.0

description: |
  Generic Performance State (P-state) binding

  Implement a generic P-state device node.

  Example configuration:

  performance-states {
          pstate_0: pstate_0 {
                  compatible = "zephyr,generic-pstate";
                  load-threshold = <50>;
                  pstate-id = <0>;
          };
          pstate_1: pstate_1 {
                  compatible = "zephyr,generic-pstate";
                  load-threshold = <20>;
                  pstate-id = <1>;
          };
          pstate_2: pstate_2 {
                  compatible = "zephyr,generic-pstate";
                  load-threshold = <0>;
                  pstate-id = <2>;
          };
  };

compatible: "zephyr,generic-pstate"

include: "zephyr,pstate.yaml"

properties:
  pstate-id:
    type: int
    required: true
    description: |
      Identifier of performance state. The state IDs shall be unique among all
      sibling nodes. It is recommended that they begin at 0 and monotonically
      increase with decreasing performance (increasing power savings).
```

## dts/bindings/p_state/zephyr,native-sim-pstate.yaml
```yaml
# Copyright (c) 2025 Analog Devices, Inc.
#
# SPDX-License-Identifier: Apache-2.0

description: Native Sim mock implementation of custom properties for performance state (pstate)

compatible: "zephyr,native-sim-pstate"

include: "zephyr,pstate.yaml"

properties:
  pstate-id:
    type: int
    required: true
    description: |
      Identifier of performance state.
```
