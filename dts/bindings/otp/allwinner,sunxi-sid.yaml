## dts/bindings/p_state/zephyr,pstate.yaml
```yaml
# Copyright (c) 2025 Analog Devices, Inc.
#
# SPDX-License-Identifier: Apache-2.0

description: Common properties for performance states (P-state)

compatible: "zephyr,pstate"

properties:
  load-threshold:
    type: int
    description: |
        CPU load threshold, in percent, for entering this performance state. Once
        the CPU load exceeds this threshold, it becomes a valid performance state
        for the P-state driver to switch to.

  frequency-hz:
    type: int
    required: true
    description: |
        CPU frequency, in hertz, associated with this performance state. CPU
        frequency policies can use this value to estimate how long a known
        number of CPU cycles will take in this state.

  transition-latency-us:
    type: int
    required: true
    description: |
        Worst-case latency, in microseconds, required to switch to this
        performance state from another valid performance state.
```

## dts/bindings/pcie/endpoint/brcm,iproc-pcie-ep-v2.yaml
```yaml
# Copyright 2020 Broadcom.
# SPDX-License-Identifier: Apache-2.0

description: Broadcom iProc PCIe EP node version 2

compatible: "brcm,iproc-pcie-ep-v2"

include: base.yaml

properties:
  reg:
    required: true
    description: |
      Register space for the memory mapped PAX(PCIe to AXI bridge) registers,
      It includes registers to access EP configuration space
      and to map Host PCIe address to PCIe Outbound memory.
```

## dts/bindings/pcie/endpoint/brcm,iproc-pcie-ep.yaml
```yaml
# Copyright 2020 Broadcom.
# SPDX-License-Identifier: Apache-2.0

description: Broadcom iProc PCIe EP node

compatible: "brcm,iproc-pcie-ep"

include: base.yaml

properties:
    reg:
      required: true
      description: |
        Register space for the memory mapped PAX(PCIe to AXI bridge) registers,
        It includes registers to access EP configuration space
        and to map Host PCIe address to PCIe Outbound memory.
```

## dts/bindings/pcie/host/intel,pcie.yaml
```yaml
# Copyright (c) 2020 Intel Corporation
# SPDX-License-Identifier: Apache-2.0

description: Intel PCIe host controller

compatible: "intel,pcie"

include: pcie-controller.yaml
```

## dts/bindings/pcie/host/pci-host-ecam-generic.yaml
```yaml
# Copyright (c) 2020 BayLibre, SAS
# SPDX-License-Identifier: Apache-2.0

description: PCIe Controller in ECAM mode

compatible: "pci-host-ecam-generic"

include: pcie-controller.yaml

properties:
  reg:
    required: true

  msi-parent:
    type: phandle

  ranges:
    type: array
    required: true
    description: |
      As described in IEEE Std 1275-1994, but must provide at least a
      definition of non-prefetchable memory. One or both of prefetchable Memory
      and IO Space may also be provided.

  iommu-maps:
    type: phandle-array
    description: |
      Maps a Request ID to an IOMMU and associated IOMMU specifier data.
      The property is an arbitrary number of tuples of
      (iommu, rid-base, iommu-base, length)

  interrupt-map-mask:
    type: array

  interrupt-map:
    type: compound

  bus-range:
    type: array
```

## dts/bindings/pcie/host/pcie-controller.yaml
```yaml
# Copyright (c) 2020 Intel Corporation
# SPDX-License-Identifier: Apache-2.0

# Common fields for PCIe bus controllers

include: [base.yaml, acpi.yaml]

description: Generic PCIe host controller

compatible: "pcie-controller"

bus: pcie

properties:
  "#address-cells":
    required: true
  "#size-cells":
    required: true
  scan-buses:
    type: array
    description: |
      List of additional PCIe bus numbers to scan for this host controller
      beyond the default bus 0. Bus 0 is always scanned.
      For example, <128> will scan bus 0 and then bus 128.
```
