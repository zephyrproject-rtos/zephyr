## dts/bindings/counter/nuvoton,npcx-lct-base.yaml
```yaml
# Copyright (c) 2025 Nuvoton Technology Corporation.
# SPDX-License-Identifier: Apache-2.0

description: Nuvoton, NPCX-LCT node

compatible: "nuvoton,npcx-lct-base"

include: [base.yaml]

properties:
  reg:
    required: true

  pwr-by-vsby:
    type: boolean
    description: |
      Select the LCT power supply source to VSBY.
```

## dts/bindings/counter/nuvoton,npcx-lct-v1.yaml
```yaml
# Copyright (c) 2025 Nuvoton Technology Corporation.
# SPDX-License-Identifier: Apache-2.0

description: Nuvoton, NPCX-LCT Version 1 node for npcx variant

compatible: "nuvoton,npcx-lct-v1"

include: ["nuvoton,npcx-lct-base.yaml"]

properties:
  lct-wui:
    type: phandle
    required: true
    description: |
        Mapping table between Wake-Up Input (WUI) and LCT count down reaches zero.
        For example,
           lct-wui = <&wui_lct>;

  maximum-cnt-in-sec:
    type: int
    required: true
    const: 9676799
    description: |
      The maximum count that the LCT module can support.
      One count means 1 second.
      This version can support (16 weeks - 1 second).
```

## dts/bindings/counter/nuvoton,npcx-lct-v2.yaml
```yaml
# Copyright (c) 2024 Nuvoton Technology Corporation.
# SPDX-License-Identifier: Apache-2.0

description: Nuvoton, NPCX-LCT Version 2 node for npcx variant

compatible: "nuvoton,npcx-lct-v2"

include: ["nuvoton,npcx-lct-base.yaml"]

properties:
  lct-wui:
    type: phandle
    required: true
    description: |
        Mapping table between Wake-Up Input (WUI) and LCT count down reaches zero.
        For example,
           lct-wui = <&wui_lct>;

  maximum-cnt-in-sec:
    type: int
    required: true
    const: 619919999
    description: |
      The maximum count that the LCT module can support.
      One count means 1 second.
      This version can support (1025 weeks - 1 second).
```

## dts/bindings/counter/nxp,imx-gpt.yaml
```yaml
# Copyright (c) 2018 Nordic Semiconductor ASA
# Copyright 2025 NXP
# SPDX-License-Identifier: Apache-2.0

description: NXP MCUX General-Purpose Timer (GPT)

compatible: "nxp,imx-gpt"

include: [base.yaml, pinctrl-device.yaml]

properties:
  reg:
    required: true

  interrupts:
    required: true

  gptfreq:
    type: int
    description: |
      Desired counter tick frequency in Hz. Required for all internal clock
      sources (periph, high-freq, low-freq, osc).
      Can be left out when clock-source = "ext" — the external clock
      frequency is unknown; counter_get_freq() returns 0 and the prescaler
      is fixed at 1.

  run-mode:
    type: string
    description: |
      Selects how the GPT counter behaves on compare events.
      - restart(default): When the counter reaches the Compare Channel 1 value,
        the counter resets to 0x00000000 and starts counting again.
      - free-run: Compare events do not reset the counter.
      Notes:
      - This driver uses Compare Channel 1 for the Zephyr counter alarm.
      - With restart, using alarms may cause the counter to reset at the
        alarm compare point.
    enum:
      - restart
      - free-run
    default: restart

  clock-source:
    type: string
    description: |
      GPT clock source. The enum order matches gpt_clock_source_t in fsl_gpt.h
      exactly so DT_INST_ENUM_IDX can be cast directly to gpt_clock_source_t.
    enum:
      - "off"
      - "periph"
      - "high-freq"
      - "ext"
      - "low-freq"
      - "osc"
    default: "periph"

  high-freq:
    type: int
    description:
      High-frequency reference clock in Hz. Only applies when clock-source = "high-freq".

  low-freq:
    type: int
    description:
      Low-frequency reference clock in Hz. Only applies when clock-source = "low-freq".

  osc-freq:
    type: int
    description:
      Oscillator frequency expressed in Hz. Only applies when clock-source = "osc".

  osc-divider:
    type: int
    default: 1
    min: 1
    max: 16
    description: |
      Prescaler for the oscillator clock. Only applies when clock-source = "osc".
```

## dts/bindings/counter/nxp,imx-qtmr.yaml
```yaml
# Copyright (c) 2022 KT-Elektronik, Klaucke und Partner GmbH
# SPDX-License-Identifier: Apache-2.0

description: NXP MCUX Quad Timer (QTMR)

compatible: "nxp,imx-qtmr"

include: base.yaml

properties:
    reg:
      required: true

    interrupts:
      required: true
```

## dts/bindings/counter/nxp,imx-snvs-rtc.yaml
```yaml
#
# Copyright (c) 2021 Basalte bv
#
# SPDX-License-Identifier: Apache-2.0
#

description: NXP SNVS LP/HP Realtime Counter

compatible: "nxp,imx-snvs-rtc"

include: base.yaml

properties:
  interrupts:
    required: true
```

## dts/bindings/counter/nxp,imx-tmr.yaml
```yaml
# Copyright (c) 2022 KT-Elektronik, Klaucke und Partner GmbH
# SPDX-License-Identifier: Apache-2.0

description: NXP MCUX Quad Timer Channel. Each channel of each quad timer can operate independently
  and hence will be realized as a separate counter device

compatible: "nxp,imx-tmr"

include: base.yaml

properties:
  label:
    required: true

  channel:
    type: int
    required: true
    enum:
      - 0
      - 1
      - 2
      - 3

  mode:
    type: string
    required: true
    description: counting mode of the timer, see qtmr_counting_mode_t enumerator type
      of the MCUXpresso SDK
    enum:
      - "kQTMR_NoOperation"
      - "kQTMR_PriSrcRiseEdge"
      - "kQTMR_PriSrcRiseAndFallEdge"
      - "kQTMR_PriSrcRiseEdgeSecInpHigh"
      - "kQTMR_QuadCountMode"
      - "kQTMR_PriSrcRiseEdgeSecDir"
      - "kQTMR_SecSrcTrigPriCnt"
      - "kQTMR_CascadeCount"

  primary_source:
    type: string
    required: true
    description: Primary source of the timer, see qtmr_primary_count_source_t enumerator type
      of the MCUXpresso SDK
    enum:
      - "kQTMR_ClockCounter0InputPin"
      - "kQTMR_ClockCounter1InputPin"
      - "kQTMR_ClockCounter2InputPin"
      - "kQTMR_ClockCounter3InputPin"
      - "kQTMR_ClockCounter0Output"
      - "kQTMR_ClockCounter1Output"
      - "kQTMR_ClockCounter2Output"
      - "kQTMR_ClockCounter3Output"
      - "kQTMR_ClockDivide_1"
      - "kQTMR_ClockDivide_2"
      - "kQTMR_ClockDivide_4"
      - "kQTMR_ClockDivide_8"
      - "kQTMR_ClockDivide_16"
      - "kQTMR_ClockDivide_32"
      - "kQTMR_ClockDivide_64"
      - "kQTMR_ClockDivide_128"

  secondary_source:
    type: string
    required: false
    description: Secondary source of the timer, see qtmr_input_source_t enumerator type
      of the MCUXpresso SDK
    enum:
      - "kQTMR_Counter0InputPin"
      - "kQTMR_Counter1InputPin"
      - "kQTMR_Counter2InputPin"
      - "kQTMR_Counter3InputPin"

  filter_count:
    type: int
    required: false
    description: Fault filter count (0-255).

  filter_period:
    type: int
    required: false
    description: Fault filter period (0-255).

  freq:
    type: int
    required: false
    description: clock frequency (only used for external clock sources)
```

## dts/bindings/counter/nxp,imx7d-gpt.yaml
```yaml
# Copyright (c) 2024, MAKEEN Energy A/S
# SPDX-License-Identifier: Apache-2.0

description: NXP IMX7D General-Purpose Timer (GPT)

compatible: "nxp,imx7d-gpt"

include: [base.yaml, pinctrl-device.yaml, "nxp,imx7d-ccm.yaml"]

properties:
  reg:
    required: true

  interrupts:
    required: true

  gptfreq:
    type: int
    required: true
    description: gpt frequencies

  rdc:
    type: int
    required: true
    description: Set the RDC permission for this peripheral
```

## dts/bindings/counter/nxp,irtc-wake-timer.yaml
```yaml
# Copyright 2026 NXP
# SPDX-License-Identifier: Apache-2.0

description: |
  NXP IRTC wake timer exposed through the counter API.

  The tick rate is selected by the "osc-div" property: 1024 Hz with the
  divide-by-32 prescaler enabled, 32768 Hz without.

  This is a one-shot down-counter, not a continuous free-running time
  source. Both counter_start() and arming a relative alarm reload the
  counter, so counter_get_value() restarts from zero at each of those
  calls. Only relative alarms are supported; do not poll it as a
  monotonic time source.

compatible: "nxp,irtc-wake-timer"

include: [base.yaml, wuc-device.yaml]

properties:
  osc-div:
    type: boolean
    description: |
      Enable the wake timer's divide-by-32 prescaler (OSC_DIV_ENA), producing a
      1024 Hz tick from the 32.768 kHz oscillator. When omitted the wake timer
      runs directly at 32768 Hz.
```

## dts/bindings/counter/nxp,kinetis-lptmr.yaml
```yaml
# Copyright 2024 NXP
# SPDX-License-Identifier: Apache-2.0

description: Deprecated compatible for NXP LPTMR

compatible: "nxp,kinetis-lptmr"

include: nxp,lptmr.yaml
```

## dts/bindings/counter/nxp,lpc-ctimer.yaml
```yaml
# Copyright (c) 2021 Toby Firth
# SPDX-License-Identifier: Apache-2.0

description: NXP MCUX Standard Timer/Counter

compatible: "nxp,lpc-ctimer"

include: [base.yaml, pinctrl-device.yaml]

properties:
  reg:
    required: true

  interrupts:
    required: true

  clk-source:
    type: int
    required: true
    description: clock to use

  mode:
    type: int
    required: true
    description: timer mode

  input:
    type: int
    required: true
    description: input channel

  prescale:
    type: int
    required: true
    description: prescale value

  inputmux-connections:
    type: phandle-array
    specifier-space: inputmux
    description: |
      INPUTMUX routing for CTIMER capture inputs. Each phandle-array entry
      is <&inputmuxN channel connection> where:
        - &inputmuxN is the INPUTMUX node providing the route
        - channel is the CAPTSEL destination index (0..3)
        - connection is an inputmux_connection_t value from
          fsl_inputmux_connections.h

      Example (route CT_INP15 to CTIMER2 CAPTSEL[0] via INPUTMUX0):
        inputmux-connections = <&inputmux0 0 0x06000010>;

counter-capture-cells:
  - channel
  - flags
```

## dts/bindings/counter/nxp,lpc-rtc-1khz.yaml
```yaml
# Copyright (c) 2022, NXP
# SPDX-License-Identifier: Apache-2.0

# Special fields for 1KHz rtc

description: NXP The High-resolution/Wake-up Timer (WAKE) 
    which is clocked at a 1 kHz rate 

compatible: "nxp,lpc-rtc-1khz"

include: [base.yaml, pinctrl-device.yaml]
```

## dts/bindings/counter/nxp,lpc-rtc-highres.yaml
```yaml
# Copyright 2023, NXP
# SPDX-License-Identifier: Apache-2.0

description: Driver that uses the NXP LPC RTC High resolution counter

compatible: "nxp,lpc-rtc-highres"

include: base.yaml
```

## dts/bindings/counter/nxp,lpit-channel.yaml
```yaml
# Copyright 2025 NXP
# SPDX-License-Identifier Apache-2.0

description: |
  Child node for the Low Power Periodic Interrupt Timer node, intended
  for an individual timer channel

compatible: "nxp,lpit-channel"

include: base.yaml

properties:
  reg:
    required: true
```

## dts/bindings/counter/nxp,lpit.yaml
```yaml
# Copyright 2025 NXP
# SPDX-License-Identifier: Apache-2.0

description: NXP Low Power Periodic Interrupt Timer (LPIT)

compatible: "nxp,lpit"

include: base.yaml

properties:
  reg:
    required: true

  clocks:
    required: true

  max-load-value:
    type: int
    required: true
    description: Maximum timeout ticks allowed for timer channels.

  enable-run-in-debug:
    type: boolean
    description: Set 1 to allows timer channels to continue running when the chip enters Debug mode.

  enable-run-in-doze:
    type: boolean
    description: Set 1 to allows timer channels to continue running when the chip enters Doze mode.
```

## dts/bindings/counter/nxp,lptmr.yaml
```yaml
# Copyright (c) 2020 Vestas Wind Systems A/S
# SPDX-License-Identifier: Apache-2.0

description: NXP LPTMR

compatible: "nxp,lptmr"

include: [rtc.yaml, wuc-device.yaml]

properties:
  reg:
    required: true

  clock-frequency:
    required: true
    description: Counter clock frequency

  prescaler:
    type: int
    deprecated: true
    description: |
      This property has been deprecated and replaced by prescale-glitch-filter.
      It no longer has any functional impact. Any value assigned to this property
      will be disregarded. Consequently, the prescaler will be bypassed.

  clk-source:
    type: int
    required: true
    enum: [0, 1, 2, 3]
    description: |
      Selects the clock to be used by the LPMTR prescaler/glitch filter.
      In time counter mode, this field selects the input clock to the prescaler.
      In pulse counter mode, this field selects the input clock to the glitch filter.
      The clock connections vary by device, see the device reference manual for
      more details.

  input-pin:
    type: int
    description: |
      When LPTMR is in Pulse mode, this value
      will be used to determine the "rising-edge
      source pin" to increment the lptmr counter.

  active-low:
    type: boolean
    description: |
      When LPTMR is in Pulse mode, this value
      will set the counter to active low.

  resolution:
    type: int
    required: true
    description: Represents the width of the counter in bits.

  prescale-glitch-filter-bypass:
    type: boolean
    description: |
      Controls the clocking of Counter (CNR). If false, the output of the prescaler
      or glitch filter clocks CNR. If true, the selected prescaler clock in Time
      Counter mode, or the selected input source in Pulse Counter mode, directly
      clocks CNR.

  prescale-glitch-filter:
    type: int
    default: 0
    enum: [0, 1, 2, 3, 4, 5, 6, 7, 8, 9, 10, 11, 12, 13, 14, 15]
    description: |
      Configures the size of the prescaler in Time Counter mode and the width of the
      glitch filter in Pulse Counter mode.

      Note: If ``prescale-glitch-filter-bypass`` is set, this property is ignored.
      When in prescaler mode, prescaler divides the prescaler clock by
        2^(prescaler-glitch-filter + 1)
      When in pulse mode, prescale-glitch-filter = 0 is not supported for glitch
        filtering. To request no filtering, set ``prescale-glitch-filter-bypass``.
        If prescale-glitch-filter is greater than 0, glitch filter recognizes change
        on input pin after 2^prescale-glitch-filter rising clock edges.

  timer-mode-sel:
    type: int
    enum: [0, 1]
    default: 0
    description: |
      This value determines rather the LPTMR is configured
      for Time-Counter mode or for Pulse mode.
      0 <- LPTMR is configured for Time Counter Mode.
      1 <- LPTMR is configured for Pulse Mode.

  run-mode:
    type: string
    description: |
      Selects how the LPTMR counter behaves on compare events.
      - restart(default): Counter resets after matching the compare value.
      - free-run: Compare events do not reset the counter; it resets on overflow.
    enum:
      - restart
      - free-run
    default: restart
```

## dts/bindings/counter/nxp,mrt-channel.yaml
```yaml
# Copyright 2023 NXP
# SPDX-License-Identifier: Apache-2.0

description: |
  NXP Multirate Timer Channel

  Must be a child node of an nxp,mrt compatible node.

compatible: "nxp,mrt-channel"

include: base.yaml

properties:
  reg:
    required: true
```

## dts/bindings/counter/nxp,mrt.yaml
```yaml
# Copyright 2023 NXP
# SPDX-License-Identifier: Apache-2.0

description: NXP Multirate Timer

compatible: "nxp,mrt"

include: base.yaml

properties:
  reg:
    required: true

  interrupts:
    required: true

  num-channels:
    type: int
    required: true
    description: Number of channels on the IP version

  num-bits:
    type: int
    required: true
    description: Timer width in bits of IP version

  clocks:
    required: true
```

## dts/bindings/counter/nxp,pit-channel.yaml
```yaml
# Copyright 2024 NXP
# SPDX-License-Identifier Apache-2.0

description: |
  Child node for the Periodic Interrupt Timer node, intended for an individual timer channel

compatible: "nxp,pit-channel"

include: base.yaml

properties:
  reg:
    required: true
```
