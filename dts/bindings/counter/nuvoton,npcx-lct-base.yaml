## dts/bindings/counter/nxp,pit.yaml
```yaml
# Copyright 2020,2023-2024 NXP
# SPDX-License-Identifier: Apache-2.0

description: NXP Periodic Interrupt Timer (PIT)

compatible: "nxp,pit"

include: base.yaml

properties:
  reg:
    required: true

  clocks:
    required: true

  max-load-value:
    type: int
    required: true
    description: maximum load value supported
```

## dts/bindings/counter/nxp,s32-sys-timer.yaml
```yaml
# Copyright 2022-2023 NXP
# SPDX-License-Identifier: Apache-2.0

description: NXP S32 System Timer Module (STM)

compatible: "nxp,s32-sys-timer"

include: base.yaml

properties:
  reg:
    required: true

  interrupts:
    required: true

  clocks:
    required: true

  prescaler:
    type: int
    required: true
    description: |
      Selects the module clock divide value for the prescaler, between 1 and 256.
      Timer frequency equals to clock-frequency divided by the prescaler value.

  freeze:
    type: boolean
    description: Stops the timer when the chip enters Debug mode.
```

## dts/bindings/counter/nxp,stm.yaml
```yaml
# Copyright 2025 NXP
# SPDX-License-Identifier: Apache-2.0

description: NXP System Timer Module (STM)

compatible: "nxp,stm"

include: base.yaml

properties:
  reg:
    required: true

  clocks:
    required: true

  interrupts:
    required: true

  prescaler:
    type: int
    default: 0
    required: true
    description: |
      Selects the module clock divide value for the prescaler (1–256).
      00h - Divide module clock by 1
      01h - Divide module clock by 2
      ...
      FFh - Divide module clock by 256
```

## dts/bindings/counter/nxp,sysctr.yaml
```yaml
# Copyright 2026 NXP
# SPDX-License-Identifier: Apache-2.0

description: NXP System Counter (SYS_CTR)

compatible: "nxp,sysctr"

include: base.yaml

properties:
  reg:
    required: true
    description: |
      Register blocks for the three SYS_CTR programming models:
        - SYS_CTR_CONTROL: counter control, frequency selection, count value
        - SYS_CTR_READ:    read-only access to current count value
        - SYS_CTR_COMPARE: compare frame control, interrupt mask and status

  reg-names:
    required: true
    description: Names for the three register blocks.

  interrupts:
    required: true
    description: |
      Single interrupt line shared by compare frame 0 and compare frame 1.

  clocks:
    required: true
    description: |
      Two clock entries in order: base clock (24 MHz XTAL) and slow clock
      (32 kHz LPO). Use IMX_CCM_SYSCTR_BASE_CLK and IMX_CCM_SYSCTR_SLOW_CLK.

  clock-names:
    required: true
    description: |
      Clock names. Must be "base" for the 24 MHz base clock and "slow" for
      the 32 kHz alternate slow clock.

  clock-source:
    type: int
    default: 0
    enum: [0, 1]
    description: |
      Active clock source selection. Maps directly to sysctr_clock_source_t:
        0 - kSYSCTR_BaseFrequency:      base clock (normal operation)
        1 - kSYSCTR_AlternateFrequency: slow clock divided by 64
                                         inside the hardware (low-power)
      Defaults to 0 (base clock) if not specified.
      NOTE: Alarm functionality is only supported with clock-source = 0.
```

## dts/bindings/counter/nxp,wake-timer.yaml
```yaml
# Copyright 2026 NXP
# SPDX-License-Identifier: Apache-2.0

description: |
  NXP Wake Timer.

  A 32-bit down-counter clocked at 1 kHz (the 16 kHz source divided down by the
  WAKE_TIMER_CTRL[OSC_DIV_ENA] ripple counter). Loading a non-zero count starts a
  countdown that, on reaching zero, raises a wake/interrupt event and halts.

compatible: "nxp,wake-timer"

include: base.yaml

properties:
  reg:
    required: true

  interrupts:
    required: true

  clock-frequency:
    type: int
    const: 1000
    description: |
      Counter clock frequency in Hz. The wake timer is clocked at 1 kHz when
      OSC_DIV_ENA is enabled, which is the only supported value.
```

## dts/bindings/counter/raspberrypi,pico-aon-timer.yaml
```yaml
# Copyright (c) 2025 Dmitrii Sharshakov
# SPDX-License-Identifier: Apache-2.0

description: Raspberry Pi Pico always-on (AON) timer

compatible: "raspberrypi,pico-aon-timer"

include: [base.yaml]
```
