## dts/bindings/counter/counter,generic.yaml
```yaml
#
# Copyright (c) 2018 Nordic Semiconductor ASA
#
# SPDX-License-Identifier: Apache-2.0
#
---
title: Generic counter
version: 0.1

description: >
    This is a representation of the generic Counter (32bit, up)

parent:
    bus: counter

properties:
    compatible:
      constraint: "counter,generic"

    label:
      type: string
      category: required
      description: Human readable string describing the device (used by Zephyr for API name)
      generation: define
...
```

## dts/bindings/counter/counter.yaml
```yaml
# Copyright (c) 2024, Basalte bv
# SPDX-License-Identifier: Apache-2.0

include: base.yaml

properties:
  "#counter-cells":
    type: int
    required: true
    description: Number of items to expect in a counter specifier
```

## dts/bindings/counter/espressif,esp32-counter.yaml
```yaml
# Copyright (c) 2025 Joel Guittet
# SPDX-License-Identifier: Apache-2.0

description: ESP32 counters

compatible: "espressif,esp32-counter"

include: base.yaml

counter-capture-cells:
  - channel
  - flags

properties:
  capture-gpios:
    type: phandle-array
    description: |
      GPIO used as the input source for counter capture. A signal edge on
      this pad is routed through the Event Task Matrix (ETM) to the timer
      capture task, latching the counter value in hardware. Only used when
      counter capture is enabled and only supported on SoCs that expose
      ETM for both the timer and GPIO peripherals.

      The 32-bit capture callback delivers the lower 32 bits of the counter
      and wraps accordingly. Use the 64-bit capture callback for timestamping
      across long intervals.
```

## dts/bindings/counter/espressif,esp32-rtc-timer.yaml
```yaml
# Copyright (c) 2022 Espressif Systems (Shanghai) Co., Ltd.
# SPDX-License-Identifier: Apache-2.0

description: |

        Espressif's Counter Driver based on RTC Main Timer.

        Any reset/sleep mode, except for the power-up reset, will not
        stop or reset the RTC Timer. This behavior may be handy when
        supporting applications that need to keep a timing baseline on
        such situations.

        There is also no need to enable the RTC Timer node, it starts
        running from power-up.

include: base.yaml

compatible: "espressif,esp32-rtc-timer"
```

## dts/bindings/counter/espressif,esp32-timer.yaml
```yaml
# Copyright (c) 2022 Espressif Systems (Shanghai) Co., Ltd.
# SPDX-License-Identifier: Apache-2.0

description: |
        Espressif's general-purpose Timers.
        Each Timer is part of a Timer Group and the number of available Timers
        is SoC-dependent.

        As as example, ESP32 has 4 Timers available, which are split in two
        different groups (TIM0_G0, TIM1_G0, TIM0_G1 and TIM1_G1).

        In order to use one of the available timers on your application add
        a <board>.overlay file with contents as below

          &timer0 {
                  status = "okay";
                  prescaler = <10>;
          };

        From the above, setting 'status' is required while the prescaler is
        optional. Check below for more information on the prescaler.

include: base.yaml

properties:
  group:
    description: |
      The Timer Group index to which a timer belongs.
    type: int
    required: true
    enum:
    - 0
    - 1

  index:
    description: |
      The index that identifies a timer within a Timer Group.
    type: int
    required: true
    enum:
    - 0
    - 1

  prescaler:
    description: |
      The prescaler value defines the factor by which the APB clock will be
      divided. The outcome of which serves as clock reference to the Timer
      itself.

      The allowed values for this property are in the range [2..65535].
      Values above that range will be 16-bit-masked. Values 0 and 1 will be
      forced to 2.
    type: int
    default: 2

compatible: "espressif,esp32-timer"
```

## dts/bindings/counter/infineon,cat1-counter.yaml
```yaml
# Copyright (c) 2022 Cypress Semiconductor Corporation (an Infineon company) or
# an affiliate of Cypress Semiconductor Corporation
#
# SPDX-License-Identifier: Apache-2.0

description: Infineon counters

compatible: "infineon,cat1-counter"

include: base.yaml

properties:
  resolution:
    type: int
    description: |
      Counter resolution
    required: true

  clock-frequency:
    type: int
    description: |
      Frequency that the counter runs

  external-trigger-gpios:
    type: phandle-array
    description: |
      External trigger that runs counter
```

## dts/bindings/counter/infineon,tcpwm-counter.yaml
```yaml
# SPDX-FileCopyrightText: <text>Copyright (c) 2026 Infineon Technologies AG,
# or an affiliate of Infineon Technologies AG. All rights reserved.</text>
#
# SPDX-License-Identifier: Apache-2.0

description: Infineon TCPWM counter

compatible: "infineon,tcpwm-counter"

include: [base.yaml, "infineon,system-interrupts.yaml"]

properties:
  external-trigger-gpios:
    type: phandle-array
    description: |
      External trigger that runs counter

  interrupts:
    description: Required for non-cat1c devices

  system-interrupts:
    description: Required for cat1c devices
```

## dts/bindings/counter/intel,ace-art-counter.yaml
```yaml
description: ACE wallclock ART counter controller

compatible: "intel,ace-art-counter"

include: base.yaml

properties:
  reg:
    required: true
```

## dts/bindings/counter/intel,ace-rtc-counter.yaml
```yaml
description: ACE wallclock RTC counter controller

compatible: "intel,ace-rtc-counter"

include: base.yaml

properties:
  reg:
    required: true
```

## dts/bindings/counter/ite,it51xxx-counter.yaml
```yaml
#
# Copyright (c) 2025 ITE Corporation.
#
# SPDX-License-Identifier: Apache-2.0
#

description: ITE IT51XXX counter

compatible: "ite,it51xxx-counter"

include: base.yaml

properties:
  reg:
    required: true

  interrupts:
    required: true
```

## dts/bindings/counter/ite,it8xxx2-counter.yaml
```yaml
#
# Copyright (c) 2025 ITE Corporation.
#
# SPDX-License-Identifier: Apache-2.0
#

description: ITE IT8XXX2 counter

compatible: "ite,it8xxx2-counter"

include: base.yaml

properties:
  reg:
    required: true

  interrupts:
    required: true
```

## dts/bindings/counter/maxim,ds3231.yaml
```yaml
#
# Copyright (c) 2019 Peter Bigot Consulting, LLC
#
# SPDX-License-Identifier: Apache-2.0
#

description: Maxim DS3231 I2C RTC/TCXO

compatible: "maxim,ds3231"

include: i2c-device.yaml

properties:
  reg:
    required: true

  32k-gpios:
    type: phandle-array
    description: |

      32 KiHz open drain output

      The DS3231 defaults to providing a 32 KiHz square wave on this
      signal.  The driver does not make use of this, but applications
      may want access.

  isw-gpios:
    type: phandle-array
    description: |

      interrupt/square wave open drain output

      The DS3231 uses this signal to notify when an alarm has triggered,
      and also to produce a square wave aligned to the countdown chain.
      Both capabilities are used within the driver.  This signal must be
      present to support time set and read operations that preserve
      sub-second accuracy.
```

## dts/bindings/counter/microchip,mec5-btmr-counter.yaml
```yaml
# Copyright 2024 Microchip Technologies Inc.
# SPDX-License-Identifier: Apache-2.0

description: Microchip MEC5 HAL based Basic Timer

compatible: "microchip,mec5-btmr-counter"

include: base.yaml

properties:
  reg:
    required: true

  interrupts:
    required: true

  clock-frequency:
    type: int
    default: 48000000
    required: true
    description: |
      Basic timer core clock input in Hertz. The current MEC5 family
      value is 48 MHz.

  prescaler:
    type: int
    required: true
    description: |
      Basic timer input clock 16-bit precaler value. The counter
      frequency is divider by (precaler + 1).

  max-value:
    type: int
    required: true
    description: |
      Maximum value of the count and preload registers. Some instances
      have 16-bit counters and others 32-bit.
```

## dts/bindings/counter/microchip,mec5-rtmr-counter.yaml
```yaml
# Copyright 2024 Microchip Technologies Inc.
# SPDX-License-Identifier: Apache-2.0

description: Microchip MEC5 HAL based RTOS timer counter driver

compatible: "microchip,mec5-rtmr-counter"

include: base.yaml

properties:
  reg:
    required: true

  interrupts:
    required: true

  clock-frequency:
    type: int
    required: true
    const: 32768
    description: RTOS timer input clock is fixed at 32 KHz.

  max-value:
    type: int
    required: true
    const: 0xffffffff
    description: Maximum value of the count and preload 32-bit registers.
```

## dts/bindings/counter/microchip,rtc-g1-counter.yaml
```yaml
# Copyright (c) 2026 Microchip Technology Inc.
# SPDX-License-Identifier: Apache-2.0

title: Microchip RTC g1 counter

description: |
  Microchip RTC counter

  RTC peripherals support measuring time intervals and generating periodic
  interrupts.
  Group g1 counter RTC peripherals include following hardware peripherals:
    - module name="RTC" id="U2250" version="2.1.0"
  The supported Families are:
    - same5xd5x family

compatible: "microchip,rtc-g1-counter"

include: microchip,rtc-g1.yaml

properties:
  max-bit-width:
    type: int
    required: true
    description: |
      Maximum bit width supported by the counter.

      This property indicates the resolution of the counter.
    enum:
      - 16
      - 32
```

## dts/bindings/counter/microchip,tc-g1-counter.yaml
```yaml
# Copyright (c) 2026 Microchip Technology Inc.
# SPDX-License-Identifier: Apache-2.0

title: Microchip TC (Timer Counter)

description: |
  Microchip TC (Timer Counter)

  The TC module supports event counting, time interval measurement,
  and periodic interrupt generation.
  The supported devices:
    - tc-u2249 (3.0.0)
  The supported families are:
    - same5xd5x

compatible: "microchip,tc-g1-counter"

include: microchip,tc-g1.yaml
```

## dts/bindings/counter/microchip,tc-g1.yaml
```yaml
# Copyright (c) 2025 Microchip Technology Inc.
# SPDX-License-Identifier: Apache-2.0
title: Microchip TC g1 peripheral.

description: |
  Microchip TC g1 peripheral.

  It is used for creating the PWM output on different channels
  as well as used as a timer/counter.
  This yaml supports the following peripherals
    - tc-u2249 (3.0.0)

compatible: "microchip,tc-g1"

include:
  - name: base.yaml
  - name: pinctrl-device.yaml

properties:
  reg:
    description: |
      Specifies the base address and size of the register set for the timer counter peripheral.
    required: true

  interrupts:
    description: |
      Defines the interrupt lines used by the timer counter peripheral.

      This property specifies the interrupt number and priority.
    required: true

  clocks:
    description: |
      Specifies the clock sources and their configurations for the timer counter peripheral.

      This property ensures the peripheral is provided with the necessary clock signals.
      The following are the clock names applicable to this property.
       - mclk
       - gclk
       - client_mclk : This is the clock subsystem of the client with
         which the instance can be paired. This is an optional clock name.
         It is only applicable to those peripherals which can be paired with another
         instance for achieving a higher max bit width. In this particular case,
         32-bit max-bit-width is attained by pairing two such instances. The ability for
         an instance to pair with another instance attain higher max-bit-width will be
         specified in their respective datasheets.It is not available for all the instances.
    required: true

  prescaler:
    type: int
    enum:
      - 1
      - 2
      - 4
      - 8
      - 16
      - 64
      - 256
      - 1024
    description: |
      Timer prescaler values.

      The prescaler divides the input clock frequency to
      achieve the desired timer frequency.

  channels:
    type: int
    required: true
    description: |
      This property indicates the maximum available channels in a peripheral instance

  max-bit-width:
    type: int
    required: true
    enum:
      - 8
      - 16
      - 32
    description: |
      Maximum bit width supported by the PWM counter.

      This property specifies the resolution of the counter. The value provided
      in the device tree should reflect the maximum supported by the hardware
      instance. It should only be overridden after consulting the relevant family
      datasheet to ensure compatibility.
```

## dts/bindings/counter/microchip,tc-g2-counter.yaml
```yaml
# Copyright (C) 2025 Microchip Technology Inc. and its subsidiaries
#
# SPDX-License-Identifier: Apache-2.0
#

description: Microchip SAM Timer Counter

compatible: "microchip,tc-g2-counter"

include: [base.yaml, pinctrl-device.yaml]

properties:
  reg:
    required: true

  interrupts:
    required: true

  clocks:
    required: true

  clock-selection:
    type: int
    enum: [0, 1, 2, 3, 4]
    default: 0
    description: |
      Refer to TC_CMR.TCCLKS in datasheet.
      GCLK is used by default.

  top-alarm:
    type: boolean
    description: |
      Reuse the top value channel as an alarm channel
      By default RC is exclusive to "top value",
      Use this option to enable the RC alarm channel.
      RA --> alarm channel 0
      RB --> alarm channel 1
      RC --> alarm channel 2 or top value
```

## dts/bindings/counter/microchip,tcc-g1-counter.yaml
```yaml
# Copyright (c) 2025 Microchip Technology Inc.
# SPDX-License-Identifier: Apache-2.0
title: Microchip TCC G1 counter peripheral.

description: |
  Microchip TCC G1 counter peripheral.

  This driver is used for configuring and managing TCC
  (Timer/Counter for Control Applications) peripheral in Microchip microcontrollers.
  This peripherals support counting events, measuring time intervals, and generating
  periodic interrupts.
  The supported peripheral IP versions :
   - TCC id="U2213" version="3.1.0"
  The supported families are:
   - SAM_E5X_D5X

compatible: "microchip,tcc-g1-counter"

include: microchip,tcc-g1.yaml
```
