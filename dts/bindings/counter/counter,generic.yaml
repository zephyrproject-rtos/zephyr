## dts/bindings/counter/microchip,tcc-g1.yaml
```yaml
# Copyright (c) 2025 Microchip Technology Inc.
# SPDX-License-Identifier: Apache-2.0

title: Microchip TCC G1 timer counter peripheral.

description: |
  Microchip TCC G1 timer counter peripheral.

  This peripheral is used for generating PWM signals.
  This compatible string is to be used for the following peripherals:
    - module name="TCC" id="U2213" version="3.1.0"

compatible: "microchip,tcc-g1"

include:
  - name: base.yaml
  - name: pinctrl-device.yaml

properties:
  reg:
    description: |
      Specifies the base address and size of the register set for the timer counter peripheral.
    required: true

  interrupts:
    description: |
      Defines the interrupt lines used by the timer counter peripheral.

      This property specifies the interrupt number and priority.
    required: true

  clocks:
    description: |
      Specifies the clock sources and their configurations for the timer counter peripheral.

      This property ensures the peripheral is provided with the necessary clock signals.
    required: true

  prescaler:
    type: int
    description: |
      Timer prescaler values.

      The prescaler divides the input clock frequency to
      achieve the desired timer frequency.
    enum:
      - 1
      - 2
      - 4
      - 8
      - 16
      - 64
      - 256
      - 1024

  channels:
    type: int
    required: true
    description: |
      This specifies the maximum number of channels available for the peripheral instance.

  max-bit-width:
    type: int
    required: true
    description: |
      Maximum bit width supported by the counter.

      This property specifies the resolution of the counter. The value provided in the device tree
      should reflect the maximum supported by the hardware instance. It should only be overridden
      after consulting the relevant family datasheet to ensure compatibility.
    enum:
      - 16
      - 24
```

## dts/bindings/counter/microcrystal,rv3032-counter.yaml
```yaml
# Copyright (c) 2025 BayLibre, SAS
# SPDX-License-Identifier: Apache-2.0

description: |
        rv3032c7 RTC counter driver

compatible: "microcrystal,rv3032-counter"

include: base.yaml

properties:
  frequency:
    type: int
    required: true
    enum:
      - 4096
      - 64
      - 1
      - 0
    description: |
      Clock freq used for timer functionality
        clk freq   period
        4096hz     224.14us
        64h        15.625ms
        1hz        1s
        1/60hz     60s (this case is presented as 0)
```

## dts/bindings/counter/neorv32,gptmr.yaml
```yaml
description: NEORV32 General Purpose Timer (GPTMR)

compatible: "neorv32,gptmr"

include: base.yaml

properties:
  interrupts:
    required: true

  reg:
    required: true

  syscon:
    type: phandle
    required: true
    description: |
      phandle to syscon (NEORV32 SYSINFO) node.

  prescaler:
    type: int
    enum: [2, 4, 8, 64, 128, 1024, 2048, 4096]
    required: true
    description: |
      Clock prescaler setting for scaling the main NEORV32 processor clock to the GPTMR clock.
```

## dts/bindings/counter/nuvoton,nct-itim32.yaml
```yaml
# Copyright (c) 2025 Nuvoton Technology Corporation.
# SPDX-License-Identifier: Apache-2.0

description: Nuvoton, NCT Internal 32-bit Timer(ITIM32) node

compatible: "nuvoton,nct-itim32"

include: base.yaml

properties:
  reg:
    required: true

  clocks:
    required: true

  prescaler:
    type: int
    default: 1
    description: |
      The prescaler value defines the factor by which the APB/LF clock will
      be divided. The outcome of which serves as clock reference to the Timer
      itself.

      The allowed values for this property are in the range [1..256].
      Values above that range will be 8-bit-masked.
```

## dts/bindings/counter/nuvoton,npck-lct.yaml
```yaml
# Copyright (c) 2025 Nuvoton Technology Corporation.
# SPDX-License-Identifier: Apache-2.0

description: Nuvoton, NPCK-LCT node for npck variant

compatible: "nuvoton,npck-lct"

include: ["nuvoton,npcx-lct-base.yaml"]

properties:
  maximum-cnt-in-sec:
    type: int
    required: true
    const: 9676799
    description: |
      The maximum count that the LCT module can support.
      One count means 1 second.
      Npck can support (16 weeks - 1 second).
```

## dts/bindings/counter/nuvoton,npcm-itim32.yaml
```yaml
# Copyright (c) 2024 Nuvoton Technology Corporation.
# SPDX-License-Identifier: Apache-2.0

description: Nuvoton, NPCM Internal 32-bit Timer(ITIM32) node

compatible: "nuvoton,npcm-itim32"

include: base.yaml

properties:
  reg:
    required: true

  clocks:
    required: true

  prescaler:
    type: int
    default: 1
    description: |
      The prescaler value defines the factor by which the APB/LF clock will
      be divided. The outcome of which serves as clock reference to the Timer
      itself.

      The allowed values for this property are in the range [1..256].
      Values above that range will be 8-bit-masked.

  low-freq-select:
    type: boolean
    description: select low-frequency input clock source.
```
