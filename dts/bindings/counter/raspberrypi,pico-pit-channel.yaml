## dts/bindings/counter/raspberrypi,pico-pit-channel.yaml
```yaml
# Copyright (c) 2024 Navimatix GmbH
# SPDX-License-Identifier: Apache-2.0

title: Raspberry Pi Pico PIT Channel

description: |
  All channels need to be child nodes of a raspberrypi,pico-pit compatible node

compatible: "raspberrypi,pico-pit-channel"

include: base.yaml

properties:
  reg:
    required: true
    description: |
     PWM Slice used by the counter (value 0-7) and thus the channel id. Using other pwm devices
     connected to this slice leads to undefined behavior. Slice 0 is connected to channels 0 and 1,
     slice 1 to 2 and 3 and so on. While the physical pins can be used for other tasks, PWM usage
     would lead to undefined behaviour. The PWM pincontrol macros are also a source of information,
     as the number directly after PWM_ is the slice used by this channel.
```

## dts/bindings/counter/raspberrypi,pico-pit.yaml
```yaml
# Copyright (c) 2024 Navimatix GmbH
# SPDX-License-Identifier: Apache-2.0

title: Raspberry Pi Pico PIT

description: |
  Provides interrupt management and clock information to raspberrypi,pico-pit-channel devices.
  They need to be child nodes of this node.

compatible: "raspberrypi,pico-pit"

include: base.yaml

properties:
  clocks:
    required: true

  interrupts:
    required: true
```

## dts/bindings/counter/raspberrypi,pico-timer.yaml
```yaml
# Copyright (c) 2023 TOKITA Hiroshi
# SPDX-License-Identifier: Apache-2.0

description: Raspberry Pi Pico timer

compatible: "raspberrypi,pico-timer"

include: [base.yaml, reset-device.yaml]
```

## dts/bindings/counter/realtek,ameba-counter.yaml
```yaml
# Copyright (c) 2024 Realtek Semiconductor Corp.
# SPDX-License-Identifier: Apache-2.0

description: Ameba counters

compatible: "realtek,ameba-counter"

include: base.yaml

properties:
  reg:
    required: true

  clock-frequency:
    type: int
    enum:
      - 32768
      - 1000000
    description: clock-frequency of basic timer clk source
```

## dts/bindings/counter/realtek,bee-counter-rtc.yaml
```yaml
# Copyright (c) 2026, Realtek Semiconductor Corporation
# SPDX-License-Identifier: Apache-2.0

description: |
  Realtek Bee Real-Time Clock (RTC) Counter.

  The Bee RTC provides timekeeping and alarm functionality.
  It supports configurable source clock frequency and prescaler settings.

compatible: "realtek,bee-counter-rtc"

include: [base.yaml]

properties:
  reg:
    required: true

  interrupts:
    required: true
    description: RTC alarm interrupt.

  channels:
    type: int
    required: true
    description: Number of RTC channels.

  src-clk-freq:
    type: int
    default: 32000
    description: |
      Frequency of the RTC source clock in Hz.
      Default is 32000. Set to 32768 if using an external crystal.
    enum:
      - 32000
      - 32768

  prescaler:
    type: int
    default: 1
    description: |
      Clock prescaler divider, range from 1 to 4096.
      The RTC counter clock = src-clk-freq / prescaler.
      Default is 1 (no division).
```

## dts/bindings/counter/realtek,bee-counter-timer.yaml
```yaml
# Copyright (c) 2026, Realtek Semiconductor Corporation
# SPDX-License-Identifier: Apache-2.0

description: Realtek Bee Timer implemented as Counter

compatible: "realtek,bee-counter-timer"

include: base.yaml
```

## dts/bindings/counter/realtek,rts5912-slwtimer.yaml
```yaml
# SPDX-License-Identifier: Apache-2.0
#
# Copyright (c) 2024 Realtek Semiconductor Corporation, SIBG-SD7
#

description: Realtek RTS5912 32-bit slow timer

compatible: "realtek,rts5912-slwtimer"

include: base.yaml

properties:
  reg:
    required: true

  interrupts:
    required: true

  max-value:
    type: int
    required: true
    description: Maximum counter value the instance can handle

  clock-frequency:
    type: int
    required: true
    description: Clock frequency information for timer operation

  prescaler:
    type: int
    required: true
    description: Timer frequency equals clock-frequency divided by the prescaler value
```

## dts/bindings/counter/realtek,rts5912-timer.yaml
```yaml
# Copyright (c) 2025, Realtek Corporation
# SPDX-License-Identifier: Apache-2.0

description: Realtek RTS5912 32bit timer

compatible: "realtek,rts5912-timer"

include: base.yaml

properties:
  reg:
    required: true

  interrupts:
    required: true

  max-value:
    type: int
    required: true
    description: Maximum counter value the instance can handle

  clock-frequency:
    type: int
    required: true
    description: Clock frequency information for timer operation

  prescaler:
    type: int
    required: true
    description: Timer frequency equals clock-frequency divided by the prescaler value
```

## dts/bindings/counter/renesas,ra-agt-counter.yml
```yaml
# Copyright (c) 2024 Renesas Electronics Corporation
# SPDX-License-Identifier: Apache-2.0

description: Renesas RA AGT as Counter.

compatible: "renesas,ra-agt-counter"

include: base.yaml
```

## dts/bindings/counter/renesas,ra-gpt-counter.yaml
```yaml
# Copyright (c) 2026 Mahad Faisal
# SPDX-License-Identifier: Apache-2.0

description: Renesas RA General PWM Timer counter

compatible: "renesas,ra-gpt-counter"

include: [base.yaml]
```

## dts/bindings/counter/renesas,ra-ulpt-counter.yaml
```yaml
# Copyright (c) 2026 Renesas Electronics Corporation
# SPDX-License-Identifier: Apache-2.0

description: Renesas RA ULPT Counter.

compatible: "renesas,ra-ulpt-counter"

include: base.yaml
```

## dts/bindings/counter/renesas,rcar-cmt-counter.yaml
```yaml
description: A single channel of Renesas R-Car Compare Match Timer as a counter

compatible: "renesas,rcar-cmt-counter"

include: base.yaml

properties:
  reg:
    description: |
      Offset of the channel register from the CMT module it belongs to.
    required: true

  interrupts:
    required: true

  channel-index:
    type: int
    required: true
    description: |
      The channel of CMT module which this counter device belongs to.
    enum:
      - 0
      - 1
      - 2
      - 3
      - 4
```

## dts/bindings/counter/renesas,rcar-cmt-timer.yaml
```yaml
description: Renesas R-Car Compare Match Timer

compatible: "renesas,rcar-cmt-timer"

include: base.yaml

properties:
  reg:
    required: true

  clock-frequency:
    type: int
    required: true
    description: Clock frequency information for Timer operation

  clocks:
    required: true
```

## dts/bindings/counter/renesas,rz-cmtw-counter.yaml
```yaml
# Copyright (c) 2025 Renesas Electronics Corporation
# SPDX-License-Identifier: Apache-2.0

description: Renesas RZ CMTW Counter

compatible: "renesas,rz-cmtw-counter"

include: [base.yaml]
```

## dts/bindings/counter/renesas,rz-gtm-counter.yaml
```yaml
# Copyright (c) 2024 Renesas Electronics Corporation
# SPDX-License-Identifier: Apache-2.0

description: Renesas RZ GTM Counter

compatible: "renesas,rz-gtm-counter"

include: [base.yaml]
```

## dts/bindings/counter/renesas,rza2m-ostm-counter.yaml
```yaml
# Copyright (c) 2025 Renesas Electronics Corporation
# SPDX-License-Identifier: Apache-2.0

description: Renesas RZA2M OSTM Counter

compatible: "renesas,rza2m-ostm-counter"

include: [base.yaml]
```

## dts/bindings/counter/renesas,smartbond-timer.yaml
```yaml
# Copyright (c) 2022 Renesas Electronics Corporation
# SPDX-License-Identifier: Apache-2.0

description: Renesas SmartBond(tm) general purpose timers

compatible: "renesas,smartbond-timer"

include: base.yaml

properties:
  reg:
    required: true

  clock-src:
    required: true
    type: phandle
    description: |
      Timer uses divn_clk or lp_clk

  prescaler:
    type: int
    required: true
    description: |
      Clock prescaler at the input of the timer
      Could be in range [0 .. 31] (CLK/(prescaler+1) )
```

## dts/bindings/counter/sifli,sf32lb-gptm.yaml
```yaml
# Copyright (c) 2025, Qingsong Gou <gouqs@hotmail.com>
# SPDX-License-Identifier: Apache-2.0

description: Sifli SF32LB General Purpose Timer (GPT)

compatible: "sifli,sf32lb-gptm"

include: base.yaml

properties:
  reg:
    required: true

  interrupts:
    required: true

  prescaler:
    type: int
    default: 0
    required: true
    description: Counter prescaler from 0 to 65535.
```

## dts/bindings/counter/silabs,burtc-counter.yaml
```yaml
# Copyright (c) 2026 Shontal Biton
# SPDX-License-Identifier: Apache-2.0

title: Silicon Labs Series 2 BURTC (Backup Real Time Counter)

description: |
  Backup RTC timer for Silicon Labs Series 2 SoCs.

compatible: "silabs,burtc-counter"

include: base.yaml

properties:
  reg:
    required: true

  clock-div:
    type: int
    default: 1
    description: Clock divider for timer
    enum:
      - 1
      - 2
      - 4
      - 8
      - 16
      - 32
      - 64
      - 128
      - 256
      - 512
      - 1024
      - 2048
      - 4096
      - 8192
      - 16384
      - 32768
```

## dts/bindings/counter/silabs,protimer.yaml
```yaml
# Copyright 2026 Silicon Laboratories Inc.
# SPDX-License-Identifier: Apache-2.0

title: Silicon Labs PROTIMER counter

description: |
  Silicon Labs Series 2 PROTIMER Counter

compatible: "silabs,protimer"

include: base.yaml
```

## dts/bindings/counter/silabs,timer-counter.yaml
```yaml
# Copyright (c) 2026 Phuc Hoang <donp172748@gmail.com>
# SPDX-License-Identifier: Apache-2.0

title: Silicon Labs TIMER Counter

description: |
  TIMER peripheral on Silicon Labs Series 2 SoCs used in counter mode.

  The TIMER peripheral on Silicon Labs Series 2 SoCs provides versatile 16-bit or 32-bit
  timer/counter capabilities. In counter mode, it can be used to count events from
  internal or external sources.

compatible: "silabs,timer-counter"

include: base.yaml
```

## dts/bindings/counter/snps,dw-timers.yaml
```yaml
# Copyright (c) 2022-2023, Intel Corporation
# SPDX-License-Identifier: Apache-2.0

description: |
    Synopsys Designware timer driver

compatible: "snps,dw-timers"

include: [base.yaml, reset-device.yaml]

properties:
  reg:
    required: true

  clock-frequency:
    type: int
    description: clock frequency information for Timer
```

## dts/bindings/counter/ti,am3352-eqep.yaml
```yaml
# SPDX-FileCopyrightText: Copyright (c) 2026 Texas Instruments
# SPDX-License-Identifier: Apache-2.0

description: TI Enhanced Quadrature Encoder Pulse based counter

include: [base.yaml, pinctrl-device.yaml]

compatible: "ti,am3352-eqep"

properties:
  reg:
    required: true

  interrupts:
    required: true
```

## dts/bindings/counter/ti,cc23x0-lgpt.yaml
```yaml
# Copyright (c) Copyright (c) 2024 BayLibre, SAS
# SPDX-License-Identifier: Apache-2.0

description: CC23x0 LGPT counter driver

properties:
  freq:
    type: int
    description: clock frequency (only used for external clock sources)

  interrupts:
    required: true

  clk-prescale:
    type: int
    required: true
    description: Counter clock prescale

  max-top-value:
    type: int
    required: true
    description: Max allowed value for counter

compatible: "ti,cc23x0-lgpt"

include: base.yaml
```

## dts/bindings/counter/ti,cc23x0-rtc.yaml
```yaml
# Copyright (c) 2024 BayLibre, SAS
# SPDX-License-Identifier: Apache-2.0

description: |
        CC23x0 RTC counter driver
        Any reset/sleep mode, except for the power-up reset, will not
        stop or reset the RTC Timer. This behavior may be handy when
        supporting applications that need to keep a timing baseline on
        such situations.
        There is also no need to enable the RTC Timer node, it starts
        running from power-up.

compatible: "ti,cc23x0-rtc"

include: base.yaml
```
