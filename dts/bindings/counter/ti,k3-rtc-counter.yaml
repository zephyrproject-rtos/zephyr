## dts/bindings/counter/ti,k3-rtc-counter.yaml
```yaml
# Copyright 2026 Texas Instruments Inc.
# SPDX-License-Identifier: Apache-2.0

description: Counter based Real Time Clock (RTC) available in the TI K3 generation of processors.

compatible: "ti,k3-rtc-counter"

include: base.yaml

properties:
  reg:
    required: true

  interrupts:
    required: true

  clock-frequency:
    type: int
    required: true
```

## dts/bindings/counter/ti,mspm0-counter.yaml
```yaml
# Copyright 2025 Linumiz GmbH
# SPDX-License-Identifier: Apache-2.0

description: |
  TI MSPM0 counter node for MSPM0 SoCs. Each timer can be configured to use for
  counter operation.

  mspm0counter : counter {
    counter_0 {
      resolution = <16>;
    };
  };

compatible: "ti,mspm0-timer-counter"

include: base.yaml

properties:
  resolution:
    type: int
    required: true
    description: |
      Counter resolution
```

## dts/bindings/counter/wch,gptm.yaml
```yaml
# Copyright (c) 2025 Michael Hope <michaelh@juju.nz>
# SPDX-License-Identifier: Apache-2.0

description: WCH General-purpose Timer (GPTM) for PWM

compatible: "wch,gptm"

include: [base.yaml]

properties:
  reg:
    required: true

  clocks:
    required: true

  channels:
    type: int
    required: true
    description: Number of timer channels.

  prescaler:
    type: int
    default: 0
    description: |
      Counter prescaler from 0 to 65535. The clock frequency to the counter
      is the input frequency divided by (prescaler + 1). For example, if the
      input clock is 48 MHz and the desired counter clock is 1 MHz, set this
      property to 47.
```

## dts/bindings/counter/xlnx,ttc-counter.yaml
```yaml
# Copyright (c) 2026 Advanced Micro Devices, Inc.
#
# SPDX-License-Identifier: Apache-2.0

description: |
  AMD/Xilinx TTC timer instance.

  Each node represents one timer within a parent TTC block.

compatible: "xlnx,ttc-counter"

include: base.yaml

properties:
  reg:
    required: true
    description: |
      Timer index inside the TTC block.

      0 = timer0
      1 = timer1
      2 = timer2

  interrupts:
    required: true

  prescaler:
    type: int
    description: |
      Clock prescaler value (0-15).
```

## dts/bindings/counter/xlnx,ttc.yaml
```yaml
# Copyright (c) 2026 Advanced Micro Devices, Inc.
#
# SPDX-License-Identifier: Apache-2.0

description: |
  AMD/Xilinx Triple Timer Counter (TTC).

  The TTC hardware block contains three independent timer/counter
  instances. Each timer may be exposed as a child node using the
  "xlnx,ttc-counter" compatible.

compatible: "xlnx,ttc"

include: base.yaml

properties:
  reg:
    required: true

  timer-width:
    type: int
    required: true
    enum:
      - 16
      - 32
    description: |
      Width of the TTC counter in bits.

  clock-frequency:
    type: int
    required: true
    description: |
      Input clock frequency in Hz shared by all timers in the TTC block.

  "#address-cells":
    const: 1

  "#size-cells":
    const: 0
```

## dts/bindings/counter/xlnx,zynqmp-rtc.yaml
```yaml
# Copyright (c) 2026 Advanced Micro Devices, Inc.
# SPDX-License-Identifier: Apache-2.0

description: Xilinx Zynq Ultrascale+ MPSoC Real Time Clock

compatible: "xlnx,zynqmp-rtc"

include: base.yaml

properties:
  reg:
    required: true

  interrupts:
    required: true
    description: |
      Two interrupts: alarm and seconds tick.
      The alarm interrupt fires when the seconds counter matches the
      alarm register. The seconds interrupt fires on each second tick.

  interrupt-names:
    required: true
    enum:
      - "alarm"
      - "sec"

  clock-frequency:
    type: int
    default: 32768
    description: |
      Crystal oscillator frequency in Hz.
```

## dts/bindings/counter/xuantie,counter.yaml
```yaml
# Copyright (C) 2017-2024 Alibaba Group Holding Limited.
# SPDX-License-Identifier: Apache-2.0

description: XuanTie COUNTER

compatible: "xuantie,counter"

include: base.yaml

properties:
  reg:
    required: true

  interrupts:
    required: true

  clock-frequency:
    type: int
    required: true
```

## dts/bindings/counter/zephyr,native-posix-counter.yaml
```yaml
# Copyright (c) 2022, Kumar Gala <galak@kernel.org>
# SPDX-License-Identifier: Apache-2.0

description: Native POSIX Counter

compatible: "zephyr,native-posix-counter"

include: "counter.yaml"

properties:
  "#counter-cells":
    const: 1

counter-cells:
  - channel
```

## dts/bindings/counter/zephyr,native-sim-counter.yaml
```yaml
# Copyright (c) 2022, Kumar Gala <galak@kernel.org>
# SPDX-License-Identifier: Apache-2.0

description: Native_sim Counter

compatible: "zephyr,native-sim-counter"

include: base.yaml

properties:
  rising-edge:
    type: boolean
    description: Emulated counter supports rising-edge capture detection

  falling-edge:
    type: boolean
    description: Emulated counter supports falling-edge capture detection

counter-capture-cells:
  - channel
  - flags
```

## dts/bindings/cpu/adi,max32-m4f-cpu1.yaml
```yaml
# Copyright (c) 2026 Analog Devices, Inc
#
# SPDX-License-Identifier: Apache-2.0

description: MAX32 ARM M4F CPU1 core

compatible: "adi,max32-m4f-cpu1"

include: ["arm,cortex-m4f.yaml", "pinctrl-device.yaml"]
```

## dts/bindings/cpu/adi,max32-rv32.yaml
```yaml
# Copyright (c) 2026 Analog Devices, Inc
#
# SPDX-License-Identifier: Apache-2.0

description: MAX32 RV32 core

compatible: "adi,max32-rv32"

include: ["riscv,cpus.yaml", "pinctrl-device.yaml"]
```

## dts/bindings/cpu/altr,nios2f.yaml
```yaml
# Copyright (c) 2018 Nordic Semiconductor ASA
# SPDX-License-Identifier: Apache-2.0

description: Altera NIOS-2F CPU

compatible: "altr,nios2f"

include: [interrupt-controller.yaml, base.yaml]

properties:
  "#interrupt-cells":
    const: 1

interrupt-cells:
  - irq
```

## dts/bindings/cpu/andes,andescore-v5.yaml
```yaml
# Copyright (c) 2024 Antmicro <www.antmicro.com>
#
# SPDX-License-Identifier: Apache-2.0

description: Andes Technology RISC-V core from the AndesCore v5 series

compatible: "andestech,andescore-v5"

include: riscv,cpus.yaml
```

## dts/bindings/cpu/arm,armv8.yaml
```yaml
# SPDX-FileCopyrightText: Copyright The Zephyr Project Contributors
# SPDX-License-Identifier: Apache-2.0

description: Generic ARMv8-A CPU

compatible: "arm,armv8"

include: cpu.yaml
```

## dts/bindings/cpu/arm,cortex-a32.yaml
```yaml
# Copyright (c) 2025 Alif Semiconductor
# SPDX-License-Identifier: Apache-2.0

description: ARM Cortex-A32 CPU

compatible: "arm,cortex-a32"

include: cpu.yaml
```

## dts/bindings/cpu/arm,cortex-a320.yaml
```yaml
# Copyright (c) 2025 BayLibre SAS
# SPDX-License-Identifier: Apache-2.0

description: Arm Cortex-A320 CPU

compatible: "arm,cortex-a320"

include: cpu.yaml
```

## dts/bindings/cpu/arm,cortex-a510.yaml
```yaml
# Copyright (c) 2025 BayLibre SAS
# SPDX-License-Identifier: Apache-2.0

description: Arm Cortex-A510 CPU

compatible: "arm,cortex-a510"

include: cpu.yaml
```

## dts/bindings/cpu/arm,cortex-a53.yaml
```yaml
# Copyright (c) 2019 Carlo Caione <ccaione@baylibre.com>
# SPDX-License-Identifier: Apache-2.0

description: ARM Cortex-A53 CPU

compatible: "arm,cortex-a53"

include: cpu.yaml
```

## dts/bindings/cpu/arm,cortex-a55.yaml
```yaml
# Copyright 2022 NXP
# SPDX-License-Identifier: Apache-2.0

description: ARM Cortex-A55 CPU

compatible: "arm,cortex-a55"

include: cpu.yaml
```

## dts/bindings/cpu/arm,cortex-a57.yaml
```yaml
# Copyright (c) 2026 BayLibre SAS
# SPDX-License-Identifier: Apache-2.0

description: ARM Cortex-A57 CPU

compatible: "arm,cortex-a57"

include: cpu.yaml
```

## dts/bindings/cpu/arm,cortex-a7.yaml
```yaml
# Copyright (c) 2025 Muhammad Waleed Badar
# SPDX-License-Identifier: Apache-2.0

description: ARM Cortex-A7 CPU

compatible: "arm,cortex-a7"

include: cpu.yaml
```

## dts/bindings/cpu/arm,cortex-a72.yaml
```yaml
# SPDX-License-Identifier: Apache-2.0

description: ARM Cortex-A72 CPU

compatible: "arm,cortex-a72"

include: cpu.yaml
```

## dts/bindings/cpu/arm,cortex-a720.yaml
```yaml
# SPDX-License-Identifier: Apache-2.0

description: Arm Cortex-A720 CPU

compatible: "arm,cortex-a720"

include: cpu.yaml
```

## dts/bindings/cpu/arm,cortex-a76.yaml
```yaml
# Copyright (c) 2022 Intel Corp.
# SPDX-License-Identifier: Apache-2.0

description: ARM Cortex-A76 CPU

compatible: "arm,cortex-a76"

include: cpu.yaml
```

## dts/bindings/cpu/arm,cortex-a78.yaml
```yaml
# SPDX-License-Identifier: Apache-2.0

description: ARM Cortex-A78 CPU

compatible: "arm,cortex-a78"

include: cpu.yaml
```
