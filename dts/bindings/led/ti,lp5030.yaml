## dts/bindings/led/ti,lp5030.yaml
```yaml
description: Texas Instruments LP5030 I2C LED controller node

compatible: ti,lp5030

include: ti,lp50xx.yaml
```

## dts/bindings/led/ti,lp5036.yaml
```yaml
description: Texas Instruments LP5036 I2C LED controller node

compatible: ti,lp5036

include: ti,lp50xx.yaml
```

## dts/bindings/led/ti,lp503x.yaml
```yaml
# Copyright (c) 2020 Seagate Technology LLC
# SPDX-License-Identifier: Apache-2.0

description: TI LP503x LED controller node

compatible: "ti,lp503x"

include: ["i2c-device.yaml", "led-controller.yaml"]

properties:
  max_curr_opt:
    type: boolean
    description: |
      If enabled the maximum current output is set to 35 mA (25.5 mA else).
  log_scale_en:
    type: boolean
    description: |
      If enabled a logarithmic dimming scale curve is used for LED brightness
      control. A linear dimming scale curve is used else.

child-binding:
  properties:
    label:
      required: true
    index:
      required: true
    color-mapping:
      required: true
```

## dts/bindings/led/ti,lp50xx-base.yaml
```yaml
# Copyright (c) 2023 Kistler Instrumente AG
# Copyright (c) 2020 Seagate Technology LLC
# SPDX-License-Identifier: Apache-2.0

include: ["i2c-device.yaml", "led-controller.yaml"]

properties:
  max_curr_opt:
    type: boolean
    description: |
      If enabled the maximum current output is set to 35 mA (25.5 mA else).
  log_scale_en:
    type: boolean
    description: |
      If enabled a logarithmic dimming scale curve is used for LED brightness
      control. A linear dimming scale curve is used else.
  enable-gpios:
    type: phandle-array
    description: |
      Chip enable input pin.

child-binding:
  description: |
    Example DT:

      lp5018@28 {
        compatible = "ti,lp5018";
        status = "okay";
        reg = <0x28>;
        enable-gpios = <&gpiok 3 GPIO_ACTIVE_HIGH>; /* optional */
        log_scale_en; /* optional */
        max_curr_opt; /* optional */

        led_0 {
          label = "STATUS 0 RGB";
          index = <0>;
          color-mapping =
            <LED_COLOR_ID_RED>,
            <LED_COLOR_ID_GREEN>,
            <LED_COLOR_ID_BLUE>;
          default-brightness = <10>; /* optional */
          norm-value = <0xff>; /* optional */
        };
      };

  properties:
    label:
      required: true
    index:
      required: true
    color-mapping:
      required: true
    default-brightness:
      type: int
      description: |
        Default brightness in percent.
    norm-value:
      type: int
      description: |
        Color value sum representing 100% brightness.
```

## dts/bindings/led/ti,lp50xx.yaml
```yaml
# Copyright (c) 2020 Seagate Technology LLC
# SPDX-License-Identifier: Apache-2.0

include: ["i2c-device.yaml", "led-controller.yaml"]

properties:
  enable-gpios:
    type: phandle-array
    description: |
      GPIO to use to enable/disable the controller.
  max-curr-opt:
    type: boolean
    description: |
      If enabled the maximum current output is set to 35 mA (25.5 mA else).
  log_scale_en:
    type: boolean
    description: |
      If enabled a logarithmic dimming scale curve is used for LED brightness
      control. A linear dimming scale curve is used else.

child-binding:
  properties:
    label:
      required: true
    index:
      required: true
    color-mapping:
      required: true
```

## dts/bindings/led/ti,lp5562.yaml
```yaml
description: TI LP5562 LED

compatible: "ti,lp5562"

include: ti,lp55xx.yaml

properties:
  white-output-current:
    type: int
    default: 175
    description: Output current of white channel in 0.1 mA (0-25.5 mA)
                 Default value is the power-on default. Valid range = 0 - 255
```

## dts/bindings/led/ti,lp55xx.yaml
```yaml
description: TI LP55XX LED

compatible: "ti,lp55xx"

include: i2c-device.yaml

properties:
  red-output-current:
    type: int
    default: 175
    description: Output current of red channel in 0.1 mA (0-25.5 mA).
                 Default value is the power-on default. Valid range = 0 - 255

  green-output-current:
    type: int
    default: 175
    description: Output current of green channel in 0.1 mA (0-25.5 mA)
                 Default value is the power-on default. Valid range = 0 - 255

  blue-output-current:
    type: int
    default: 175
    description: Output current of blue channel in 0.1 mA (0-25.5 mA)
                 Default value is the power-on default. Valid range = 0 - 255

  enable-gpios:
    type: phandle-array
    description: |
      GPIO to enable LP5562 (both Charge-pump and Digital Communications interface).
      If not provided, user must ensure enable pin is already asserted externally (e.g:
      pull-up resistor).
```

## dts/bindings/led/ti,lp5815.yaml
```yaml
# Copyright (c) 2026 Kristina Kisiuk, Aliensense
# SPDX-License-Identifier: Apache-2.0

description: |
  Texas Instruments LP5815 3-channel I2C RGB LED controller with autonomous
  animation engine and instant blinking support. Each channel supports 8-bit
  PWM dimming and individual 8-bit dot current control. Maximum output current
  per channel is selectable between 25.5mA and 51mA.

compatible: "ti,lp5815"

include: ["i2c-device.yaml", "led-controller.yaml"]

properties:
  max-current-51mA:
    type: boolean
    description: |
      Set the MAX_CURRENT bit in DEV_CONFIG0 to select 51mA maximum output
      current per channel. If not set, the default 25.5mA is used.

  out0-dot-current:
    type: int
    default: 0
    description: |
      Dot current setting for output channel 0 (0-255).
      Controls the analog output current as a ratio of the maximum current.
      0 means no current output (default), 255 means 100% of max current.

  out1-dot-current:
    type: int
    default: 0
    description: |
      Dot current setting for output channel 1 (0-255).
      Controls the analog output current as a ratio of the maximum current.
      0 means no current output (default), 255 means 100% of max current.

  out2-dot-current:
    type: int
    default: 0
    description: |
      Dot current setting for output channel 2 (0-255).
      Controls the analog output current as a ratio of the maximum current.
      0 means no current output (default), 255 means 100% of max current.

child-binding:
  properties:
    index:
      required: true
    color-mapping:
      required: true
```

## dts/bindings/led/ti,lp5860.yaml
```yaml
description: Texas Instruments LP5860 I2C LED controller node

compatible: "ti,lp5860"

include: ti,lp586x.yaml
```

## dts/bindings/led/ti,lp5861.yaml
```yaml
description: Texas Instruments LP5861 I2C LED controller node

compatible: "ti,lp5861"

include: ti,lp586x.yaml
```

## dts/bindings/led/ti,lp5862.yaml
```yaml
description: Texas Instruments LP5862 I2C LED controller node

compatible: "ti,lp5862"

include: ti,lp586x.yaml
```

## dts/bindings/led/ti,lp5864.yaml
```yaml
description: Texas Instruments LP5864 I2C LED controller node

compatible: "ti,lp5864"

include: ti,lp586x.yaml
```

## dts/bindings/led/ti,lp5866.yaml
```yaml
description: Texas Instruments LP5866 I2C LED controller node

compatible: "ti,lp5866"

include: ti,lp586x.yaml
```

## dts/bindings/led/ti,lp5868.yaml
```yaml
description: Texas Instruments LP5868 I2C LED controller node

compatible: "ti,lp5868"

include: ti,lp586x.yaml
```

## dts/bindings/led/ti,lp586x.yaml
```yaml
# Copyright (c) 2026 Draeger
# SPDX-License-Identifier: Apache-2.0

description: Texas Instruments LP586X I2C LED controller

include: ["i2c-device.yaml", "led-controller.yaml"]

properties:
  enable-gpios:
    type: phandle-array
    description: |
      GPIO to use to enable/disable the controller.
  vsync-en:
    type: boolean
    description: |
      If enabled the controller will wait for a vertical synchronization signal
      before updating the LED states. This is useful to avoid visual artifacts
      when the LEDs are used as backlight for a display.
      The vertical synchronization signal must be provided externally.
      If not enabled the controller will update the LED states immediately when
      a change is requested.
  phase-shift-en:
    type: boolean
    description: |
      If enabled a phase shift is activated for each current sink to avoid the
      current overshot when turning on LEDs simultaneously.
  exp-scale-en:
    type: boolean
    description: |
      If enabled an exponential dimming scale curve is used for LED brightness
      control. A linear dimming scale curve is used else.

child-binding:
  properties:
    label:
      required: true
    index:
      required: true
    color-mapping:
      required: true
```

## dts/bindings/led/ti,tlc59108.yaml
```yaml
description: TI TLC59108 LED

compatible: "ti,tlc59108"

include: i2c-device.yaml
```

## dts/bindings/led/ti,tlc59116.yaml
```yaml
# Copyright (c) 2025 Tridonic GmbH & Co KG
# SPDX-License-Identifier: Apache-2.0

description: Texas Instruments TLC59116 LED controller

compatible: "ti,tlc59116"

include: i2c-device.yaml

properties:
  reset-gpios:
    type: phandle-array
    description: |
      GPIO to reset TLC59116
```

## dts/bindings/led/ti,tlc59731.yaml
```yaml
# Copyright (c) 2024 Javad Rahimipetroudi <javad.rahimipetroudi@mind.be>
# SPDX-License-Identifier: Apache-2.0

compatible: "ti,tlc59731"
description: TLC59731 RGB LED Controller

properties:
  gpios:
    required: true
    type: phandle-array
    description: |
      GPIO to send command data to the controller.
  min_period:
    type: int
    default: 0
    description: |
      Minimum acceptable LED blinking time period (in ms).
      Zero means user-defined in the application code.
  max_period:
    type: int
    default: 0
    description: |
      Maximum acceptable LED blinking time period (in ms).
      Zero means user-defined in the application code.
  min_brightness:
    type: int
    default: 0
    description: |
      Minimum acceptable LED brightness value.
  max_brightness:
    type: int
    default: 255
    description: |
      Maximum acceptable LED brightness value.
  label:
    type: string
    description: |
      RGB Label
```

## dts/bindings/led/x-powers,axp192-led.yaml
```yaml
# Copyright (c) 2024 TOKITA Hiroshi
# SPDX-License-Identifier: Apache-2.0

description: |
  AXP192 LED controller

  The AXP192 has one LED can automatically display error or charging status,
  or be controlled by software.

compatible: "x-powers,axp192-led"

on-bus: axp192

properties:
  x-powers,mode:
    type: string
    enum:
      - "by-reg"
      - "by-charge"
    description:
      Select the LED control method.
      If you select "by-reg", you can control it from software.
      Please refer to the datasheet for details on "by-charge".
```

## dts/bindings/led/x-powers,axp2101-led.yaml
```yaml
# Copyright (c) 2024 TOKITA Hiroshi
# SPDX-License-Identifier: Apache-2.0

description: |
  AXP2101 LED controller

  The AXP2101 has one LED can automatically display error or charging status,
  or be controlled by software.

compatible: "x-powers,axp2101-led"

on-bus: axp2101

properties:
  x-powers,mode:
    type: string
    enum:
      - "type-a"
      - "type-b"
      - "by-reg"
    description:
      Select the LED control method.
      If you select "by-reg", you can control it from software.
      Please refer to the datasheet for details on "type-a" and "type-b".
```

## dts/bindings/led/zephyr,fake-leds.yaml
```yaml
# SPDX-FileCopyrightText: Copyright (c) 2026 Henrik Brix Andersen <henrik@brixandersen.dk>
# SPDX-License-Identifier: Apache-2.0

description: |
    This binding provides a fake LED controller for use as either a stub or a mock in Zephyr
    testing.

compatible: "zephyr,fake-leds"

include: led-controller.yaml

examples:
  - |
    fake_leds: fake-leds {
      compatible = "zephyr,fake-leds";

      fake_led: fake-led {
        label = "Fake LED";
      };

      fake_red_led: fake-red-led {
        label = "Fake Red LED";
        color-mapping = <LED_COLOR_ID_RED>;
      };

      fake_green_led: fake-green-led {
        label = "Fake Green LED";
        color-mapping = <LED_COLOR_ID_GREEN>;
      };

      fake_blue_led: fake-blue-led {
        label = "Fake Blue LED";
        color-mapping = <LED_COLOR_ID_BLUE>;
      };

      fake_rgb_led: fake-rgb-led {
        label = "Fake RGB LED";
        color-mapping = <LED_COLOR_ID_RED>,
                        <LED_COLOR_ID_GREEN>,
                        <LED_COLOR_ID_BLUE>;
      };
    };
```

## dts/bindings/led/zephyr,native-linux-leds.yaml
```yaml
# SPDX-FileCopyrightText: Copyright (c) 2026 Google, LLC
# SPDX-License-Identifier: Apache-2.0

description: |
  Linux LED backed LED device

compatible: "zephyr,native-linux-leds"

child-binding:
  description: Linux LED child node

  include:
    - name: led-node.yaml
      property-allowlist:
        - label

  properties:
    path:
      type: string
      required: true

examples:
  - |
    / {
      leds {
        compatible = "zephyr,native-linux-leds";

        led0: led_0 {
          /* /sys/class/leds/tpacpi::lid_logo_dot/brightness */
          path = "tpacpi::lid_logo_dot";
        };
        led1: led_1 {
          /* /sys/class/leds/tpacpi::power/brightness */
          path = "tpacpi::power";
        };
      };
    };
```

## dts/bindings/led_strip/apa,apa-102.yaml
```yaml
description: APA102 SPI LED strip

compatible: "apa,apa102"

include: spi-device.yaml
```

## dts/bindings/led_strip/arduino,modulino-pixels.yaml
```yaml
# Copyright (c) 2025 Google, LLC
# SPDX-License-Identifier: Apache-2.0

description: Arduino Modulino Pixels

compatible: "arduino,modulino-pixels"

include: [led-strip.yaml, i2c-device.yaml]

properties:
  reg:
    required: true
```
