## dts/bindings/led/led-controller.yaml
```yaml
# Copyright (c) 2020 Seagate Technology LLC
# SPDX-License-Identifier: Apache-2.0

# Common fields for LED controllers and child LEDs

child-binding:
  description: LED child node

  include: led-node.yaml

  properties:
    index:
      type: int
      description: |
        Index of the LED on a controller. It can be used by drivers or
        applications to map a logical LED to its real position on the
        controller. For example, this allows to handle boards where the
        LEDs in an array/strip are not wired following the LED order of
        the controller.
```

## dts/bindings/led/led-node.yaml
```yaml
# Copyright (c) 2025 Seagate Technology LLC
# SPDX-License-Identifier: Apache-2.0

# Common fields for LED nodes

properties:
  label:
    type: string
    description: |
      Human readable string describing the LED. It can be used by an
      application to identify this LED or to retrieve its number/index
      (i.e. child node number) on the parent device.
  color-mapping:
    type: array
    description: |
      Channel to color mapping of a multicolor LED. If a LED supports
      several colors, then the color-mapping property can be used to
      describe how the hardware channels and the colors are mapped.

      For example the channel to color mapping of RGB LEDs would be

         color-mapping =
              <LED_COLOR_ID_RED>,
              <LED_COLOR_ID_GREEN>,
              <LED_COLOR_ID_BLUE>;
```

## dts/bindings/led/leds-group-multicolor.yaml
```yaml
# Copyright (c) 2025 Seagate Technology LLC
# SPDX-License-Identifier: Apache-2.0

title: Combines several monochromatic LEDs into one multi-color LED.

description: |
  Defines an RGB LED with a group of monochromatic PWM LEDs. Note that the
  pwms property definition handle depends on the PWM controller model.

compatible: "leds-group-multicolor"

include: led-node.yaml

properties:
  leds:
    required: true
    type: phandles
    description: |
      References to monochromatic LED nodes.

examples:
  - |
    /* Example where PWM controller is STM32 */
    #include <zephyr/dt-bindings/led/led.h>

    / {
            monochromatic-leds {
                    compatible = "pwm-leds";

                    red_pwm_led: led-0 {
                            pwms = <&pwm1 1 PWM_MSEC(20) PWM_POLARITY_NORMAL>;
                    };

                    green_pwm_led: led-1 {
                            pwms = <&pwm2 1 PWM_MSEC(20) PWM_POLARITY_NORMAL>;
                    };

                    blue_pwm_led: led-2 {
                            pwms = <&pwm3 1 PWM_MSEC(20) PWM_POLARITY_NORMAL>;
                    };
            };

            rgb-led {
                    compatible = "leds-group-multicolor";

                    leds = <&red_pwm_led>, <&green_pwm_led>, <&blue_pwm_led>;
                    color-mapping = <LED_COLOR_ID_RED>,
                                    <LED_COLOR_ID_GREEN>,
                                    <LED_COLOR_ID_BLUE>;
            };
    };
```

## dts/bindings/led/microchip,xec-bbled.yaml
```yaml
# Copyright (c) 2022, Microchip Technology Inc.
# SPDX-License-Identifier: Apache-2.0

description: Microchip XEC BBLED

include: [base.yaml, pinctrl-device.yaml]

compatible: "microchip,xec-bbled"

properties:
  reg:
    required: true

  interrupts:
    required: true

  girqs:
    type: array
    required: true
    description: Array of pairs of GIRQ number and bit position

  pcrs:
    type: array
    required: true
    description: BBLED PCR register index and bit position
```

## dts/bindings/led/nordic,npm10xx-led.yaml
```yaml
# Copyright (c) 2026 Nordic Semiconductor ASA
# SPDX-License-Identifier: Apache-2.0

title: Nordic nPM10 Series PMIC's LED driver

description: |
  Nordic's nPM10 Series PMICs feature an LED driver whose outputs are multiplexed with GPIOs.
  GPIO number to use for each LED child node is specified by its "index" property, therefore it is
  required. Using GPIO interface on a GPIO configured as LED will lead to undefined behaviour and
  must be avoided.

  Every LED can be controlled either by the host SoC or automatically. When an automatic mode is
  used, the SW is allowed to control only the brightness of this LED (except for the "error" mode).

  HW limitation: the on/off delays passed to the API function `led_blink` are shared between all
  LED instances, i.e. blinking different LEDs with different delays is not supported.

compatible: nordic,npm10xx-led

properties:
  pwm-freq-hz:
    type: int
    default: 977
    enum:
      - 122
      - 244
      - 488
      - 977
    description: PWM frequency in Hz.

  phase-shift-enable:
    type: boolean
    description: |
      Enable phase shifting to minimize peak load currents. Useful when multiple LEDs are used at
      once, for example in RGB setting.

  blink-mode:
    type: string
    default: forever
    enum:
      - single
      - double
      - forever
    description: Perform a single or a double blink, or blink forever on blink tasks.

include: led-controller.yaml

child-binding:
  properties:
    index:
      required: true
      enum:
        - 0
        - 1
        - 2

    led-mode:
      type: string
      default: host
      enum:
        - host
        - charge
        - error
        - vbus-good
      description: |
        LED operation mode. Available options are as follows:
          host: LED is controlled through LED device driver APIs, on/off, blink, brightness.
          charge: LED indicates charging. Brightness control available.
          error: LED indicates charging errors. No controls available.
          vbus-good: LED indicates VBUS GOOD status. Brightness control available.

    drive-current-ma:
      type: int
      default: 5
      enum:
        - 5
        - 10
      description: LED drive strength in mA.

examples:
  - |
    npm1012: pmic@6a {
      /* ... */

      leds {
        compatible = "nordic,npm10xx-led";
        pwm-freq-hz = <488>;

        charge_indicator: led0 {
          index = <1>;
          label = "Charge indication LED on GPIO1";
          led-mode = "charge";
        };

        user_led: led1 {
          index = <0>;
          label = "Red LED on GPIO0";
          drive-current-ma = <10>;
        };
      };

      /* ... */
    };
```

## dts/bindings/led/nordic,npm1300-led.yaml
```yaml
# Copyright (c) 2023 Nordic Semiconductor ASA
# SPDX-License-Identifier: Apache-2.0

description: |
  Nordic nPM1300 LED controller

  The nPM1300 has three LED outputs.
  Each LED can automatically display error or charging status,
  or be controlled by software.

compatible: "nordic,npm1300-led"

include: "nordic,npm13xx-led-common.yaml"
```

## dts/bindings/led/nordic,npm1304-led.yaml
```yaml
# Copyright (c) 2025 Nordic Semiconductor ASA
# SPDX-License-Identifier: Apache-2.0

description: |
  Nordic nPM1304 LED controller

  The nPM1304 has three LED outputs.
  Each LED can automatically display error or charging status,
  or be controlled by software.

compatible: "nordic,npm1304-led"

include: "nordic,npm13xx-led-common.yaml"
```

## dts/bindings/led/nordic,npm13xx-led-common.yaml
```yaml
# Copyright (c) 2025 Nordic Semiconductor ASA
# SPDX-License-Identifier: Apache-2.0

description: Nordic nPM13xx LED controller common properties

properties:
  nordic,led0-mode:
    type: string
    required: true
    enum:
    - error
    - charging
    - host
    description: LED 0 mode

  nordic,led1-mode:
    type: string
    required: true
    enum:
    - error
    - charging
    - host
    description: LED 1 mode

  nordic,led2-mode:
    type: string
    required: true
    enum:
    - error
    - charging
    - host
    description: LED 2 mode
```

## dts/bindings/led/nxp,pca9530.yaml
```yaml
# SPDX-FileCopyrightText: Copyright The Zephyr Project Contributors
# SPDX-License-Identifier: Apache-2.0

description: NXP PCA9530 2-bit LED dimmer

compatible: "nxp,pca9530"

include: nxp,pca953x.yaml
```

## dts/bindings/led/nxp,pca9531.yaml
```yaml
# SPDX-FileCopyrightText: Copyright The Zephyr Project Contributors
# SPDX-License-Identifier: Apache-2.0

description: NXP PCA9531 8-bit LED dimmer

compatible: "nxp,pca9531"

include: nxp,pca953x.yaml

properties:
  reset-gpios:
    type: phandle-array
    description: "Reset GPIO. The pin should be configured active-low if connected directly."
```

## dts/bindings/led/nxp,pca9532.yaml
```yaml
# SPDX-FileCopyrightText: Copyright The Zephyr Project Contributors
# SPDX-License-Identifier: Apache-2.0

description: NXP PCA9532 16-bit LED dimmer

compatible: "nxp,pca9532"

include: nxp,pca953x.yaml

properties:
  reset-gpios:
    type: phandle-array
    description: "Reset GPIO. The pin should be configured active-low if connected directly."
```

## dts/bindings/led/nxp,pca953x.yaml
```yaml
# SPDX-FileCopyrightText: Copyright The Zephyr Project Contributors
# SPDX-License-Identifier: Apache-2.0

include: ["i2c-device.yaml", "led-controller.yaml"]
```

## dts/bindings/led/nxp,pca9633.yaml
```yaml
description: NXP PCA9633 LED

compatible: "nxp,pca9633"

include: i2c-device.yaml

properties:
  disable-allcall:
    type: boolean
    description: Disable response to LED All Call address request
```

## dts/bindings/led/nxp,pca9634.yaml
```yaml
description: NXP PCA9634 LED

compatible: "nxp,pca9634"

include: i2c-device.yaml
```

## dts/bindings/led/nxp,pca9956.yaml
```yaml
# Copyright (c) 2022 Esco Medical ApS
# SPDX-License-Identifier: Apache-2.0

description: NXP PCA9956 LED

compatible: "nxp,pca9956"

include: i2c-device.yaml
```

## dts/bindings/led/onnn,ncp5623.yaml
```yaml
# Copyright (c) 2023 NXP Semiconductors
# Copyright (c) 2023 Congipilot Foundation
# SPDX-License-Identifier: Apache-2.0

description: |
  NCP5623 Triple Output I2C Controlled RGB LED driver

  The LED_SHELL application can be used for testing

  The following example defines a single RGB LED in the ncp5623 DT node

  ncp5623c@39 {
    compatible = "onnn,ncp5623";
    reg = <0x39>;

    led_0 {
      label = "RGB LED";
      index = <0>;
      color-mapping =
        <LED_COLOR_ID_RED>,
        <LED_COLOR_ID_GREEN>,
        <LED_COLOR_ID_BLUE>;
    };
  };

  The following example defines three single-channel LEDs in the ncp5623 DT node

  ncp5623c@39 {
    compatible = "onnn,ncp5623";
    reg = <0x39>;

    led_0 {
      label = "RED LED";
      index = <0>;
      color-mapping =
        <LED_COLOR_ID_RED>;
    };

    led_1 {
      label = "GREEN LED";
      index = <1>;
      color-mapping =
        <LED_COLOR_ID_GREEN>;
    };

    led_2 {
      label = "BLUE LED";
      index = <2>;
      color-mapping =
        <LED_COLOR_ID_BLUE>;
    };
  };


compatible: "onnn,ncp5623"

include: ["i2c-device.yaml", "led-controller.yaml"]

child-binding:
  properties:
    label:
      required: true

    index:
      required: true

    color-mapping:
      required: true
```

## dts/bindings/led/pwm-leds.yaml
```yaml
# Copyright (c) 2018, Linaro Limited
# SPDX-License-Identifier: Apache-2.0

description: |
  Group of PWM-controlled LEDs.

  Each LED is defined in a child node of the pwm-leds node.

compatible: "pwm-leds"

child-binding:
  description: PWM LED child node

  include:
    - name: led-node.yaml
      property-allowlist:
        - label

  properties:
    pwms:
      required: true
      type: phandle-array
      description: |
        Reference to a PWM instance.

        The period field is used by the set_brightness function of the LED API.
        Its value should at least be greater that 100 nanoseconds (for a full
        brigtness granularity) and lesser than 50 milliseconds (average visual
        persistence time of the human eye). Typical values for the PWM period
        are 10 or 20 milliseconds.
```

## dts/bindings/led/raspberrypi,pico_w.yaml
```yaml
# Copyright (c) 2025 Beechwoods Software Inc.
#
# SPDX-License-Identifier: Apache-2.0

description: |
  Raspberry Pi Pico W
  LED Port

compatible: "raspberrypi,pico_w"

child-binding:
  description: Pico W LED
  properties:
    gpios:
      type: phandle-array
      required: true
```

## dts/bindings/led/rgb-leds.yaml
```yaml
# Copyright (c) 2023, Prevas A/S
# SPDX-License-Identifier: Apache-2.0

description: |
  This allows you to define an emulated RGB LED by combining 3 individual LEDs.
  The individual LEDs must have their own driver and be defined in the dts.

  Here is an example
  / {
    rgb_leds {
      compatible = "rgb-leds";
      led_0 {
        red-led = <&red_led>;
        green-led = <&green_led>;
        blue-led = <&blue_led>;
      };
    };
  };

compatible: "rgb-leds"

child-binding:
  description: RGB LED child node
  properties:
    red-led:
      type: phandle
      required: true
      description: red led device

    green-led:
      type: phandle
      required: true
      description: green led device

    blue-led:
      type: phandle
      required: true
      description: blue led device
```

## dts/bindings/led/sct,sct2024.yaml
```yaml
description: SCT2024 LED driver

compatible: "sct,sct2024"

include: ["spi-device.yaml", "led-controller.yaml"]

properties:
  la-gpios:
    description:
      GPIO specifier for the LA (Latch) pin.
      The LA pin is used to apply previously transferred data to all LEDs simultaneously. When the
      LA pin is high, the LED outputs reflect the current contents of the shift register
      (transparent mode). When the LA pin is low, the current shift-register data is latched and
      held on the LED outputs until the next latch operation.
    required: true
    type: phandle-array
  oe-gpios:
    description:
      GPIO specifier for the OE (Output Enable) pin.
      The OE pin can be used to disable all LEDs connected to the device. When the OE pin is high,
      all LEDs are disabled.
    type: phandle-array

child-binding:
  properties:
    index:
      required: true
```

## dts/bindings/led/ti,lp5009.yaml
```yaml
description: Texas Instruments LP5009 I2C LED controller node

compatible: ti,lp5009

include: ti,lp50xx.yaml
```

## dts/bindings/led/ti,lp5012.yaml
```yaml
description: Texas Instruments LP5012 I2C LED controller node

compatible: ti,lp5012

include: ti,lp50xx.yaml
```

## dts/bindings/led/ti,lp5018.yaml
```yaml
description: Texas Instruments LP5018 I2C LED controller node

compatible: ti,lp5018

include: ti,lp50xx.yaml
```

## dts/bindings/led/ti,lp5024.yaml
```yaml
description: Texas Instruments LP5024 I2C LED controller node

compatible: ti,lp5024

include: ti,lp50xx.yaml
```
