## dts/bindings/mtd/atmel,at25xv021a.yaml
```yaml
# Copyright (c) 2025 Cirrus Logic, Inc.
# SPDX-License-Identifier: Apache-2.0

description: |
  AT25XV021A SPI flash variants

  Example datasheet: https://www.renesas.com/en/document/dst/at25xv021a-datasheet

  The AT25XV021A variants add sector protect and unprotect features, which
  requires additional steps to program or erase data from the device when compared
  to other devices in the AT25 family.

compatible: "atmel,at25xv021a"

include: "spi-device.yaml"

properties:
  jedec-id:
    type: uint8-array
    default: [0x1f, 0x43, 0x01]
    description: JEDEC Standard ID

  size:
    type: int
    required: true
    description: Flash capacity in bytes.

  page-size:
    type: int
    required: true
    description: Flash page size in bytes.

  timeout:
    type: int
    default: 3
    description: |
      Timeout for read/write operations in milliseconds. Per the referenced
      datasheet, page program operations can take up to 2.5 milliseconds.

  timeout-erase:
    type: int
    default: 4000
    description: |
      Timeout for erase operations (including chip erase) in milliseconds.
      Per the referenced datasheet, chip erase can take up to 4 seconds.

  read-only:
    type: boolean
    description: Set flash device to be read-only.

  ultra-deep-sleep:
    type: boolean
    description: Go into ultra deep sleep mode instead of deep sleep mode.

  wp-gpios:
    type: phandle-array
    description: |
      The WP pin of AT25XV021A is active low.
      If connected directly the MCU pin should be configured
      as active low.
```

## dts/bindings/mtd/atmel,at2x-base.yaml
```yaml
# Copyright (c) 2019 Vestas Wind Systems A/S
# SPDX-License-Identifier: Apache-2.0

# Common fields for AT24 (I2C) and AT25 (SPI) EEPROM devices

include: eeprom-base.yaml

properties:
  size:
    required: true
  pagesize:
    type: int
    required: true
    description: EEPROM page size in bytes
  address-width:
    type: int
    required: true
    description: EEPROM address width in bits
  timeout:
    type: int
    required: true
    description: EEPROM write cycle timeout in milliseconds
  wp-gpios:
    type: phandle-array
    description: |
      GPIO to which the write-protect pin of the chip is connected.

      The device will interpret this signal as active-low.
```

## dts/bindings/mtd/atmel,at45.yaml
```yaml
# Copyright (c) 2020 Nordic Semiconductor ASA
# SPDX-License-Identifier: Apache-2.0

description: Atmel AT45 (or compatible) SPI flash

compatible: "atmel,at45"

include: [spi-device.yaml]

properties:
  jedec-id:
    type: uint8-array
    required: true
    description: JEDEC ID as manufacturer ID (1 byte) and device ID (2 bytes).

  size:
    type: int
    required: true
    description: Flash capacity in bits.

  sector-size:
    type: int
    required: true
    description: Flash sector size in bytes.

  block-size:
    type: int
    required: true
    description: Flash block size in bytes.

  page-size:
    type: int
    required: true
    description: Flash page size in bytes.

  use-udpd:
    type: boolean
    description: |
      When set, the driver will use the Ultra-Deep Power-Down command instead
      of the default Deep Power-Down one to put the chip into low power mode.

      From the driver perspective, as it does not rely on the contents of the
      SRAM buffers in the chip, the difference between the Deep and Ultra-Deep
      Power-Down modes is that the chip consumes far less power in the latter
      but needs some more time to enter this mode and to exit from it.

  enter-dpd-delay:
    type: int
    default: 0
    description: |
      Time, in nanoseconds, needed by the chip to enter the Deep Power-Down
      mode (or Ultra-Deep Power-Down mode when the "use-udpd" property is set)
      after the corresponding command is issued.

  exit-dpd-delay:
    type: int
    default: 0
    description: |
      Time, in nanoseconds, needed by the chip to exit from the Deep Power-Down
      mode (or Ultra-Deep Power-Down mode when the "use-udpd" property is set)
      after the corresponding command is issued.

  reset-gpios:
    type: phandle-array
    description: |
      The RESET pin of AT45 is active low.
      If connected directly the MCU pin should be configured
      as active low.

  wp-gpios:
    type: phandle-array
    description: |
      The WP pin of AT45 is active low.
      If connected directly the MCU pin should be configured
      as active low.
```

## dts/bindings/mtd/atmel,sam0-qspi-nor.yaml
```yaml
# Copyright (c) 2020 Google LLC.
# SPDX-License-Identifier: Apache-2.0

description: |
  QSPI NOR flash supporting the JEDEC CFI interface.

compatible: "atmel,sam0-qspi-nor"

include: [spi-device.yaml, "jedec,spi-nor-common.yaml"]
```

## dts/bindings/mtd/atmosic,tz-fixed-partitions.yaml
```yaml
description: Atmosic Trustzone Fixed partitions

compatible: "atmosic,tz-fixed-partitions"

include: fixed-partitions.yaml

child-binding:
  properties:
    secure:
      type: boolean
      description: set this property if the partition is a secure parition.
  child-binding:
    child-binding:
      properties:
        secure:
          type: boolean
          description: set this property if the partition is a secure parition.
        label:
          type: string
          description: |
            Human readable string describing the flash partition.
        read-only:
          type: boolean
          description: set this property if the partition is read-only
        reg:
          type: array
          description: |
            This should be in the format <OFFSET SIZE>, where OFFSET
            is the offset of the flash partition relative to the base
            address of the parent memory, and SIZE is the size of
            the partition in bytes.
          required: true
```

## dts/bindings/mtd/bflb,sf-device.yaml
```yaml
# Copyright (c) 2026 MASSDRIVER EI
# SPDX-License-Identifier: Apache-2.0

title: Bouffalolab Serial Flash controller device

description: |
  Bouffalolab Serial Flash controller device

compatible: "bflb,sf-device"

examples:
  - |
    // S3A1604 MRAM in QPI QIO
    &sf_bank2 {
      reg = <0xa4000000 0x200000>;
      ranges = <0x0 0xa4000000 0x200000>;
      status = "okay";

      pinctrl-0 = <&sf3_default>;
      pinctrl-names = "default";

      s3a1604: mram@0 {
        compatible = "bflb,sf-device";
        reg = <0 0x200000>;

        spi-bus-mode = <4>;
        use-qpi;
        sf-pad = <3>;
        jedec-id = [d9 01 05];

        read-command = <0x0b>;
        read-dummy-cycles = <3>;
        write-command = <0xda>;
        write-dummy-cycles = <0>;
        enter-qpi-command = <0x38>;
        exit-qpi-command = <0xff>;

        initialization-sequence = <0x06 0x0 0x0 0x87 0x01250600 0x4>;
        quirk-bytes-read = [ a0 ];
        quirk-bytes-write = [ a0 ];
      };
    };
  - |
    // PM004MNI MRAM in QPI QIO
    &sf_bank2 {
      reg = <0xa4000000 0x80000>;
      ranges = <0x0 0xa4000000 0x80000>;
      status = "okay";

      pinctrl-0 = <&sf2_default>;
      pinctrl-names = "default";

      pm004mni: mram@0 {
        compatible = "bflb,sf-device";
        reg = <0 0x80000>;

        spi-bus-mode = <4>;
        use-qpi;
        sf-pad = <2>;
        jedec-id = [29 55 00];

        read-command = <0xeb>;
        read-dummy-cycles = <0>;
        write-command = <0x38>;
        write-dummy-cycles = <0>;
        enter-qpi-command = <0x35>;
        exit-qpi-command = <0xf5>;
      };
    };

include:
  - soc-nv-flash.yaml

properties:
  reg:
    required: true

  sf-pad:
    type: int
    required: true
    description: |
      Which pad is this device using. This is directly related to which pins are used.
      Pad 1 is usually the embedded flash, Pad 2 and Pad 3 are usually external.
      Main exception is BL70x/L where the default embedded pad is SF2.
      External pads require a pinctrl entry at the bank.
    enum:
      - 1
      - 2
      - 3

  spi-bus-mode:
    type: int
    required: true
    description: |
     The width and mode of SPI bus to use for the device.
     Numbers refer to the number of line used in each direction.

     Possible values are:
      - IO <0> = 1-1-1 mode
      - DO <1> = 1-1-2 mode
      - QO <2> = 1-1-4 mode
      - DIO <3> = 1-2-2 mode
      - QIO <4> = 1-4-4 mode or 4-4-4 mode (QPI), or 0-4-4 mode (Continuous Read / XIP mode)

    enum:
      - 0
      - 1
      - 2
      - 3
      - 4

  use-qpi:
    type: boolean
    description: Enable QPI, only 4-4-4 is supported

  sf-pad-is-external:
    type: boolean
    description: |
      Some pads can be both external and internal (like SF2 on BL70x/L).
      Use external pad instead of the internal one.

  read-command:
    type: int
    description: |
      SPI command to use for memory-mapped reading.

  read-dummy-cycles:
    type: int
    description: |
      Dummy cycles for automatic read mode.
      They are expressed in bytes of the address: 8 cycles with NIO, DO, QO, 4 with DIO, 2 with QIO.

  continuous-read-command:
    type: int
    description: |
      Enable continuous read using this command setting.

  write-command:
    type: int
    description: |
      SPI command to use for memory-mapped writing. Device must not require explicit or page sized
      erase.

  write-dummy-cycles:
    type: int
    description: |
      Dummy cycles for automatic write mode.
      They are expressed in bytes of the address: 8 cycles with NIO, DO, QO, 4 with DIO, 2 with QIO.

  initialization-sequence:
    type: array
    description: |
      Triples of command, data, datalength writes to set things up at setup time.
      For example to clear out block protection, or setup dummy timing.
      up to 4 bytes of data can be sent at once.
      Remember the byte order is inverted (right to left).
      Example of setting OC bits to 11 and disabling block protections on MX25L25645G:
      initialization-sequence = <0x06 0x0 0x0 0x1 0xc002 0x2>;
      If using this on internal flash this can be VERY dangerous, devcube / eflash loader is able
      to recover register settings in case of needs.

  enter-qpi-command:
    type: int
    description: Command to enter QPI

  exit-qpi-command:
    type: int
    description: Command to exit QPI

  jedec-id:
    type: uint8-array
    description: JEDEC ID as manufacturer ID, memory type, memory density.

  read-delay:
    type: int
    default: 1
    enum:
      - 0
      - 1
      - 2
      - 3
      - 4
    description: Flash Read delay. The default is appropriate for standard flash speed.

  clock-invert:
    type: boolean
    description: Invert Clock Signal.

  rx-clock-invert:
    type: boolean
    description: Invert RX Clock Signal.

  quirk-bytes-write:
    type: uint8-array
    description: Up to 4 bytes appended after the address for the auto-write command.

  quirk-bytes-read:
    type: uint8-array
    description: Up to 4 bytes appended after the address for the auto-read command.

  tune-di:
    type: int
    default: 0
    description: Fine tune pad delay for data in (0-3). Fine tuning is not usually necessary.

  tune-do:
    type: int
    default: 0
    description: Fine tune pad delay for data out (0-3). Fine tuning is not usually necessary.

  tune-cs:
    type: int
    default: 0
    description: Fine tune pad delay for CS (0-3). Fine tuning is not usually necessary.

  tune-clk:
    type: int
    default: 0
    description: Fine tune pad delay for CLK (0-3). Fine tuning is not usually necessary.

  tune-oe:
    type: int
    default: 0
    description: Fine tune pad delay for output enable (0-3). Fine tuning is not usually necessary.
```

## dts/bindings/mtd/bflb,sf-flash.yaml
```yaml
# Copyright (c) 2026 MASSDRIVER EI
# SPDX-License-Identifier: Apache-2.0

title: Bouffalolab Serial Flash controller Flash

description: Bouffalolab Serial Flash controller Flash or device compatible with JESD216

compatible: "bflb,sf-flash"

include:
  - "bflb,sf-device.yaml"
  - "jedec,spi-nor-common.yaml"

examples:
  - |
    // mx25l51245g in DIO mode.
    mx25l51245g: flash@0 {
      compatible = "bflb,sf-flash", "soc-nv-flash";
      reg = <0 0x1000000>;
      write-block-size = <1>;
      erase-block-size = <DT_SIZE_K(4)>;

      spi-bus-mode = <3>;
      sf-pad = <3>;
      jedec-id = [c2 20 1a];
      use-sfdp;

      initialization-sequence = <0x06 0x0 0x0 0x1 0x0002 0x2>;
      partitions {
        #address-cells = <1>;
        #size-cells = <1>;

        storage_partition2: partition2@0 {
          compatible = "zephyr,mapped-partition";
          label = "storage_2";
          reg = <0x0 0x1000000>;
        };
      };
    };

properties:
  use-sfdp:
    type: boolean
    description: |
      Fetch commands from flash using SFDP instead of using defaults (Recommended).
      In the case of setting both 'override-bank1' and this, bank1 will use the sdfp command
      matching the spi-bus-mode selected, or override with dts command if it is set.
```

## dts/bindings/mtd/cypress,fm24w256.yaml
```yaml
# Copyright (c) 2021 Caspar Friedrich <c.s.w.friedrich@gmail.com>
# SPDX-License-Identifier: Apache-2.0

description: 256-Kbit (32K × 8) Serial (I2C) F-RAM

compatible: "cypress,fm24w256"

include: [eeprom-base.yaml, i2c-device.yaml]

properties:
  wp-gpios:
    type: phandle-array
    required: false
    description: Active high. Set to enable write protection on all addresses.
```

## dts/bindings/mtd/cypress,fm25w256.yaml
```yaml
# Copyright (c) 2021 Caspar Friedrich <c.s.w.friedrich@gmail.com>
# SPDX-License-Identifier: Apache-2.0

description: 256-Kbit (32K × 8) Serial (SPI) F-RAM

compatible: "cypress,fm25w256"

include: [eeprom-base.yaml, spi-device.yaml]

properties:
  wp-gpios:
    type: phandle-array
    required: false
    description: Active low. Set to enable write protection on status register.

  spi-mode:
    type: int
    required: false
    default: 0
    enum:
      - 0
      - 3
    description: |
      Set the SPI mode. Modes 0 and 3 are available.

      - SPI Mode 0: CPOL = 0, CPHA = 0
      - SPI Mode 3: CPOL = 1, CPHA = 1
```

## dts/bindings/mtd/cypress,s26kl.yaml
```yaml
#
# Copyright (c) 2019, Riedo Networks Ltd
#
# SPDX-License-Identifier: Apache-2.0
#

title: Hyperflash (Octo-SPI) NOR FLASH
version: 0.1

description: >
  This binding gives a base representation of Crypress S26LKxxxS familly devices.

inherits:
  !include jedec,spi-nor.yaml

properties:
  compatible:
    constraint: "cypress,s26kl"
```
