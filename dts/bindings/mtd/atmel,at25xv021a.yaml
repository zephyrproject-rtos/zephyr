## dts/bindings/mtd/fixed-partitions.yaml
```yaml
description: |
  This binding is used to describe fixed partitions of a flash (or
  other nonvolatile storage) memory.

  Here is an example:

    &flash0 {
            partitions {
                    compatible = "fixed-partitions";
                    #address-cells = <1>;
                    #size-cells = <1>;

                    boot_partition: partition@0 {
                            label = "mcuboot";
                            reg = <0x00000000 0x0000C000>;
                    };
                    slot0_partition: partition@c000 {
                            label = "image-0";
                            reg = <0x0000C000 0x00076000>;
                    };
                    slot1_partition: partition@82000 {
                            label = "image-1";
                            reg = <0x00082000 0x00076000>;
                    };

                    /*
                     * The flash starting at 0x000f8000 and ending at
                     * 0x000fffff is reserved for use by the application.
                     */

                    /*
                     * Storage partition will be used by FCB/LittleFS/NVS
                     * if enabled.
                     */
                    storage_partition: partition@f8000 {
                            label = "storage";
                            reg = <0x000f8000 0x00008000>;
                    };
            };
    };

  Note that the usual name for this node is 'partitions'.
  The fixed-partitions node should be a child of the flash
  memory node. Note also that the flash memory node is usually
  different from the node representing the flash controller
  IP block.

  Above, slot0_partition's register address 0xc000 means that
  the partition begins at that offset from the parent flash
  memory flash0's base address. That is, partition addresses
  are relative; physical addresses must be calculated by adding
  the start address of flash0 in memory to each partition's
  reg address.

compatible: "fixed-partitions"

properties:
  "#address-cells":
    type: int
    description: |
      Number of cells required to represent a child node's
      reg property address. This must be large enough to
      represent the start offset of each partition.

  "#size-cells":
    type: int
    description: |
      Number of cells required to represent a child node's
      reg property address. This must be large enough to
      represent the size of each partition in bytes.

child-binding:
  description: |
    Each child node of the fixed-partitions node represents
    an individual flash partition. These should usually
    look like this:

      partition_nodelabel: partition@START_OFFSET {
              label = "human-readable-name";
              reg = <0xSTART_OFFSET 0xSIZE>;
      };
  properties:
    label:
      type: string
      description: |
        Human readable string describing the flash partition.
    read-only:
      type: boolean
      description: set this property if the partition is read-only
    reg:
      type: array
      description: |
        This should be in the format <OFFSET SIZE>, where OFFSET
        is the offset of the flash partition relative to the base
        address of the parent memory, and SIZE is the size of
        the partition in bytes.
      required: true
```

## dts/bindings/mtd/fixed-subpartitions.yaml
```yaml
description: |
  Fixed subpartitions of a flash (or other nonvolatile storage) memory.

  Here is an example:

    &flash0 {
            partitions {
                    compatible = "fixed-partitions";
                    #address-cells = <1>;
                    #size-cells = <1>;

                    slot0_partition: partition@10000 {
                            compatible = "fixed-subpartitions";
                            label = "image-0";
                            reg = <0x00010000 0x70000>;
                            ranges = <0x0 0x10000 0x70000>;
                            #address-cells = <1>;
                            #size-cells = <1>;

                            slot0_s_partition: partition@0 {
                                    label = "image-0-secure";
                                    reg = <0x00000000 0x40000>;
                            };

                            slot0_ns_partition: partition@40000 {
                                    label = "image-0-nonsecure";
                                    reg = <0x00040000 0x30000>;
                            };
                    };
            };
    };

compatible: "fixed-subpartitions"

properties:
  label:
    type: string
    description: |
      Human readable string describing the flash partition.
  read-only:
    type: boolean
    description: set this property if the partition is read-only
  reg:
    type: array
    description: |
      This should be in the format <OFFSET SIZE>, where OFFSET
      is the offset of the flash partition relative to the base
      address of the parent memory, and SIZE is the size of
      the partition in bytes.
    required: true
  "#address-cells":
    type: int
    description: |
      Number of cells required to represent a child node's
      reg property address. This must be large enough to
      represent the start offset of each partition.
  "#size-cells":
    type: int
    description: |
      Number of cells required to represent a child node's
      reg property address. This must be large enough to
      represent the size of each partition in bytes.

child-binding:
  description: |
    Each child node of the fixed-partitions node represents
    an individual flash partition. These should usually
    look like this:

      partition_nodelabel: partition@START_OFFSET {
              label = "human-readable-name";
              reg = <0xSTART_OFFSET 0xSIZE>;
      };
  properties:
    label:
      type: string
      description: |
        Human readable string describing the flash partition.
    read-only:
      type: boolean
      description: set this property if the partition is read-only
    reg:
      type: array
      description: |
        This should be in the format <OFFSET SIZE>, where OFFSET
        is the offset of the flash partition relative to the base
        address of the parent memory, and SIZE is the size of
        the partition in bytes.
      required: true
```

## dts/bindings/mtd/flash.yaml
```yaml
#
# Copyright (c) 2018, Findlay Feng
#
# SPDX-License-Identifier: Apache-2.0
#
---
title: FLASH Base Structure
version: 0.1

description: >
    This binding gives the base structures for all FLASH devices

properties:
    label:
      type: string
      category: required
      description: Human readable string describing the device (used by Zephyr for API name)
      generation: define

    reg:
      type: array
      description: If flash can be accessed directly
      generation: define
      category: optional

...
```

## dts/bindings/mtd/fujitsu,mb85rcxx.yaml
```yaml
# Copyright (c) 2023 Antmicro <www.antmicro.com>
# SPDX-License-Identifier: Apache-2.0

description: Fujitsu MB85RCXX series I2C FRAM

compatible: "fujitsu,mb85rcxx"

include: ["eeprom-base.yaml", i2c-device.yaml]

properties:
  size:
    required: true
    description: Total FRAM size in bytes.

  pagesize:
    type: int
    description: |
      Size of the single FRAM module in bytes.
      If not provided it is assumed to be the same as total size.

  address-width:
    type: int
    required: true
    description: FRAM address width in bits.

  wp-gpios:
    type: phandle-array
    description: GPIO to which the write-protect pin of the chip is connected.
```

## dts/bindings/mtd/gd,gd32-nv-flash-v1.yaml
```yaml
# Copyright (c) 2022 BrainCo Inc.
# SPDX-License-Identifier: Apache-2.0

description: |
  Flash memory binding of GD32 FMC v1.

  GD32 series use this type flash memory:
    - GD32C10x
    - GD32C11x
    - GD32E10x
    - GD32E11x
    - GD32E50x
    - GD32F3x0
    - GD32F1x0
    - GD32E23x
    - GD32VF103
    - GD32L23x

include: soc-nv-flash.yaml

compatible: gd,gd32-nv-flash-v1

properties:
  max-erase-time-ms:
    type: int
    required: true
    description: Max erase time(millisecond) of a flash page

  page-size:
    type: int
    required: true
    description: Flash memory page size
```

## dts/bindings/mtd/gd,gd32-nv-flash-v2.yaml
```yaml
# Copyright (c) 2022 BrainCo Inc.
# SPDX-License-Identifier: Apache-2.0

description: |
  Flash memory binding of GD32 FMC v2.

  GD32 series use this type flash memory:
    - GD32F10x
    - GD32F20x
    - GD32F30x
    - GD32F403

include: soc-nv-flash.yaml

compatible: gd,gd32-nv-flash-v2

properties:
  max-erase-time-ms:
    type: int
    required: true
    description: Max erase time(millisecond) of a flash page

  bank0-page-size:
    type: int
    required: true
    description: Flash memory page size for bank0

  bank1-page-size:
    type: int
    required: true
    description: Flash memory page size for bank1
```

## dts/bindings/mtd/gd,gd32-nv-flash-v3.yaml
```yaml
# Copyright (c) 2022 BrainCo Inc.
# SPDX-License-Identifier: Apache-2.0

description: |
  Flash memory binding of GD32 FMC v3.

  GD32 series use this type flash memory:
    - GD32F4xx

include: soc-nv-flash.yaml

compatible: gd,gd32-nv-flash-v3

properties:
  max-erase-time-ms:
    type: int
    required: true
    description: max erase time(millisecond) of a flash sector
```

## dts/bindings/mtd/heimann,htpa-flash.yaml
```yaml
# Copyright (c) 2026 sensry.io
# SPDX-License-Identifier: Apache-2.0

description: Heimann HTPA Flash used for storing sensor calibration data

compatible: "heimann,htpa-flash"

include: [spi-device.yaml]

properties:
  size:
    type: int
    required: true
    description: Memory capacity in bytes
```

## dts/bindings/mtd/infineon,fm25xxx.yaml
```yaml
# Copyright (c) 2025 Luna Pes <zephyr@orangemurker.com>
# SPDX-License-Identifier: Apache-2.0

description: Infineon FM25XXX SPI FRAM

compatible: "infineon,fm25xxx"

include: ["eeprom-base.yaml", spi-device.yaml]

properties:
  size:
    required: true
    description: Total FRAM size in bytes.
```

## dts/bindings/mtd/infineon,s25h-flash.yaml
```yaml
# Copyright (c) 2025 Siemens Mobility GmbH
# SPDX-License-Identifier: Apache-2.0

description: MSPI Infineon S25H Flash

compatible: "infineon,s25h-flash"

on-bus: mspi

include: ["soc-nv-flash.yaml", "pinctrl-device.yaml", "mspi-device.yaml"]

properties:
  reg:
    required: true

  reset-startup-time-us:
    required: true
    type: int
    description: |
      Time the device requires to recover after a reset in microseconds

  flash-size:
    required: true
    type: int
    description: |
      Size of the flash in byte

  device-id:
    required: true
    type: int
    description: |
     16 bit JEDEC device id of the flash device that will be read to verify the
     communication is working

  manufacturer-id:
    required: true
    type: int
    description: |
      8 bit JEDEC manufacturer id of the flash device that will be read to
      verify the communication is working

  keep-startup-mspi-config:
    type: boolean
    description: |
      Don't change the MSPI config to 4S-4S-4S during startup and stay at the
      configuration specified in the devicetree. This allows communication with
      slow but very similar flash device that aren't fully supported yet
```

## dts/bindings/mtd/infineon,s28hx512t-mspi.yaml
```yaml
# SPDX-FileCopyrightText: 2026 Texas Instruments Incorporated
# SPDX-License-Identifier: Apache-2.0

description: Infineon S28HX512T Flash

compatible: "infineon,s28hx512t"

on-bus: mspi

include: ["jedec,nor-mspi.yaml"]
```

## dts/bindings/mtd/infineon,xmc4xxx-nv-flash.yaml
```yaml
# Copyright (c) 2022, Schlumberger
# SPDX-License-Identifier: Apache-2.0

description: XMC4XXX flash

compatible: "infineon,xmc4xxx-nv-flash"

include: soc-nv-flash.yaml

child-binding:
    description: Flash page layout description
    child-binding:
        description: Individual flash page layout entry
        properties:
            pages-count:
              description: Number of consecutive pages with size pages-size bytes
              type: int
              required: true

            pages-size:
              type: int
              required: true
```

## dts/bindings/mtd/is66wv-mspi.yaml
```yaml
# Copyright (c) 2026 Nordic Semiconductor ASA
# SPDX-License-Identifier: Apache-2.0

description: ISSI IS66/67WV Serial PSRAM on MSPI bus

compatible: "is66wv"

include: [mspi-device.yaml, "jedec,jesd216.yaml"]
```

## dts/bindings/mtd/jedec,jesd216.yaml
```yaml
# Copyright (c) 2018 Peter Bigot Consulting, LLC
# Copyright (c) 2019-2020 Nordic Semiconductor ASA
# SPDX-License-Identifier: Apache-2.0

# Common properties used by nodes describing serial flash devices that
# are compatible with the JESD216 Serial Flash Discoverable Parameters
# specification.
#
# This allows encoding the entire BFP block in devicetree to avoid
# reading at runtime, while still allowing the driver to pull out extra
# data of interest, such as erase sizes.
#
# Alternatively the BFP block can be absent, but critical fields like
# size can be provided directly along with the JEDEC ID of the expected
# device to verify its presence at runtime.
#
# Only properties supported by parameter tables documented in the
# JESD216 standards should be listed in this binding include file.

properties:
  jedec-id:
    type: uint8-array
    description: JEDEC ID as manufacturer ID, memory type, memory density

  size:
    type: int
    description: flash capacity in bits

  sfdp-bfp:
    type: uint8-array
    description: |
      Contains the 32-bit words in little-endian byte order from the
      JESD216 Serial Flash Discoverable Parameters Basic Flash
      Parameters table.  This provides flash-specific configuration
      information in cases were runtime retrieval of SFDP data
      is not desired.

  quad-enable-requirements:
    type: string
    enum:
      - "NONE"
      - "S2B1v1"
      - "S1B6"
      - "S2B7"
      - "S2B1v4"
      - "S2B1v5"
      - "S2B1v6"
    description: |
      Quad Enable Requirements value from JESD216 BFP DW15.

      Use NONE if the device detects 1-1-4 and 1-4-4 modes by the
      instruction.  Use S1B6 if QE is bit 6 of the first status register
      byte, and can be configured by reading then writing one byte with
      RDSR and WRSR.  For other fields see the specification.

  enter-4byte-addr:
    type: int
    description: |
      Enter 4-Byte Addressing value from JESD216 BFP DW16

      This property is ignored if the device is configured to use SFDP data
      from the sfdp-bfp property (CONFIG_SPI_NOR_SFDP_DEVICETREE) or to read
      SFDP properties at runtime (CONFIG_SPI_NOR_SFDP_RUNTIME).

      For CONFIG_SPI_NOR_SFDP_MINIMAL this is the 8-bit value from bits 31:24
      of DW16 identifying ways a device can be placed into 4-byte addressing
      mode.  If provided as a non-zero value the driver assumes that 4-byte
      addressing is require to access the full address range, and
      automatically puts the device into 4-byte address mode when the device
      is initialized.

  page-size:
    type: int
    description: |
      Number of bytes in a page from JESD216 BFP DW11

      This property is only used in the CONFIG_SPI_NOR_SFDP_MINIMAL configuration.
      It is ignored if the device is configured to use SFDP data
      from the sfdp-bfp property (CONFIG_SPI_NOR_SFDP_DEVICETREE) or
      if the SFDP parameters are read from the device at
      runtime (CONFIG_SPI_NOR_SFDP_RUNTIME).

      The default value is 256 bytes if the value is not specified.
```
