## dts/bindings/mtd/sifli,sf32lb-mpi-qspi-nor.yaml
```yaml
# Copyright 2025 Core Devices LLC
# SPDX-License-Identifier: Apache-2.0

description: SiFli SF32LB Memory Peripheral Interface (MPI) in QSPI NOR mode

compatible: "sifli,sf32lb-mpi-qspi-nor"

include: base.yaml

bus: qspi

properties:
  reg:
    required: true

  reg-names:
    required: true

  clocks:
    required: true

  dmas:
    required: true

  "#address-cells":
    required: true
    const: 1

  "#size-cells":
    required: true
    const: 0

  sifli,lines:
    type: int
    enum:
      - 1
      - 4
    description: |
      Number of data lines connected to the flash device.

  sifli,psclr:
    type: int
    default: 4
    description: |
      Prescaler value for the MPI clock. The MPI clock frequency (MCLK) is:

        MCLK = FCLK         if PSCLR  = 0
             = FCLK / PSCLR if PSCLR != 0

      where FCLK is the frequency of the clock provided to the MPI peripheral.
      The value must be between 0 and 255. Default is boot time value.

  sifli,invert-rx-clk:
    type: boolean
    description: |
      Invert internal RX clock to add half-cycle delay (coarse tune) when
      sampling data. It may be needed for flash devices with high frequency.
```

## dts/bindings/mtd/soc-nv-flash.yaml
```yaml
description: Flash node

compatible: "soc-nv-flash"

include: base.yaml

properties:
  erase-block-size:
    type: int
    description: address alignment required by flash erase operations

  write-block-size:
    type: int
    description: address alignment required by flash write operations
```

## dts/bindings/mtd/st,m24c04-a125.yaml
```yaml
# Copyright (c) 2024 SILA Embedded Solutions GmbH
# SPDX-License-Identifier: Apache-2.0

description: ST M24C04-A125 automotive 4-kbit I2C EEPROM

compatible: "st,m24c04-a125"

include: ["st,m24xxx-a125-base.yaml"]
```

## dts/bindings/mtd/st,m24c16-eeprom.yaml
```yaml
# Copyright (c) 2021 Vossloh
# SPDX-License-Identifier: Apache-2.0

# STM32 M24C16 EEPROM

description: ST M24C16 I2C EEPROM

compatible: "st,m24c16-eeprom"

include: eeprom-base.yaml

properties:
    size:
      required: true
    pagesize:
      type: int
      required: true
      description: EEPROM page size in bytes
    address-width:
      type: int
      required: true
      description: EEPROM address width in bits
    timeout:
      type: int
      required: true
      description: EEPROM write cycle timeout in milliseconds
    wc-gpios:
      type: phandle-array
      required: false
      description: EEPROM Write Control pin.
```

## dts/bindings/mtd/st,m24c32-a125.yaml
```yaml
# Copyright (c) 2024 SILA Embedded Solutions GmbH
# SPDX-License-Identifier: Apache-2.0

description: ST M24C32-A125 automotive 32-kbit I2C EEPROM

compatible: "st,m24c32-a125"

include: ["st,m24xxx-a125-base.yaml"]
```

## dts/bindings/mtd/st,m24c64-a125.yaml
```yaml
# Copyright (c) 2024 SILA Embedded Solutions GmbH
# SPDX-License-Identifier: Apache-2.0

description: ST M24C64-A125 automotive 64-kbit I2C EEPROM

compatible: "st,m24c64-a125"

include: ["st,m24xxx-a125-base.yaml"]
```

## dts/bindings/mtd/st,m24m01-a125.yaml
```yaml
# Copyright (c) 2024 SILA Embedded Solutions GmbH
# SPDX-License-Identifier: Apache-2.0

description: ST M24M01-A125 automotive 1-Mbit I2C EEPROM

compatible: "st,m24m01-a125"

include: ["st,m24xxx-a125-base.yaml"]
```
