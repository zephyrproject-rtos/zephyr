## dts/bindings/mtd/nxp,xspi-nor.yaml
```yaml
# Copyright 2024-2025 NXP
# SPDX-License-Identifier: Apache-2.0

description: NXP XSPI Flash

compatible: "nxp,xspi-nor"

include: ["nxp,xspi-device.yaml", soc-nv-flash.yaml, "jedec,jesd216.yaml"]

properties:
  erase-size:
    type: int
    default: 4096
    description: Erase sector size in bytes.
```

## dts/bindings/mtd/nxp,xspi-psram.yaml
```yaml
# Copyright 2025 NXP
# SPDX-License-Identifier: Apache-2.0

description: NXP XSPI Flash

compatible: "nxp,xspi-psram"

include: ["nxp,xspi-device.yaml"]
```

## dts/bindings/mtd/nxp,xspi.yaml
```yaml
# Copyright 2024-2025 NXP
# SPDX-License-Identifier: Apache-2.0

description: NXP XSPI controller

compatible: "nxp,xspi"

include: [spi-controller.yaml, pinctrl-device.yaml]

properties:
  reg:
    required: true

  interrupts:
    required: true

  amba-address:
    type: int
    required: true
    description: |
      XSPI AMBA memory map.

  byte-order:
    type: int
    default: 3
    enum: [0, 1, 2, 3]
    description: |
      Byte ordering endianness.
      0 = 64-bit BE, 1 = 32-bit LE, 2 = 32-bit BE, 3 = 64-bit LE

  enable-ahb-write:
    type: boolean
    description: Enable AHB write access.

  ahb-buffer-write-flush:
    type: boolean
    description: Enable flushing AHB buffer on write or IP access.

  ahb-prefetch:
    type: boolean
    description: Enable AHB read prefetch feature.

child-binding:
  description: NXP XSPI port

  include: nxp,xspi-device.yaml
```

## dts/bindings/mtd/onnn,le25s20xa.yaml
```yaml
# Copyright (c) 2026 Cirrus Logic, Inc.
# SPDX-License-Identifier: Apache-2.0

description: |
  LE25S20XA SPI flash chip

  Datasheet: https://www.onsemi.com/pdf/datasheet/le25s20xa-d.pdf

compatible: "onnn,le25s20xa"

include: "spi-device.yaml"

properties:
  jedec-id:
    type: uint8-array
    default: [0x62, 0x16, 0x12]
    description: JEDEC Standard ID

  size:
    type: int
    required: true
    description: Flash capacity in bytes.

  page-size:
    type: int
    required: true
    description: Flash page size in bytes.

  read-only:
    type: boolean
    description: Set flash device to be read-only.

  small-sector-erase:
    type: boolean
    description: |
      Set sector erase operation to erase 4 kB regions of
      memory instead of 64 kB regions.

  wp-gpios:
    type: phandle-array
    description: |
      Active low write protection pin to prevent status registers from
      being changed.
```

## dts/bindings/mtd/partition.yaml
```yaml
description: Flash partitions parent node

compatible: "fixed-partitions"

properties:
    "#address-cells":
        type: int
        required: false
        description: number of address cells in reg property

    "#size-cells":
        type: int
        required: false
        description: number of size cells in reg property

child-binding:
    description: Flash partition child node
    properties:
       label:
          type: string
          required: false
          description: Human readable string describing the device (used as device_get_binding() argument)
       read-only:
          type: boolean
          required: false
          description: if the partition is read-only or not
       reg:
          type: array
          description: register space
          required: true
       erase-block-size:
          type: int
          required: false
          description: Erase block size used for erasing the partition, should
                       be multiple of the flash erase block size at the location
                       of the partition. When a partition is used that spans
                       regions with different erase block sizes the value should
                       be a multiple of the largest block size. If unspecified
                       the partition size is used as erase block size.
```

## dts/bindings/mtd/realtek,bee-nor-flash.yaml
```yaml
# Copyright (c) 2026 Realtek Semiconductor Corporation
# SPDX-License-Identifier: Apache-2.0

description: Realtek Bee NOR flash

compatible: "realtek,bee-nor-flash"

include: soc-nv-flash.yaml

properties:
  supports-2bit:
    type: boolean
    description: Set if flash supports 2-bit (Dual) mode

  supports-4bit:
    type: boolean
    description: Set if flash supports 4-bit (Quad) mode

  supports-dtr-4bit:
    type: boolean
    description: Set if flash supports 4-bit DTR (Quad) mode
```

## dts/bindings/mtd/renesas,ra-nv-code-flash.yaml
```yaml
# Copyright (c) 2024-2025 Renesas Electronics Corporation
# SPDX-License-Identifier: Apache-2.0

description: |
  Flash memory binding for Renesas RA Code flash region

include: [base.yaml, soc-nv-flash.yaml]

compatible: "renesas,ra-nv-code-flash"

properties:
  programming-enable:
    type: boolean
    description: Enable code flash programming configuration

  erase-block-size:
    type: int
    description: |
      The flash controller is limited by hardware to erase whole blocks of flash
      at a time. This property describes the largest erase block size in erase-blocks.

  erase-blocks:
    type: phandle-array
    description: |
      The flash controller is limited by hardware to erase whole blocks of flash
      at a time. This property describes the layout of the erase-blocks, which can
      vary in size within the flash memory area.

      Currently, Renesas SoCs use different versions of code-flash. While most code-flash
      defines `erase-block-size` as one block, some versions have blocks with different sizes
      and divided into regions. Therefore, this property reflects the actual `erase-block-size`
      for each region of code-flash, depending on the flash version.

      For example:
        - The R7FA8M1AHECBD's code-flash has `flash-hardware-version = <40>` and uses
        the following blocks layout:
          |--------------------|
          | 8 Kbytes           |
          |--------------------|  number of 8kb blocks = 8
          | 8 Kbytes           |
          |--------------------|
          | 32 Kbytes          |
          |--------------------|
          | 32 Kbytes          |  number of 32kb blocks = 61
          |--------------------|
          | 32 Kbytes          |
          |--------------------|
        The "erase-block" should has the value like this:
          erase-blocks = <&flash 8 8192>, <&flash 61 32768>;

        - The R7FA4L1BD4CFP's code-flash has `flash-hardware-version = <4>` and uses
        the following blocks layout:
          |--------------------|
          | 2 Kbytes           |
          |--------------------|
          | 2 Kbytes           |  number of 2kb blocks = 256
          |--------------------|
          | 2 Kbytes           |
          |--------------------|
        The "erase-block" should has the value like this:
          erase-blocks = <&flash 256 2048>;
```

## dts/bindings/mtd/renesas,ra-nv-data-flash.yaml
```yaml
# Copyright (c) 2024-2025 Renesas Electronics Corporation
# SPDX-License-Identifier: Apache-2.0

description: |
  Flash memory binding for Renesas RA Data flash region

include: [base.yaml, soc-nv-flash.yaml]

compatible: "renesas,ra-nv-data-flash"

properties:
  programming-enable:
    type: boolean
    description: |
      Enable data flash programming configuration
```

## dts/bindings/mtd/renesas,ra-nv-flash.yaml
```yaml
# Copyright (c) 2024 Renesas Electronics Corporation
# SPDX-License-Identifier: Apache-2.0

description: |
  Flash memory binding of Renesas RA family

include: [base.yaml, soc-nv-flash.yaml]

compatible: "renesas,ra-nv-flash"

properties:
  renesas,programming-enable:
    type: boolean
    description: Enable flash programming configuration
```

## dts/bindings/mtd/renesas,ra-nv-mram.yaml
```yaml
# Copyright (c) 2025 Renesas Electronics Corporation
# SPDX-License-Identifier: Apache-2.0

description: MRAM memory of Renesas RA family

include: [soc-nv-flash.yaml]

compatible: "renesas,ra-nv-mram"

properties:
  reg:
    required: true
```

## dts/bindings/mtd/renesas,ra-ospi-b-nor.yaml
```yaml
# Copyright (c) 2024-2026 Renesas Electronics Corporation
# SPDX-License-Identifier: Apache-2.0

description: Renesas RA OSPI FLASH

compatible: "renesas,ra-ospi-b-nor"

include: [base.yaml, "jedec,jesd216.yaml"]

properties:
  jedec-id:
    required: true
    description: |
      The JEDEC ID of the flash memory connected to OSPI. This is used to match the flash
      memory to a compatible flash driver, and to ensure the correct SPI NOR flash

  protocol-mode:
    type: int
    required: true
    description: |
     The width of OSPI bus to which flash memory is connected.

     Possible values are :
      - OSPI_SPI_MODE  <1> = SPI mode on 1 data line
      - OSPI_DUAL_MODE <2> = Dual mode on 2 data lines
      - OSPI_QUAD_MODE <4> = Quad mode on 4 data lines
      - OSPI_OPI_MODE  <8> = Octo mode on 8 data lines
    enum:
      - 1
      - 2
      - 4
      - 8

  ospi-max-frequency:
    type: int
    required: true
    description: |
      Max frequency input on OSPI

  enter-4byte-command:
    type: int
    description: |
      Enter 4-byte address mode command (Only require if SPI NOR
      Flash has the incorrect BFPT DW16 information in SFDP)

  rdsr-addr-4bytes:
    type: boolean
    description: |
      Whether RDSR command requires 4-byte address (Only require if SPI NOR
      Flash has the incorrect PROFILE1 DW1 information in SFDP)

  default-8d-dummy-cycles:
    type: int
    description: |
      Default dummy cycles for read command (Only require if SPI NOR Flash enter 8D mode
      but don't has dummy cycles information or the information is incorrect in SFDP)
```

## dts/bindings/mtd/renesas,ra-qspi-nor.yaml
```yaml
# Copyright (c) 2024 Renesas Electronics Corporation
# SPDX-License-Identifier: Apache-2.0

description: Renesas RA QSPI FLASH

compatible: "renesas,ra-qspi-nor"

include: [base.yaml]

on-bus: qspi

properties:
  reg:
    required: true
    description: Flash Memory base address and size in bytes

  erase-block-size:
    type: int
    description: address alignment required by flash erase operations

  write-block-size:
    type: int
    description: address alignment required by flash write operations

  qpi-enable:
    type: boolean
    description: Enable Quad SPI protocol (QPI) (4-4-4)
```

## dts/bindings/mtd/renesas,ra-rv40f-flash.yaml
```yaml
# Copyright (c) 2024 Piotr Rak
# SPDX-License-Identifier: Apache-2.0

description: |
  This binding describes the Rensas RA-series RV40F Phase-2 flash area layout.

  Renesas RA-series MCUs use two kinds of flash memory:

  |---------------|-------------------------------|-------------------------|
  | Varian        | Board                         |                         |
  |---------------|-------------------------------|-------------------------|
  | RV40F Phase 2 | eg. RA6M1, RA6M2, RA6M3 RA6T1 | <= Describing this here |
  |---------------|-------------------------------|-------------------------|
  | MF3           | eg. RA2A1 RA4M1 RA4W1         | _NOT_ applicable        |
  |---------------|-------------------------------|-------------------------|

  Documentation:
    - Application Note "Renesas RA Family - Flash Memory Programming Rev 1.20"
      (https://www.renesas.com/us/en/document/apn/flash-memory-programming)
    - Additionally:
       * RA6Mx RA6Tx Groups "User's Manual: Hardware"
       * RA8D1 RA8M1 RA8T1 Groups "User's Manual: Hardware"

  The Renesas RA MCUs RV40F kind flash area varies in:
    - the write-block-size(s) (referred to as programming-size in above mentioned documentation),
    - the read size
    - the layout of erase-blocks

  for different regions and kinds of flash.

  E.g. the code flash layout of R7FA6M5BH3CFC:

  |-------------------|
  | Block 0 (8 KiB)   |  erase = 8 KiB (1 block); write = 128 B
  |-------------------|
  | Block 1 (8 KiB)   |  erase = 8 KiB (1 block); write = 128 B
  |-------------------|
  | ...               |  erase = 8 KiB (1 block); write = 128 B
  |-------------------|
  | Block 7 (8 KiB)   |  erase = 8 KiB (1 block); write = 128 B
  |-------------------|
  | Block 8 (32 KiB)  |  erase = 32 KiB (1 block); write = 128 B
  |-------------------|
  | Block 9 (32 KiB)  |  erase = 32 KiB (1 block); write = 128 B
  |-------------------|
  | ...               |  erase = 32 KiB (1 block); write = 128 B
  |-------------------|
  | Block 68 (32 KiB) |  erase = 32 KiB (1 block); write = 128 B
  |-------------------|


  E.g. the data flash layout of R7FA6M5BH3CFC:

  |-------------------|
  | Block 0 (64 B)    |  erase1 = 64 B (1 block); erase2 = 64/128/256 B; write = 4/8/16 B
  |-------------------|
  | Block 1 (64 B)    |  erase1 = 64 B (1 block); erase2 = 64/128/256 B; write = 4/8/16 B
  |-------------------|
  | ...               |  erase1 = 64 B (1 block); erase2 = 64/128/256 B; write = 4/8/16 B
  |-------------------|
  | Block 127 (64 B)  |  erase1 = 64 B (1 block); erase2 = 64/128/256 B; write = 4/8/16 B
  |-------------------|


  This flash area layout would be described as:

  TODO

  Notes:
    The flash area layout node flash0 should have both this
    compatible, "renesas,ra-rv40f", and the "soc-nv-flash"
    compatible. The latter is used from mcuboot and other
    modules to identify the flash area.

compatible: "renesas,ra-rv40f-flash"

include: base.yaml

properties:
  write-block-size:
    type: int
    description: |
      TODO

  erase-block-size:
    type: int
    description: |
      TODO

  fixme-erase2-block-sizes:
    type: int
    description: |
      TODO

  fixme-erase-blocks:
    type: phandle-array
    description: |
      TODO
```

## dts/bindings/mtd/renesas,rh850-code-flash.yaml
```yaml
# Copyright (c) 2026 Renesas Electronics Corporation
# SPDX-License-Identifier: Apache-2.0

description: Flash memory binding of Renesas RH850 family

include: [base.yaml, soc-nv-flash.yaml]

compatible: "renesas,rh850-code-flash"

properties:
  renesas,programming-enable:
    type: boolean
    description: Enable flash programming configuration for code flash
```

## dts/bindings/mtd/renesas,rh850-data-flash.yaml
```yaml
# Copyright (c) 2026 Renesas Electronics Corporation
# SPDX-License-Identifier: Apache-2.0

description: Flash memory binding of Renesas RH850 family

include: [base.yaml, soc-nv-flash.yaml]

compatible: "renesas,rh850-data-flash"

properties:
  renesas,programming-enable:
    type: boolean
    description: Enable flash programming configuration for data flash
```

## dts/bindings/mtd/renesas,rx-nv-flash.yaml
```yaml
# Copyright (c) 2024 Renesas Electronics Corporation
# SPDX-License-Identifier: Apache-2.0

description: Flash memory binding of Renesas RX family

include: [base.yaml, soc-nv-flash.yaml]

compatible: "renesas,rx-nv-flash"

properties:
  programming-enable:
    type: boolean
    description: Enable flash programming configuration for code flash

  bgo-enable:
    type: boolean
    description: |
      Enable module in BGO (background operations) mode for data flash.
```

## dts/bindings/mtd/serial-flash.yaml
```yaml
---
title: Flash base node description
version: 0.1

description: >
    This binding gives a base FLASH description

inherits:
    !include flash.yaml

properties:
    compatible:
      type: string
      category: required
      description: compatible strings
      constraint: "serial-flash"

...
```
