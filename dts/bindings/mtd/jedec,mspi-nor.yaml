## dts/bindings/mtd/jedec,mspi-nor.yaml
```yaml
# Copyright (c) 2024 Nordic Semiconductor ASA
# SPDX-License-Identifier: Apache-2.0

description: Generic NOR flash on MSPI bus

compatible: "jedec,mspi-nor"

include:
  - name: mspi-device.yaml
  - name: jedec,spi-nor-common.yaml
    property-allowlist:
      - jedec-id
      - size
      - sfdp-bfp
      - sfdp-ff05
      - sfdp-ff84
      - quad-enable-requirements
      - has-dpd
      - dpd-wakeup-sequence
      - t-enter-dpd
      - t-exit-dpd

properties:
  read-frequency:
    type: int
    description: |
      Clock frequency of device to configure in Hz for read
      command, when reads are desired to be in a different
      frequency than the rest of the commands.

  read-io-mode:
    type: string
    enum:
      - "MSPI_IO_MODE_SINGLE"
      - "MSPI_IO_MODE_DUAL"
      - "MSPI_IO_MODE_DUAL_1_1_2"
      - "MSPI_IO_MODE_DUAL_1_2_2"
      - "MSPI_IO_MODE_QUAD"
      - "MSPI_IO_MODE_QUAD_1_1_4"
      - "MSPI_IO_MODE_QUAD_1_4_4"
      - "MSPI_IO_MODE_OCTAL"
      - "MSPI_IO_MODE_OCTAL_1_1_8"
      - "MSPI_IO_MODE_OCTAL_1_8_8"
      - "MSPI_IO_MODE_HEX"
      - "MSPI_IO_MODE_HEX_8_8_16"
      - "MSPI_IO_MODE_HEX_8_16_16"
    description: |
      MSPI I/O mode setting for read command when desired to
      be different from base device `mspi-io-mode` for the rest
      of the commands.

  write-frequency:
    type: int
    description: |
      Clock frequency of device to configure in Hz for write
      command, when write are desired to be in a different
      frequency than the rest of the commands.

  write-io-mode:
    type: string
    enum:
      - "MSPI_IO_MODE_SINGLE"
      - "MSPI_IO_MODE_DUAL"
      - "MSPI_IO_MODE_DUAL_1_1_2"
      - "MSPI_IO_MODE_DUAL_1_2_2"
      - "MSPI_IO_MODE_QUAD"
      - "MSPI_IO_MODE_QUAD_1_1_4"
      - "MSPI_IO_MODE_QUAD_1_4_4"
      - "MSPI_IO_MODE_OCTAL"
      - "MSPI_IO_MODE_OCTAL_1_1_8"
      - "MSPI_IO_MODE_OCTAL_1_8_8"
      - "MSPI_IO_MODE_HEX"
      - "MSPI_IO_MODE_HEX_8_8_16"
      - "MSPI_IO_MODE_HEX_8_16_16"
    description: |
      MSPI I/O mode setting for write command when desired to
      be different from base device `mspi-io-mode` for the rest
      of the commands.

  reset-gpios:
    type: phandle-array
    description: |
      RESET line. If specified, the flash chip will be reset at initialization.

  t-reset-pulse:
    type: int
    description: |
      Minimum duration, in nanoseconds, of an active pulse on the RESET line.

  t-reset-recovery:
    type: int
    description: |
      Minimum time, in nanoseconds, the flash chip needs to recover after reset.
      Such delay is performed when a GPIO or software reset is done, or after
      power is supplied to the chip if the "supply-gpios" property is specified.

  transfer-timeout:
    type: int
    default: 10
    description: |
      Maximum time, in milliseconds, allowed for a single transfer on the MSPI
      bus in communication with the flash chip. The default value is the one
      that was previously hard-coded in the flash_mspi_nor driver.

  use-4byte-addressing:
    type: boolean
    description: |
      Indicates that 4-byte addressing is to be used in communication with
      the flash chip. The driver will use dedicated 4-byte address instruction
      codes for commands that require addresses (like Read, Page Program,
      or Erase) if those are supported by the flash chip, or if necessary,
      it will switch the chip to 4-byte addressing mode.

  initial-soft-reset:
    type: boolean
    description: |
      When set, the flash driver performs software reset of the flash chip
      at initialization.
```

## dts/bindings/mtd/jedec,qspi-nor.yaml
```yaml
# Copyright (c) 2025 Core Devices LLC
# SPDX-License-Identifier: Apache-2.0

description: Generic NOR flash on QSPI bus

compatible: "jedec,qspi-nor"

on-bus: qspi

include: [base.yaml, "jedec,spi-nor-common.yaml"]
```

## dts/bindings/mtd/jedec,spi-nor-common.yaml
```yaml
# Copyright (c) 2018 Peter Bigot Consulting, LLC
# Copyright (c) 2019 Nordic Semiconductor ASA
# SPDX-License-Identifier: Apache-2.0

# Common properties used by nodes describing M25P80-compatible SPI NOR
# serial flash devices, regardless of which Zephyr driver is being used.
#
# This extends JESD216-defined features with additional functionality
# that may be specific to the vendor of a M25P80-compatible device and
# only supported in certain drivers.  Any information that can be
# obtained from standardized SFDP parameter blocks should be in
# jedec,jesd216.yaml instead.

include: "jedec,jesd216.yaml"

properties:
  requires-ulbpr:
    type: boolean
    description: |
      Indicates the device requires the ULBPR (0x98) command.

      Some flash chips such as the Microchip SST26VF series have a block
      protection register that initializes to write-protected.  Use this
      property to indicate that the BPR must be unlocked before write
      operations can proceed.

  has-dpd:
    type: boolean
    description: |
      Indicates the device supports the DPD (0xB9) command.

      Use this property to indicate the flash chip supports the Deep
      Power-Down mode that is entered by command 0xB9 to reduce power
      consumption below normal standby levels.  Use of this property
      implies that the RDPD (0xAB) Release from Deep Power Down command
      is also supported.  (On some chips this command functions as Read
      Electronic Signature; see t-enter-dpd).

  dpd-wakeup-sequence:
    type: array
    description: |
      Specifies wakeup durations for devices without RDPD.

      Some devices (Macronix MX25R in particular) wake from deep power
      down by a timed sequence of CSn toggles rather than the RDPD
      command.  This property specifies three durations measured in
      nanoseconds, in this order:
      (1) tDPDD (Delay Time for Release from Deep Power-Down Mode)
      (2) tCDRP (CSn Toggling Time before Release from Deep Power-Down Mode)
      (3) tRDP (Recovery Time for Release from Deep Power-Down Mode)

      Absence of this property indicates that the RDPD command should be
      used to wake the chip from Deep Power-Down mode.

  t-enter-dpd:
    type: int
    description: |
      Duration required to complete the DPD command.

      This provides the duration, in nanoseconds, that CSn must be
      remain deasserted after issuing DPD before the chip will enter
      deep power down.

      If not provided the driver does not enforce a delay.

  t-exit-dpd:
    type: int
    description: |
      Duration required to complete the RDPD command.

      This provides the duration, in nanoseconds, that CSn must be
      remain deasserted after issuing RDPD before the chip will exit
      deep power down and be ready to receive additional commands.

      If not provided the driver does not enforce a delay.

  has-lock:
    type: int
    description: |
      Bit mask of bits of the status register that should be cleared on
      startup.

      Some devices from certain vendors power-up with block protect bits
      set in the status register, which prevent any erase or program
      operation from working.  Devices that have this behavior need to
      clear those bits on startup.  However, other devices have
      non-volatile bits in the status register that should not be
      cleared.

      This value, when present, identifies bits in the status register
      that should be cleared when the device is initialized.

  mxicy,mx25r-power-mode:
    type: string
    enum:
      - "low-power"
      - "high-performance"
    description:
      Select to configure flash to use ultra low power mode or high
      performance mode (L/H switch). The high performance mode has
      faster write and erase performance, but use more power than ultra
      low power mode.

      Only supported on Macronix MX25R Ultra Low Power series.

  use-4b-addr-opcodes:
    type: boolean
    description: |
      Indicates the device uses special 4-byte address opcodes.
      Instead of switching to 4-byte addressing mode, the device uses
      special opcodes for 4-byte addressing.

      Some devices support 4-byte address opcodes for read/write/erase
      operations.  Use this property to indicate that the device supports
      4-byte address opcodes.
```

## dts/bindings/mtd/microchip,24aa02xexx-base.yaml
```yaml
# Copyright (c) 2021 Benjamin S. Scarlet
# SPDX-License-Identifier: Apache-2.0

description: Microchip 24AA02XEXX I2C EEPROMs with EUI node identity

compatible: "microchip,24aa02xexx"

include: eeprom-base.yaml

properties:
    size:
      required: true
    pagesize:
      type: int
      required: true
      description: EEPROM page size in bytes
```

## dts/bindings/mtd/microchip,24mac402.yaml
```yaml
# Copyright (c) 2025 Microchip Technology Inc.
# SPDX-License-Identifier: Apache-2.0

description: Microchip AT24 (or compatible) I2C EEPROM

compatible: "microchip,at24mac402"

include: [i2c-device.yaml]
```

## dts/bindings/mtd/microchip,24xx01-eeprom.yaml
```yaml
# Copyright (c) 2024, Basalte bv
# SPDX-License-Identifier: Apache-2.0

description: 24XX01 EEPROM controller

compatible: "microchip,24xx01-eeprom"

include: ["eeprom-base.yaml", i2c-device.yaml]

properties:
  size:
    const: 128
    required: true
    description: Total EEPROM size in bytes.
  pagesize:
    type: int
    const: 8
    required: true
    description: EEPROM page size in bytes
  write-cycle-time:
    type: int
    const: 5
    required: true
    description: EEPROM maximum write cycle time
  wp-gpios:
    type: phandle-array
    description: GPIO to which the write-protect pin of the chip is connected.
```

## dts/bindings/mtd/microchip,ateccx08-base.yaml
```yaml
# Copyright (c) 2024 Vogl Electronic GmbH
# SPDX-License-Identifier: Apache-2.0

include: ["eeprom-base.yaml", i2c-device.yaml]

properties:
  wake-delay:
    type: int
    description: delay in us to wait for the device to wake up
    default: 1500
  retries:
    type: int
    description: number of retries for operations
    default: 20
```

## dts/bindings/mtd/microchip,ateccx08-otp.yaml
```yaml
# Copyright (c) 2024 Vogl Electronic GmbH
# SPDX-License-Identifier: Apache-2.0

description: Microchip ATECCx08 otp binding

compatible: "microchip,ateccx08-otp"

include: [eeprom-base.yaml, base.yaml]

on-bus: ateccx08
```

## dts/bindings/mtd/microchip,flash-g2.yaml
```yaml
# Copyright (c) 2025-2026 Microchip Technology Inc.
# SPDX-License-Identifier: Apache-2.0

title: Microchip Flash G2

description: |
  Microchip G2 driver for Flash

  Group g2 NVMCTRL driver supports following hardware peripherals:
    - module name="NVMCTRL" id="03929" version="1a0"

compatible: "microchip,flash-g2"

include: soc-nv-flash.yaml

examples:
  - |
    /*
     * Multiple flash regions in g3 devices are considered as a single block
     * of memory:
     *
     *   - 0x00000000--0x0007FFFF, main flash area
     *   - 0x00400000--0x00401FFF, data flash area
     *
     * The region in between these flash are considered as
     * unimplemented regions and driver would avoid accessing
     * these regions
     *
     * data-flash-start-addr - tarting address of data flash region
     * user-row-start-addr - starting address of user-row
     */

    nvmctrl: flash-controller@44002000 {
      compatible = "microchip,nvmctrl-g2";
      reg = <0x41004000 0xa0>;
      /* ... */

      flash0: flash@8000000 {
        reg = <0x0 (DT_SIZE_K(512) + DT_SIZE_K(3584) + DT_SIZE_K(8))>;
        compatible = "microchip,flash-g2", "soc-nv-flash";
        unsupported-region = <0x00080000 0x003fffff>;
        write-block-size = <64>;
        erase-block-size = <256>;
        data-flash-start-addr = <0x00400000>;
        user-row-start-addr = <0x00804000>;
      };
    };

properties:
  unsupported-region:
    type: array
    description: array of unaddressable regions in the given flash area
  data-flash-start-addr:
    type: int
    description: starting address of data flash region
  user-row-start-addr:
    type: int
    description: starting address of user-row flash region
```

## dts/bindings/mtd/microchip,pic32cxsg-flash.yaml
```yaml
# Copyright (c) 2023 Bjarki Arge Andreasen
# SPDX-License-Identifier: Apache-2.0

description: |
  This binding describes the Microchip PIC32CXSG flash area layout.

  The Microchip PIC32CXSG flash area varies in write-block-size, memory area,
  and the layout of erase-blocks.

  E.g. the flash area layout of the ATSAM4E16C:

    |--------------------|
    | 8 Kbytes           |  erase block size = 2048
    |--------------------|
    | 8 Kbytes           |  erase block size = 2048
    |--------------------|
    | 48 Kbytes          |  erase block size = 4096
    |--------------------|
    | 64 Kbytes          |  erase block size = 4096
    |--------------------|
    | ...                |

  The ATSAM4E16C has a flash area which is 1000Kbytes
  (1024 * 1024 bytes) with a write-block-size of 8 bytes. The first
  16 Kbytes can be erased in blocks of 2048 bytes
  (8 blocks of 2048 bytes), the remaining flash area is erasable
  in blocks of 4096 bytes (252 blocks of 4096 bytes).

  This flash area layout would described as:

    / {
      soc {
        eefc: flash-controller@400e0a00 {
        compatible = "microchip,pic32cxsg-flash-controller";
        reg = <0x400e0a00 0x200>;
        clocks = <&pmc PMC_TYPE_PERIPHERAL 6>;
        status = "okay";

        #address-cells = <1>;
        #size-cells = <1>;
        #erase-block-cells = <2>;

        flash0: flash@400000 {
          compatible = "microchip,pic32cxsg-flash", "soc-nv-flash";
          reg = <0x400000 0x100000>;
          write-block-size = <8>;
          erase-block-size = <4096>;
          erase-blocks = <&eefc 8 2048>, <&eefc 252 4096>;
        };
      };
    };

  Notes:
    The flash area layout node flash0 should have both this
    compatible, "microchip,pic32cxsg-flash", and the "soc-nv-flash"
    compatible. The latter is used from mcuboot and other
    modules to identify the flash area.

    If partitions are used, remember that their addresses are
    offsets relative to the flash area address.  E.g. using
    mcuboot and a allocating a storage partition:

      &flash0 {
        partitions {
          compatible = "fixed-partitions";
          #address-cells = <1>;
          #size-cells = <1>;

          boot_partition: partition@0 {
            label = "mcuboot";
            reg = <0x0 0x10000>;
          };

          slot0_partition: partition@10000 {
            label = "slot0";
            reg = <0x10000 0x70000>;
          };

          slot1_partition: partition@80000 {
            label = "slot1";
            reg = <0x80000 0x70000>;
          };

          storage_partition: partition@f0000 {
            label = "storage";
            reg = <0xf0000 0x100000>;
          };
        };
      };

compatible: "microchip,pic32cxsg-flash"

include: base.yaml

properties:
  write-block-size:
    type: int
    description: |
      The flash controller is limited by hardware to writing blocks of
      this size, aligned to this size, in bytes, to previously erased
      flash, within the flash memory area.

  erase-block-size:
    type: int
    description: |
      The flash controller is limited by hardware to erase whole
      blocks of flash at a time. This property describes the largest
      erase block size in erase-blocks.

  erase-blocks:
    type: phandle-array
    required: true
    description: |
      The flash controller is limited by hardware to erase whole
      blocks of flash at a time. This property describes the layout of
      the erase-blocks, which can vary in size within the flash memory
      area.
```
