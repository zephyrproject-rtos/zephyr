## dts/bindings/mtd/microchip,xec-eeprom.yaml
```yaml
# Copyright (c) 2022 Microchip Technology Inc.
# SPDX-License-Identifier: Apache-2.0

description: Microchip on-chip EEPROM

compatible: "microchip,xec-eeprom"

include:
  - name: eeprom-base.yaml
  - name: pinctrl-device.yaml
  - name: microchip,dmec-ecia-girq.yaml

properties:
  reg:
    required: true

  pcr-scr:
    type: int
    required: true
    description: EEPROM PCR register index and bit position
```

## dts/bindings/mtd/micron,mt25qu02g.yaml
```yaml
# Copyright (c) 2022 -2023 Intel Corporation
# SPDX-License-Identifier: Apache-2.0

description: Micron QSPI Flash

compatible: "micron,mt25qu02g"

include: flash-controller.yaml

properties:
  size:
    type: int
    description: Flash memory size in bit.

  sector-size:
    type: int
    description: Flash memory sector-size.

  subsector-size:
    type: int
    description: Flash memory block-size.

  page-size:
    type: int
    description: Flash memory page-size.

  address-byte:
    type: int
    description: Flash memory address bytes.

  bytes-per-block:
    type: int
    description: Flash memory bytes-per-block.
```

## dts/bindings/mtd/mspi-aps-z8.yaml
```yaml
# Copyright (c) 2025, Ambiq Micro Inc. <www.ambiq.com>
# SPDX-License-Identifier: Apache-2.0

description: AP Memory pSRAM Version Z8 on MSPI bus

compatible: "mspi-aps-z8"

include: [mspi-device.yaml, "jedec,jesd216.yaml"]
```

## dts/bindings/mtd/mspi-aps256n.yaml
```yaml
# Copyright (c) 2024, Ambiq Micro Inc. <www.ambiq.com>
# SPDX-License-Identifier: Apache-2.0

description: AP Memory APS256 pSRAM on MSPI bus

compatible: "mspi-aps256n"

include: [mspi-device.yaml, "jedec,jesd216.yaml"]
```

## dts/bindings/mtd/mspi-aps6404l.yaml
```yaml
# Copyright (c) 2024, Ambiq Micro Inc. <www.ambiq.com>
# SPDX-License-Identifier: Apache-2.0

description: AP Memory APS6404L pSRAM on MSPI bus

compatible: "mspi-aps6404l"

include: [mspi-device.yaml, "jedec,jesd216.yaml"]
```

## dts/bindings/mtd/mspi-atxp032.yaml
```yaml
# Copyright (c) 2024, Ambiq Micro Inc. <www.ambiq.com>
# SPDX-License-Identifier: Apache-2.0

description: NOR Flash devices ATXP032 on MSPI bus

compatible: "mspi-atxp032"

include: [mspi-device.yaml, "jedec,jesd216.yaml"]
```

## dts/bindings/mtd/mspi-is25xX0xx.yaml
```yaml
# Copyright (c) 2025, Ambiq Micro Inc. <www.ambiq.com>
# SPDX-License-Identifier: Apache-2.0

description: ISSI IS25(W/L)X0(32/64) on MSPI bus

compatible: "mspi-is25xX0xx"

include: [mspi-device.yaml, "jedec,jesd216.yaml"]

properties:
  reset-gpios:
    type: phandle-array
    description: |
      RESET line. If specified, the flash chip will be reset at initialization.

  t-reset-pulse:
    type: int
    description: |
      Minimum duration, in nanoseconds, of an active pulse on the RESET line.
  t-reset-recovery:
    type: int
    description: |
      Minimum time, in nanoseconds, the flash chip needs to recover after reset.
```

## dts/bindings/mtd/mspi-nor-mx25.yaml
```yaml
# Copyright (c) 2024, STMicroelectronics
# SPDX-License-Identifier: Apache-2.0

description: NOR Flash devices MX25xx on MSPI bus supporting the JEDEC CFI interface

compatible: "mspi-nor-mx25"

include: [mspi-device.yaml, "jedec,jesd216.yaml"]
```

## dts/bindings/mtd/mxicy,mx25u.yaml
```yaml
# Copyright (c) 2026 EXALT Technologies.
# SPDX-License-Identifier: Apache-2.0

description: Macronix MX25U series SPI NOR flash

compatible: "mxicy,mx25u"

include: jedec,mspi-nor.yaml
```

## dts/bindings/mtd/netsol,s3axx04.yaml
```yaml
# Copyright (c) 2025 MASSDRIVER EI (massdriver.space)
# SPDX-License-Identifier: Apache-2.0

description: Netsol S3Axx04 SPI MRAM

compatible: "netsol,s3axx04"

include: [spi-device.yaml]

properties:
  size:
    type: int
    required: true
    description: Total MRAM size in bytes.

  config-regs:
    type: uint8-array
    default: [0x00, 0x00, 0x20, 0x00]
    description: Configuration Registers, see datasheet. 4 Registers, 1 byte per register.
      These registers are non-volatile and need to be re-set in case there was a previous issue.
      Defaults sets a safe working configuration with the lowest driving strength.

  disable-wren:
    type: boolean
    description: Disable the need for WREN command before writing to memory, making it a bit faster.
```

## dts/bindings/mtd/nordic,owned-partitions.yaml
```yaml
# Copyright (c) 2024 Nordic Semiconductor ASA
# SPDX-License-Identifier: Apache-2.0

description: |
  Nordic Owned Partitions

  Memory partition table with permission attributes common to its partitions.
  This is a special case of the Nordic Owned Memory binding.

  Every compatible node is expected to be a child of a memory node, where the
  listed partitions belong.

  A single memory node can contain multiple partition tables, each with a
  different set of permissions. For each such table, the smallest memory region
  spanning the contained partitions will be recorded in the UICR. These regions
  are allowed to contain gaps between the partitions, but this is discouraged.

  Example:

    mram1x: mram@e000000 {
        compatible = "nordic,mram";
        reg = <0xe000000 0x200000>;
        ...

        rx-partitions {
            compatible = "nordic,owned-partitions";
            perm-read;
            perm-execute;
            #address-cells = <1>;
            #size-cells = <1>;

            slot0_partition: partition@c0000 {
                label = "image-0";
                reg = <0xc0000 0x40000>;
            };
        };

        rw-partitions {
            compatible = "nordic,owned-partitions";
            perm-read;
            perm-write;
            #address-cells = <1>;
            #size-cells = <1>;

            slot1_partition: partition@100000 {
                label = "image-1";
                reg = <0x100000 0x50000>;
            };
            storage_partition: partition@150000 {
                label = "storage";
                reg = <0x150000 0x6000>;
            };
        };
    };

  From this example, two memory regions will be inferred:

    - 0x0E0C0000--0x0E100000, with read & execute permissions, containing the
      partition labeled "image-0".
    - 0x0E100000--0x0E156000, with read & write permissions, containing the
      partitions labeled "image-1" and "storage".

compatible: "nordic,owned-partitions"

include:
  - name: nordic,owned-memory.yaml
    property-blocklist:
      - reg

properties:
  "#address-cells":
    required: true

  "#size-cells":
    required: true

child-binding:
  description: |
    Partitions in the table are defined as subnodes. Each partition must have a
    size and an offset relative to the base address of the parent memory node.

  include:
    - name: base.yaml
      property-blocklist:
        - compatible

  properties:
    reg:
      required: true
```

## dts/bindings/mtd/nordic,qspi-nor.yaml
```yaml
# Copyright (c) 2019 Nordic Semiconductor ASA
# SPDX-License-Identifier: Apache-2.0

description: |
  QSPI NOR flash supporting the JEDEC CFI interface.

compatible: "nordic,qspi-nor"

include: [base.yaml, "jedec,spi-nor-common.yaml"]

on-bus: qspi

properties:
  reg:
    required: true

  label:
    required: true

  jedec-id:
    required: true

  size:
    required: true

  readoc:
    type: string
    required: false
    enum:
      - "fastread"        # Single data line SPI, FAST_READ (0x08)
      - "read2o"          # Dual data line SPI, READ2O (0x3B)
      - "read2io"         # Dual data line SPI, READ2IO (0xBB)
      - "read4o"          # Quad data line SPI, READ4O (0x6B)
      - "read4io"         # Quad data line SPI, READ4IO (0xEB)
    description: |
      Specify the number of data lines and opcode used for reading.
      If not provided fastread will be selected.

  writeoc:
    type: string
    required: false
    enum:
      - "pp"            # Single data line SPI, PP (0x02)
      - "pp2o"          # Dual data line SPI, PP2O (0xA2)
      - "pp4o"          # Dual data line SPI, PP4O (0x32)
      - "pp4io"         # Quad data line SPI, PP4IO (0x38)
    description: |
      Specify the number of data lines and opcode used for writing.
      If not provided pp will be selected.

  address-size-32:
    type: boolean
    required: false
    description: |
      Set to indicate that 32-bit addressing is to be used.
      If not specified 24-bit addressing will be used.

  ppsize-512:
    type: boolean
    required: false
    description: |
      Set to indicate that the write opcode operates on 512-byte pages.
      If not specified the write opcode operates on 256-byte pages.

  sck-delay:
    type: int
    required: false
    default: 0
    description: |
      Number of clock cycles CSn must be asserted before it can go low
      again, specified in nanoseconds.

  cpha:
    type: boolean
    required: false
    description: |
      Set to indicate phase starts with asserted half-phase (CPHA=1).
      For this driver using this property requires also using cpol.

  cpol:
    type: boolean
    required: false
    description: |
      Set to indicate clock leading edge is falling (CPOL=1).
      For this driver using this property requires also using cpha.

  sck-frequency:
    type: int
    required: true
    description: |
      Maximum clock speed supported by the device, in Hz.
```

## dts/bindings/mtd/nordic,tz-nonsecure.yaml
```yaml
# Copyright (c) 2026 Nordic Semiconductor ASA
# SPDX-License-Identifier: Apache-2.0

description: |
  Tags non-secure flash partitions in an ARM TrustZone-M layout on
  Nordic SoCs.

compatible: "nordic,tz-nonsecure"

include: base.yaml

properties:
  code-partitions:
    type: phandles
    required: true
    description: |
      Phandles to "zephyr,mapped-partition" nodes holding non-secure
      image slots.

  data-partitions:
    type: phandles
    description: |
      Phandles to "zephyr,mapped-partition" nodes holding non-secure
      data (storage / settings / ZMS, etc.).
```

## dts/bindings/mtd/nordic,tz-secure.yaml
```yaml
# Copyright (c) 2026 Nordic Semiconductor ASA
# SPDX-License-Identifier: Apache-2.0

description: |
  Tags secure flash partitions in an ARM TrustZone-M layout on Nordic
  SoCs.

compatible: "nordic,tz-secure"

include: base.yaml

properties:
  code-partitions:
    type: phandles
    required: true
    description: |
      Phandles to "zephyr,mapped-partition" nodes holding secure image
      slots.

  data-partitions:
    type: phandles
    description: |
      Phandles to "zephyr,mapped-partition" nodes holding secure data
      (PS / ITS / OTP / NV counters, etc.).
```

## dts/bindings/mtd/nvmem-consumer.yaml
```yaml
# Copyright (c) 2024, Andriy Gelman <andriy.gelman@gmail.com>
# SPDX-License-Identifier: Apache-2.0

include: base.yaml

properties:
  nvmem-cell-names:
    type: string-array
    description:
      Names for each nvmem-cells specified.

  nvmem-cells:
    type: phandles
    description:
      List of phandle to the nvmem data cells.
```
