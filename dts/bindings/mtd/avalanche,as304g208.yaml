## dts/bindings/mtd/lattice,machxo2-ufm.yaml
```yaml
# Copyright (c) 2026 FIRST RF
# SPDX-License-Identifier: Apache-2.0

description: |
  Lattice MachXO2 user flash memory (UFM).

  The UFM is a single erase sector with 16-byte pages and is erased as a whole.
  It is accessed through the sysCONFIG transport of the parent Lattice MachXO2
  FPGA node.

  UFM size depends on the device family (TN1204, table 14-20):
    - LCMXO2-256: 0 bytes (no UFM; do not instantiate this node)
    - LCMXO2-640: 192 bytes
    - LCMXO2-640U: 512 bytes
    - LCMXO2-1200: 512 bytes
    - LCMXO2-1200U: 640 bytes
    - LCMXO2-2000: 640 bytes
    - LCMXO2-2000U: 768 bytes
    - LCMXO2-4000: 768 bytes
    - LCMXO2-7000: 2048 bytes

  The HC/HE/ZE/UHC/UHE suffixes do not change the UFM size; the U variants
  listed above do.

  If fixed-partitions are used, a partition must cover the entire UFM to be
  erasable. Smaller partitions are usable for read and write access only,
  because an erase always affects the whole UFM.

compatible: "lattice,machxo2-ufm"

include: [base.yaml]

properties:
  size:
    type: int
    required: true
    enum: [192, 512, 640, 768, 2048]
    description: |
      UFM size in bytes for the populated device, as listed above. It must be
      a multiple of the 16-byte UFM page size. The whole UFM is one erase
      sector and is erased as a whole, so a valid erase covers the full size.

  write-block-size:
    type: int
    default: 16
    enum: [16]
    description: |
      UFM page size used for writes, in bytes. This must be 16.

examples:
  - |
    &spi0 {
            machxo2: machxo2@0 {
                    compatible = "lattice,machxo2-fpga";
                    reg = <0>;
                    spi-max-frequency = <1000000>;

                    ufm: ufm {
                            compatible = "lattice,machxo2-ufm";
                            size = <512>;             /* LCMXO2-1200 */
                            write-block-size = <16>;
                    };
            };
    };
```

## dts/bindings/mtd/microchip,flash-g3.yaml
```yaml
# Copyright (c) 2026 Microchip Technology Inc.
# SPDX-License-Identifier: Apache-2.0

title: Microchip NVMCTRL G3 Flash

description: |
  Microchip NVMCTRL G3 Flash driver.

  Supports the following hardware modules:
    - FCW_03433 (PIC32CK SG/GC, PIC32CZ CA) - Quad Double Word (32 B)
    - FCW_04971 (PIC32CM SG/GC) - Quad Word (16 B)

compatible: "microchip,flash-g3"

include: soc-nv-flash.yaml

examples:
  - |
    /*
     * Multiple flash regions in g3 devices are considered as a single block
     * of memory:
     *
     *   - 0x08000000--0x08020000, boot flash area
     *   - 0x0C000000--0x0C800000, main flash area
     *
     * The region in between these flash are considered as
     * unimplemented regions and driver would avoid accessing
     * these regions
     */

    nvmctrl: flash-controller@44002000 {
      compatible = "microchip,nvmctrl-g3";
      reg = <0x44002000 0x200000>;
      /* ... */

      flash0: flash@8000000 {
        reg = <0x08000000
              (DT_SIZE_K(128) + DT_SIZE_K(65408) + DT_SIZE_M(8))>;
        compatible = "microchip,flash-g3", "soc-nv-flash";
        write-block-size = <8>;
        write-block-size-quad-dw = <32>;
        write-block-size-row = <1024>;
        erase-block-size = <4096>;
        unimplemented-region = <0x08020000 0x0bffffff>;
      };
    };

properties:
  write-block-size-quad-dw:
    type: int
    required: true
    description: |
      Size in bytes of a quad write operation.
      32 bytes (Quad Double Word) on FCW_03433 (PIC32CK SG/GC, PIC32CZ CA),
      16 bytes (Quad Word) on FCW_04971 (PIC32CM SG/GC).
  write-block-size-row:
    type: int
    description: address alignment required by row flash write operations
  unimplemented-region:
    type: array
    description: array of unimplemented regions in the given flash area
```

## dts/bindings/mtd/microchip,qspi-g1-flash.yaml
```yaml
# Copyright (c) 2026 Microchip Technology Inc.
# SPDX-License-Identifier: Apache-2.0
title: Microchip MSPI/QSPI child flash (vendor extensions)

description: |
  Microchip QSPI flash device with vendor-specific timing properties.

  Defines vendor-specific properties for flash devices attached to the
  Microchip MSPI/QSPI controller. This augments the standard MSPI device
  binding with hardware-specific timing parameters (DLYBS, DLYCS, DLYBCT)
  and operating mode selection (serial memory vs SPI mode).

compatible: "microchip,qspi-g1-flash"

include: ["mspi-device.yaml"]

properties:
  serial-memory-mode:
    type: boolean
    description: |
      When present, use serial memory mode (memory-mapped XIP-style access).
      When absent, use SPI mode (register-based byte transfers).

  dlybs:
    type: int
    description: |
      Delay Before SCK (BAUD.DLYBS): Number of peripheral clock cycles to delay
      between CS assertion and first SCK edge. Range: 0-255.
      Delay = dlybs / f_peripheral_clock

  dlycs:
    type: int
    description: |
      Minimum Inactive CS Delay (CTRLB.DLYCS): Minimum number of peripheral
      clock cycles CS must remain HIGH between transfers. Range: 0-255.
      If 0, one CLK_QSPI_AHB period is inserted by default.
      Delay = dlycs / f_peripheral_clock

  dlybct:
    type: int
    description: |
      Delay Between Consecutive Transfers (CTRLB.DLYBCT): Delay inserted after
      each transfer and before removing chip select. Range: 0-255.
      When 0, no delay is inserted and clock keeps its duty cycle.
      In Serial Memory mode (MODE=1), DLYBCT is ignored by hardware.
      Delay = (dlybct / f_peripheral_clock) / 32
```

## dts/bindings/mtd/microcrystal,rv3028-eeprom.yaml
```yaml
# Copyright (c) 2026 Janez Ugovsek <janez@ugovsek.info>
# SPDX-License-Identifier: Apache-2.0

description: Micro Crystal RV3028 RTC EEPROM driver

compatible: "microcrystal,rv3028-eeprom"

include: base.yaml

examples:
  - |
    /* Example node for RV3028 EEPROM on the i2c0 bus. */
    &i2c0 {
      status = "okay";
      clock-frequency = <I2C_BITRATE_STANDARD>;

      rv3028: rv3028@52 {
        compatible = "microcrystal,rv3028";
        reg = <0x52>;
        backup-switch-mode = "disabled";
        status = "okay";

        rv3028_eeprom: rv3028_eeprom {
          compatible = "microcrystal,rv3028-eeprom";
          status = "okay";
        };
      };
    };
```

## dts/bindings/mtd/mxicy,mx25um51345g.yaml
```yaml
# Copyright 2026 NXP
# SPDX-License-Identifier: Apache-2.0

description: Macronix MX25UM51345G Octal SPI NOR flash

compatible: "mxicy,mx25um51345g"

include: soc-nv-flash.yaml
```

## dts/bindings/mtd/nordic,mram-bank.yaml
```yaml
# Copyright (c) 2026 Nordic Semiconductor ASA
# SPDX-License-Identifier: Apache-2.0

description: |
  A single MRAM bank within a Nordic MRAM memory node. Each bank maps to one
  entry in the parent controller's "nordic,mutexes" list, at the same index.

compatible: "nordic,mram-bank"

include: base.yaml

properties:
  reg:
    required: true

  nordic,mutex-index:
    type: int
    description: |
      Index into the parent controller's "nordic,mutexes" list, selecting the
      hardware mutex that serializes access to this bank. Omit it for banks that
      do not require cross-domain hardware-mutex locking.
```

## dts/bindings/mtd/nordic,mram.yaml
```yaml
# Copyright (c) 2024 Nordic Semiconductor ASA
# SPDX-License-Identifier: Apache-2.0

description: Nordic MRAM

compatible: "nordic,mram"

include: soc-nv-flash.yaml

properties:
  reg:
    required: true

  nordic,mutexes:
    type: phandle-array
    specifier-space: mutex
    description: |
      Hardware mutexes used to serialize MRAM access across CPU domains, one
      per MRAM bank. The list index corresponds to the mram-bank child node at
      the same index within the mram-memory node, and each specifier is the
      index of the mutex within the referenced MUTEX instance. When present,
      the driver claims the bank's hardware mutex around each write and erase
      transaction.
```
