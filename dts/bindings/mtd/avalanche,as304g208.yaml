## dts/bindings/mtd/avalanche,as304g208.yaml
```yaml
# Copyright (c) 2026 Space Cubics Inc.
# SPDX-License-Identifier: Apache-2.0

description: |
  Avalanche Technology AS304G208 4 Gbit MRAM-based persistent SRAM.

  The device exposes two separately selected QSPI interfaces, each with
  2 Gbit of storage. A node describes one interface and exposes 256 MiB.
  Combining both interfaces in dual-parallel mode is not supported.

compatible: "avalanche,as304g208"

include: avalanche,serial-mram-common.yaml
```

## dts/bindings/mtd/avalanche,as3064204.yaml
```yaml
# Copyright (c) 2026 Space Cubics Inc.
# SPDX-License-Identifier: Apache-2.0

description: Avalanche Technology AS3064204 64 Mbit QSPI MRAM-based persistent SRAM

compatible: "avalanche,as3064204"

include: avalanche,serial-mram-common.yaml
```

## dts/bindings/mtd/avalanche,as308g208.yaml
```yaml
# Copyright (c) 2026 Space Cubics Inc.
# SPDX-License-Identifier: Apache-2.0

description: |
  Avalanche Technology AS308G208 8 Gbit MRAM-based persistent SRAM.

  The device exposes two separately selected QSPI interfaces, each with
  4 Gbit of storage. A node describes one interface and exposes 512 MiB.
  Combining both interfaces in dual-parallel mode is not supported.

compatible: "avalanche,as308g208"

include: avalanche,serial-mram-common.yaml
```

## dts/bindings/mtd/avalanche,as3128208.yaml
```yaml
# Copyright (c) 2026 Space Cubics Inc.
# SPDX-License-Identifier: Apache-2.0

description: |
  Avalanche Technology AS3128208 128 Mbit MRAM-based persistent SRAM.

  The device exposes two separately selected QSPI interfaces, each with
  64 Mbit of storage. A node describes one interface and exposes 8 MiB.
  Combining both interfaces in dual-parallel mode is not supported.

compatible: "avalanche,as3128208"

include: avalanche,serial-mram-common.yaml
```

## dts/bindings/mtd/avalanche,serial-mram-common.yaml
```yaml
# Copyright (c) 2026 Space Cubics Inc.
# SPDX-License-Identifier: Apache-2.0

description: Common properties for Avalanche Technology serial MRAM-based persistent SRAM

include: [spi-device.yaml]

properties:
  spi-rx-bus-width:
    type: int
    required: true
    enum: [1, 4]
    description: |
      Number of data lines used to receive data. Set both spi-rx-bus-width and
      spi-tx-bus-width to 4 to operate the device in QPI (4-4-4) mode.

  spi-tx-bus-width:
    type: int
    required: true
    enum: [1, 4]
    description: |
      Number of transmit data lines. Must match spi-rx-bus-width.
```

## dts/bindings/mtd/eeprom-base.yaml
```yaml
# Copyright (c) 2019-2026 Vestas Wind Systems A/S
# SPDX-License-Identifier: Apache-2.0

# Common fields for EEPROM devices

include: base.yaml

class: eeprom

properties:
  size:
    type: int
    description: Total EEPROM size in bytes
  read-only:
    type: boolean
    description: Disable writes to the EEPROM
```

## dts/bindings/mtd/everspin,em004lxq.yaml
```yaml
# Copyright (c) 2026 Space Cubics Inc.
# SPDX-License-Identifier: Apache-2.0

description: Everspin EM004LXQ 4-Mbit serial MRAM

compatible: "everspin,em004lxq"

include: everspin,emxxlx-common.yaml
```

## dts/bindings/mtd/everspin,em008lxq.yaml
```yaml
# Copyright (c) 2026 Space Cubics Inc.
# SPDX-License-Identifier: Apache-2.0

description: Everspin EM008LXQ 8-Mbit serial MRAM

compatible: "everspin,em008lxq"

include: everspin,emxxlx-common.yaml
```

## dts/bindings/mtd/everspin,em016lxq.yaml
```yaml
# Copyright (c) 2026 Space Cubics Inc.
# SPDX-License-Identifier: Apache-2.0

description: Everspin EM016LXQ 16-Mbit serial MRAM

compatible: "everspin,em016lxq"

include: everspin,emxxlx-common.yaml
```

## dts/bindings/mtd/everspin,em032lxq.yaml
```yaml
# Copyright (c) 2026 Space Cubics Inc.
# SPDX-License-Identifier: Apache-2.0

description: Everspin EM032LXQ 32-Mbit serial MRAM

compatible: "everspin,em032lxq"

include: everspin,emxxlx-common.yaml
```

## dts/bindings/mtd/everspin,em064lxq.yaml
```yaml
# Copyright (c) 2026 Space Cubics Inc.
# SPDX-License-Identifier: Apache-2.0

description: Everspin EM064LXQ 64-Mbit serial MRAM

compatible: "everspin,em064lxq"

include: everspin,emxxlx-common.yaml
```

## dts/bindings/mtd/everspin,emxxlx-common.yaml
```yaml
# Copyright (c) 2026 Space Cubics Inc.
# SPDX-License-Identifier: Apache-2.0

description: Common properties for Everspin EMxxLX serial MRAM

include: spi-device.yaml

properties:
  spi-rx-bus-width:
    type: int
    required: true
    enum: [1, 4]
    description: |
      Number of receive data lines. Both bus widths must match. A width of
      4 selects Quad STR (4-4-4) without a data strobe.

  spi-tx-bus-width:
    type: int
    required: true
    enum: [1, 4]
    description: |
      Number of transmit data lines. Must match spi-rx-bus-width.
```

## dts/bindings/mtd/fujitsu,mb85rsxx.yaml
```yaml
# Copyright (c) 2024 Antmicro <www.antmicro.com>
# Copyright (c) 2026 RAKwireless Technology Limited
# SPDX-License-Identifier: Apache-2.0

description: Fujitsu MB85RSxx SPI FRAM (MB85RS2MT, MB85RS2MTA, MB85RS4MT)

compatible: "fujitsu,mb85rsxx"

include: ["eeprom-base.yaml", spi-device.yaml]

properties:
  size:
    required: true
    description: Total FRAM size in bytes.
```

## dts/bindings/mtd/gd,gd32-nv-flash.yaml
```yaml
# Copyright (c) 2026 GigaDevice Semiconductor Inc.
# SPDX-License-Identifier: Apache-2.0

description: |
  GD32 flash memory.

  This binding is for the flash memory itself, not the flash controller
  peripheral. For that, see the "gd,gd32-flash-controller" binding and the
  series bindings such as "gd,gd32m53x-flash-controller" and
  "gd,gd32f527-flash-controller".

include: soc-nv-flash.yaml

compatible: "gd,gd32-nv-flash"

properties:
  max-erase-time-ms:
    type: int
    required: true
    description: Max erase time(millisecond) of a flash page or sector

  page-size:
    type: int
    required: true
    description: Flash memory page size, for a bank of equal pages
```

## dts/bindings/mtd/infineon,smif-nor.yaml
```yaml
# SPDX-FileCopyrightText: Copyright (c) 2026 Infineon Technologies AG,
# SPDX-FileCopyrightText: or an affiliate of Infineon Technologies AG. All rights reserved.
#
# SPDX-License-Identifier: Apache-2.0

description: |
  Infineon SMIF NOR flash device.

  One node per external NOR flash device attached to an infineon,smif
  controller. This node must be a child of an infineon,smif controller node
  (on the "smif" bus); it exposes the Zephyr flash API for the memory in the
  slot selected by "chip-select".

  SFDP auto-discovery is intentionally not used, as it issues command-mode
  transactions that are unsafe on a device that is executed in place from and
  already configured by the boot ROM. The device geometry advertised to the
  Zephyr flash API is taken from the properties below.

compatible: "infineon,smif-nor"

include: [flash-controller.yaml]

on-bus: smif

properties:
  reg:
    required: true
    description: |
      Base address and size of the device's memory-mapped XIP window.

  chip-select:
    type: int
    required: true
    enum: [0, 1, 2, 3]
    description: |
      SMIF chip-select / slave-select slot index (0..3) that addresses this
      memory device on the parent SMIF controller.

  data-select:
    type: int
    required: true
    enum: [0, 1, 2, 3]
    description: |
      SMIF data-line selection (CY_SMIF_DATA_SELx) routing this slot's data
      signals to a group of SMIF I/O pads.

  address-bytes:
    type: int
    required: true
    enum: [3, 4]
    description: Number of address bytes used by the memory device.

  protocol:
    type: string
    required: true
    enum:
      - "single-spi"
      - "quad-spi"
    description: |
      Bus protocol used for the read command. "quad-spi" issues a
      1-4-4 quad read with a mode byte, "single-spi" issues a plain
      single-line (1-1-1) read, for a device driven in legacy SPI mode.
      Program, erase and status commands are single-line for both protocols,
      so devices with different protocols can share one SMIF instance without
      changing controller-wide settings.

  read-command:
    type: int
    required: true
    description: |
      Read opcode used in command mode (0xEB 1-4-4 quad read with mode byte
      0x01 for "quad-spi", 0x0C single-line fast read for "single-spi"), with
      dummy cycles given by "read-dummy-cycles".

  read-dummy-cycles:
    type: int
    required: true
    description: Number of dummy cycles for the read command.

  program-command:
    type: int
    required: true
    description: |
      Single-line page-program opcode.

  erase-command:
    type: int
    required: true
    description: |
      Block-erase opcode used for a sector erase of "erase-block-size" bytes.

  page-size:
    type: int
    required: true
    description: Program page size in bytes used by the page-program command.

  erase-time-ms:
    type: int
    required: true
    description: |
      Maximum sector-erase time in milliseconds, used as the busy-wait timeout
      after a sector erase. Increase for large sectors / high-density parts.

  chip-erase-time-ms:
    type: int
    required: true
    description: Maximum chip-erase time in milliseconds (busy-wait timeout).

  program-time-us:
    type: int
    required: true
    description: Maximum page-program time in microseconds (busy-wait timeout).

  hybrid-region-address:
    type: array
    description: |
      Start address of each hybrid (mixed-size) erase region, one entry per
      region. When present, the five "hybrid-region-*" arrays
      describe a device whose sectors are not uniform. Each region is erased
      with its own opcode and sector size, overriding the uniform
      "erase-command" / "erase-block-size" for addresses it covers.
      All five arrays must have the same number of entries.

  hybrid-region-sectors:
    type: array
    description: Number of sectors in each hybrid erase region.

  hybrid-region-erase-command:
    type: array
    description: Sector-erase opcode used within each hybrid erase region.

  hybrid-region-erase-size:
    type: array
    description: Sector size in bytes within each hybrid erase region.

  hybrid-region-erase-time-ms:
    type: array
    description: Per-sector erase time in milliseconds for each hybrid region.

  write-block-size:
    type: int
    required: true
    description: |
      Minimum write alignment exposed to the Zephyr flash API.

  erase-block-size:
    type: int
    required: true
    description: Smallest erasable sector size in bytes. For hybrid devices,
      this is the most prevalent sector size of all hybrid regions.
```

## dts/bindings/mtd/jedec,mspi-nand.yaml
```yaml
# SPDX-FileCopyrightText: Copyright The Zephyr Project Contributors
# SPDX-License-Identifier: Apache-2.0

title: Generic NAND flash on the MSPI bus

description: |
  Serial NAND flash memory on an MSPI bus that uses the command set common
  to SPI NAND devices.

  The command, address and dummy lengths follow from the command set, so
  rx-dummy, tx-dummy, read-command, write-command, command-length and
  address-length are not used. A page is transferred in one packet: if the
  controller has a packet-data-limit, write-block-size must not exceed it.

  The geometry and the maximum operation durations are not discovered at
  run time and are taken from the device datasheet. During initialization
  the device is reset, its ID is compared with jedec-id, the ONFI parameter
  page is read and all blocks are unlocked. Initialization fails if the ID
  differs or no valid parameter page is found. A geometry that differs from
  the parameter page is reported as a warning.

compatible: "jedec,mspi-nand"

include: [mspi-device.yaml, "jedec,spi-nand-common.yaml"]

properties:
  mspi-endian:
    default: "MSPI_BIG_ENDIAN"

  transfer-timeout:
    type: int
    default: 10
    description: |
      Maximum time, in milliseconds, allowed for a single transfer on the MSPI
      bus in communication with the flash chip. The longest transfer is a
      page of write-block-size bytes, which is not split into smaller
      packets, so the value has to exceed the duration of a page transfer at
      the clock frequency in use. The default covers a 2048-byte page at 2 MHz
      and a 4096-byte page at 4 MHz.
```

## dts/bindings/mtd/jedec,spi-nand.yaml
```yaml
# Copyright (c) 2025 Embeint Pty Ltd
# SPDX-License-Identifier: Apache-2.0

title: Generic NAND flash on the SPI bus

description: |
  Serial NAND flash memory on a SPI bus that uses the command set common to
  SPI NAND devices.

  The geometry and the maximum operation durations are not discovered at
  run time and are taken from the device datasheet. During initialization
  the device is reset, its ID is compared with jedec-id, the ONFI parameter
  page is read and all blocks are unlocked. Initialization fails if the ID
  differs or no valid parameter page is found. A geometry that differs from
  the parameter page is reported as a warning.

compatible: "jedec,spi-nand"

include: [spi-device.yaml, "jedec,spi-nand-common.yaml"]
```

## dts/bindings/mtd/jedec,spi-nor.yaml
```yaml
# Copyright (c) 2018 Peter Bigot Consulting, LLC
# Copyright (c) 2019 Nordic Semiconductor ASA
# SPDX-License-Identifier: Apache-2.0

description: |
  Properties supporting Zephyr spi-nor flash driver (over the Zephyr SPI
  API) control of serial flash memories using the standard M25P80-based
  command set.

compatible: "jedec,spi-nor"

include: [spi-device.yaml, "jedec,spi-nor-common.yaml"]

properties:
  wp-gpios:
    type: phandle-array
    description: WPn pin
  hold-gpios:
    type: phandle-array
    description: HOLDn pin
  reset-gpios:
    type: phandle-array
    description: RESETn pin
  wait-ready-timeout-ms:
    type: int
    default: 1500000
    description: |
      Time in milliseconds after which waiting for a program, erase or status
      register write to complete fails with -ETIMEDOUT, so a device that never
      clears its Write-In-Progress bit cannot hang the caller.
      It must exceed the longest chip erase time of the device; refer to your
      device's datasheet and correct accordingly.
      The default exceeds the 1381 s maximum of the 1 Gb Infineon SEMPER
      S25HL01GT/S25HS01GT. Set a lower value for smaller devices to fail faster.
```
