## dts/bindings/mtd/nxp,xspi-device.yaml
```yaml
# Copyright 2024-2025 NXP
# SPDX-License-Identifier: Apache-2.0

description: NXP XSPI device

include: [base.yaml]

properties:
  device-name:
    type: string
    description: Memory device name.

  size:
    type: int
    required: true
    description: Total memory size in bytes.

  enable-differential-clk:
    type: boolean
    description: Enable differential clock pad.

  sample-clk-source:
    type: int
    default: 3
    enum: [1, 2, 3, 5, 9]
    description: Sample clock source.

  enable-dqs-latency:
    type: boolean
    description: Enable DQS latency.
```

## dts/bindings/mtd/nxp,xspi-flash.yaml
```yaml
# Copyright 2024-2025 NXP
# SPDX-License-Identifier: Apache-2.0

description: NXP XSPI Flash

compatible: "nxp,xspi-flash"

include: ["nxp,xspi-device.yaml", soc-nv-flash.yaml, "jedec,jesd216.yaml"]
```

## dts/bindings/mtd/nxp,xspi-mx25um51345g.yaml
```yaml
# Copyright 2024 NXP
# SPDX-License-Identifier: Apache-2.0

description: NXP XSPI MX25UM51345G

compatible: "nxp,xspi-mx25um51345g"

include: ["nxp,xspi-device.yaml", soc-nv-flash.yaml]
```
