## dts/bindings/mtd/nxp,c40-flash.yaml
```yaml
# Copyright 2025 NXP
# SPDX-License-Identifier: Apache-2.0
title: NXP C40 Internal Flash

description: |
  On-chip C40 flash array used with NXP C40 flash controller.

compatible: "nxp,c40-flash"

include: soc-nv-flash.yaml

properties:
  erase-block-size:
    const: 8192
    description: Minimum erase size for C40 is 8 KiB.

  write-block-size:
    const: 8
    description: Smallest programmable unit is 8 bytes.
```

## dts/bindings/mtd/nxp,imx-flexspi-aps6404l.yaml
```yaml
# Copyright 2022 NXP
# SPDX-License-Identifier: Apache-2.0

description: AP Memory APS6404L pSRAM on NXP FlexSPI bus

compatible: "nxp,imx-flexspi-aps6404l"

include: nxp,imx-flexspi-device.yaml
```

## dts/bindings/mtd/nxp,imx-flexspi-aps6408l.yaml
```yaml
# Copyright 2022 NXP
# SPDX-License-Identifier: Apache-2.0

description: AP Memory APS6408L pSRAM on NXP FlexSPI bus

compatible: "nxp,imx-flexspi-aps6408l"

include: nxp,imx-flexspi-device.yaml
```

## dts/bindings/mtd/nxp,imx-flexspi-device.yaml
```yaml
# Copyright 2020 NXP
# SPDX-License-Identifier: Apache-2.0

description: NXP FlexSPI device

compatible: "nxp,imx-flexspi-device"

include: [spi-device.yaml, "jedec,jesd216.yaml"]

properties:
    cs-interval-unit:
      type: int
      required: false
      default: 1
      enum:
        - 1
        - 256
      description: |
        Chip select interval units, in serial clock cycles. See the
        CSINTERVALUNIT field in registers FLASHA1CR0 through FLASHB2CR0. The
        default corresponds to the reset value of the register field.

    cs-interval:
      type: int
      required: false
      default: 0
      description: |
        Minimum interval between chip select deassertion and assertion. See the
        CSINTERVAL field in registers FLASHA1CR0 through FLASHB2CR0. The
        default corresponds to the reset value of the register field.

    cs-setup-time:
      type: int
      required: false
      default: 3
      description: |
        Chip select setup time, in serial clock cycles. See the TCSS field in
        registers FLASHA1CR0 through FLASHB2CR0. The default corresponds to the
        reset value of the register field.

    cs-hold-time:
      type: int
      required: false
      default: 3
      description: |
        Chip select hold time, in serial clock cycles. See the TCSH field in
        registers FLASHA1CR0 through FLASHB2CR0. The default corresponds to the
        reset value of the register field.

    data-valid-time:
      type: int
      required: false
      default: 0
      description: |
        Data valid time, in nanoseconds. See the registers DLLACR through
        DLLBCR.

    column-space:
      type: int
      required: false
      default: 0
      description: |
        Column address bit width. Set to zero if the flash does not support
        column address. See the CAS field in registers FLASHA1CR0 through
        FLASHB2CR0. The default corresponds to the reset value of the register
        field.

    word-addressable:
      type: boolean
      required: false
      description: |
        Don't transmit the least significant address bit when the flash is word
        addressable. See the WA field in registers FLASHA1CR0 through
        FLASHB2CR0.

    ahb-write-wait-unit:
      type: int
      required: false
      default: 2
      enum:
        - 2
        - 8
        - 32
        - 128
        - 512
        - 2048
        - 8192
        - 32768
      description: |
        AHB write wait interval units, in AHB clock cycles. See the AWRWAITUNIT
        field in registers FLASHA1CR2 through FLASHB2CR2. The default
        corresponds to the reset value of the register field.

    ahb-write-wait-interval:
      type: int
      required: false
      default: 0
      description: |
        Time to wait between AHB triggered command sequences. See the AWRWAIT
        field in registers FLASHA1CR2 through FLASHB2CR2. The default
        corresponds to the reset value of the register field.
```

## dts/bindings/mtd/nxp,imx-flexspi-hyperflash.yaml
```yaml
# Copyright 2020-22 NXP
# SPDX-License-Identifier: Apache-2.0

description: NXP FlexSPI HyperFlash

compatible: "nxp,imx-flexspi-hyperflash"

include: ["nxp,imx-flexspi-device.yaml", soc-nv-flash.yaml]
```

## dts/bindings/mtd/nxp,imx-flexspi-hyperram.yaml
```yaml
# Copyright 2021 Basalte bv
# SPDX-License-Identifier: Apache-2.0

description: NXP FlexSPI HyperRAM

compatible: "nxp,imx-flexspi-hyperram"

include: nxp,imx-flexspi-device.yaml
```

## dts/bindings/mtd/nxp,imx-flexspi-is66wvq8m4.yaml
```yaml
# Copyright 2023 NXP
# SPDX-License-Identifier: Apache-2.0

description: ISSI IS66WVQ8M4 pSRAM on NXP FlexSPI bus

compatible: "nxp,imx-flexspi-is66wvq8m4"

include: nxp,imx-flexspi-device.yaml
```

## dts/bindings/mtd/nxp,imx-flexspi-is66wvs8m8.yaml
```yaml
# Copyright 2023 NXP
# SPDX-License-Identifier: Apache-2.0

description: ISSI IS66WVS8M8 pSRAM on NXP FlexSPI bus

compatible: "nxp,imx-flexspi-is66wvs8m8"

include: nxp,imx-flexspi-device.yaml
```

## dts/bindings/mtd/nxp,imx-flexspi-mx25um51345g.yaml
```yaml
# Copyright 2021 NXP
# SPDX-License-Identifier: Apache-2.0

description: NXP FlexSPI MX25UM51345G

compatible: "nxp,imx-flexspi-mx25um51345g"

include: ["nxp,imx-flexspi-device.yaml", soc-nv-flash.yaml]
```

## dts/bindings/mtd/nxp,imx-flexspi-nand.yaml
```yaml
# Copyright 2026 NXP
# SPDX-License-Identifier: Apache-2.0

description: |
  ONFI-compatible NAND device connected to an NXP FlexSPI controller.

compatible: "nxp,imx-flexspi-nand"

include: ["nxp,imx-flexspi-device.yaml", soc-nv-flash.yaml]
```

## dts/bindings/mtd/nxp,imx-flexspi-nor.yaml
```yaml
# Copyright 2020 NXP
# SPDX-License-Identifier: Apache-2.0

description: NXP FlexSPI NOR

compatible: "nxp,imx-flexspi-nor"

include: ["nxp,imx-flexspi-device.yaml"]

properties:
  reset-gpios:
    type: phandle-array
    description: Reset GPIO pin.

  reset-assert-duration-ms:
    type: int
    description: |
      Minimum duration to activate a hardware reset.
      Ignored if no reset GPIO pin specified.

  boot-duration-ms:
    type: int
    description: |
      Minimum time to wait following a hardware reset.
      Ignored if no reset GPIO pin specified.

  initial-soft-reset:
    type: boolean
    description: |
      When set, the driver issues a software reset sequence (RSTEN 0x66
      followed by RST 0x99) to the flash at initialization, before reading
      SFDP. This ensures the flash is in a known 3-byte address mode
      regardless of state left by a previous boot, for example after a
      warm reset that did not power-cycle the flash device.

  t-reset-recovery:
    type: int
    description: |
      Minimum time in nanoseconds the flash chip needs after a software
      reset before it is ready to accept new commands. Used when
      initial-soft-reset is set. If not provided no delay is applied.
```

## dts/bindings/mtd/nxp,imx-flexspi-s27ks0641.yaml
```yaml
# Copyright 2021 Basalte bv
# Copyright 2022 NXP
# SPDX-License-Identifier: Apache-2.0

description: Cypress S27KS0641 HyperRAM on NXP FlexSPI bus

compatible: "nxp,imx-flexspi-s27ks0641"

include: nxp,imx-flexspi-device.yaml
```

## dts/bindings/mtd/nxp,imx-flexspi-w956a8mbya.yaml
```yaml
# Copyright (c) 2023, ithinx GmbH
# Copyright (c) 2023, Tonies GmbH
# SPDX-License-Identifier: Apache-2.0

description: Winbond W956A8MBYA HyperRAM on NXP FlexSPI bus

compatible: "nxp,imx-flexspi-w956a8mbya"

include: nxp,imx-flexspi-device.yaml
```

## dts/bindings/mtd/nxp,imx-xspi-mx25um51345g.yaml
```yaml
# Copyright 2024 NXP
# SPDX-License-Identifier: Apache-2.0

description: NXP XSPI MX25UM51345G

compatible: "nxp,imx-xspi-mx25um51345g"

include: ["nxp,imx-xspi-device.yaml", soc-nv-flash.yaml]
```

## dts/bindings/mtd/nxp,lpc11u6x-eeprom.yaml
```yaml
# Copyright (c) 2020 Seagate Technology LLC
# SPDX-License-Identifier: Apache-2.0

description: NXP LPC11U6X on-chip EEPROM node

compatible: "nxp,lpc11u6x-eeprom"

include: eeprom-base.yaml
```

## dts/bindings/mtd/nxp,mcxw-ifr.yaml
```yaml
description: NXP MCXW Flash IFR Node

compatible: "nxp,mcxw-ifr"

include: [base.yaml, soc-nv-flash.yaml, fixed-layout.yaml]
```

## dts/bindings/mtd/nxp,s32-qspi-device.yaml
```yaml
# Copyright 2023-2024 NXP
# SPDX-License-Identifier: Apache-2.0

description: |
  QSPI memory device supporting xSPI or Hyperbus.

compatible: "nxp,s32-qspi-device"

include: [base.yaml, "jedec,jesd216.yaml"]

on-bus: qspi

properties:
  reg:
    required: true

  max-program-buffer-size:
    type: int
    required: true
    description: |
      The maximum of programming page buffer size of the flash memory device,
      as specified in the flash memory device datasheet.

  write-block-size:
    type: int
    required: true
    description: |
      The number of bytes used in write operations.
```

## dts/bindings/mtd/nxp,s32-qspi-hyperflash.yaml
```yaml
# Copyright 2024 NXP
# SPDX-License-Identifier: Apache-2.0

description: |
  QSPI hyperflash connected to the NXP S32 QSPI bus.

compatible: "nxp,s32-qspi-hyperflash"

include: "nxp,s32-qspi-device.yaml"

properties:
  device-id-word-addr:
    required: true
    type: int
    description: |
      The word address of the device ID in ASO (Application-Specific Object).
      This address specifies the exact location within the memory where the device ID is stored.

  rwds-low-dual-error:
    type: boolean
    description: |
      Enable Read-Write Data Strobe (RWDS) dual error detect.

  secure-region-locked:
    type: boolean
    description: |
      The secure region is locked and cannot be accessed or modified.
      This is particularly useful in scenarios where sensitive data needs protection from
      unauthorized access, such as in financial applications or secure communication systems.
      If it is disable, having access to all memory regions is beneficial during development
      or debugging phases.

  vcc-mv:
    type: int
    required: true
    enum:
      - 1800
      - 3000
    description: |
      The memory operating voltage supply in mV.

  drive-strength-ohm:
    type: int
    required: true
    enum:
      - 12
      - 14
      - 16
      - 20
      - 24
      - 27
      - 34
      - 40
      - 45
      - 68
      - 71
      - 117
    description: |
      Specifies the output drive strength in ohm, which based on the operating device VCC.
      The supported typical impedance settings:
        For 1.8V: 117 Ohm, 68 Ohm, 45 Ohm, 34 Ohm, 27 Ohm, 24 Ohm, 20 Ohm
        For 3V: 71 Ohm, 40 Ohm, 27 Ohm, 20 Ohm, 16 Ohm, 14 Ohm, 12 Ohm
      See the xVCR[14:12] field in VCR configuration register in the memory device datasheet.

  read-latency-cycles:
    type: int
    required: true
    enum:
      - 5
      - 6
      - 7
      - 8
      - 9
      - 10
      - 11
      - 12
      - 13
      - 14
      - 15
      - 16
    description: |
      Specifies the read latency in cycles, which is determined based on the operating frequency
      as specified in the memory device datasheet.

  support-only-uniform-sectors:
    type: boolean
    description: |
      The memory device supports only uniform (256KB) sectors.

  ppw-sectors-addr-mapping:
    type: string
    required: true
    enum:
      - LOW
      - HIGH
    description: |
      The mapping of the parameter and read password sectors:
        - LOW: Parameter and read password sectors mapped into lowest addresses
        - HIGH: Parameter and read password sectors mapped into highest addresses
```

## dts/bindings/mtd/nxp,s32-qspi-nor.yaml
```yaml
# Copyright 2023 NXP
# SPDX-License-Identifier: Apache-2.0

description: |
  QSPI NOR flash connected to the NXP S32 QSPI bus.

compatible: "nxp,s32-qspi-nor"

include: "nxp,s32-qspi-device.yaml"

properties:
  has-32k-erase:
    type: boolean
    description: |
      Set if the memory device supports 32 KiBy block erase operation.

  readoc:
    type: string
    enum:
      - "1-1-1"   # 0x0B
      - "1-1-2"   # 0x3B
      - "1-2-2"   # 0xBB
      - "1-1-4"   # 0x6B
      - "1-4-4"   # 0xEB
    description: |
      Specify the number of data lines and opcode used for reading.
      If not provided, 1-1-1 will be selected.

  writeoc:
    type: string
    enum:
      - "1-1-1"   # 0x02
      - "1-1-2"   # 0xA2
      - "1-1-4"   # 0x32
      - "1-4-4"   # 0x38
    description: |
      Specify the number of data lines and opcode used for writing.
      If not provided, 1-1-1 will be selected.
```

## dts/bindings/mtd/nxp,s32-xspi-device.yaml
```yaml
# Copyright 2025 NXP
# SPDX-License-Identifier: Apache-2.0

description: |
  XSPI memory device supporting XSPI or Hyperbus.

compatible: "nxp,s32-xspi-device"

include: [base.yaml, "jedec,jesd216.yaml"]

on-bus: xspi

properties:
  reg:
    required: true

  max-program-buffer-size:
    type: int
    required: true
    description: |
      The maximum of programming page buffer size of the flash memory device,
      as specified in the flash memory device datasheet.

  write-block-size:
    type: int
    required: true
    description: |
      The number of bytes used in write operations.
```

## dts/bindings/mtd/nxp,s32-xspi-hyperram.yaml
```yaml
# Copyright 2025 NXP
# SPDX-License-Identifier: Apache-2.0

description: |
  XSPI hyperram connected to the NXP S32 XSPI bus.

compatible: "nxp,s32-xspi-hyperram"

include: "nxp,s32-xspi-device.yaml"

properties:
  device-id-word-addr:
    required: true
    type: int
    description: |
      The word address of the device ID in ASO (Application-Specific Object).
      This address specifies the exact location within the memory where the device ID is stored.

  master-clock-type:
    type: string
    enum:
      - "SINGLE_ENDED"
      - "DIFFERENTIAL"
    description: |
      Selects the clock types:
        - Differential Clock: Command, address, and data information is output with respect
          to the crossing of the CK and CK# signals. Differential clock is used on 1.8V I/O devices.
        - Single Ended Clock: CK# is not used on 3.0V devices, only a single ended CK is used.
          The clock is not required to be free-running.

  drive-strength-ohm:
    type: int
    required: true
    enum: [19, 22, 27, 34, 46, 67, 115]
    default: 34
    description: |
      Specifies the output drive strength in ohm, which based on the operating device VCC.
      The supported typical impedance settings:
        19 ohm, 22 ohm, 27 ohm, 34 ohm, 46 ohm, 67 ohm, 115 ohm
      See the CR0[14:12] field in CR0 configuration register in the memory device datasheet.
      Defaults to reset value.

  refresh-interval-multiplier:
    type: string
    enum:
      - "1"
      - "1.5"
      - "2"
      - "4"
    default: "1"
    description: |
      Automatic memory refresh interval multiplier. Controls how frequently memory is refreshed.
      Defaults to reset value.

  initial-latency-cycles:
    type: int
    required: true
    enum: [3, 4, 5, 6, 7]
    description: |
      Specifies the read latency in cycles, which is determined based on the operating frequency
      as specified in the memory device datasheet.
```

## dts/bindings/mtd/nxp,s32k3x-c40.yaml
```yaml
# SPDX-License-Identifier: Apache-2.0
title: NXP S32K3x C40 Internal Flash Controller

description: |
  On-chip C40 flash used in NXP S32K3x MCUs (e.g. S32K344).

compatible: "nxp,s32k3x-c40"

# Inherit common SoC flash schema (reg/status, partitions, etc.)
include: soc-nv-flash.yaml

properties:
  erase-block-size:
    const: 8192
    description: Minimum erase size for C40 is 8 KiB.

  write-block-size:
    const: 8
    description: Smallest programmable unit is 8 bytes.
```
