## dts/bindings/mux/ti,am13e2-xbar-in.yaml
```yaml
# SPDX-FileCopyrightText: 2026 Texas Instruments Incorporated
# SPDX-License-Identifier: Apache-2.0

description: |
  TI AM13E2 Input XBAR peripheral binding.

  Routes a GPIO pin (raw GPIO number, TRM Table 20-9) into one of the 28
  INPUTXBAR channels. A consumer selects the channel via the control cell.

  The trailing mux-states cell is packed with
  AM13E2_XBAR_IN_STATE(pin, raw) from
  <zephyr/dt-bindings/mux/ti_am13e2_xbar_in.h> - each GPIO's signal
  reaches the Input X-BAR through a RAW_INPUTSELECT_Pn mux. 
  raw=1 selects the raw pad signal, raw=0 (reset default) selects
  the signal after the GPIO peripheral module processes it.

  Consumers may also drive the channel at runtime with mux-controls and
  mux_control_set(dev, AM13E2_XBAR_IN_STATE(gpio_number, 1)).

compatible: "ti,am13e2-xbar-in"

include: [base.yaml, mux-controller.yaml]

properties:
  reg:
    required: true

  "#mux-control-cells":
    const: 1

  "#mux-state-cells":
    const: 2


mux-control-cells:
  - channel

mux-state-cells:
  - channel
  - pin

examples:
  - |
    #include <zephyr/dt-bindings/mux/ti_am13e2_xbar_in.h>

    &xbar1 {
            status = "okay";
    };

    my_consumer {
            mux-states = <&xbar1 CHANNEL AM13E2_XBAR_IN_STATE(GPIO_NUMBER, 1)>;
    };
  - |
    &xbar1 {
            status = "okay";
    };

    my_consumer {
            mux-controls = <&xbar1 CHANNEL>;
    };
```

## dts/bindings/mux/ti,am13e230-xbar-in.yaml
```yaml
# SPDX-FileCopyrightText: 2026 Texas Instruments Incorporated
# SPDX-License-Identifier: Apache-2.0

description: |
  TI AM13E230 Input XBAR peripheral binding.

  Routes a GPIO pin (raw GPIO number, TRM Table 20-9) into one of the 28
  INPUTXBAR channels. A consumer selects the channel via the control cell.

  The trailing mux-states cell is packed with
  AM13E230_XBAR_IN_STATE(pin, raw) from
  <zephyr/dt-bindings/mux/ti_am13e230_xbar_in.h> - each GPIO's signal
  reaches the Input X-BAR through a RAW_INPUTSELECT_Pn mux (TRM Figure
  20-1): raw=1 selects the raw pad signal, raw=0 (reset default) selects
  the signal after the GPIO peripheral module processes it. This SoC has
  no GPIO driver yet, so raw=1 is the only usable value today; raw=0
  becomes meaningful once an AM13E GPIO driver exists.

    &xbar1 {
            status = "okay";
    };

    my_consumer {
            mux-states = <&xbar1 CHANNEL AM13E230_XBAR_IN_STATE(GPIO_NUMBER, 1)>;
    };

  Or drive it at runtime instead of fixing it in devicetree:

    my_consumer {
            mux-controls = <&xbar1 CHANNEL>;
    };

    mux_control_set(dev, AM13E230_XBAR_IN_STATE(gpio_number, 1));

compatible: "ti,am13e230-xbar-in"

include: [base.yaml, mux-controller.yaml]

properties:
  reg:
    required: true

  "#mux-control-cells":
    const: 1

  "#mux-state-cells":
    const: 2

mux-control-cells:
  - channel

mux-state-cells:
  - channel
  - pin
```

## dts/bindings/mux/ti,am13e230-xbar-out.yaml
```yaml
# SPDX-FileCopyrightText: 2026 Texas Instruments Incorporated
# SPDX-License-Identifier: Apache-2.0

description: |
  TI AM13E230 Output XBAR peripheral binding.

  mux-control-cells is a single packed cell built with the
  AM13E230_XBAR_OUT_CTRL(idx, group, bit) macro from
  <zephyr/dt-bindings/mux/ti_am13e230_xbar_out.h> — idx selects which of
  the 8 physical OUTPUTXBARx outputs, group/bit select one of the 64
  one-hot source-select bits (G0SEL/G1SEL) for that output.

  state=1 ORs the bit in (select the source), state=0 clears it
  (deselect); mux_control_set() always addresses exactly one bit:

    #include <zephyr/dt-bindings/mux/ti_am13e230_xbar_out.h>

    &xbar2 {
            status = "okay";
    };

    my_consumer {
            mux-controls = <&xbar2 AM13E230_XBAR_OUT_CTRL(idx, group, bit)>;
    };

    mux_control_set(dev, 1);   /* select this source   */
    mux_control_set(dev, 0);   /* deselect this source */

  Or fix the source statically in devicetree:

    my_consumer {
            mux-states = <&xbar2 AM13E230_XBAR_OUT_CTRL(idx, group, bit) 1>;
    };

  mux_control_disconnect() clears BOTH G0SEL and G1SEL for the output
  named by idx (the group/bit portion of the control cell is ignored).

compatible: "ti,am13e230-xbar-out"

include: [base.yaml, mux-controller.yaml]

properties:
  reg:
    required: true

  "#mux-control-cells":
    const: 1

  "#mux-state-cells":
    const: 2

mux-control-cells:
  - select

mux-state-cells:
  - select
  - enable
```

## dts/bindings/mux/wch,ch446q.yaml
```yaml
# SPDX-FileCopyrightText: Copyright The Zephyr Project Contributors
# SPDX-License-Identifier: Apache-2.0

description: |
  WCH CH446Q 8 x 16 analog crosspoint switch, in serial address mode, as a
  MUX controller.

  The chip connects any of its X lines (X0-X15) to any of its Y lines
  (Y0-Y7) through 128 analog switches.  Each X line is a control line, with
  one addressing cell: the X line number.  Its state is a bitmask of the Y
  lines it connects to: bit y closes the Xx-Yy switch.
  mux_control_set() writes only the switches whose state changes,
  mux_state_get() returns the mask last written (the chip has no readback)
  and mux_control_disconnect() opens every switch of the X line.

  In serial address mode (P/S tied low, AX0-AX3 and AY0-AY2 tied to GND), a
  switch is set by shifting its 7-bit address, y * 16 + x, into DAT on the
  rising edges of CK, AY2 first, then presenting its state on DAT (high
  closes it) and pulsing STB high.  When the data, clock and strobe lines
  are on one GPIO port, each step is a single port write.

  Several chips may share the data, clock and reset lines, each with its
  own strobe line.  RST opens every switch of every chip on it, so the
  driver pulses reset-gpios only at initialization.  Without reset-gpios,
  the driver opens the 128 switches one by one at initialization.

compatible: "wch,ch446q"

include: [base.yaml, mux-controller.yaml]

properties:
  data-gpios:
    type: phandle-array
    required: true
    description: DAT, the serial address and the switch data.

  clock-gpios:
    type: phandle-array
    required: true
    description: CS/CK, the serial clock, active on its rising edge.

  strobe-gpios:
    type: phandle-array
    required: true
    description: STB, the strobe that latches DAT into the addressed switch.

  reset-gpios:
    type: phandle-array
    description: |
      RST, active high: opens every switch.  It may be shared with other
      chips, so it is pulsed at initialization only.

  "#mux-control-cells":
    const: 1

  "#mux-state-cells":
    const: 2

mux-control-cells:
  # The X line, 0-15
  - x

mux-state-cells:
  - x
  # The Y lines X connects to: bit y closes the Xx-Yy switch
  - mask

examples:
  - |
    #include <zephyr/dt-bindings/gpio/gpio.h>

    /* Two chips sharing data, clock and reset, on an I2C GPIO expander */
    crosspoint0: crosspoint-0 {
            compatible = "wch,ch446q";
            data-gpios = <&expander 0 GPIO_ACTIVE_HIGH>;
            clock-gpios = <&expander 1 GPIO_ACTIVE_HIGH>;
            strobe-gpios = <&expander 2 GPIO_ACTIVE_HIGH>;
            reset-gpios = <&expander 4 GPIO_ACTIVE_HIGH>;
            #mux-control-cells = <1>;
            #mux-state-cells = <2>;
    };

    crosspoint1: crosspoint-1 {
            compatible = "wch,ch446q";
            data-gpios = <&expander 0 GPIO_ACTIVE_HIGH>;
            clock-gpios = <&expander 1 GPIO_ACTIVE_HIGH>;
            strobe-gpios = <&expander 3 GPIO_ACTIVE_HIGH>;
            reset-gpios = <&expander 4 GPIO_ACTIVE_HIGH>;
            #mux-control-cells = <1>;
            #mux-state-cells = <2>;
    };
```

## dts/bindings/net/wireless/ti,rcl-coex-one-wire-grant.yaml
```yaml
# Copyright (c) 2026 Texas Instruments Incorporated
# SPDX-License-Identifier: Apache-2.0

description: |
  TI RCL RF Coexistence - One-Wire Mode (GRANT only)

  Uses single input signal for passive coexistence control:
    - GRANT (input): Monitored by hardware

  GPIO Pin Constraints:

    Only DIOs with LRFD peripheral functions can be used.
    --------+----------------------------------------------------------------
    Device  | Valid DIO Choices
    --------+----------------------------------------------------------------
    CC23X0  | DIO1, DIO3, DIO4, DIO5, DIO6, DIO7, DIO9, DIO11, DIO14, DIO21
    CC27XX  | DIO17, DIO18, DIO19, DIO20, DIO21, DIO22, DIO27, DIO28
    --------+----------------------------------------------------------------

  Example on CC27XX devices:

  &pinctrl {
      coex_grant_default: coex_grant_default {
          pinmux = <17 DIO17_LRFD0>; /* GRANT - input */
          input-enable;
          bias-pull-up;
      };

      coex_grant_sleep: coex_grant_sleep {
          pinmux = <17 DIO17_GPIO17>;
          input-enable;
          bias-pull-up;
      };
  };

  / {
      ti_rcl_coex: rcl_coex {
          compatible = "ti,rcl-coex-one-wire-grant";
          status = "okay";

          pinctrl-0 = <&coex_grant_default>;
          pinctrl-1 = <&coex_grant_sleep>;
          pinctrl-names = "default", "sleep";

          grant-gpios = <&gpio0 17 GPIO_ACTIVE_LOW>;
      };
  };

compatible: "ti,rcl-coex-one-wire-grant"

include: [base.yaml, pinctrl-device.yaml]

properties:
  grant-gpios:
    type: phandle-array
    required: true
    description: |
      GPIO for GRANT signal. Must be a DIO that supports LRFD peripheral
      function. Use GPIO_ACTIVE_HIGH/LOW flag for polarity.
```

## dts/bindings/net/wireless/ti,rcl-coex-one-wire-request.yaml
```yaml
# Copyright (c) 2026 Texas Instruments Incorporated
# SPDX-License-Identifier: Apache-2.0

description: |
  TI RCL RF Coexistence - One-Wire Mode (REQUEST only)

  Uses single output signal for informational coexistence:
    - REQUEST (output): Indicates upcoming RF activity, asserted T1 µs before transmission

  GPIO Pin Constraints:

    Only DIOs with LRFD peripheral functions can be used.
    --------+----------------------------------------------------------------
    Device  | Valid DIO Choices
    --------+----------------------------------------------------------------
    CC23X0  | DIO1, DIO3, DIO4, DIO5, DIO6, DIO7, DIO9, DIO11, DIO14, DIO21
    CC27XX  | DIO17, DIO18, DIO19, DIO20, DIO21, DIO22, DIO27, DIO28
    --------+----------------------------------------------------------------

  Example on CC27XX devices:

  &pinctrl {
      coex_request_default: coex_request_default {
          pinmux = <17 DIO17_LRFD0>; /* REQUEST - output */
      };

      coex_request_sleep: coex_request_sleep {
          pinmux = <17 DIO17_GPIO17>;
      };
  };

  / {
      ti_rcl_coex: rcl_coex {
          compatible = "ti,rcl-coex-one-wire-request";
          status = "okay";

          pinctrl-0 = <&coex_request_default>;
          pinctrl-1 = <&coex_request_sleep>;
          pinctrl-names = "default", "sleep";

          request-gpios = <&gpio0 17 GPIO_ACTIVE_HIGH>;

          t1-us = <130>;
      };
  };


compatible: "ti,rcl-coex-one-wire-request"

include: [base.yaml, pinctrl-device.yaml]

properties:
  request-gpios:
    type: phandle-array
    required: true
    description: |
      GPIO for REQUEST signal. Must be a DIO that supports LRFD peripheral
      function. Use GPIO_ACTIVE_HIGH/LOW flag for polarity.

  t1-us:
    type: int
    default: 120
    description: |
      RF Activity Latency Time in microseconds [90, 150]. Time from REQUEST
      assertion to actual RF activity start. Default 120 µs matches SimpleLink.
```

## dts/bindings/net/wireless/ti,rcl-coex-two-wire-grant-request.yaml
```yaml
# Copyright (c) 2026 Texas Instruments Incorporated
# SPDX-License-Identifier: Apache-2.0

description: |
  TI RCL RF Coexistence - Two-Wire Mode (REQUEST + GRANT)

  Uses two signals for basic coexistence control:
    - REQUEST (output): Indicates upcoming RF activity, asserted T1 µs before transmission
    - GRANT (input): Monitored by hardware

  GPIO Pin Constraints:

    Only DIOs with LRFD peripheral functions can be used.
    --------+----------------------------------------------------------------
    Device  | Valid DIO Choices
    --------+----------------------------------------------------------------
    CC23X0  | DIO1, DIO3, DIO4, DIO5, DIO6, DIO7, DIO9, DIO11, DIO14, DIO21
    CC27XX  | DIO17, DIO18, DIO19, DIO20, DIO21, DIO22, DIO27, DIO28
    --------+----------------------------------------------------------------

  Example on CC27XX devices:

  &pinctrl {
      coex_request_default: coex_request_default {
          pinmux = <22 DIO22_LRFD5>; /* REQUEST - output */
      };

      coex_grant_default: coex_grant_default {
          pinmux = <21 DIO21_LRFD4>; /* GRANT - input */
          input-enable;
          bias-pull-up;
      };

      coex_request_sleep: coex_request_sleep {
          pinmux = <22 DIO22_GPIO22>;
      };

      coex_grant_sleep: coex_grant_sleep {
          pinmux = <21 DIO21_GPIO21>;
          input-enable;
          bias-pull-up;
      };
  };

  / {
      ti_rcl_coex: rcl_coex {
          compatible = "ti,rcl-coex-two-wire-grant-request";
          status = "okay";

          pinctrl-0 = <&coex_request_default &coex_grant_default>;
          pinctrl-1 = <&coex_request_sleep &coex_grant_sleep>;
          pinctrl-names = "default", "sleep";

          request-gpios = <&gpio0 22 GPIO_ACTIVE_HIGH>;
          grant-gpios = <&gpio0 21 GPIO_ACTIVE_LOW>;

          t1-us = <120>;
      };
  };


compatible: "ti,rcl-coex-two-wire-grant-request"

include: [base.yaml, pinctrl-device.yaml]

properties:
  request-gpios:
    type: phandle-array
    required: true
    description: |
      GPIO for REQUEST signal. Must be a DIO that supports LRFD peripheral
      function. Use GPIO_ACTIVE_HIGH/LOW flag for polarity.

  grant-gpios:
    type: phandle-array
    required: true
    description: |
      GPIO for GRANT signal. Must be a DIO that supports LRFD peripheral
      function. Use GPIO_ACTIVE_HIGH/LOW flag for polarity.

  t1-us:
    type: int
    default: 120
    description: |
      RF Activity Latency Time in microseconds [90, 150]. Time from REQUEST
      assertion to actual RF activity start. Default 120 µs matches SimpleLink.
```
