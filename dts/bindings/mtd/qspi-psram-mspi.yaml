## dts/bindings/mtd/qspi-psram-mspi.yaml
```yaml
# SPDX-FileCopyrightText: Copyright The Zephyr Project Contributors
# SPDX-FileCopyrightText: Copyright (c) 2026 Kirill Shypachov
# SPDX-License-Identifier: Apache-2.0

title: Generic QPI PSRAM device on MSPI bus

description: |
  Three mutually exclusive operating modes are supported. Pick one - the
  device parameters come either from the driver or from devicetree, never
  from both.

  1. Known chip variant (chip-variant names a part):
     The driver takes every device parameter from its internal table:
     read/write commands for the selected mspi-io-mode, command and
     address length, rx/tx dummy cycles, CE refresh interval and maximum
     burst size. None of these have to be given in devicetree, and neither
     is size. Besides the MSPI bus properties (reg, mspi-max-frequency,
     mspi-io-mode) only chip-variant is needed.
     Supported chip variants: ESP-PSRAM64H, ISSI IS66WVS4M8BLL, IS66WVS8M8BLL.

  2. Auto detection (chip-variant = "AUTO"):
     The driver identifies the chip from its Read ID response at init.
     The ID reveals the ID family (AP Memory and its clones, or ISSI) and
     the density, which is all any QPI PSRAM on the market exposes; the
     driver then applies the family command set and the capacity from the
     ID. The temperature grade is not readable, so the worst-grade CE
     refresh limit of the family is assumed (AP family 3 us, ISSI 1 us);
     give ce-break-config to relax it when the grade of the part is
     known. A size property is not needed by the driver (a differing
     value only produces a warning), but the MSPI controller may still
     require one to size its memory-mapped window.

  3. Generic mode (chip-variant is omitted):
     The driver uses the standard de-facto QPI PSRAM init sequence
     (Enter QPI 0x35, Reset 0x66+0x99, Read ID 0x9F, all overridable) but
     skips KGD verification, and takes every device parameter from
     devicetree: size, read-command, write-command, command-length,
     address-length, rx-dummy, and CE timing via ce-break-config. All of
     those except rx-dummy and the CE timing are checked at init and the
     driver refuses to probe without them.

  Some MSPI controllers expect their child node to carry a controller
  specific compatible in addition to this one; the STM32 OCTOSPI/XSPI
  controllers for example need "st,psram-device" and take the device size
  from the size property. List this compatible first so the node is
  described by this binding.

compatible: "qspi-psram"

include: [mspi-device.yaml]

properties:
  size:
    type: int
    description: |
      Memory capacity in bits (e.g. 67108864 for 64 Mbit).
      Required in generic mode; when chip-variant is set the capacity of that
      part is known to the driver and any value given here is ignored.

  chip-variant:
    type: string
    enum:
      - "ESP64H"          # Espressif ESP-PSRAM64H  64 Mbit (8 MB)
      - "IS66WVS4M8BLL"   # ISSI IS66WVS4M8BLL      32 Mbit (4 MB)
      - "IS66WVS8M8BLL"   # ISSI IS66WVS8M8BLL      64 Mbit (8 MB)
      - "AUTO"            # Identify the chip from its Read ID response
    description: |
      Selects the PSRAM chip variant. The driver then takes all device
      parameters from its internal table and overrides whatever DT holds
      for them, so none of read-command, write-command, command-length,
      address-length, rx-dummy, tx-dummy or ce-break-config needs to be
      given. The Read ID response is compared with the named part and a
      KGD or identity mismatch is logged as a warning, but the driver
      keeps the devicetree choice: the decision stays with the user.
      AUTO identifies the chip from its Read ID response instead
      of naming it, with the worst-grade CE timing of the detected family
      unless ce-break-config overrides it. Omit this property to use
      generic mode, in which the transfer parameters must be specified
      in DT instead.

  mspi-io-mode:
    description: |
      Bus width the device is operated in. MSPI_IO_MODE_QUAD (QPI, 4-4-4)
      is what these parts are meant for and gives the full bandwidth;
      MSPI_IO_MODE_SINGLE (SPI, 1-1-1) is also supported and uses the
      serial read/write commands. Other modes are rejected at init. Whether
      memory mapping is available in a given mode is up to the MSPI
      controller. Left optional to match the other MSPI device bindings;
      note that an omitted value means MSPI_IO_MODE_SINGLE.

  mspi-data-rate:
    const: "MSPI_DATA_RATE_SINGLE"
    description: |
      Must be MSPI_DATA_RATE_SINGLE, the default; this device family is
      single data rate only and the driver rejects anything else.

  read-command:
    description: |
      Read command byte sent by the MSPI controller in DMA/memory-mapped
      mode; it has to match mspi-io-mode (e.g. 0xEB in QPI, 0x0B in SPI).
      Generic mode only, where the driver rejects a missing value; ignored
      and overridden from the internal chip table when chip-variant is set.

  write-command:
    description: |
      Write command byte sent by the MSPI controller in DMA/memory-mapped
      mode; it has to match mspi-io-mode (e.g. 0x38 in QPI, 0x02 in SPI).
      Generic mode only, where the driver rejects a missing value; ignored
      and overridden from the internal chip table when chip-variant is set.

  command-length:
    description: |
      Length of the read/write command in bytes.
      Generic mode only, where the driver rejects a missing value; ignored
      when chip-variant is set (the chip table holds INSTR_1_BYTE for all
      supported variants).

  address-length:
    description: |
      Length of the address phase in bytes.
      Generic mode only, where the driver rejects a missing value; ignored
      when chip-variant is set (the chip table holds ADDR_3_BYTE for all
      supported variants).

  rx-dummy:
    description: |
      Read dummy cycles. Use the value from the chip datasheet for the
      chosen read command and operating frequency (typically 6 for the QPI
      fast read at or below 80 MHz, 8 for the SPI fast read 0x0B).
      Generic mode only, where leaving it at 0 disables the dummy phase and
      is warned about at init; ignored when chip-variant is set (the chip
      table holds the datasheet value).

  enter-qpi-cmd:
    type: int
    default: 0x35
    description: |
      SPI command to switch the chip into QPI (quad) mode.
      Default 0x35 is the de-facto standard for most QPI PSRAM vendors.
      Only used in generic mode (chip-variant not set); for known variants
      the driver takes this value from its internal chip table.

  exit-qpi-cmd:
    type: int
    default: 0xF5
    description: |
      QPI command to return the chip to SPI mode.
      Default 0xF5 is the de-facto standard.
      Only used in generic mode (chip-variant not set).

  reset-en-cmd:
    type: int
    default: 0x66
    description: |
      Reset Enable command (sent before reset-cmd).
      Default 0x66 is the de-facto standard.
      Only used in generic mode (chip-variant not set).

  reset-cmd:
    type: int
    default: 0x99
    description: |
      Reset command.
      Default 0x99 is the de-facto standard.
      Only used in generic mode (chip-variant not set).

  read-id-cmd:
    type: int
    default: 0x9F
    description: |
      Read ID command. The driver reads 3 bytes (MF / KGD / EID) at address 0.
      Default 0x9F is the de-facto standard.
      In generic mode KGD verification is skipped; the command is still
      issued so the chip presence can be confirmed via LOG_INF output.
      Only used in generic mode (chip-variant not set).

examples:
  - |
    /* Known part: the driver supplies size, commands, dummy cycles and CE
     * timing from its internal table.
     */
    psram0: psram@0 {
        compatible = "qspi-psram";
        reg = <0>;
        chip-variant = "ESP64H";
        mspi-max-frequency = <DT_FREQ_M(80)>;
        mspi-io-mode = "MSPI_IO_MODE_QUAD";
        memmap-config = <1 0 0 0>;
    };
  - |
    /* Unknown part: the driver identifies the chip from its Read ID and
     * takes size, commands and dummy cycles from its table, assuming the
     * worst-grade CE timing of the detected family.
     */
    psram0: psram@0 {
        compatible = "qspi-psram";
        reg = <0>;
        chip-variant = "AUTO";
        mspi-max-frequency = <DT_FREQ_M(80)>;
        mspi-io-mode = "MSPI_IO_MODE_QUAD";
        memmap-config = <1 0 0 0>;
    };
  - |
    /* Any other QPI PSRAM: every parameter comes from devicetree. */
    psram0: psram@0 {
        compatible = "qspi-psram";
        reg = <0>;
        size = <DT_SIZE_M(64)>; /* 64 Mbit */
        mspi-max-frequency = <DT_FREQ_M(80)>;
        mspi-io-mode = "MSPI_IO_MODE_QUAD";
        read-command = <0xeb>;
        write-command = <0x38>;
        command-length = "INSTR_1_BYTE";
        address-length = "ADDR_3_BYTE";
        rx-dummy = <6>;
        ce-break-config = <1024 8>;
        memmap-config = <1 0 0 0>;
    };
```

## dts/bindings/mtd/renesas,ra6b1-nvmc.yaml
```yaml
# SPDX-FileCopyrightText: 2026 Renesas Electronics Corporation
# SPDX-License-Identifier: Apache-2.0

description: Renesas RA6B1 NVMC driver.

include: flash-controller.yaml

compatible: "renesas,ra6b1-nvmc"

properties:
  interrupts:
    required: true
```

## dts/bindings/mtd/st,m95p32-mspi.yaml
```yaml
# SPDX-FileCopyrightText: Copyright 2026 EXALT Technologies
#
# SPDX-License-Identifier: Apache-2.0

title: ST M95P32 page EEPROM on a MSPI bus

description: |
  The M95P32 is a 32-Mbit page EEPROM with a 512-byte page size. In
  addition to the main memory array, it provides a factory identification
  page and a customer-programmable identification page. It also provides an
  internal page buffer that can be loaded before programming the main memory
  array.

compatible: "st,m95p32"

include: jedec,nor-mspi.yaml
```

## dts/bindings/mtd/st,stm32-nv-flash.yaml
```yaml
description: |
  STM32 flash memory.

  This binding is for the flash memory itself, not the flash controller peripheral.
  For that, see the "st,stm32-flash-controller" binding.

include: soc-nv-flash.yaml

compatible: "st,stm32-nv-flash"

properties:
  max-erase-time:
    type: int
    description: max erase time(millisecond) of a flash sector or page or half-page
    required: true
  bank2-flash-size:
    type: int
    deprecated: true
    description: |
      Deprecated. This property was used to obtain the sizes of flash banks on the Cortex-M4 of
      dual core MCUs.  Said sizes are now derived from the size cell. It's safe to simply remove
      this property.
```

## dts/bindings/mtd/ti,cc35xx-nv-flash.yaml
```yaml
# Copyright (c) 2025 Conclusive Engineering Sp. z o.o.
# SPDX-License-Identifier: Apache-2.0

description: |
  cc35xx flash memory.

include: soc-nv-flash.yaml

compatible: ti,cc35xx-nv-flash
```

## dts/bindings/mtd/winbond,w25h512nw.yaml
```yaml
# Copyright 2026 NXP
# SPDX-License-Identifier: Apache-2.0

description: Winbond W25H512NW Dual/Quad SPI NOR flash

compatible: "winbond,w25h512nw"

include: soc-nv-flash.yaml
```

## dts/bindings/mtd/winbond,w25q25pw.yaml
```yaml
# SPDX-FileCopyrightText: Copyright 2026 NXP
# SPDX-License-Identifier: Apache-2.0

description: Winbond W25Q25PW Quad SPI NOR flash

compatible: "winbond,w25q25pw"

include: soc-nv-flash.yaml
```

## dts/bindings/mtd/winbond,w25q512nw.yaml
```yaml
# Copyright 2026 NXP
# SPDX-License-Identifier: Apache-2.0

description: Winbond W25Q512NW Quad SPI NOR flash

compatible: "winbond,w25q512nw"

include: soc-nv-flash.yaml
```

## dts/bindings/mtd/winbond,w35t51nw-mspi.yaml
```yaml
# SPDX-FileCopyrightText: Copyright The Zephyr Project Contributors
# SPDX-License-Identifier: Apache-2.0

description: Winbond W35T51NW Octal DDR NOR flash

compatible: "winbond,w35t51nw"

include: jedec,nor-mspi.yaml
```

## dts/bindings/mtd/winbond,w958d6.yaml
```yaml
# Copyright 2026 NXP
# SPDX-License-Identifier: Apache-2.0

description: Winbond W958D6 family PSRAM

compatible: "winbond,w958d6"

include: [base.yaml]
```

## dts/bindings/mtd/zephyr,i2c-target-eeprom.yaml
```yaml
# SPDX-License-Identifier: Apache-2.0

description: Zephyr I2C target EEPROM

compatible: "zephyr,i2c-target-eeprom"

include: regset-target-base.yaml
```

## dts/bindings/mtd/zephyr,sim-eeprom.yaml
```yaml
# Copyright (c) 2019 Laczen
# SPDX-License-Identifier: Apache-2.0

description: Zephyr Simulated EEPROM device

compatible: "zephyr,sim-eeprom"

include: eeprom-base.yaml

properties:
  size:
    required: true
  memory-region:
    type: phandle
    description: |
      Memory region used by the simulated EEPROM. If this option is used
      the memory that is used by the simulated EEPROM is not erased.
```

## dts/bindings/mux/infineon,trigmux.yaml
```yaml
# SPDX-FileCopyrightText: Copyright (c) 2026 Linumiz
# SPDX-License-Identifier: Apache-2.0

title: Infineon trigger multiplexer

description: |
  Trigger multiplexer of the Infineon PERI block. Each trigger multiplexer
  output is driven by one input of its group (multiplexer group) or by one
  fixed input that is switched on or off (one-to-one group).

  The output cell is the trigger multiplexer output, as the PDL trigger
  output number. The flags cell is IFX_TRIGMUX_LEVEL or IFX_TRIGMUX_EDGE,
  optionally combined with IFX_TRIGMUX_INV. The select cell is the input
  that drives the output: the PDL trigger input number for an output in a
  multiplexer group, or IFX_TRIGMUX_ON for the single input of an output in
  a one-to-one group. IFX_TRIGMUX_OFF disconnects the output.

  The values are defined in zephyr/dt-bindings/mux/infineon-trigmux.h and
  in the SoC specific zephyr/dt-bindings/mux/infineon-trigmux-<soc>.h.

compatible: "infineon,trigmux"

include: [base.yaml, mux-controller.yaml]

properties:
  reg:
    required: true

  "#mux-control-cells":
    const: 2

  "#mux-state-cells":
    const: 3

mux-control-cells:
  - output
  - flags

mux-state-cells:
  - output
  - flags
  - select
```

## dts/bindings/mux/nxp,trgmux.yaml
```yaml
# SPDX-FileCopyrightText: 2026 NXP
# SPDX-License-Identifier: Apache-2.0

description: |
  NXP TRGMUX peripheral wrapper.

  TRGMUX provides per-device output trigger inputs. Each device exposes
  up to 4 trigger input slots, and each slot can be routed to one of the
  TRGMUX trigger sources.

  The first cell selects the destination device, the second selects the
  trigger input slot. The state value is the source to route to that slot.

compatible: "nxp,trgmux"

include: [base.yaml, mux-controller.yaml]

properties:
  reg:
    required: true

  "#mux-control-cells":
    const: 2

  "#mux-state-cells":
    const: 3

mux-control-cells:
  - device
  - input

mux-state-cells:
  - device
  - input
  - source

examples:
  - |
    trgmux0: trgmux@40063000 {
            compatible = "nxp,trgmux";
            reg = <0x40063000 0x1000>;
            #mux-control-cells = <2>;
            #mux-state-cells = <3>;
    };

    adc-trigger {
            mux-states = <&trgmux0 5 1 7>; /* device=5, input=1, source=7 */
    };
```
