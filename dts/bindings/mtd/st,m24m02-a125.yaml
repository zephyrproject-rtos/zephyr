## dts/bindings/mtd/st,m24m02-a125.yaml
```yaml
# Copyright (c) 2024 SILA Embedded Solutions GmbH
# SPDX-License-Identifier: Apache-2.0

description: ST M24M02-A125 automotive 2-Mbit I2C EEPROM

compatible: "st,m24m02-a125"

include: ["st,m24xxx-a125-base.yaml"]
```

## dts/bindings/mtd/st,m24xxx-a125-base.yaml
```yaml
# Copyright (c) 2024 SILA Embedded Solutions GmbH
# SPDX-License-Identifier: Apache-2.0

description: ST M24XXX-A125 automotive I2C EEPROM

include: ["eeprom-base.yaml", i2c-device.yaml]

properties:
  wp-gpios:
    type: phandle-array
    description: GPIO to which the write-protect pin of the chip is connected
```

## dts/bindings/mtd/st,m24xxx.yaml
```yaml
# Copyright (c) 2024 SILA Embedded Solutions GmbH
# SPDX-License-Identifier: Apache-2.0

description: ST M24xxx I2C EEPROM

compatible: "st,m24xxx"

include: ["atmel,at24.yaml"]
```

## dts/bindings/mtd/st,st25dv.yaml
```yaml
# Copyright (c) 2023 Kickmaker
# Copyright (c) 2021 Martin Schröder <info@swedishembedded.com>
# SPDX-License-Identifier: Apache-2.0

description: ST25DV NFC as EEPROM

compatible: "st,st25dv"

include: eeprom-base.yaml

properties:
  reg:
    required: true
  size:
    required: true
  i2c-transfer-is-limited:
    type: boolean
```

## dts/bindings/mtd/st,stm32-eeprom.yaml
```yaml
# Copyright (c) 2019 Kwon Tae-young <tykwon@m2i.co.kr>
# SPDX-License-Identifier: Apache-2.0

description: STM32 on-chip EEPROM

compatible: "st,stm32-eeprom"

include: eeprom-base.yaml

properties:
  reg:
    required: true
```

## dts/bindings/mtd/st,stm32-ospi-psram-aps6408l.yaml
```yaml
# Copyright (c) 2025 ZAL Zentrum für Angewandte Luftfahrtforschung GmbH
# Copyright (c) 2025 Mario Paja
# SPDX-License-Identifier: Apache-2.0

description: |
  STM32 OSPI PSRAM.

compatible: "st,stm32-ospi-psram-aps6408l"

include: ["st,stm32-ospi-psram.yaml"]

properties:

  fixed-latency:
    type: boolean
    description: |
      Read latency type: variable if not set, fixed if set.

  read-latency:
    type: int
    default: 5
    description: |
      Read latency code
      - 0: LCx2 3 / Fmax 66 MHz
      - 1: LCx2 4 / Fmax 104 MHz
      - 2: LCx2 5 / Fmax 133 MHz
      - 3: LCx2 6 / Fmax 133 MHz
      - 4: LCx2 7 / Fmax 133 MHz
      - 5: LCx2 5 / Fmax 133 MHz
    enum:
      - 0
      - 1
      - 2
      - 3
      - 4
      - 5

  drive-strength:
    type: int
    default: 0
    description: |
      Drive strength code:
      - 0: 200Ω
      - 1: 133Ω
      - 2: 100Ω
      - 3: 80Ω
      - 4: 66Ω
      - 5: 66Ω
      - 6: 50Ω
      - 7: 50Ω (default)
    enum:
      - 0
      - 1
      - 2
      - 3
      - 4
      - 5
      - 6
      - 7

  write-latency:
    type: int
    default: 2
    description: |
      Write latency code:
      - 0: WLC 3 / Fmax 66 MHz
      - 4: WLC 4 / Fmax 109 MHz
      - 2: WLC 5 / Fmax 133 MHz
      - 5: WLC 6 / Fmax 166 MHz
      - 1: WLC 7 / Fmax 200 MHz
    enum:
      - 0
      - 1
      - 2
      - 4
      - 5
```

## dts/bindings/mtd/st,stm32f4-nv-flash.yaml
```yaml
description: |
  STM32F4 flash memory.

include: st,stm32-nv-flash.yaml

compatible: st,stm32f4-nv-flash

properties:
  write-block-size:
    required: true
    type: int
    enum:
      - 1
      - 2
      - 4
      - 8
    default: 1
    description: |
      Number of bytes used in write operations. Default value is based on the
      reset value of Flash Control Register (FLASH_CR).
```

## dts/bindings/mtd/st,stm32l0-nv-flash.yaml
```yaml
description: |
  STM32L0 flash memory.

include: st,stm32-nv-flash.yaml

compatible: st,stm32l0-nv-flash

properties:
  write-block-size:
    required: true
    type: int
    enum:
      - 1
      - 2
      - 4
    description: |
      Number of bytes used in write operations.
```

## dts/bindings/mtd/ti,cc23x0-ccfg-flash.yaml
```yaml
# Copyright (c) 2024 BayLibre, SAS
# SPDX-License-Identifier: Apache-2.0

description: |
  This binding describes the TI CC23X0 flash CCFG (custom configuration)
  area content.

  Notes:
    The flash CCFG sector node (e.g. flash1) should have both
    "ti,cc23x0-ccfg-flash" and the "soc-nv-flash" compatibles.
    The latter is used from mcuboot and other modules to identify
    the flash area.

compatible: "ti,cc23x0-ccfg-flash"

include: soc-nv-flash.yaml

properties:
  ti,bldr-vtor-flash:
    type: int
    description: |
      Bootloader entry point when a boot from flash is selected.
      Valid range: 0 - 0x0effffff
      Default is 0, which is the standard initial configuration.
    default: 0

  ti,serial-io-cfg-index:
    type: int
    description: |
      Index of which I/O mapping to use for UART/SPI.
      Valid range: 0 - 2
      Default is 0, which is the standard initial configuration. Other values can be
      used depending on I/O availability.
    default: 0

  ti,pin-trigger:
    type: boolean
    description: |
      If not present, then bootloader unconditionally triggers.
      Else normal pin trigger check is performed.

  ti,pin-trigger-dio:
    type: int
    description: |
      Index of DIO pin to use for pin trigger check.
      Valid range: 0 - 25
      Default is 0, which is the standard initial configuration. Other values can be
      used depending on DIO availability.
    default: 0

  ti,pin-trigger-level-hi:
    type: boolean
    description: |
      If not present, then the level on trigger pin that triggers bootloader is low.
      Else level that triggers bootloader is high.

  ti,debug-port:
    type: boolean
    description: |
      If not present, then the SWD port is disabled altogether at a certain point in boot
      before invoking either bootloader or application.

  ti,energy-trace:
    type: boolean
    description: |
      Allows using EnergyTrace power analyzer tool.
      EnergyTrace software is an energy-based code analysis tool that measures
      and displays the energy profile of an application and helps optimize it for
      ultra-low-power consumption.

  ti,flash-verify:
    type: boolean
    description: |
      Determines whether flash verifying SACI commands are allowed. These commands only check
      integrity against a provided CRC32 value, never return any flash contents. Flash verify
      commands are always allowed after a chip erase and until the first reset after the CCFG
      sector has been programmed.

  ti,flash-program:
    type: boolean
    description: |
      Determines whether flash programming SACI commands are allowed.
      Reset to allowed after a chip erase.

  ti,chip-erase:
    type: boolean
    description: |
      Determines whether chip erasing SACI commands are allowed.

  ti,ret-to-factory:
    type: boolean
    description: |
      Allows return-to-factory procedure by SACI.
      To do full failure analysis including flash, a return to factory procedure is supported.

  ti,wr-er-prot-sect0-31:
    type: int
    description: |
      Bitmask for write/erase protection of individual sectors in sector range [0, 31].
      Controls whether flash programming is allowed through SACI. The same mechanism
      controls whether the application is allowed to program these sectors.
      0 = protected.
      Valid range: 0 - 0xffffffff
      Default is 0xffffffff to allow programming these sectors.
    default: 0xffffffff

  ti,wr-er-prot-sect32-255:
    type: int
    description: |
      Bitmask for write/erase protection of groups of 8 sectors, in sector range [32, 255].
      Bit i protects sectors [32 + 8i, 39 + 8i].
      0 = protected.
      Valid range: 0 - 0xffffffff
      Default is 0xffffffff to allow programming these sectors.
    default: 0xffffffff

  ti,wr-er-prot-ccfg-sect:
    type: int
    description: |
      Bitmask for write/erase protection of CCFG sectors.
      Valid range: 0 - 0xffffffff
      Default is 0 to prevent from mistakenly programming these sectors.
    default: 0

  ti,wr-er-prot-fcfg-sect:
    type: int
    description: |
      Bitmask for write/erase protection of FCFG sectors.
      Valid range: 0 - 0xffffffff
      Default is 0 to prevent from mistakenly programming these sectors.
    default: 0

  ti,wr-er-prot-engr-sect:
    type: int
    description: |
      Bitmask for write/erase protection of ENGR sectors.
      Valid range: 0 - 0xffffffff
      Default is 0 to prevent from mistakenly programming these sectors.
    default: 0

  ti,chip-er-retain-sect0-31:
    type: int
    description: |
      Bitmask for chip erase protection of individual sectors in sector range [0, 31].
      Controls whether a chip erase affects a sector or not. The mechanism is intended
      to allow flash sectors devoted to logging or runtime state/configuration to survive
      the chip erase during a FW update.
      0 = protected.
      Valid range: 0 - 0xffffffff
      Default is 0 to prevent from mistakenly programming these sectors.
    default: 0

  ti,chip-er-retain-sect32-255:
    type: int
    description: |
      Bitmask for chip erase protection of groups of 8 sectors, in sector range [32, 255].
      Bit i protects sectors [32 + 8i, 39 + 8i].
      0 = protected.
      Valid range: 0 - 0xffffffff
      Default is 0 to prevent from mistakenly programming these sectors.
    default: 0
```

## dts/bindings/mtd/ti,mspm0-nv-flash.yaml
```yaml
# Copyright 2025 Texas Instruments
# Copyright 2025 Linumiz GmbH
# SPDX-License-Identifier: Apache-2.0

description: Texas Instruments MSPM0 Flash driver

include: soc-nv-flash.yaml

compatible: ti,mspm0-nv-flash

properties:
  max-erase-time:
    type: int
    description: max erase time(millisecond) of a flash sector or page or half-page
    required: false
```

## dts/bindings/mtd/ti,tmp116-eeprom.yaml
```yaml
# Copyright (c) 2020 Innoseis B.V
# SPDX-License-Identifier: Apache-2.0

description: TI TMP116 EEPROM controller binding

compatible: "ti,tmp116-eeprom"

include: eeprom-base.yaml

on-bus: tmp116
```

## dts/bindings/mtd/ti,tmp11x-eeprom.yaml
```yaml
# Copyright (c) 2020 Innoseis B.V
# SPDX-License-Identifier: Apache-2.0

description: TI TMP11X EEPROM controller

compatible: "ti,tmp11x-eeprom"

include: eeprom-base.yaml

on-bus: tmp11x
```

## dts/bindings/mtd/winbond,w25q16.yaml
```yaml
# Copyright (c) 2018, Linaro Limited
# SPDX-License-Identifier: Apache-2.0

description: SPI slave NOR FLASH

compatible: "winbond,w25q16"

include: spi-device.yaml
```

## dts/bindings/mtd/winbond,w25qxx.yaml
```yaml
#
# Copyright (c) 2018, Linaro Limited
#
# SPDX-License-Identifier: Apache-2.0
#

title: SPI NOR FLASH

description: >
    This binding gives a base representation of SPI slave NOR FLASH

inherits:
    !include spi-device.yaml

properties:
    compatible:
      constraint: "winbond,w25qxx"

    size:
        type: int
        category: required
        description: flash capacity in bits

    device-id:
        type: uint8-array
        category: required
        description: DEVICE ID as manufacturer ID, memory type, memory density

    page-program-size:
        type: int
        category: required
        description: This is the maximum size of a page program operation
```

## dts/bindings/mtd/zephyr,application-image.yaml
```yaml
# Copyright (c) 2021 Nordic Semiconductor ASA
# SPDX-License-Identifier: Apache-2.0

description: |
  Partition or other storage area for application binary image.

compatible: "zephyr,application-image"

include: base.yaml

properties:
  label:
    required: true
  reg:
    required: true
```

## dts/bindings/mtd/zephyr,eeprom-to-flash.yaml
```yaml
# Copyright (c) 2025 MASSDRIVER EI (massdriver.space)
# SPDX-License-Identifier: Apache-2.0

description: |
  Statically provide a flash API for a EEPROM driver
  This is intended for usage with FRAM, MRAM, and other fast NVRAMs.

compatible: "zephyr,eeprom-to-flash"

include: base.yaml

properties:
  eeprom:
    type: phandle
    required: true
    description: |
      EEPROM device this aliases
```

## dts/bindings/mtd/zephyr,emu-eeprom.yaml
```yaml
# Copyright (c) 2019 Laczen
# SPDX-License-Identifier: Apache-2.0

description: Zephyr Emulated EEPROM device

compatible: "zephyr,emu-eeprom"

include: eeprom-base.yaml

properties:
    size:
      required: true
    pagesize:
      type: int
      required: true
      description: Size of a page used to emulate EEPROM in flash
    partition:
      type: phandle
      required: true
      description: Flash partition used to store the emulated EEPROM data
    rambuf:
      type: boolean
      required: false
      description: Enable a ram buffer of EEPROM size for improved read speed
    partition-erase:
      type: boolean
      required: false
      description: |
        Delay erase until complete partition is used. This enables a
        ram buffer to allow data to be copied during the partition erase. If
        power is lost during the partition erase the data will be lost.
```

## dts/bindings/mtd/zephyr,emul-flash-mspi.yaml
```yaml
# Copyright (c) 2024 Ambiq Inc.
# SPDX-License-Identifier: Apache-2.0

description: Zephyr MSPI flash emulator

compatible: "zephyr,emul-flash"

include: ["zephyr,emul-device-mspi.yaml", "jedec,jesd216.yaml"]
```

## dts/bindings/mtd/zephyr,fake-eeprom.yaml
```yaml
# Copyright (c) 2022 Vestas Wind Systems A/S
# SPDX-License-Identifier: Apache-2.0

description: |
    This binding provides a fake EEPROM for use as either a stub or a mock in Zephyr testing.

compatible: "zephyr,fake-eeprom"

include: eeprom-base.yaml

properties:
  size:
    required: true
```
