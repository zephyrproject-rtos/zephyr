## dts/bindings/dsa/renesas,ra-eswm-switch.yaml
```yaml
# Copyright The Zephyr Project Contributors
# SPDX-License-Identifier: Apache-2.0

description: |
  Renesas RA Ethernet Switch Module (ESWM) switch ports.

  Child of a renesas,ra-eswm-dsa node. The port reg is the ESWM port
  number: 0 and 1 are the Ethernet ports, 2 is the CPU port.

compatible: "renesas,ra-eswm-switch"

include: [dsa.yaml, base.yaml]
```

## dts/bindings/edac/ti,k3-ecc-aggr.yaml
```yaml
# Copyright (c) 2026 BeagleBoard.org Foundation
# SPDX-License-Identifier: Apache-2.0

description: |
  Texas Instruments K3 ECC Aggregator.

  Collects single-error-correctable (SEC) and double-error-detectable (DED)
  events from one or more ECC-protected memories. Exposed through the Zephyr
  EDAC API for status polling, clear, and optional interrupt notification.

compatible: "ti,k3-ecc-aggr"

include: [base.yaml]

properties:
  reg:
    required: true

  interrupts:
    description: |
      Optional aggregator interrupt (SEC and/or DED). When omitted the driver
      operates in poll-only mode.
```

## dts/bindings/energy-meter/microchip,atm90e26-common.yaml
```yaml
# Copyright (c) 2025 Pedro Ramos
# SPDX-License-Identifier: Apache-2.0

description: |
  Microchip ATM90E26 single-phase energy metering IC (formerly Atmel M90E26).

  Register properties hold 16-bit register values and default to the
  datasheet power-on values.

properties:
  meter-constant:
    type: int
    default: 3200
    description: |
      Meter constant (MC) in pulses per kWh: one CF pulse is 1 kWh / MC.
      It must match the value pl-constant was derived from.

  current-scale:
    type: array
    default: [1, 1]
    min-len: 2
    max-len: 2
    description: |
      Ratio <numerator denominator> of the actual current to the current
      the chip is calibrated to read. Each value is from 1 to 65535.

      The RMS current registers stop at 65.535 A and the power registers
      at 32.767 kW. For larger loads the chip is calibrated (i-gain-l,
      i-gain-n, l-gain, n-gain) to read a fraction of the actual current,
      and this property is the inverse of that fraction. The ratio applies
      to current, power and energy, not to voltage, power factor, phase
      angle or frequency. meter-constant and pl-constant keep their
      calibrated values.

      For example, a meter calibrated to read one tenth of the load
      current uses <10 1>.

  irq-gpios:
    type: phandle-array
    description: IRQ interrupt output.

  wrn-out-gpios:
    type: phandle-array
    description: WarnOut fatal error warning output.

  cf1-gpios:
    type: phandle-array
    description: CF1 active energy pulse output.

  cf2-gpios:
    type: phandle-array
    description: CF2 reactive energy pulse output.

  func-en:
    type: int
    default: 0x000c
    description: FuncEn (02h), function enable.

  sag-th:
    type: int
    default: 0x1d6a
    description: SagTh (03h), voltage sag threshold.

  pl-constant:
    type: int
    default: 0x0015d174
    description: PL_Constant, split across PLconstH (21h) and PLconstL (22h).

  l-gain:
    type: int
    default: 0x0000
    description: Lgain (23h), L line calibration gain.

  l-phi:
    type: int
    default: 0x0000
    description: Lphi (24h), L line calibration angle.

  n-gain:
    type: int
    default: 0x0000
    description: Ngain (25h), N line calibration gain.

  n-phi:
    type: int
    default: 0x0000
    description: Nphi (26h), N line calibration angle.

  p-start-th:
    type: int
    default: 0x08bd
    description: PStartTh (27h), active startup power threshold.

  p-nol-th:
    type: int
    default: 0x0000
    description: PNolTh (28h), active no-load power threshold.

  q-start-th:
    type: int
    default: 0x0aec
    description: QStartTh (29h), reactive startup power threshold.

  q-nol-th:
    type: int
    default: 0x0000
    description: QNolTh (2Ah), reactive no-load power threshold.

  mmode:
    type: int
    default: 0x9422
    description: MMode (2Bh), metering mode configuration.

  u-gain:
    type: int
    default: 0x6720
    description: Ugain (31h), voltage RMS gain.

  i-gain-l:
    type: int
    default: 0x7a13
    description: IgainL (32h), L line current RMS gain.

  i-gain-n:
    type: int
    default: 0x7530
    description: IgainN (33h), N line current RMS gain.

  u-offset:
    type: int
    default: 0x0000
    description: Uoffset (34h), voltage offset.

  i-offset-l:
    type: int
    default: 0x0000
    description: IoffsetL (35h), L line current offset.

  i-offset-n:
    type: int
    default: 0x0000
    description: IoffsetN (36h), N line current offset.

  p-offset-l:
    type: int
    default: 0x0000
    description: PoffsetL (37h), L line active power offset.

  q-offset-l:
    type: int
    default: 0x0000
    description: QoffsetL (38h), L line reactive power offset.

  p-offset-n:
    type: int
    default: 0x0000
    description: PoffsetN (39h), N line active power offset.

  q-offset-n:
    type: int
    default: 0x0000
    description: QoffsetN (3Ah), N line reactive power offset.
```
