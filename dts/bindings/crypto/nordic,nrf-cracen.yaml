## dts/bindings/display/ilitek,ili98xx-dsi.yaml
```yaml
# Copyright (c) 2026 Analog Devices, Inc.
# SPDX-License-Identifier: Apache-2.0

description: |
   Shared properties for ILI98XX display controllers on MIPI DSI interfaces

include: [mipi-dsi-device.yaml, display-controller.yaml]

properties:
  reset-gpios:
    type: phandle-array
    description: |
      The RESETn pin is asserted to disable the sensor causing a hard
      reset.  The sensor receives this as an active-low signal.

  bl-gpios:
    type: phandle-array
    description: |
      The BLn pin is asserted to control the backlight of the panel.
      The sensor receives this as an active-high signal.

  hp-mode:
    type: boolean
    description: |
      Set to attach to the MIPI-DSI host in high power mode. If not present,
      the host will attach in low power mode.

  burst-mode:
    type: boolean
    description: |
      Set to enable burst mode for the MIPI-DSI interface. If not present,
      burst mode will be disabled.

  init-seq:
    type: uint8-array
    required: true
    description: |
      Initialization sequence for the display panel. This should be an array of
      bytes encoded like so:
      - The first byte is the register address.
      - The second byte is the length of the command data.
      - The following bytes are the command data itself.
      For example, an initialization sequence with two commands might look like:
      [01 00 11 02 01 22 33]
      Here, 0x01 is the first register, 0x00 is the length of its command data (none),
      followed by 0x11 as the next register, 0x02 as the length of its command data,
      and 0x22, 0x33 as the command data itself.
```

## dts/bindings/display/lcd-controller.yaml
```yaml
# Copyright 2023 NXP
# SPDX-License-Identifier: Apache-2.0

# Common fields for LCD controllers driving a panel.

include: display-controller.yaml

properties:
  pixel-format:
    type: string
    required: true
    description: |
      Initial Pixel format of this controller's output data, which is sent
      to a panel directly or to an adapter.
      Use the lowercase suffix of a PIX_FMT_* definition from
      zephyr/dt-bindings/media/pixel_format.h, for example "bgr24".
```

## dts/bindings/display/nxp,lpc-lcdc.yaml
```yaml
# SPDX-FileCopyrightText: Copyright The Zephyr Project Contributors
# SPDX-License-Identifier: Apache-2.0

description: |
  NXP LPC LCD controller (LCDC).

  The LCDC drives a parallel-RGB TFT panel. Panel timings are described by a
  "zephyr,panel-timing" child node, matching the convention used by the other
  NXP LCD controller bindings, so panel shields apply unchanged.

compatible: "nxp,lpc-lcdc"

include: [lcd-controller.yaml, pinctrl-device.yaml]

properties:
  reg:
    required: true

  interrupts:
    required: true

  clocks:
    required: true

  data-bus-width:
    type: string
    default: "16-bit"
    enum:
      - "16-bit"
      - "8-bit"
      - "18-bit"
      - "24-bit"
    description: |
      LCD data bus width, as set by panel shields shared with other NXP LCD
      controllers. The LCDC has no bus width setting in TFT mode; the pin
      routing determines which data lines reach the panel.

  backlight-gpios:
    type: phandle-array
    description: |
      LCD backlight control GPIO. The driver starts with it inactive and drives
      it on display blanking off and on.

  pwms:
    type: phandle-array
    description: |
      Optional PWM driving the LCD backlight. When present it takes precedence
      over the backlight-gpios property. The driver implements
      display_set_brightness() (linear 0-255 to duty cycle) and turns the
      backlight off on blanking on and back to the set brightness on blanking
      off. The PWM period sets the backlight frequency.

  memory-region:
    type: phandle
    required: true
    description: |
      Phandle to the memory region (typically external SDRAM) that holds the
      two driver-owned framebuffers.
```

## dts/bindings/display/raspberrypi,bcm2711-framebuffer.yaml
```yaml
# Copyright (c) 2026 Muhammad Waleed Badar
# SPDX-License-Identifier: Apache-2.0

description: |
    Raspberry Pi BCM2711 framebuffer display device.

    Note:
      For HDMI output configuration and related framebuffer settings, see:
      https://www.raspberrypi.com/documentation/computers/legacy_config_txt.html

compatible: "raspberrypi,bcm2711-framebuffer"

include: simple-framebuffer.yaml

properties:
  firmware:
    required: true

  pixel-format:
    type: string
    required: true
    description: |
      Initial Pixel format of this controller's output data.
    enum:
      - "bgra32"
      - "rgba32"

  red-blue-swap:
    type: boolean
    description: |
      Flip RGB color channels order for compatibility with VideoCore firmware.

examples:
  - |
    fb0: framebuffer {
      /* ... */

      pixel-format = "rgba32";
    };
```

## dts/bindings/display/renesas,rz-lcdc.yaml
```yaml
# SPDX-FileCopyrightText: 2026 Renesas Electronics Corporation
# SPDX-License-Identifier: Apache-2.0

description: Renesas LCD controller

compatible: "renesas,rz-lcdc"

include: [display-controller.yaml, pinctrl-device.yaml]

properties:
  reg:
    required: true

  pinctrl-0:
    description: |
      Provide a pin configuration for using parallel pixel output. In combination with DSI HOST
      the pin configuration is not necessary due to dedicated (MIPI D-PHY) pins.

  interrupts:
    required: true

  interrupt-names:
    type: string-array
    required: true
    description: name of each interrupt

  backlight-gpios:
    type: phandle-array
    description: |
      The BLn pin is asserted to control the backlight of the panel.
      The sensor receives this as an active-high signal.

  input-pixel-format:
    type: string
    required: true
    description: |
      Initial input Pixel format for LCD controller.
    enum:
      - "bgr24"
      - "bgra32"
      - "rgb565"

  pixel-format:
    type: string
    required: true
    description: |
      Initial output Pixel format for LCD controller.
    enum:
      - "bgr24"
      - "rgb565"

  background-color-alpha:
    type: int
    default: 0
    description: Alpha component of the background color.

  background-color-red:
    type: int
    default: 0
    description: Red component of the background color.

  background-color-green:
    type: int
    default: 0
    description: Green component of the background color.

  background-color-blue:
    type: int
    default: 0
    description: Blue component of the background color.
```

## dts/bindings/display/tes,cdc-2.1.yaml
```yaml
# Copyright (C) 2024 Alif Semiconductor
# SPDX-License-Identifier: Apache-2.0

description: TES CDC200 controller

compatible: "tes,cdc-2.1"

include: [display-controller.yaml, pinctrl-device.yaml]

properties:
  reg:
    required: true

  interrupts:
    required: true

  interrupt-names:
    required: true

  enable-l1:
    type: boolean
    description:
      Enable layer 1.

  enable-l2:
    type: boolean
    description:
      Enable layer 2.

  pixel-fmt-l1:
    type: string
    description: Pixel format for Layer 1. Must be set if layer 1 is enabled.
    enum:
      - "argb-8888"
      - "rgb-888"
      - "rgb-565"
      - "rgba-8888"
      - "al-44"
      - "l-8"
      - "argb-1555"
      - "argb-4444"
      - "undefined"

  pixel-fmt-l2:
    type: string
    description: Pixel format for Layer 2. Must be set if layer 2 is enabled.
    enum:
      - "argb-8888"
      - "rgb-888"
      - "rgb-565"
      - "rgba-8888"
      - "al-44"
      - "l-8"
      - "argb-1555"
      - "argb-4444"
      - "undefined"

  def-back-color-l1:
    type: int
    description: Default display background color - layer 1.

  def-back-color-l2:
    type: int
    description: Default display background color - layer 2.

  bg-color:
    type: int
    default: 0x0
    description: |
      RGB value of the default display background color.
      Default is the reset value of black


  win-x0-l1:
    type: int
    description: Window X0 for Layer 1.

  win-y0-l1:
    type: int
    description: Window Y0 for Layer 1.

  win-x1-l1:
    type: int
    description: Window X1 for Layer 1.

  win-y1-l1:
    type: int
    description: Window Y1 for Layer 1.

  win-x0-l2:
    type: int
    description: Window X0 for Layer 2.

  win-y0-l2:
    type: int
    description: Window Y0 for Layer 2.

  win-x1-l2:
    type: int
    description: Window X1 for Layer 2.

  win-y1-l2:
    type: int
    description: Window Y1 for Layer 2.

  blend-factor1-l1:
    type: int
    default: 6
    description: |
      Blend factor 1 for current layer color to be used for blending algorithm
      for layer 1. Default is reset value of register.
    enum:
      - 4
      - 6

  blend-factor2-l1:
    type: int
    default: 7
    description: |
      Blend factor 2 for subjacent layer color to be used for blending algorithm
      for layer 1. Default is reset value of register.
    enum:
      - 5
      - 7

  blend-factor1-l2:
    type: int
    default: 6
    description: |
      Blend factor 1 for current layer color to be used for blending algorithm for layer 2.
      Default is reset value of register.
    enum:
      - 4
      - 6

  blend-factor2-l2:
    type: int
    default: 7
    description: |
      Blend factor 2 for subjacent layer color to be used for blending algorithm for layer 2.
      Default is reset value of register.
    enum:
      - 5
      - 7

  const-alpha-l1:
    type: int
    default: 0xff
    description: |
      Constant alpha to be used for layer 1. Default is reset value of register.

  const-alpha-l2:
    type: int
    default: 0xff
    description: |
      Constant alpha to be used for layer 2. Default is reset value of register.

  panel-dev:
    type: phandle
    required: true
    description: Reference to the display panel node.
```

## dts/bindings/display/zephyr,sdl-dc.yaml
```yaml
# Copyright (c) 2021 Nordic Semiconductor ASA
# Copyright (c) 2025 Abderrahmane JARMOUNI
# SPDX-License-Identifier: Apache-2.0

description: SDL based emulated display controller

compatible: "zephyr,sdl-dc"

include: display-controller.yaml

properties:
  title:
    type: string
    description: |
      Name of graphical window

  pixel-format:
    type: string
    required: true
    description: |
      Initial Pixel format of this controller's output data.
    enum:
      - "bgr24"
      - "mono01"
      - "mono10"
      - "bgra32"
      - "rgb565"
      - "rgb565x"
      - "grey"
      - "al88"
      - "bgrx32"
      - "rgb24"
      - "rgba32"
      - "abgr32"
      - "argb32"
      - "i4"

examples:
  - |
    sdl_dc: sdl_dc {
      /* ... */

      pixel-format = "rgba32";
    };
```

## dts/bindings/dma/snps,designware-dma-axi.yaml
```yaml
# Copyright (c) 2023 Intel Corporation. All rights reserved.
# SPDX-License-Identifier: Apache-2.0

description: Synopsys Designware axi DMA Controller

compatible: "snps,designware-dma-axi"

include: [dma-controller.yaml, reset-device.yaml]

properties:
  reg:
    required: true

  dma-channels:
    required: true

  interrupts:
    required: true

  "#dma-cells":
    const: 1

  snps,src-osr-limit:
    type: int
    default: 0
    description: |
      Source outstanding request limit programmed into CHx_CFG.SRC_OSR_LMT
      of every channel. Each channel may have up to (value + 1) outstanding
      AXI read requests. Valid range is 0-15; the default of 0 (one
      outstanding request) matches the hardware reset value. Raising it
      hides read latency on high-latency paths such as DRAM.

  snps,dst-osr-limit:
    type: int
    default: 0
    description: |
      Destination outstanding request limit programmed into
      CHx_CFG.DST_OSR_LMT of every channel. Each channel may have up to
      (value + 1) outstanding AXI write requests. Valid range is 0-15; the
      default of 0 matches the hardware reset value.

# #dma-cells : Must be <1>.
# The 1st cell specifies the hardware handshaking signal ID
# Example of device-tree dma channel configuration:
#
# &spi0 {
#      /* Configure DMA */
#   dmas = <&dma0 18>, <&dma0 19>;
#   dma-names = "tx", "rx";
# };
#
# In above spi node numbers 18 and 19 represents the
# peripheral handshaking interface ID
dma-cells:
  - slot
```

## dts/bindings/dma/ti,am62l-bcdma.yaml
```yaml
# SPDX-FileCopyrightText: Copyright The Zephyr Project Contributors
# SPDX-License-Identifier: Apache-2.0

title: TI AM62L main DMSS Block Copy DMA (BCDMA)

description: |
  TI AM62L main DMSS Block Copy DMA (BCDMA)

  The BCDMA moves data described by Transfer Request (TR) descriptors that
  software places on a ring per channel. The driver writes the channel and
  ring registers directly and uses no TISCI resource manager. Each ring has
  its own GIC SPI, so the ring interrupts are described with an
  interrupt-map keyed by the ring index. The ring-to-SPI table is not in
  the TRM; it follows the TI vendor devicetree.

  Channel numbers use one index space shared with the rings and with the
  interrupt-map child specifier:

    0-127    split TX/RX channels that serve the PDMA peripherals
             (CHANRT index)
    128-143  block-copy (memory to memory) channels; the CHANRT and ring
             index is the channel number, block-copy channel n is 128 + n

  A DMA specifier has two cells, the channel number and the ASEL (address
  space select, TRM 11.3.2.4.3) used for the rings, descriptors and data of
  that channel. ASEL 14 and 15 route the transfers through the A53 ACP so
  they are coherent with the CPU caches (TRM 3.5).

  A split channel pairs with its PDMA peer through CHANRT_CTL.AUTOPAIR, so
  the specifier carries no PSI-L thread. The McASP endpoints use the rings
  48-53 of the interrupt-map. The vendor devicetree gives each McASP
  instance and direction a PSI-L thread (in parentheses, TX threads have
  bit 15 set; the RX ones are in the PDMA_MCASP range of TRM Table 4-81)
  and no channel number: the numbering below follows the ring order and
  only McASP0 (channels 48 and 49) ran on hardware. The driver sets ACC32
  and BURST of the PDMA static TR for the channels 48-53, the only PDMA
  endpoints it serves, because the DMA API has no field for them:

    McASP0 tx / rx   <&main_bcdma 49 0> (0xc500)  <&main_bcdma 48 0> (0x4500)
    McASP1 tx / rx   <&main_bcdma 51 0> (0xc501)  <&main_bcdma 50 0> (0x4501)
    McASP2 tx / rx   <&main_bcdma 53 0> (0xc502)  <&main_bcdma 52 0> (0x4502)

compatible: "ti,am62l-bcdma"

include: [dma-controller.yaml, interrupt-nexus.yaml]

properties:
  reg:
    required: true
    description: |
      Global configuration (gcfg), split channel realtime (chanrt),
      block-copy channel realtime (bchanrt) and ring realtime (ringrt)
      regions.

  reg-names:
    required: true

  "#address-cells":
    required: true
    const: 0

  "#interrupt-cells":
    const: 1

  "#dma-cells":
    const: 2

  dma-channels:
    required: true
    const: 144

  dma-buf-addr-alignment:
    const: 64

  ti,asel:
    type: int
    default: 0
    enum: [0, 14, 15]
    description: |
      ASEL of the block-copy channels when the DMA configuration does not
      select one. 0 is the default address space; 14 and 15 go through the
      A53 ACP.

dma-cells:
  - channel_id
  - asel

examples:
  - |
    #include <zephyr/dt-bindings/interrupt-controller/arm-gic.h>

    main_bcdma: dma-controller@485c4000 {
      compatible = "ti,am62l-bcdma";
      reg = <0x485c4000 0x4000>, <0x48800000 0x80000>,
            <0x48880000 0x10000>, <0x47000000 0x200000>;
      reg-names = "gcfg", "chanrt", "bchanrt", "ringrt";
      #address-cells = <0>;
      #interrupt-cells = <1>;
      interrupt-map = <128 &gic 0 GIC_SPI 516 IRQ_TYPE_LEVEL IRQ_DEFAULT_PRIORITY>;
      #dma-cells = <2>;
      dma-channels = <144>;
      dma-buf-addr-alignment = <64>;
    };
```
