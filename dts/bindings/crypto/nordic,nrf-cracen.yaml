## dts/bindings/crypto/nordic,nrf-cracen.yaml
```yaml
# Copyright (c) 2026 Embeint Pty Ltd
# SPDX-License-Identifier: Apache-2.0

description: |
  Nordic CRACEN cryptographic accelerator

  The CRACEN peripheral contains the CryptoMaster (symmetric cryptography DMA
  engine), the RNG (true random number generator) and the PKE/IKG (public key
  engine) modules. The device instance owns initialisation of the nrfx CRACEN
  library, and arbitrates access to the hardware between its users, such as
  the "nordic,nrf-cracen-ctrdrbg" entropy driver, which must be a child node.

compatible: "nordic,nrf-cracen"

include: base.yaml

properties:
  reg:
    required: true
    description: |
      CRACEN wrapper and CRACENCORE register blocks.

  reg-names:
    required: true
    enum:
      - "wrapper"
      - "core"
    description: |
      Must be "wrapper" and "core".

  interrupts:
    required: true
```

## dts/bindings/crypto/nxp,lpc-sha.yaml
```yaml
# SPDX-FileCopyrightText: Copyright The Zephyr Project Contributors
# SPDX-License-Identifier: Apache-2.0

description: |
  NXP LPC SHA engine.

  The block computes SHA-1 and SHA-256. Only SHA-256 is reachable through the
  Zephyr crypto API, which has no SHA-1 algorithm.

compatible: "nxp,lpc-sha"

include: base.yaml

properties:
  reg:
    required: true
```

## dts/bindings/dac/espressif,esp32-dac.yaml
```yaml
# Copyright (c) 2022 Espressif Systems (Shanghai) Co., Ltd.
# SPDX-License-Identifier: Apache-2.0

description: |
    ESP32 Digital to Analog converter (DAC)

    Part of the RTC low-power domain and belongs to the SENSE
    peripherals set. RTC peripherals has GPIOs controlled by the
    RTCIO mux, which is separated from the main IO mux.

    Two GPIO pads can only be connected to the DAC peripheral.

    Pad mapping uses a zero-based dac-channel-id.

    ESP32 pads
      - GPIO25 uses dac-channel-id 0
      - GPIO26 uses dac-channel-id 1

    ESP32-S2 pads
      - GPIO17 uses dac-channel-id 0
      - GPIO18 uses dac-channel-id 1

    ESP32-S31 pads
      - GPIO4 uses dac-channel-id 0
      - GPIO5 uses dac-channel-id 1

    ESP32 and ESP32-S2 resolution is 8 bits. ESP32-S31 resolution is
    12 bits. A buffered ESP32-S31 channel uses the wide output swing:
    codes 248 to 3848 are linear, and codes outside that range may
    saturate. The driver still accepts codes 0 through 4095.

    To enable the DAC peripheral it must be enabled in the board
    dts, or in subsequent overlay file.

          &dac {
              status = "okay";
          };

    To specify the DAC channel to use, dts overlay must include
    properties 'dac-channel-id', which uses zero based channel index.
    Variable 'dac-resolution' must be also specified. Use 8 for ESP32
    and ESP32-S2, and 12 for ESP32-S31.

          / {
            zephyr,user {
              dac = <&dac>;
              dac-channel-id = <0>;
              dac-resolution = <8>;
            };
          };

    NOTE: The DAC peripheral outputs are fixed to gpio pads, therefore
          it does not need to be controlled by the pinctrl node.

compatible: "espressif,esp32-dac"

include: [dac-controller.yaml]

properties:

  "#io-channel-cells":
    const: 1

io-channel-cells:
  - output
```

## dts/bindings/dac/infineon,hppass-csg-dac.yaml
```yaml
# SPDX-FileCopyrightText: Copyright (c) 2026 Infineon Technologies AG,
# SPDX-FileCopyrightText: or an affiliate of Infineon Technologies AG. All rights reserved.
#
# SPDX-License-Identifier: Apache-2.0

description: |
  Infineon HPPASS CSG DAC.

  Represents the 10-bit, 30 Msps DAC inside a single CSG slice.  This node
  must be a child of an "infineon,hppass-csg" CSG MFD parent.

  This DAC has no external output pin.  Its output is wired internally to
  the paired comparator's negative input, and may optionally be
  routed to the SAR ADC for observation through CSG_CTRL.VDAC_OUT_SEL.
  The paired comparator need not be enabled when the DAC is used only
  for SAR observation. On MCPASS v3 (PSC3M6), the CSG parent powers the
  group containing each enabled comparator or DAC.

  Resolution is fixed at 10 bits.  Only direct-write mode is supported
  through the standard Zephyr DAC API.  Advanced modes (buffered, slope,
  LUT) are not yet supported.

compatible: "infineon,hppass-csg-dac"

include: [dac-controller.yaml]

properties:
  reg:
    type: array
    required: true
    description: |
      Register region covering this slice's DAC_CFG, DAC_VAL_A, DAC_VAL_B
      and DAC_VAL within the CSG block.  Slice index is derived at
      compile time from the offset divided by the CSG slice stride.

  interrupts:
    description: |
      DAC interrupt line for this slice.  DAC interrupt only occurs in
      advanced modes: HW start trigger, SLOPE/LUT done, or BUFFERED/HYSTERETIC
      buffer empty.

  deglitch:
    type: int
    default: 0
    min: 0
    max: 7
    description: |
      DAC output deglitch length in HPPASS clock cycles
      (DAC_CFG.DAC_DEGLITCH, 0-7).  Glitches shorter than this width are
      filtered out on the DAC analog output before it is driven into the
      paired comparator's negative input.

  initial-value:
    type: int
    min: 0
    max: 1023
    description: |
      Optional 10-bit value (0..1023) to write into SLICE[s].DAC_VAL at
      driver init, before the HPPASS AC enters its locked state. On MCPASS v3,
      the same value is loaded into DAC_VAL_A before the firmware start.
      When omitted, the initial value is 0
      (~0 V output).  Useful when the paired comparator must see a
      stable mid-rail or other reference before the application has a
      chance to call dac_write_value().

  "#io-channel-cells":
    const: 1

io-channel-cells:
  - output
```

## dts/bindings/dac/infineon,hppass-dac-v3.yaml
```yaml
# SPDX-FileCopyrightText: Copyright (c) 2026 Infineon Technologies AG,
# SPDX-FileCopyrightText: or an affiliate of Infineon Technologies AG. All rights reserved.
#
# SPDX-License-Identifier: Apache-2.0

description: |
  Infineon MCPASS v3 standalone 12-bit DAC with an integrated output buffer.
  Each node represents one of the two independent hardware DAC instances
  and exposes channel 0. These are separate from the 10-bit CSG DACs.

  The driver supports direct writes to the buffered pin output. Channel
  configuration must select 12-bit resolution and zephyr,buffered.
  Unbuffered output, zephyr,internal, waveform generation and the companion
  comparator are not supported. The reference is fixed to VDDA; external
  reference selection is not supported. The driver loads factory trims from SFLASH.

compatible: "infineon,hppass-dac-v3"

include: dac-controller.yaml

properties:
  reg:
    required: true

  "#io-channel-cells":
    const: 1

  power-mode:
    type: int
    default: 3
    enum: [0, 1, 3]
    description: |
      Output buffer power mode: 0 supports up to 100 uA and 1 supports up
      to 1 mA, both intended for internal loads. Mode 3 supports up to
      10 mA for static loads on the output pin and is the default for
      buffered pin output. Mode 2 is not supported.

io-channel-cells:
  - output
```

## dts/bindings/dac/ti,am13-cmpss-dac.yaml
```yaml
# Copyright (c) 2026 Texas Instruments Incorporated
# SPDX-License-Identifier: Apache-2.0

description: |
  Texas Instruments AM13 CMPSS low DAC (DACL) used as a general purpose DAC.

  Each node is one CMPSS instance exposing a single 12-bit channel (channel 0).
  The DAC output range is VSSA to VDDA (fixed, not selectable). The output
  voltage is ((value + 1) * VDDA) / 4096.

compatible: "ti,am13-cmpss-dac"

include: dac-controller.yaml

properties:
  reg:
    required: true

  ti,sysctl:
    type: phandle
    required: true
    description: |
      SYSCTL syscon node. The CMPSSCTL register that routes the low DAC output
      to the device pin lives there, not in the CMPSS register block.

  ti,ldacouten-bit:
    type: int
    required: true
    enum: [0, 1]
    description: |
      Bit position of this instance's LDACOUTEN field in SYSCTL.CMPSSCTL.
      0 for CMPSS2 (CMP2LDACOUTEN), 1 for CMPSS3 (CMP3LDACOUTEN).

  ti,pwren-bit:
    type: int
    required: true
    description: |
      Bit position of this instance's PWREN bit field in SYSCTL.PWREN_MCPERIPH.
      12 for CMPSS2 (cmpss2), 13 for CMPSS3 (cmpss3).

  ti,reset-bit:
    type: int
    required: true
    description: |
      Bit position of this instance's RSTCTL bit field in SYSCTL.RSTCTL Registers.
      12 for CMPSS2 (cmpss2), 13 for CMPSS3 (cmpss3).

  "#io-channel-cells":
    const: 1

io-channel-cells:
  - output
```

## dts/bindings/disk/zephyr,usb-msc-disk.yaml
```yaml
# Copyright (c) 2026 Espressif Systems (Shanghai) Co., Ltd.
# SPDX-License-Identifier: Apache-2.0

description: |
  Disk exposing a USB mass storage device attached to a USB host
  controller. The node is a child of the USB host controller node, and
  with CONFIG_USB_MSC_DISK_INITIALIZE_AT_BOOT that controller is
  initialized and enabled at boot, so no USB host code is needed in the
  application.

  The enabled nodes of this compatible are matched, in instance order, to
  the mass storage devices the host stack serves. An attached device takes
  the lowest free index, so with more than one device the disk a device
  appears as depends on the order the devices were attached in. Only the
  first logical unit of a device is used.

compatible: "zephyr,usb-msc-disk"

include: [base.yaml]

properties:
  disk-name:
    type: string
    required: true
    description: |
      Disk name.
```

## dts/bindings/display/chipone,co5300-mspi.yaml
```yaml
# Copyright (c) 2026 Muhammad Waleed Badar
# SPDX-License-Identifier: Apache-2.0

description: Chipone CO5300 display controller on MSPI bus

compatible: "chipone,co5300"

include: ["mspi-device.yaml", "chipone,co5300-common.yaml"]

properties:
  pixel-format:
    type: string
    required: true
    description: |
      Initial Pixel format of this controller's output data.
    enum:
      - "bgr24"
      - "rgb565"

  chunk-size:
    type: int
    default: 4096
    description: |
      Chunk size in bytes to be used for data transfers.

examples:
  - |
    co5300_display: co5300-display@0 {
      /* ... */

      pixel-format = "rgb565";
    };
```

## dts/bindings/display/chipone,co5300-spi.yaml
```yaml
# Copyright (c) 2026 Muhammad Waleed Badar
# SPDX-License-Identifier: Apache-2.0

description: |
  Chipone CO5300 display controller on SPI bus.

  The CO5300's SPI protocol uses opcode/address framing: a fixed
  instruction byte (0x02) followed by a 3-byte address encoding the DCS
  command ({8'h00, CMD[7:0], 8'h00}), followed by the command's
  parameters or pixel data, all shifted out over a single data line.

compatible: "chipone,co5300"

include: ["spi-device.yaml", "chipone,co5300-common.yaml"]

properties:
  pixel-format:
    type: string
    required: true
    description: |
      Initial Pixel format of this controller's output data.
    enum:
      - "bgr24"
      - "rgb565"

examples:
  - |
    co5300_display: co5300-display@0 {
      /* ... */

      pixel-format = "rgb565";
    };
```

## dts/bindings/display/espressif,esp32-lcd-cam-rgb.yaml
```yaml
# Copyright (c) 2026 Gustavo Reis
# SPDX-License-Identifier: Apache-2.0

description: |
  ESP32 LCD-CAM parallel RGB (DPI / dot-clock) display controller.

  This node must be a child of the "espressif,esp32-lcd-cam" controller node
  and includes a "display-timings" child node with compatible
  "zephyr,panel-timing".

compatible: "espressif,esp32-lcd-cam-rgb"

include: [lcd-controller.yaml]

properties:
  data-bus-width:
    type: int
    default: 16
    enum:
      - 8
      - 16
    description: |
      Parallel RGB output data bus width in bits. Default is 16-bit (RGB565).

  backlight-gpios:
    type: phandle-array
    description: |
      Optional GPIO used to control the display panel backlight. The driver
      initializes this GPIO to active state when blanking is turned off.

  disp-gpios:
    type: phandle-array
    description: |
      Optional GPIO used to control the panel display enable (DISP / STBYB)
      pin.

  reset-gpios:
    type: phandle-array
    description: |
      Optional GPIO connected to the panel hardware reset line.

  pclk-idle-high:
    type: boolean
    description: |
      Set the pixel clock (PCLK) level high during the idle phase. By default
      the pixel clock idles low.

  de-mode-only:
    type: boolean
    description: |
      Suppress HSYNC output during the vertical porch region (pure DE mode).
      By default HSYNC is also output in the vertical porch region (HV+DE mode).

  invert-byte-order:
    type: boolean
    description: |
      Swap adjacent bytes of DMA pixel data before outputting to the RGB bus.

  invert-bit-order:
    type: boolean
    description: |
      Reverse the bit order of DMA pixel data before outputting to the RGB bus.

examples:
  - |
    &lcd_cam {
      status = "okay";
      pinctrl-0 = <&lcd_cam_default>;
      pinctrl-names = "default";

      lcd_rgb: lcd-rgb {
        compatible = "espressif,esp32-lcd-cam-rgb";
        width = <480>;
        height = <272>;
        pixel-format = <PANEL_PIXEL_FORMAT_RGB_565>;
        data-bus-width = <16>;
        backlight-gpios = <&gpio0 2 GPIO_ACTIVE_HIGH>;
        status = "okay";

        display-timings {
          compatible = "zephyr,panel-timing";
          clock-frequency = <12000000>;
          hsync-len = <1>;
          hback-porch = <42>;
          hfront-porch = <20>;
          vsync-len = <10>;
          vback-porch = <12>;
          vfront-porch = <4>;
          hsync-active = <0>;
          vsync-active = <0>;
          de-active = <1>;
          pixelclk-active = <1>;
        };
      };
    };
```

## dts/bindings/display/focuslcds,mw405.yaml
```yaml
# Copyright (c) 2026 Analog Devices, Inc.
# SPDX-License-Identifier: Apache-2.0

description: Focus-LCDs E43GB-I-MW405-C Panel

compatible: "focuslcds,mw405"

include: ilitek,ili9806e.yaml
```

## dts/bindings/display/ilitek,ili9806e.yaml
```yaml
# Copyright (c) 2024 Renesas Electronics Corporation
# Copyright (c) 2026 Analog Devices, Inc.
# SPDX-License-Identifier: Apache-2.0

title: Ilitek ILI9806E display controller

description: |
   The Ilitek ILI9806E is a 16.7M colors TFT-LCD controller
   with a maximum 480RGBx864 resolution.

compatible: "ilitek,ili9806e"

include: ilitek,ili98xx-dsi.yaml

properties:
  init-seq-name:
    enum:
     - rtkmipilcdb00000be
     - mw405
```

## dts/bindings/display/ilitek,ili9881c.yaml
```yaml
# SPDX-FileCopyrightText: 2026 Renesas Electronics Corporation
# SPDX-FileCopyrightText: (c) 2026 Analog Devices, Inc.
# SPDX-License-Identifier: Apache-2.0

title: ILI9881C display controller

description: |
   The Ilitek ILI9881C is a 16.7M colors TFT-LCD controller
   with a maximum 720RGBx1280 resolution.

compatible: "ilitek,ili9881c"

include: ilitek,ili98xx-dsi.yaml

properties:
  init-seq-name:
    enum:
      - "rtkapplcdms02001be"
```
