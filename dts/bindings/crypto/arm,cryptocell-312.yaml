## dts/bindings/crypto/arm,cryptocell-312.yaml
```yaml
# Copyright (c) 2018, 2020 Nordic Semiconductor ASA
# SPDX-License-Identifier: Apache-2.0

description: ARM TrustZone CryptoCell 312

compatible: "arm,cryptocell-312"

include: base.yaml

properties:
    reg:
      required: true

    interrupts:
      required: true
```

## dts/bindings/crypto/atmel,ataes132a.yaml
```yaml
# Copyright (c) 2022, Kumar Gala <galak@kernel.org>
#
# SPDX-License-Identifier: Apache-2.0

description: Atmel ATAES132A 32K AES Serial EEPROM

compatible: "atmel,ataes132a"

include: [i2c-device.yaml]
```

## dts/bindings/crypto/bflb,sec-eng-aes.yaml
```yaml
description: Bouffalo Lab SEC Engine AES hardware accelerator

compatible: "bflb,sec-eng-aes"

include: base.yaml

properties:
  reg:
    required: true

  reg-names:
    type: string-array
    required: true
    description: Register names must include "aes" and "sec_eng".

  interrupts:
    required: true
```

## dts/bindings/crypto/bflb,sec-eng-sha.yaml
```yaml
description: Bouffalo Lab SEC Engine SHA hardware accelerator

compatible: "bflb,sec-eng-sha"

include: base.yaml

properties:
  reg:
    required: true

  reg-names:
    type: string-array
    required: true
    description: Register names must include "sha" and "sec_eng".

  interrupts:
    required: true
```

## dts/bindings/crypto/bflb,sec-eng-trng.yaml
```yaml
description: Bouffalo Lab SEC Engine TRNG (True Random Number Generator)

compatible: "bflb,sec-eng-trng"

include: base.yaml

properties:
  reg:
    required: true

  interrupts:
    required: true
```

## dts/bindings/crypto/espressif,esp32-aes.yaml
```yaml
# Copyright (c) 2025 Espressif Systems (Shanghai) Co., Ltd.
# SPDX-License-Identifier: Apache-2.0

description: |
  Espressif ESP32 family AES Hardware Accelerator

  The AES peripheral provides hardware acceleration for AES encryption
  and decryption operations. It supports:
  - ECB, CBC, CTR modes (SoC dependent)
  - 128, 192, 256-bit key lengths
  - XTS mode on selected SoCs (S2, S3, C3, C6, H2)

compatible: "espressif,esp32-aes"

include: base.yaml
```

## dts/bindings/crypto/espressif,esp32-sha.yaml
```yaml
# Copyright (c) 2025 Espressif Systems (Shanghai) Co., Ltd.
# SPDX-License-Identifier: Apache-2.0

description: Espressif ESP32 SHA Hardware Accelerator

compatible: "espressif,esp32-sha"

include: base.yaml
```

## dts/bindings/crypto/infineon,mxcrypto-crypto.yaml
```yaml
# SPDX-FileCopyrightText: Copyright (c) 2026 Infineon Technologies AG,
# SPDX-FileCopyrightText: or an affiliate of Infineon Technologies AG. All rights reserved.
#
# SPDX-License-Identifier: Apache-2.0

description: |
  Infineon MXCRYPTO crypto engine (AES / SHA).

  This is a child of an "infineon,mxcrypto" node and shares its register
  base address and access mutex with the sibling TRNG function.

compatible: "infineon,mxcrypto-crypto"

include: base.yaml
```

## dts/bindings/crypto/infineon,mxcryptolite-crypto.yaml
```yaml
# SPDX-FileCopyrightText: Copyright (c) 2026 Infineon Technologies AG,
# SPDX-FileCopyrightText: or an affiliate of Infineon Technologies AG. All rights reserved.
#
# SPDX-License-Identifier: Apache-2.0

description: |
  Infineon MXCRYPTOLITE crypto engine (AES / SHA-256).

  This is a child of an "infineon,mxcryptolite" node and shares its register
  base address and access mutex with the sibling TRNG function.

compatible: "infineon,mxcryptolite-crypto"

include: base.yaml
```

## dts/bindings/crypto/infineon,mxcryptolite-trng.yaml
```yaml
# SPDX-FileCopyrightText: Copyright (c) 2026 Infineon Technologies AG,
# SPDX-FileCopyrightText: or an affiliate of Infineon Technologies AG. All rights reserved.
#
# SPDX-License-Identifier: Apache-2.0

description: |
  Infineon MXCRYPTOLITE True Random Number Generator.

  This is a child of an "infineon,mxcryptolite" node and shares its register
  base address with the sibling crypto (AES / SHA-256) function.

compatible: "infineon,mxcryptolite-trng"

include: base.yaml
```

## dts/bindings/crypto/intel,adsp-sha.yaml
```yaml
# Copyright (c) 2022, Intel Corporation
# SPDX-License-Identifier: Apache-2.0

description: Intel ADSP Crypto SHA accelerator.

compatible: "intel,adsp-sha"

include: base.yaml

properties:
  reg:
    required: true
```

## dts/bindings/crypto/intel,sha.yaml
```yaml
# Copyright (c) 2022, Intel Corporation
# SPDX-License-Identifier: Apache-2.0

description: Intel Crypto SHA accelerator.

compatible: "intel,sha"

include: base.yaml

properties:
    reg:
      required: true
```

## dts/bindings/crypto/ite,it51xxx-sha.yaml
```yaml
# Copyright (c) 2025 ITE Corporation
# SPDX-License-Identifier: Apache-2.0

description: ITE IT51XXX Crypto SHA accelerator.

compatible: "ite,it51xxx-sha"

include: base.yaml

properties:
  reg:
    required: true
```

## dts/bindings/crypto/ite,it8xxx2-sha-v2.yaml
```yaml
# Copyright (c) 2024, ITE Corporation
# SPDX-License-Identifier: Apache-2.0

description: ITE IT8XXX2 Crypto SHA accelerator V2.

compatible: "ite,it8xxx2-sha-v2"

include: base.yaml

properties:
  reg:
    required: true
```

## dts/bindings/crypto/ite,it8xxx2-sha.yaml
```yaml
# Copyright (c) 2023, ITE Corporation
# SPDX-License-Identifier: Apache-2.0

description: ITE IT8XXX2 Crypto SHA accelerator.

compatible: "ite,it8xxx2-sha"

include: base.yaml

properties:
  reg:
    required: true
```

## dts/bindings/crypto/lowrisc,opentitan-aes.yaml
```yaml
# Copyright (c) 2026, Bana Tawalbeh
# SPDX-License-Identifier: Apache-2.0

description: OpenTitan AES Hardware Accelerator

compatible: "lowrisc,opentitan-aes"

include: [base.yaml]
```

## dts/bindings/crypto/microchip,aes-g1-crypto.yaml
```yaml
# Copyright (C) 2025-2026 Microchip Technology Inc. and its subsidiaries
#
# SPDX-License-Identifier: Apache-2.0
#

title: Microchip G1 AES Controller Driver

description: |
  Microchip SAM Advanced Encryption Standard (AES).

  Group G1 AES driver supports following hardware peripherals:
    - module name="AES" id="6149" version="702"

compatible: "microchip,aes-g1-crypto"

include: [base.yaml]

properties:
  reg:
    required: true

  clocks:
    required: true
```

## dts/bindings/crypto/microchip,aes-g1.yaml
```yaml
# Copyright (C) 2025-2026 Microchip Technology Inc. and its subsidiaries
#
# SPDX-License-Identifier: Apache-2.0
#

title: Microchip AES Accelerator G1

description: |
  Microchip AES (Advanced Encryption Standard) Accelerator G1.

  AES device Group G1 supports following hardware peripherals:
    - module name="AES" id="6149" version="702"

compatible: "microchip,aes-g1"

include: [base.yaml]

properties:
  reg:
    required: true

  clocks:
    required: true
```

## dts/bindings/crypto/microchip,sha-g1-crypto.yaml
```yaml
# Copyright (C) 2025-2026 Microchip Technology Inc. and its subsidiaries
#
# SPDX-License-Identifier: Apache-2.0
#

title: Microchip G1 SHA Controller Driver

description: |
  Microchip SAM Secure Hash Algorithm (SHA).

  Group G1 SHA driver supports following hardware peripherals:
    - module name="SHA" id="6156" version="700"

compatible: "microchip,sha-g1-crypto"

include: [base.yaml]

properties:
  reg:
    required: true

  clocks:
    required: true
```

## dts/bindings/crypto/microchip,xec-symcr.yaml
```yaml
# Copyright (c) 2023 Microchip Technology Inc.
# SPDX-License-Identifier: Apache-2.0

description: Microchip XEC symmetric crypto (AES/Hash) accelerator.

compatible: "microchip,xec-symcr"

include:
  - name: base.yaml
  - name: microchip,dmec-ecia-girq.yaml

properties:
  reg:
    required: true

  pcr:
    type: int
    required: true
    description: |
      Integer encoding the PCR register index and bit position
      of this Crypto controller.
```

## dts/bindings/crypto/nordic,nrf-cc310-sw.yaml
```yaml
# Copyright (c) 2020, Nordic Semiconductor ASA
# SPDX-License-Identifier: Apache-2.0

description: |
  Stub access to cryptocell via platform driver

  Non-secure configurations can use this compatible to declare
  devicetree nodes which access the CC310 via callbacks into secure
  code.

compatible: "nordic,nrf-cc310-sw"

include: base.yaml

properties:
  label:
    required: true
```

## dts/bindings/crypto/nordic,nrf-cc310.yaml
```yaml
# Copyright (c) 2018, Nordic Semiconductor ASA
# SPDX-License-Identifier: Apache-2.0

description: Nordic Control Interface for ARM TrustZone CryptoCell 310

compatible: "nordic,nrf-cc310"

include: base.yaml

properties:
  reg:
    required: true
```

## dts/bindings/crypto/nordic,nrf-cc312-sw.yaml
```yaml
# Copyright (c) 2021, Nordic Semiconductor ASA
# SPDX-License-Identifier: Apache-2.0

description: |
  Stub access to cryptocell via platform driver

  Non-secure configurations can use this compatible to declare
  devicetree nodes which access the CC312 via callbacks into secure
  code.

compatible: "nordic,nrf-cc312-sw"

include: base.yaml

properties:
  label:
    required: true
```

## dts/bindings/crypto/nordic,nrf-cc312.yaml
```yaml
# Copyright (c) 2018, 2020 Nordic Semiconductor ASA
# SPDX-License-Identifier: Apache-2.0

description: Nordic Control Interface for ARM TrustZone CryptoCell 312

compatible: "nordic,nrf-cc312"

include: base.yaml

properties:
  reg:
    required: true
```

## dts/bindings/crypto/nordic,nrf-ccm.yaml
```yaml
# Copyright (c) 2022 Nordic Semiconductor ASA
# SPDX-License-Identifier: Apache-2.0

description: Nordic nRF family CCM (AES CCM mode encryption)

compatible: "nordic,nrf-ccm"

include: base.yaml

properties:
  reg:
    required: true

  interrupts:
    required: true

  length-field-length-8-bits:
    type: boolean
    description: |
      Indicates whether the CCM peripheral supports the extended length
      (8 bits) of the LENGTH field in encrypted/decrypted packets.
      If not set, only the default length (5 bits) is supported.

  headermask-supported:
    type: boolean
    description: |
      Indicates whether the CCM peripheral supports the headermask register to
      set the PDU header bitmask used to derive the additional authentication
      data (AAD) in CCM for Bluetooth Low Energy ACL, BIS and CIS PDUs.
```
