## dts/bindings/crypto/nordic,nrf-ecb.yaml
```yaml
# Copyright (c) 2020 Nordic Semiconductor ASA
# SPDX-License-Identifier: Apache-2.0

description: Nordic ECB (AES electronic codebook mode encryption)

compatible: "nordic,nrf-ecb"

interrupt-source: true

include: base.yaml

properties:
  reg:
    required: true
```

## dts/bindings/crypto/nordic,nrf52-cc310-aes.yaml
```yaml
# Copyright (c) 2025 GARDENA GmbH
# SPDX-License-Identifier: Apache-2.0

description: Nordic CryptoCell 310 (AES electronic codebook mode encryption)

compatible: "nordic,nrf52-cc310-aes"

include: [arm, cryptocell-310.yaml]
```

## dts/bindings/crypto/nuvoton,npcx-sha.yaml
```yaml
# Copyright (c) 2022 Nuvoton Technology Corporation.
# SPDX-License-Identifier: Apache-2.0

description: NPCX Crypto SHA accelerator.

compatible: "nuvoton,npcx-sha"

include: base.yaml

properties:
  reg:
    required: true

  context-buffer-size:
    type: int
    required: true
    description: |
      Size of the pre-allocated buffer for the SHA ROM API to store the
      intermdiate computation result and final digest.
```

## dts/bindings/crypto/nxp,els.yaml
```yaml
# Copyright 2025 NXP
# SPDX-License-Identifier: Apache-2.0

description: NXP EdgeLock Secure Subsystem

compatible: "nxp,els"

include: base.yaml

properties:
  reg:
    required: true
```

## dts/bindings/crypto/nxp,mcux-dcp.yaml
```yaml
# Copyright (c) 2023, Basalte bv
# SPDX-License-Identifier: Apache-2.0

description: NXP Data Co-Processor (DCP) Crypto accelerator.

compatible: "nxp,mcux-dcp"

include: base.yaml

properties:
  reg:
    required: true
```

## dts/bindings/crypto/nxp,s32-crypto-hse-mu.yaml
```yaml
# Copyright 2025 NXP
# SPDX-License-Identifier: Apache-2.0

description: |
  NXP S32 HSE Messaging Unit. The Messaging Unit (MU) module facilitates communication between
  HSE processor core and application processor core (e.g any of RTU core) on a chip.
  Processors side-A inside the MU is accessible only by HSE core, whether side-B is accessible
  by application core. To enable a dedicated MU instance for Crypto operation:
    &mub0 {
      status = "okay";
    };

compatible: "nxp,s32-crypto-hse-mu"

include: base.yaml

properties:
  reg:
    required: true
```

## dts/bindings/crypto/pufsecurity,otp.yaml
```yaml
# Copyright (c) 2024, Rapid Silicon
# SPDX-License-Identifier: Apache-2.0

description: |
  PUF security IP PUFcc also contains the one time programmable
  memory region. That region can be accessed using this driver.

compatible: "pufsecurity,otp"

include: [base.yaml]
```

## dts/bindings/crypto/pufsecurity,pufcc.yaml
```yaml
# Copyright (c) 2024, Rapid Silicon
# SPDX-License-Identifier: Apache-2.0

description: |
  PUF security IP PUFcc can be used for the authentication and decryption
  of the secure images under several authentication and encryption algorithms.
  PUFcc has in built DMA to decrypt the encrypted images on the fly.

compatible: "pufsecurity,pufcc"

include: [base.yaml]

properties:
  reg:
    required: true

  interrupts:
    required: true
```

## dts/bindings/crypto/raspberrypi,pico-sha256.yaml
```yaml
# Copyright (c) 2025 TOKITA Hiroshi
# SPDX-License-Identifier: Apache-2.0

description: Raspberry Pi Pico SHA-256 accelerator

compatible: "raspberrypi,pico-sha256"

include: base.yaml

properties:
  reg:
    required: true
```

## dts/bindings/crypto/realtek,rts5912-sha.yaml
```yaml
# SPDX-License-Identifier: Apache-2.0
#
# Copyright (c) 2025 Realtek Semiconductor Corporation, SIBG-SD7
#

description: Realtek RTS5912 Crypto SHA accelerator.

compatible: "realtek,rts5912-sha"

include: base.yaml

properties:
  reg:
    required: true

  reg-names:
    type: string-array
    required: true
```

## dts/bindings/crypto/renesas,smartbond-crypto.yaml
```yaml
# Copyright (c) 2023 Renesas Electronics Corporation
# SPDX-License-Identifier: Apache-2.0

include: base.yaml

description: Renesas SmartBond(tm) CRYPTO

compatible: "renesas,smartbond-crypto"

properties:
  reg:
    required: true

  interrupts:
    required: true
```

## dts/bindings/crypto/sifli,sf32lb-crypto.yaml
```yaml
# Copyright (c) 2025 SiFli Technologies(Nanjing) Co., Ltd
# SPDX-License-Identifier: Apache-2.0

description: SiFli SF32LB Series Crypto Accelerator (AES/HASH)

compatible: "sifli,sf32lb-crypto"

include: base.yaml

properties:
  reg:
    required: true

  interrupts:
    required: true

  clocks:
    required: true
```

## dts/bindings/crypto/silabs,gecko-semailbox.yaml
```yaml
# Copyright (c) 2021 Safran Passenger Innovations Germany GmbH
# SPDX-License-Identifier: Apache-2.0

title: Silicon Labs Series 2 SE (Secure Engine) Mailbox

description: |
  Mailbox interface for the Secure Engine on Silicon Labs Series 2 devices
  with Hardware Secure Element.

compatible: "silabs,gecko-semailbox"

include: base.yaml

properties:
  reg:
    required: true

  interrupts:
    required: true
```

## dts/bindings/crypto/silabs,si32-aes.yaml
```yaml
# Copyright (c) 2024 GARDENA GmbH
# SPDX-License-Identifier: Apache-2.0

description: Si32 AES node

compatible: "silabs,si32-aes"

include: base.yaml

properties:
  reg:
    required: true

  interrupts:
    required: true

  dmas:
    required: true

  dma-names:
    required: true
```

## dts/bindings/crypto/st,stm32-aes.yaml
```yaml
# Copyright (c) 2021, Thomas Stranger
# SPDX-License-Identifier: Apache-2.0

description: STM32 AES Accelerator

compatible: "st,stm32-aes"

include: st,stm32-crypto-common.yaml
```

## dts/bindings/crypto/st,stm32-cryp.yaml
```yaml
# Copyright (c) 2020, Markus Fuchs <markus.fuchs@de.sauter-bc.com>
# SPDX-License-Identifier: Apache-2.0

description: STM32 Cryptographic Accelerator

compatible: "st,stm32-cryp"

include: st,stm32-crypto-common.yaml
```

## dts/bindings/crypto/st,stm32-crypto-common.yaml
```yaml
# Copyright (c) 2020, Markus Fuchs <markus.fuchs@de.sauter-bc.com>
# SPDX-License-Identifier: Apache-2.0

include: [base.yaml, reset-device.yaml]

properties:
  reg:
    required: true

  interrupts:
    required: true

  clocks:
    required: true

  resets:
    required: true
```

## dts/bindings/crypto/st,stm32-saes.yaml
```yaml
# Copyright (c) 2026 Vossloh AG
# SPDX-License-Identifier: Apache-2.0

description: STM32 Secure AES co-processor

compatible: "st,stm32-saes"

include: st,stm32-crypto-common.yaml
```

## dts/bindings/crypto/st,stm32l4-aes.yaml
```yaml
# Copyright (c) 2024, Lucas Dietrich
# SPDX-License-Identifier: Apache-2.0

description: STM32L4 AES Accelerator

compatible: "st,stm32l4-aes"

include: st,stm32-crypto-common.yaml
```

## dts/bindings/crypto/ti,aes.yaml
```yaml
# Copyright (c) 2025 Linumiz GmbH
# SPDX-License-Identifier: Apache-2.0

description: |
  Texas Instruments MSPM0 G series Advanced Encryption Standard (AES) Engine
  This peripheral provides AES-128 encryption and decryption.

compatible: "ti,mspm0-aes"

include: base.yaml

properties:
  reg:
    required: true

  interrupts:
    required: true
```

## dts/bindings/crypto/ti,cc23x0-aes.yaml
```yaml
# Copyright (c) Copyright (c) 2024 BayLibre, SAS
# SPDX-License-Identifier: Apache-2.0

description: TI CC23X0 AES accelerator.

compatible: "ti,cc23x0-aes"

include: base.yaml

properties:
  reg:
    required: true

  interrupts:
    required: true

  dmas:
    description: |
      Optional CHA & CHB DMA specifiers. Each specifier will have a phandle
      reference to the DMA controller, the channel number, and the peripheral
      trigger source.

      Example for channels 4/5 with aestrga/aestrgb trigger sources:
        dmas = <&dma 4 3>, <&dma 5 4>;

      For ECB mode:
        - CHA moves plaintext data into buffer registers when AES operation starts,
        - CHB moves ciphertext to memory when AES completes.
      For CTR (also used by CCM):
        - CHA moves plaintext data into text XOR registers when AES operation starts,
        - CHB moves ciphertext to memory after CHA has written the last text XOR register.
      For CBC-MAC (also used by CCM):
        - CHA moves plaintext data into buffer when AES operation starts,
        - CHB is not used.

  dma-names:
    description: |
      Required if the dmas property exists. These must be "cha" and "chb"
      to match the dmas property.

      Example:
        dma-names = "cha", "chb";
```

## dts/bindings/crypto/ti,mspm0-aes.yaml
```yaml
# Copyright (c) 2026 Linumiz
# SPDX-License-Identifier: Apache-2.0

description: |
  Texas Instruments MSPM0 G series Advanced Encryption Standard (AES) Engine
  This peripheral provides AES-128 and AES-256 encryption and decryption.

compatible: "ti,mspm0-aes"

include: base.yaml

properties:
  reg:
    required: true

  interrupts:
    required: true
```

## dts/bindings/dac/adi,ad5529r.yaml
```yaml
# Copyright (c) 2026 Analog Devices, Inc.
# SPDX-License-Identifier: Apache-2.0

description: |
  Analog Devices AD5529R 16-channel, 16-bit voltage output DAC.

  The AD5529R is a high precision, low noise, 16-bit, 16-channel DAC with
  integrated reference (4.096V). It supports multiple output voltage ranges
  and communicates over SPI.

compatible: "adi,ad5529r"

include: [dac-controller.yaml, spi-device.yaml]

properties:
  "#io-channel-cells":
    const: 1

  device-id:
    type: int
    default: 0
    description: |
      Device address ID (0-7) for multi-device SPI configurations.
      Set by the AD0/AD1 pin strapping on the device. The default
      corresponds to both address pins left unconnected (logic low),
      which is the typical single-device configuration.

  output-range:
    type: string
    default: "range-0-5v"
    enum:
      - "range-0-5v"
      - "range-0-10v"
      - "range-0-20v"
      - "range-0-40v"
      - "range-pm-5v"
      - "range-pm-10v"
      - "range-pm-15v"
      - "range-pm-20v"
    description: |
      Default output voltage range for all channels.
      The default of range-0-5v matches the vendor-specified power-on
      reset value of the output range register. A different range would
      be needed if the application requires bipolar output or a wider
      voltage swing.

  reset-gpios:
    type: phandle-array
    description: |
      GPIO connected to the RESET pin of the device (active low).
      If not provided, software reset will be used during initialization.

  ldac-gpios:
    type: phandle-array
    description: |
      GPIO connected to the LDAC pin of the device (active low).
      The LDAC signal transfers data from input registers to output registers.
      If not provided, updates occur immediately on register write.

  clear-gpios:
    type: phandle-array
    description: |
      GPIO connected to the CLEAR pin of the device (active low).
      The CLEAR signal resets all DAC outputs to their clear code value.

io-channel-cells:
  - output

examples:
  - |
    #include <zephyr/dt-bindings/gpio/gpio.h>

    &spi1 {
        status = "okay";

        ad5529r: dac@0 {
            compatible = "adi,ad5529r";
            reg = <0>;
            spi-max-frequency = <50000000>;
            #io-channel-cells = <1>;
            output-range = "range-0-5v";
            reset-gpios = <&gpio0 1 GPIO_ACTIVE_LOW>;
            ldac-gpios = <&gpio0 2 GPIO_ACTIVE_LOW>;
        };
    };
```

## dts/bindings/dac/adi,ad5592-dac.yaml
```yaml
# Copyright (c) 2023 Grinn
# SPDX-License-Identifier: Apache-2.0

description: AD5592 DAC Controller

compatible: "adi,ad5592-dac"

include: dac-controller.yaml

properties:
  "#io-channel-cells":
    const: 1

io-channel-cells:
  - output
```

## dts/bindings/dac/adi,ad559x-dac.yaml
```yaml
# Copyright (c) 2023 Grinn
# SPDX-License-Identifier: Apache-2.0

description: AD559x DAC Controller

compatible: "adi,ad559x-dac"

include: dac-controller.yaml

properties:
  "#io-channel-cells":
    const: 1

  double-output-range:
    type: boolean
    description: |
      Default DAC output range is 0V to Vref.
      This option increases the range from 0V to 2 x Vref. Note that this
      requires VDD >= 2 x Vref.

io-channel-cells:
  - output
```
