## dts/bindings/comparator/infineon,autanalog-ptcomp-comp.yaml
```yaml
# Copyright (c) 2026 Infineon Technologies AG,
# or an affiliate of Infineon Technologies AG.
#
# SPDX-License-Identifier: Apache-2.0

description: |
  Infineon AutAnalog PTComp comparator.

  Each node represents one of the two comparators (Comp0 or Comp1) within
  a PTComp block. The comparator compares the voltage on the non-inverting
  input to the voltage on the inverting input and produces a digital output.

  Input routing is configured via positive-mux and negative-mux properties
  using the cy_en_autanalog_ptcomp_comp_mux_t values:
    0  = CTB0 Pin 1            8  = CTB0 OA0 output
    1  = CTB0 Pin 4            9  = CTB0 OA1 output
    2  = CTB0 Pin 6           10  = CTB1 OA0 output
    3  = CTB0 Pin 7           11  = CTB1 OA1 output
    4  = CTB1 Pin 1           12  = DAC0 (VREF0)
    5  = CTB1 Pin 4           13  = DAC1 (VREF1)
    6  = CTB1 Pin 6           14  = PRB OUT0 (VREF2)
    7  = CTB1 Pin 7           15  = PRB OUT1 (VREF3)
    16-23 = SAR/PTC GPIO Pin 0-7

  The parent node must have compatible "infineon,autanalog-ptcomp".

compatible: "infineon,autanalog-ptcomp-comp"

include: [base.yaml]

properties:
  reg:
    required: true
    description: |
      Comparator index within the PTComp block (0 or 1).

  power-mode:
    type: int
    required: true
    description: |
      Comparator power mode.
      Use IFX_AUTANALOG_PTCOMP_PWR_* constants from
      <dt-bindings/comparator/infineon-autanalog-ptcomp.h>.
        IFX_AUTANALOG_PTCOMP_PWR_OFF    (0) - Off
        IFX_AUTANALOG_PTCOMP_PWR_ULP    (1) - Ultra-low power (< 300nA, 7us)
        IFX_AUTANALOG_PTCOMP_PWR_LP     (2) - Low power (< 10uA, 1us)
        IFX_AUTANALOG_PTCOMP_PWR_NORMAL (3) - Normal (< 150uA, 0.1us)
    enum:
      - 0
      - 1
      - 2
      - 3

  hysteresis:
    type: boolean
    description: |
      Enable 30mV input hysteresis for the comparator.

  interrupt-mode:
    type: int
    default: 0
    description: |
      Edge detection mode for comparator interrupts.
      Use IFX_AUTANALOG_PTCOMP_INT_* constants from
      <dt-bindings/comparator/infineon-autanalog-ptcomp.h>.
        IFX_AUTANALOG_PTCOMP_INT_DISABLED     (0) - Disabled
        IFX_AUTANALOG_PTCOMP_INT_EDGE_RISING  (1) - Rising edge
        IFX_AUTANALOG_PTCOMP_INT_EDGE_FALLING (2) - Falling edge
        IFX_AUTANALOG_PTCOMP_INT_EDGE_BOTH    (3) - Both edges

  positive-mux:
    type: int
    required: true
    description: |
      Non-inverting (positive) input mux selector.
      Use IFX_AUTANALOG_PTCOMP_MUX_* constants from
      <dt-bindings/comparator/infineon-autanalog-ptcomp.h>, values 0-23.

  negative-mux:
    type: int
    required: true
    description: |
      Inverting (negative) input mux selector.
      Use IFX_AUTANALOG_PTCOMP_MUX_* constants from
      <dt-bindings/comparator/infineon-autanalog-ptcomp.h>, values 0-23.

  pp-input-source:
    type: int
    default: 0
    description: |
      Post-processing input source.
      Use IFX_AUTANALOG_PTCOMP_PP_SRC_* constants from
      <dt-bindings/comparator/infineon-autanalog-ptcomp.h>.
        IFX_AUTANALOG_PTCOMP_PP_SRC_DISABLED (0)
        IFX_AUTANALOG_PTCOMP_PP_SRC_COMP0    (1)
        IFX_AUTANALOG_PTCOMP_PP_SRC_COMP1    (2)
    enum: [0, 1, 2]

  pp-input-type:
    type: int
    default: 0
    description: |
      Post-processing edge/level sensing type.
      Use IFX_AUTANALOG_PTCOMP_PP_TYPE_* constants from
      <dt-bindings/comparator/infineon-autanalog-ptcomp.h>.
        IFX_AUTANALOG_PTCOMP_PP_TYPE_LEVEL        (0)
        IFX_AUTANALOG_PTCOMP_PP_TYPE_EDGE_RISING  (1)
        IFX_AUTANALOG_PTCOMP_PP_TYPE_EDGE_FALLING (2)
        IFX_AUTANALOG_PTCOMP_PP_TYPE_EDGE_BOTH    (3)
    enum: [0, 1, 2, 3]

  pp-count-mode:
    type: int
    default: 0
    description: |
      Post-processing counter mode.
      Use IFX_AUTANALOG_PTCOMP_PP_MODE_* constants from
      <dt-bindings/comparator/infineon-autanalog-ptcomp.h>.
        IFX_AUTANALOG_PTCOMP_PP_MODE_DIRECT (0) - Count events, reset on condition
        IFX_AUTANALOG_PTCOMP_PP_MODE_FRAME  (1) - Count events within a frame period
        IFX_AUTANALOG_PTCOMP_PP_MODE_WINDOW (2) - Sliding window counter
    enum: [0, 1, 2]

  pp-data-function:
    type: int
    default: 0
    description: |
      Post-processing LUT boolean function combining both comp outputs.
      Use IFX_AUTANALOG_PTCOMP_PP_FUNC_* constants from
      <dt-bindings/comparator/infineon-autanalog-ptcomp.h>, values 0-13.

  pp-window-size:
    type: int
    default: 0
    description: |
      Post-processing window size for WINDOW mode.
      Use IFX_AUTANALOG_PTCOMP_PP_WIN_* constants from
      <dt-bindings/comparator/infineon-autanalog-ptcomp.h>.
        IFX_AUTANALOG_PTCOMP_PP_WIN_2   (0)
        IFX_AUTANALOG_PTCOMP_PP_WIN_4   (1)
        IFX_AUTANALOG_PTCOMP_PP_WIN_8   (2)
        IFX_AUTANALOG_PTCOMP_PP_WIN_16  (3)
        IFX_AUTANALOG_PTCOMP_PP_WIN_32  (4)
        IFX_AUTANALOG_PTCOMP_PP_WIN_64  (5)
        IFX_AUTANALOG_PTCOMP_PP_WIN_128 (6)
    enum: [0, 1, 2, 3, 4, 5, 6]

  pp-period:
    type: int
    default: 0
    description: |
      Post-processing frame period in clock cycles (FRAME mode).

  pp-limit-condition:
    type: int
    default: 0
    description: |
      Post-processing counter limit condition.
      Use IFX_AUTANALOG_PTCOMP_PP_COND_* constants from
      <dt-bindings/comparator/infineon-autanalog-ptcomp.h>.
        IFX_AUTANALOG_PTCOMP_PP_COND_BELOW   (0) - Below threshold-low
        IFX_AUTANALOG_PTCOMP_PP_COND_INSIDE  (1) - Between low and high
        IFX_AUTANALOG_PTCOMP_PP_COND_ABOVE   (2) - Above threshold-high
        IFX_AUTANALOG_PTCOMP_PP_COND_OUTSIDE (3) - Below low or above high
    enum: [0, 1, 2, 3]

  pp-threshold-low:
    type: int
    default: 0
    description: |
      Post-processing low threshold for counter range detection.

  pp-threshold-high:
    type: int
    default: 0
    description: |
      Post-processing high threshold for counter range detection.

child-binding:
  description: |
    Dynamic mux-routing configuration slot.

    Each child node defines one slot in the dynamic configuration pool.
    In advanced mode, the STT selects which slot to use per AC state via
    ptcomp0-dyn-cfg-idx-comp0/comp1.  Slots are numbered in devicetree
    order, with comp@0 slots first, then comp@1 slots.

    When no child nodes are present (basic mode), a single slot is
    auto-generated from the comparator's own positive-mux / negative-mux
    properties.

  properties:
    positive-mux:
      type: int
      default: 0
      description: |
        Non-inverting (positive) input mux selector.
        Use IFX_AUTANALOG_PTCOMP_MUX_* constants from
        <dt-bindings/comparator/infineon-autanalog-ptcomp.h>.

    negative-mux:
      type: int
      default: 0
      description: |
        Inverting (negative) input mux selector.
        Use IFX_AUTANALOG_PTCOMP_MUX_* constants from
        <dt-bindings/comparator/infineon-autanalog-ptcomp.h>.

examples:
  - |
    /*
     * Use constants from <dt-bindings/comparator/infineon-autanalog-ptcomp.h>.
     */
    ptcomp0: ptcomp@0 {
        compatible = "infineon,autanalog-ptcomp";
        status = "okay";

        comp0: comp@0 {
            compatible = "infineon,autanalog-ptcomp-comp";
            reg = <0>;
            power-mode = <IFX_AUTANALOG_PTCOMP_PWR_NORMAL>;
            interrupt-mode = <IFX_AUTANALOG_PTCOMP_INT_EDGE_RISING>;
            positive-mux = <IFX_AUTANALOG_PTCOMP_MUX_GPIO2>;
            negative-mux = <IFX_AUTANALOG_PTCOMP_MUX_PRB_OUT0>;
        };
    };
  - |
    /*
     * Advanced mode: 2 dynamic mux config slots on comp@0.
     * Each child node is one slot with named properties.
     */
    ptcomp0: ptcomp@0 {
        compatible = "infineon,autanalog-ptcomp";
        status = "okay";

        comp0: comp@0 {
            compatible = "infineon,autanalog-ptcomp-comp";
            reg = <0>;
            power-mode = <IFX_AUTANALOG_PTCOMP_PWR_NORMAL>;
            interrupt-mode = <IFX_AUTANALOG_PTCOMP_INT_EDGE_RISING>;
            positive-mux = <IFX_AUTANALOG_PTCOMP_MUX_GPIO2>;
            negative-mux = <IFX_AUTANALOG_PTCOMP_MUX_PRB_OUT0>;

            dyn-cfg-0 {
                positive-mux = <IFX_AUTANALOG_PTCOMP_MUX_GPIO2>;
                negative-mux = <IFX_AUTANALOG_PTCOMP_MUX_PRB_OUT0>;
            };

            dyn-cfg-1 {
                positive-mux = <IFX_AUTANALOG_PTCOMP_MUX_GPIO2>;
                negative-mux = <IFX_AUTANALOG_PTCOMP_MUX_DAC0>;
            };
        };
    };
```

## dts/bindings/comparator/infineon,hppass-csg-comp.yaml
```yaml
# Copyright (c) 2026 Infineon Technologies AG,
# or an affiliate of Infineon Technologies AG.
#
# SPDX-License-Identifier: Apache-2.0

description: |
  Infineon HPPASS CSG comparator.

  One instance represents the comparator inside a CSG slice.  This
  node must be a child of an "infineon,hppass-csg" CSG MFD parent.

  The comparator's negative input may select either the paired in-slice
  DAC output or one of two external analog inputs (AIN_NA, AIN_NB):

    - When negative-input = "dac", the paired DAC must also be configured
      and enabled.
    - When negative-input = "ain-na" or "ain-nb", the comparator operates
      as a standalone analog-only comparator and the paired DAC is unused.

  The CSG MFD parent owns the combined comparator interrupt and dispatches
  callbacks.

compatible: "infineon,hppass-csg-comp"

include: [base.yaml]

properties:
  reg:
    type: array
    required: true
    description: |
      Register region for this slice's CMP_CFG within the CSG block.
      Slice index is derived at compile time from the offset divided
      by the CSG slice stride.

  positive-input:
    type: string
    required: true
    enum:
      - "ain-pa"
      - "ain-pb"
    description: |
      Selects the comparator's positive input source (CMP_CFG.CMP_POS_SEL):
        - "ain-pa": external analog input AIN_PA
        - "ain-pb": external analog input AIN_PB

  negative-input:
    type: string
    required: true
    enum:
      - "dac"
      - "ain-na"
      - "ain-nb"
    description: |
      Selects the comparator's negative input source (CMP_CFG.CMP_NEG_SEL):
        - "dac":    paired in-slice DAC output (default operating mode)
        - "ain-na": external analog input AIN_NA (standalone comparator)
        - "ain-nb": external analog input AIN_NB (standalone comparator)

  invert-output:
    type: boolean
    description: |
      Invert the digital comparator output before edge detection, blanking
      and status visibility (CMP_CFG.CMP_POLARITY).

  blank-mode:
    type: string
    default: "disabled"
    enum:
      - "disabled"
      - "gate-on-one"
      - "gate-on-zero"
    description: |
      Comparator output blanking mode (CMP_CFG.CMP_BLANK_MODE).

      Blanking gates the comparator output to inactive while a selected
      external trigger is asserted, preventing a trip on a transient condition.

        - "disabled":     no blanking applied
        - "gate-on-one":  comparator output is forced inactive while the
                          selected blanking trigger is high
        - "gate-on-zero": comparator output is forced inactive while the
                          selected blanking trigger is low

  blank-trigger-sel:
    type: string
    default: "disabled"
    enum:
      - "disabled"
      - "tr0"
      - "tr1"
      - "tr2"
      - "tr3"
      - "tr4"
      - "tr5"
      - "tr6"
      - "tr7"
    description: |
      Selects which HPPASS trigger input gates the comparator output when
      blank-mode is enabled (CMP_CFG.CMP_BLANK_TR_SEL).  Trigger sources
      "tr0".."tr7" correspond to the eight HPPASS trigger inputs
      configured on the parent "infineon,hppass-analog" node.
```

## dts/bindings/comparator/infineon,lp-comp-channel.yaml
```yaml
# Copyright (c) 2026 Infineon Technologies AG,
# or an affiliate of Infineon Technologies AG.
#
# SPDX-License-Identifier: Apache-2.0

description: |
  Infineon LPComp channel node (child of infineon,lp-comp).
  Device node shall be a child of a "infineon,lp-comp" compatible node.

compatible: "infineon,lp-comp-channel"

properties:
  channel:
    type: int
    required: true
    description: LPComp channel index (0 or 1).
  power:
    type: string
    enum: ["off", "ulp", "lp", "normal"]
    description: |
      Power mode for the comparator channel:
        - "off": Power off
        - "ulp": Ultra Low Power mode, uses local Ibias
        - "lp": Low Power mode
        - "normal": Normal mode
  hysteresis:
    type: boolean
    description: Enable or disable hysteresis.
  output-mode:
    type: string
    enum: ["pulse", "direct", "sync"]
    description: |
      Output mode selection for the LPComp:
        - "pulse": DSI output with the pulse option, no bypass.
        - "direct": Bypass mode, direct comparator output.
        - "sync": DSI output with the level option, similar to bypass but 1 cycle slower.
  intr-type:
    type: string
    enum: ["disable", "rising", "falling", "both"]
    description: Interrupt trigger type.
  input-p:
    type: string
    enum: ["open", "gpio", "amux_a", "amux_b", "local_vref"]
    description: |
      Positive input selection for the comparator.
      - "open": The low-power comparator input is not connected.
      - "gpio": The low-power comparator input connects to GPIO pin.
      - "amux_a": The low-power comparator input connects to AMUXBUSA.
      - "amux_b": The low-power comparator input connects to AMUXBUSB.
      - "local_vref": The low-power comparator input connects to local VREF.
  input-n:
    type: string
    enum: ["open", "gpio", "amux_a", "amux_b", "local_vref"]
    description: |
      Negative input selection for the comparator.
      - "open": The low-power comparator input is not connected.
      - "gpio": The low-power comparator input connects to GPIO pin.
      - "amux_a": The low-power comparator input connects to AMUXBUSA.
      - "amux_b": The low-power comparator input connects to AMUXBUSB.
      - "local_vref": The low-power comparator input connects to local VREF.
```

## dts/bindings/comparator/infineon,lp-comp.yaml
```yaml
# Copyright (c) 2026 Infineon Technologies AG,
# or an affiliate of Infineon Technologies AG.
#
# SPDX-License-Identifier: Apache-2.0

description: |
  Infineon Low Power Comparator (LPComp) for CAT1 family.


compatible: "infineon,lp-comp"

include:
  - base.yaml
```
