## dts/bindings/clock/wch,ch32v20x_30x-lse-clock.yaml
```yaml
# Copyright (c) 2026 Fiona Behrens
# SPDX-License-Identifier: Apache-2.0

description: WCH CH32F/V20x_30x Low Speed External clock

compatible: "wch,ch32v20x_30x-lse-clock"

include: [fixed-clock.yaml]

properties:
  lse-bypass:
    type: boolean
    description: |
      LSE Crystal oscillator bypass
      Set to the property to by-pass the oscillator with an external clock.
```

## dts/bindings/clock/wch,ch32v20x_30x-pll-clock.yaml
```yaml
# Copyright (c) 2024 MASSDRIVER EI (massdriver.space)
# SPDX-License-Identifier: Apache-2.0

description: WCH CH32V20x/30x PLL

compatible: "wch,ch32v20x_30x-pll-clock"

include: [clock-controller.yaml, base.yaml]

properties:
  "#clock-cells":
    const: 0

  clocks:
    type: phandle-array
    required: true

  mul:
    type: int
    required: true
    description: |
        Main PLL multiplication factor
    enum:
      - 2   # x2
      - 3   # x3
      - 4   # x4
      - 5   # x5
      - 6   # x6
      - 7   # x7
      - 8   # x8
      - 9   # x9
      - 10  # x10
      - 11  # x11
      - 12  # x12
      - 13  # x13
      - 14  # x14
      - 15  # x15
      - 16  # x16
      - 18  # x18

  hsi-prediv:
    type: int
    default: 1
    description: |
        HSI predivider value before PLL input. Controls the EXTEN_PLL_HSI_PRE
        bit in the EXTEN_CTR register. Only applicable when the PLL clock source
        is HSI. The HSI predivider has a hardware default of /2, but we use a default
        of /1 to allow for mul values to be interchangeable with HSE.
        1 = HSI fed directly to PLL (no division, matches HSE behavior)
        2 = HSI divided by 2 before PLL (hardware reset default)
    enum:
      - 1
      - 2
```

## dts/bindings/clock/wch,ch56x-clkmux.yaml
```yaml
# Copyright (c) 2023-2024 Chen Xingyu <hi@xingrz.me>
# SPDX-License-Identifier: Apache-2.0

description: WCH CH56x clock mux controller

compatible: "wch,ch56x-clkmux"

include: [clock-controller.yaml, base.yaml]

properties:
  clock-frequency:
    type: int
    description: |
      System clock frequency in Hz. Supported values are:
        - DT_FREQ_M(2)
        - DT_FREQ_M(15)
        - DT_FREQ_M(30)
        - DT_FREQ_M(60)
        - DT_FREQ_M(80)
        - DT_FREQ_M(96)
        - DT_FREQ_M(120)
    enum:
      - 2000000
      - 15000000
      - 30000000
      - 60000000
      - 80000000
      - 96000000
      - 120000000

  "#clock-cells":
    const: 0
```

## dts/bindings/clock/wch,clock-controller.yaml
```yaml
# Copyright (c) 2025 Fiona Behrens
# SPDX-License-Identifier: Apache-2.0

description: WCH clock controller node

compatible: "wch,clock-controller"

include: [clock-controller.yaml, base.yaml]

properties:
  reg:
    required: true

  "#clock-cells":
    const: 1

clock-cells:
  - id
```

## dts/bindings/clock/wch,rcc.yaml
```yaml
# Copyright (c) 2024 Michael Hope
# SPDX-License-Identifier: Apache-2.0

description: WCH CH32V00x Reset and Clock Control (RCC)

compatible: "wch,rcc"

include: [clock-controller.yaml, base.yaml]

properties:
  "#clock-cells":
    const: 1

clock-cells:
  - id
```

## dts/bindings/clock/wch,sysclk.yaml
```yaml
# Copyright (c) 2025 Fiona Behrens
# SPDX-License-Identifier: Apache-2.0

description: WCH CH32 SYS Clock

compatible: "wch,sysclk"

include: [clock-controller.yaml, base.yaml]

properties:
  "#clock-cells":
    const: 0

  clocks:
    type: phandle-array
    required: true
```

## dts/bindings/clock/xhsc,hc32-bus-fcg.yaml
```yaml
# Copyright (C) 2024-2025, Xiaohua Semiconductor Co., Ltd.
# SPDX-License-Identifier: Apache-2.0

description: HC32 Bus FCG
        enable peripherals clock.get cells value ref macro HC32_MODULES_CLOCKS

compatible: "xhsc,hc32-bus-fcg"

include: [clock-controller.yaml, base.yaml]

properties:
  "#clock-cells":
    const: 3

clock-cells:
  - bus
  - fcg
  - bits
```

## dts/bindings/clock/xhsc,hc32-clock-control.yaml
```yaml
# Copyright (C) 2024-2025, Xiaohua Semiconductor Co., Ltd.
# SPDX-License-Identifier: Apache-2.0

description: HC32 Clock Control

compatible: "xhsc,hc32-clock-control"

include: [base.yaml, pinctrl-device.yaml]

properties:

  clock-conf:
    type: array
    description: |
        clock control configuration
```

## dts/bindings/clock/xhsc,hc32-clock-hrc.yaml
```yaml
# Copyright (C) 2024-2025, Xiaohua Semiconductor Co., Ltd.
# SPDX-License-Identifier: Apache-2.0

description: HC32 Hrc Clock

compatible: "xhsc,hc32-clock-hrc"

include: [fixed-clock.yaml]
```

## dts/bindings/clock/xhsc,hc32-clock-mrc.yaml
```yaml
# Copyright (C) 2024-2025, Xiaohua Semiconductor Co., Ltd.
# SPDX-License-Identifier: Apache-2.0

description: HC32 Mrc Clock

compatible: "xhsc,hc32-clock-mrc"

include: [fixed-clock.yaml]
```

## dts/bindings/clock/xhsc,hc32-clock-pll.yaml
```yaml
# Copyright (C) 2024-2025, Xiaohua Semiconductor Co., Ltd.
# SPDX-License-Identifier: Apache-2.0

description: |
  PLL node binding for HC32 devices

compatible: "xhsc,hc32-clock-pll"

include: [clock-controller.yaml, base.yaml]

properties:

  clocks:
    required: true

  clock_frequency:
    type: int
    required: true

  div-m:
    type: int
    required: true
    description: |
        Division factor for PLL
        input clock
        Valid range: 1 - 24

  mul-n:
    type: int
    required: true
    description: |
        Main PLL multiplication factor for VCO
        Valid range: 20 - 480

  div-p:
    type: int
    description: |
        PLL division factor for pll_p_ck
        Valid range: 2 - 16

  div-q:
    type: int
    description: |
        PLL division factor for pll_q_ck
        Valid range: 2 - 16

  div-r:
    type: int
    description: |
        PLL division factor for pll_r_ck
        Valid range: 2 - 16

  "#clock-cells":
    const: 0
```

## dts/bindings/clock/xhsc,hc32-clock-sys.yaml
```yaml
# Copyright (C) 2024-2025, Xiaohua Semiconductor Co., Ltd.
# SPDX-License-Identifier: Apache-2.0

description: HC32 System Clock

compatible: "xhsc,hc32-clock-sys"

include: [base.yaml]

properties:
  div-hclk:
    type: int
    required: true
    description: |
        Division factor for HCLK
    enum:
      - 1
      - 2
      - 4
      - 8
      - 16
      - 32
      - 64

  div-exclk:
    type: int
    required: true
    description: |
          Division factor for ExMC CLK
    enum:
    - 1
    - 2
    - 4
    - 8
    - 16
    - 32
    - 64

  div-pclk0:
    type: int
    required: true
    description: |
        Division factor for PCLK0
    enum:
    - 1
    - 2
    - 4
    - 8
    - 16
    - 32
    - 64

  div-pclk1:
    type: int
    required: true
    description: |
        Division factor for PCLK1
    enum:
    - 1
    - 2
    - 4
    - 8
    - 16
    - 32
    - 64

  div-pclk2:
    type: int
    required: true
    description: |
        Division factor for PCLK2
    enum:
    - 1
    - 2
    - 4
    - 8
    - 16
    - 32
    - 64

  div-pclk3:
    type: int
    required: true
    description: |
        Division factor for PCLK3
    enum:
    - 1
    - 2
    - 4
    - 8
    - 16
    - 32
    - 64

  div-pclk4:
    type: int
    required: true
    description: |
        Division factor for PCLK4
    enum:
    - 1
    - 2
    - 4
    - 8
    - 16
    - 32
    - 64
```

## dts/bindings/clock/xhsc,hc32-clock-xtal.yaml
```yaml
# Copyright (C) 2024-2025, Xiaohua Semiconductor Co., Ltd.
# SPDX-License-Identifier: Apache-2.0

description: HC32 XTAL Clock

compatible: "xhsc,hc32-clock-xtal"

include: [fixed-clock.yaml]
```

## dts/bindings/clock/xhsc,hc32-clock-xtal32.yaml
```yaml
# Copyright (C) 2024-2025, Xiaohua Semiconductor Co., Ltd.
# SPDX-License-Identifier: Apache-2.0

description: HC32 XTAL32 Clock

compatible: "xhsc,hc32-clock-xtal32"

include: [fixed-clock.yaml]

properties:
  drive-strength:
    type: int
    required: true
    enum:
      - 0   # Medium drive strength, equals to DDL macro CLK_XTAL32_DRV_MID
      - 1   # High drive strength, equals to DDL macro CLK_XTAL32_DRV_HIGH
    description: |
        Configure the driving current of the external low-speed crystal
        based on varying capacitances.
```

## dts/bindings/comparator/comparator.yaml
```yaml
# Copyright (c) 2023, Nordic Semiconductor ASA
# SPDX-License-Identifier: Apache-2.0

# Common fields for comparators

include: base.yaml

child-binding:
  description: |
    Initial configuration to be applied to the comparator device.
    The child node must be named "initial-configuration".

  properties:
    input-positive:
      type: int
      required: true
      description: |
        Positive input specification.
        This field is composed of vendor-specific values.

    input-negative:
      type: int
      required: true
      description: |
        Positive input specification.
        This field is composed of vendor-specific values.

    flags:
      type: int
      required: true
      description: |
        Flags with additional configuration options.
        This field can contain COMPARATOR_FLAG_* values and vendor-specific
        flags.
```

## dts/bindings/comparator/espressif,esp32-ana-cmpr.yaml
```yaml
# Copyright (c) 2026 Espressif Systems (Shanghai) Co., Ltd.
# SPDX-License-Identifier: Apache-2.0

description: |
  Espressif Analog Comparator (ana_cmpr)

  Compares a fixed analog source GPIO pad against either an internal
  (VDD-divider) or external GPIO reference voltage, and reports the
  crossing as edge events via the generic comparator API.

  Both the source pad and, when ref-source is "external", the reference
  pad are fixed per SoC and per unit, and are not configurable via
  devicetree:
    ESP32-C5 unit0: source GPIO9,  external reference GPIO8
    ESP32-H2 unit0: source GPIO11, external reference GPIO10
    ESP32-P4 unit0: source GPIO52, external reference GPIO51
    ESP32-P4 unit1: source GPIO54, external reference GPIO53

  Example (internal reference at 50% VDD):

    &ana_cmpr1 {
            status = "okay";
            ref-source = "internal";
            ref-voltage = <50>;
    };

compatible: "espressif,esp32-ana-cmpr"

include: [base.yaml]

properties:
  interrupts:
    required: true

  unit:
    type: int
    required: true
    description: |
      Analog comparator unit index (0-based). Selects the fixed source and
      external-reference GPIO pads for this instance; see ana_cmpr_periph.c
      for the chip.

  ref-source:
    type: string
    default: "internal"
    enum:
      - "internal"
      - "external"
    description: |
      Reference voltage source. "internal" uses a VDD-divider generated by
      ref-voltage; "external" uses this unit's fixed external-reference GPIO
      pad.

  ref-voltage:
    type: int
    default: 0
    enum:
      - 0
      - 10
      - 20
      - 30
      - 40
      - 50
      - 60
      - 70
    description: |
      Internal reference voltage, in percent of VDD. Only used when
      ref-source = "internal".

  debounce-cycles:
    type: int
    default: 0
    description: |
      Debounce cycle count applied to cross detection: once a cross is
      detected, the comparator waits this many PAD_COMP_CLK cycles before
      confirming it, to filter out glitches.
```
