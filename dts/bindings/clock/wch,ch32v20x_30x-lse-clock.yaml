## dts/bindings/comparator/ite,it51xxx-vcmp.yaml
```yaml
# Copyright (c) 2025 ITE Technology Corporation.
# SPDX-License-Identifier: Apache-2.0

description: ITE, it51xxx Voltage Comparator node

compatible: "ite,it51xxx-vcmp"

include: base.yaml

properties:
  reg:
    required: true

  interrupts:
    required: true

  vcmp-ch:
    type: int
    required: true
    description: |
      Voltage comparator channel.
      Check include/zephyr/dt-bindings/comparator/it51xxx-vcmp.h file for
      pre-defined values.

  threshold-mv:
    type: int
    required: true
    description: |
      16-bit value in milli-volts present on ADC data as threshold assert.

  io-channels:
    type: phandle-array
    required: true
    description: |
      ADC channel that will perform measurement.

  scan-period:
    type: int
    description: |
      0x1: Set comparator scan period to 100US
      0x2: Set comparator scan period to 200US
      0x3: Set comparator scan period to 400US
      0x4: Set comparator scan period to 600US
      0x5: Set comparator scan period to 800US
      0x6: Set comparator scan period to 1MS
      0x7: Set comparator scan period to 1.5MS
      0x8: Set comparator scan period to 2MS
      0x9: Set comparator scan period to 2.5MS
      0xA: Set comparator scan period to 3MS
      0xB: Set comparator scan period to 4MS
      0xC: Set comparator scan period to 5MS
    default: 0x4
    enum:
      - 0x1
      - 0x2
      - 0x3
      - 0x4
      - 0x5
      - 0x6
      - 0x7
      - 0x8
      - 0x9
      - 0xA
      - 0xB
      - 0xC
```

## dts/bindings/comparator/nordic,nrf-comp.yaml
```yaml
# Copyright (c) 2024 Nordic Semiconductor ASA
# SPDX-License-Identifier: Apache-2.0

description: |
  Nordic nRF COMP (analog COMParator)

  This comparator has varying configurations which require varying
  properties be set in the devicetree.

  The following example displays the minimum node layout:

    comp: comp@deadbeef {
            compatible = "nordic,nrf-comp";
            reg = <0xdeadbeef 0x1000>;
            interrupts = <0 NRF_DEFAULT_IRQ_PRIORITY>;
            status = "disabled";
    };

  Enabling the comparator node requires setting the default
  configuration of the comparator.

  The following example displays enabling the comparator in
  single-ended mode, selecting an internal reference:

    &comp {
            status = "okay";
            main-mode = "SE";
            psel = "AIN0";
            refsel = "INT_1V2";
            sp-mode = "NORMAL";
            th-up = <36>;
            th-down = <30>;
            isource = "DISABLED";
    };

  To select an external reference, select the "AREF"
  reference and add the external reference:

    &comp {
            ...
            refsel = "AREF";
            extrefsel = "AIN1";
            ...
    };

  The following example displays enabling the comparator
  in differential mode:

    &comp {
            status = "okay";
            main-mode = "DIFF";
            psel = "AIN0";
            extrefsel = "AIN1";
            sp-mode = "NORMAL";
            enable-hyst;
            isource = "DISABLED";
    };

compatible: "nordic,nrf-comp"

include: base.yaml

properties:
  main-mode:
    type: string
    enum:
      - "SE"
      - "DIFF"

  psel:
    type: string
    enum:
      - "AIN0"
      - "AIN1"
      - "AIN2"
      - "AIN3"
      - "AIN4"
      - "AIN5"
      - "AIN6"
      - "AIN7"
      - "VDD_DIV2"
      - "VDDH_DIV5"

  extrefsel:
    type: string
    enum:
      - "AIN0"
      - "AIN1"
      - "AIN2"
      - "AIN3"
      - "AIN4"
      - "AIN5"
      - "AIN6"
      - "AIN7"

  refsel:
    type: string
    enum:
      - "INT_1V2"
      - "INT_1V8"
      - "INT_2V4"
      - "AVDDAO1V8"
      - "VDD"
      - "AREF"

  enable-hyst:
    type: boolean

  sp-mode:
    type: string
    enum:
      - "LOW"
      - "NORMAL"
      - "HIGH"

  th-up:
    type: int

  th-down:
    type: int

  isource:
    type: string
    enum:
      - "DISABLED"
      - "2UA5"
      - "5UA"
      - "10UA"
```

## dts/bindings/comparator/nordic,nrf-lpcomp.yaml
```yaml
# Copyright (c) 2024 Nordic Semiconductor ASA
# SPDX-License-Identifier: Apache-2.0

description: |
  Nordic nRF LPCOMP (analog Low-Power COMParator)

  The following example displays the minimum node layout:

    comp: comp@deadbeef {
            compatible = "nordic,nrf-lpcomp";
            reg = <0xdeadbeef 0x1000>;
            interrupts = <0 NRF_DEFAULT_IRQ_PRIORITY>;
            status = "disabled";
    };

  Enabling the comparator node requires setting the default
  configuration of the comparator.

  The following example displays enabling the comparator
  using an internal reference:

    &comp {
            status = "okay";
            psel = <NRF_COMP_AIN0>;
            refsel = "VDD_4_8";
            enable-hyst;
    };

  To select an external reference, select the "AREF"
  reference and add the external reference:

    &comp {
            ...
            refsel = "AREF";
            extrefsel = <NRF_COMP_AIN1>;
            ...
    };

compatible: "nordic,nrf-lpcomp"

include: base.yaml

properties:
  psel:
    type: int

  extrefsel:
    type: int

  refsel:
    type: string
    enum:
      - "VDD_1_8"
      - "VDD_2_8"
      - "VDD_3_8"
      - "VDD_4_8"
      - "VDD_5_8"
      - "VDD_6_8"
      - "VDD_7_8"
      - "VDD_1_16"
      - "VDD_3_16"
      - "VDD_5_16"
      - "VDD_7_16"
      - "VDD_9_16"
      - "VDD_11_16"
      - "VDD_13_16"
      - "VDD_15_16"
      - "AREF"

  enable-hyst:
    type: boolean
```

## dts/bindings/comparator/nxp,acomp.yaml
```yaml
# Copyright 2025 NXP
# SPDX-License-Identifier: Apache-2.0

description: |
  NXP Analog Comparator (ACOMP)

compatible: "nxp,acomp"

include:
  - base.yaml
  - pinctrl-device.yaml

properties:
  reg:
    required: true

  interrupts:
    required: true

  positive-input:
    type: string
    enum:
      - ch0
      - ch1
      - ch2
      - ch3
      - ch4
      - ch5
      - ch6
      - ch7
      - daca
      - dacb
    required: true
    description: |
      Positive input selection.

  negative-input:
    type: string
    enum:
      - ch0
      - ch1
      - ch2
      - ch3
      - ch4
      - ch5
      - ch6
      - ch7
      - daca
      - dacb
      - vref1p2
      - vssa
      - vio-0p25
      - vio-0p50
      - vio-0p75
      - vio-1p00
    required: true
    description: |
      Negative input selection.

  positive-hysteresis-mv:
    type: int
    enum: [0, 10, 20, 30, 40, 50, 60, 70]
    description: |
      Positive input hysteresis in millivolts.

  negative-hysteresis-mv:
    type: int
    enum: [0, 10, 20, 30, 40, 50, 60, 70]
    description: |
      Negative input hysteresis in millivolts.

  warmup-time-us:
    type: int
    enum: [1, 2, 4, 8]
    description: |
      Warm-up time before the comparator becomes active.

  response-mode:
    type: string
    enum: ["fast", "medium", "slow"]
    description: |
      Bias/response speed selection.

  inactive-value-high:
    type: boolean
    description: |
      Set comparator output high when disabled.

  enable-pin-out:
    type: boolean
    description: |
      Enable routing comparator output to its GPIO pin.

  invert-output:
    type: boolean
    description: |
      Invert the comparator output routed to GPIO.

  async-output:
    type: boolean
    description: |
      Use asynchronous comparator output for pin routing and interrupts.
```

## dts/bindings/comparator/nxp,cmp.yaml
```yaml
# Copyright 2025 NXP
# SPDX-License-Identifier: Apache-2.0

description: |
  NXP Comparator

compatible: "nxp,cmp"

include:
  - base.yaml
  - pinctrl-device.yaml

properties:
  interrupts:
    required: true

  reg:
    required: true

  enable-high-speed-mode:
    type: boolean
    description: |
      Enable CMP high speed mode.
      False: In this mode, CMP has slower output propagation
             delay and lower current consumption.
      True: CMP has faster output propagation delay and
            higher current consumption.

  hysteresis-mode:
    type: string
    enum:
      - "LEVEL0"
      - "LEVEL1"
      - "LEVEL2"
      - "LEVEL3"
    description: |
      Select CMP Hysteresis level.

  invert-output:
    type: boolean
    description: |
      Invert CMP output.

  enable-pin-out:
    type: boolean
    description: |
      Enable CMP output to associated pin.

  use-unfiltered-output:
    type: boolean
    description: |
      Use unfiltered output as the final result.
      If users need unfiltered output, enable this property, and
      do not need to configure 'filter-count' and 'filter-period'.
      If users need filtered output, disbable this property, and
      configure 'filter-count' >= 1, 'filter-period' >= 1.

  filter-count:
    type: int
    enum:
      - 0
      - 1
      - 2
      - 3
      - 4
      - 5
      - 6
      - 7
    description: |
      Represents the number of consecutive samples that must agree
      prior to the comparator output filter accepting a new output state.
      0: Filter is disabled, setting 'use-unfiltered-output' to enable
         or disable has the same effect.
      1: One sample must agree. The comparator output is simply sampled.
      2: 2 consecutive samples must agree.
      3: 3 consecutive samples must agree.
      4: 4 consecutive samples must agree.
      5: 5 consecutive samples must agree.
      6: 6 consecutive samples must agree.
      7: 7 consecutive samples must agree.

  filter-period:
    type: int
    description: |
      Specifies the sampling period, in bus clock cycles.
      Valid range: 0 - 255.

  dac-vref-source:
    type: string
    enum:
      - "VIN1"
      - "VIN2"
    description: |
      DAC reference source select.

  dac-value:
    type: int
    description: |
      Selects an output voltage from one of 64 distinct levels.
      DACO = (Vin / 64) * (dac-value + 1) , so the DACO range is
      from Vin/64 to Vin .

  positive-mux-input:
    type: string
    enum:
      - "IN0"
      - "IN1"
      - "IN2"
      - "IN3"
      - "IN4"
      - "IN5"
      - "IN6"
      - "IN7"
    description: |
      Positive input mux, determines which input is selected for
      positive minus input of the comparator.
      IN0: Input 0
      IN1: Input 1
      IN2: Input 2
      IN3: Input 3
      IN4: Input 4
      IN5: Input 5
      IN6: Input 6
      IN7: Input 7, DACO

  negative-mux-input:
    type: string
    enum:
      - "IN0"
      - "IN1"
      - "IN2"
      - "IN3"
      - "IN4"
      - "IN5"
      - "IN6"
      - "IN7"
    description: |
      Positive input mux, determines which input is selected for
      positive minus input of the comparator.
      IN0: Input 0
      IN1: Input 1
      IN2: Input 2
      IN3: Input 3
      IN4: Input 4
      IN5: Input 5
      IN6: Input 6
      IN7: Input 7, DACO
```
