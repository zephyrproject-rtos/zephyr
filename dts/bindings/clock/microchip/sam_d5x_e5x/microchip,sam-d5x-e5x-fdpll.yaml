## dts/bindings/clock/nordic,nrf-clock-hfclk192m.yaml
```yaml
# Copyright (c) 2025 Nordic Semiconductor ASA
# SPDX-License-Identifier: Apache-2.0

description: Nordic nRF HFCLK192M clock control node

compatible: "nordic,nrf-clock-hfclk192m"

include: base.yaml
```

## dts/bindings/clock/nordic,nrf-clock-lfclk.yaml
```yaml
# Copyright (c) 2025 Nordic Semiconductor ASA
# SPDX-License-Identifier: Apache-2.0

description: Nordic nRF LFCLK clock control node

compatible: "nordic,nrf-clock-lfclk"

include: base.yaml

properties:

  k32src-frequency:
    type: int
    default: 32768

  k32src:
    type: string
    default: "xtal"
    description: "32KHz clock source"
    enum:
      - "rc"
      - "xtal"
      - "synth"
      - "ext_low_swing"
      - "ext_full_swing"

  k32src-accuracy-ppm:
    type: int
    default: 50
    description: "32KHz clock accuracy in ppm:
                  500 means 251-500 ppm
                  250 means 151-250 ppm
                  150 means 101-150 ppm
                  100 means 76-100 ppm
                  75  means 51-75 ppm
                  50  means 31-50 ppm
                  30  means 21-30 ppm
                  20  means 0-20 ppm
                  if k32src is set to RC this property by default should be set to:
                  - 500 for NRF52 series
                  - 250 for the rest of the SoCs"
    enum:
      - 500
      - 250
      - 150
      - 100
      - 75
      - 50
      - 30
      - 20
```

## dts/bindings/clock/nordic,nrf-clock-xo.yaml
```yaml
# Copyright (c) 2025 Nordic Semiconductor ASA
# SPDX-License-Identifier: Apache-2.0

description: Nordic nRF XO clock control node

compatible: "nordic,nrf-clock-xo"

include: [base.yaml, fixed-clock.yaml]
```

## dts/bindings/clock/nordic,nrf-clock-xo24m.yaml
```yaml
# Copyright (c) 2025 Nordic Semiconductor ASA
# SPDX-License-Identifier: Apache-2.0

description: Nordic nRF XO24M clock control node

compatible: "nordic,nrf-clock-xo24m"

include: [base.yaml, fixed-clock.yaml]
```

## dts/bindings/clock/nordic,nrf-clock.yaml
```yaml
# Copyright (c) 2018 Nordic Semiconductor ASA
# SPDX-License-Identifier: Apache-2.0

description: Nordic nRF clock control node

compatible: "nordic,nrf-clock"

interrupt-source: true

include: base.yaml

properties:
  reg:
    required: true

  hfclkaudio-frequency:
    type: int
    description: |
      Frequency of the HFCLKAUDIO clock in Hz. Adjustable with 3.3 ppm
      resolution in two frequency bands - 11.176 MHz to 11.402 MHz, and
      12.165 MHz to 12.411 MHz (refer to the relevant Product Specification).
      The HFCLKAUDIO clock is only available in the nRF53 Series SoCs.
```

## dts/bindings/clock/nordic,nrf-fll16m.yaml
```yaml
# Copyright (c) 2024 Nordic Semiconductor ASA
# SPDX-License-Identifier: Apache-2.0

description: |
  Nordic FLL16M

  The FLL16M can use the following clocks as clock sources:

    - HFXO: The HFXO clock is used as a clock source if the
      FLL16M mode is BYPASS, or if the FLL16M mode is
      closed-loop and the LFXO clock is not available.

    - LFXO: The LFXO clock is used as a clock source if the
      FLL16M mode is closed-loop and the LFXO clock is
      available.

  Devicetree example:

    fll16m {
            open-loop-accuracy-ppm = <20000>;
            closed-loop-base-accuracy-ppm = <5000>;
            clocks = <&hfxo>, <&lfxo>;
            clock-names = "hfxo", "lfxo";
    };

compatible: "nordic,nrf-fll16m"

include: fixed-clock.yaml

properties:
  clock-frequency:
    const: 16000000

  open-loop-accuracy-ppm:
    type: int
    description: Clock accuracy in parts per million if open-loop clock source is used.

  closed-loop-base-accuracy-ppm:
    type: int
    description: |
      Base clock accuracy in parts per million if closed-loop clock source is used.
      The actual accuracy is this property plus the accuracy of the HFXO or LFXO.
```

## dts/bindings/clock/nordic,nrf-hfxo.yaml
```yaml
# Copyright (c) 2024 Nordic Semiconductor ASA
# SPDX-License-Identifier: Apache-2.0

description: Nordic nRF high-frequency crystal oscillator

compatible: "nordic,nrf-hfxo"

include: [fixed-clock.yaml]

properties:
  clock-frequency:
    const: 32000000

  load-capacitors:
    type: string
    enum:
      - "internal"
      - "external"
    description: |
      Type of load capacitors connected to the crystal. If not specified,
      adjustments may still happen when the device trimming happens during
      system initialization.

  load-capacitance-femtofarad:
    type: int
    enum:
      - 4000
      - 4250
      - 4500
      - 4750
      - 5000
      - 5250
      - 5500
      - 5750
      - 6000
      - 6250
      - 6500
      - 6750
      - 7000
      - 7250
      - 7500
      - 7750
      - 8000
      - 8250
      - 8500
      - 8750
      - 9000
      - 9250
      - 9500
      - 9750
      - 10000
      - 10250
      - 10500
      - 10750
      - 11000
      - 11250
      - 11500
      - 11750
      - 12000
      - 12250
      - 12500
      - 12750
      - 13000
      - 13250
      - 13500
      - 13750
      - 14000
      - 14250
      - 14500
      - 14750
      - 15000
      - 15250
      - 15500
      - 15750
      - 16000
      - 16250
      - 16500
      - 16750
      - 17000
    description: |
      Load capacitance in femtofarads. This property is only used when
      load-capacitors is set to "internal".
```

## dts/bindings/clock/nordic,nrf-hsfll-global.yaml
```yaml
# Copyright (c) 2024 Nordic Semiconductor ASA
# SPDX-License-Identifier: Apache-2.0

description: |
  Nordic Global HSFLL clock.

  The lowest supported clock frequency is the default
  clock frequency.

  Example:

    global_hsfll: global_hsfll {
            compatible = "nordic,nrf-hsfll-global";
            clocks = <&fll16>;
            #clock-cells = <0>;
            clock-frequency = <320000000>;
            supported-clock-frequencies = <64000000
                                           128000000
                                           256000000
                                           320000000>;
    };

compatible: "nordic,nrf-hsfll-global"

include:
  - "base.yaml"
  - "clock-controller.yaml"

properties:
  clocks:
    required: true

  "#clock-cells":
    const: 0

  supported-clock-frequencies:
    type: array
    description: Supported clock frequencies in ascending order

  clock-frequency:
    type: int
    description: |
      Optional fixed frequency specified if used in fixed
      frequency mode.
```

## dts/bindings/clock/nordic,nrf-hsfll.yaml
```yaml
# Copyright (c) 2024 Nordic Semiconductor ASA
# SPDX-License-Identifier: Apache-2.0

description: |
  Nordic nRF HSFLL

  The HSFLL mixed-mode IP generates several clock frequencies in the range from
  64 MHz to 400 MHz (in steps of 16 MHz).

  Usage example:

    hsfll: clock@deadbeef {
        compatible = "nordic,nrf-hsfll";
        reg = <0xdeadbeef 0x1000>;
        clocks = <&fll16m>;
        clock-frequency = <DT_FREQ_M(320)>;
        nordic,ficrs = <&ficr NRF_FICR_TRIM_APPLICATION_HSFLL_TRIM_VSUP>,
                       <&ficr NRF_FICR_TRIM_APPLICATION_HSFLL_TRIM_COARSE_0>,
                       <&ficr NRF_FICR_TRIM_APPLICATION_HSFLL_TRIM_FINE_0>;
        nordic,ficr-names = "vsup", "coarse", "fine";
    };

  Required FICR entries are for VSUP, COARSE and FINE trim values.

compatible: "nordic,nrf-hsfll"

include: [base.yaml, fixed-clock.yaml, nordic-nrf-ficr-client.yaml]

properties:
  reg:
    required: true

  clocks:
    required: true

  clock-frequency:
    enum:
      - 64000000
      - 80000000
      - 96000000
      - 112000000
      - 128000000
      - 144000000
      - 160000000
      - 176000000
      - 192000000
      - 208000000
      - 224000000
      - 240000000
      - 256000000
      - 272000000
      - 288000000
      - 304000000
      - 320000000
      - 336000000
      - 352000000
      - 368000000
      - 384000000
      - 400000000

  nordic,ficrs:
    required: true

  nordic,ficr-names:
    required: true
```

## dts/bindings/clock/nordic,nrf-lfclk.yaml
```yaml
# Copyright (c) 2024 Nordic Semiconductor ASA
# SPDX-License-Identifier: Apache-2.0

description: |
  nRF LFCLK (Low Frequency CLocK)

  The LFCLK can use the following clocks as clock sources:

    - HFXO: The HFXO clock is used as a clock source if the
      LFCLK SYNTH mode is selected and the LFXO clock is not
      available. The HFXO clock is used indirectly through
      the FLL16M clock in BYPASS mode.

    - LFXO: The LFXO clock is used as a clock source if the
      LFCLK SYNTH mode is selected and the LFXO clock is
      available. The LFXO clock is used indirectly through
      the FLL16M clock in BYPASS mode.

  Devicetree example:

    lfclk {
            lfrc-accuracy-ppm = <500>;
            lflprc-accuracy-ppm = <1000>;
            clocks = <&hfxo>, <&lfxo>;
            clock-names = "hfxo", "lfxo";
    };

compatible: "nordic,nrf-lfclk"

include: fixed-clock.yaml

properties:
  clock-frequency:
    const: 32768

  lfrc-accuracy-ppm:
    type: int
    description: Clock accuracy in parts per million if LFRC clock source is used.

  lflprc-accuracy-ppm:
    type: int
    description: Clock accuracy in parts per million if LFLPRC clock source is used.
```

## dts/bindings/clock/nordic,nrf-lfxo.yaml
```yaml
# Copyright (c) 2024 Nordic Semiconductor ASA
# SPDX-License-Identifier: Apache-2.0

description: Nordic nRF low-frequency crystal oscillator

compatible: "nordic,nrf-lfxo"

include: fixed-clock.yaml

properties:
  clock-frequency:
    const: 32768

  load-capacitors:
    type: string
    enum:
      - "internal"
      - "external"
    description: |
      Type of load capacitors connected to the crystal. If not specified,
      adjustments may still happen when the device trimming happens during
      system initialization.

  load-capacitance-femtofarad:
    type: int
    enum:
      - 4000
      - 4500
      - 5000
      - 5500
      - 6000
      - 6500
      - 7000
      - 7500
      - 8000
      - 8500
      - 9000
      - 9500
      - 10000
      - 10500
      - 11000
      - 11500
      - 12000
      - 12500
      - 13000
      - 13500
      - 14000
      - 14500
      - 15000
      - 15500
      - 16000
      - 16500
      - 17000
      - 17500
      - 18000
    description: |
      Load capacitance in femtofarads. This property is only used when
      load-capacitors is set to "internal".
```

## dts/bindings/clock/nordic,nrf-oscillators.yaml
```yaml
# Copyright (c) 2022 Nordic Semiconductor ASA
# SPDX-License-Identifier: Apache-2.0

description: Nordic nRF family OSCILLATORS (Oscillator Control)

compatible: "nordic,nrf-oscillators"

include: base.yaml

properties:
  reg:
    required: true
```

## dts/bindings/clock/nordic,nrf51-hfxo.yaml
```yaml
# Copyright (c) 2025 Nordic Semiconductor ASA
# SPDX-License-Identifier: Apache-2.0

description: Nordic nRF high-frequency crystal oscillator (nRF51 series)

compatible: "nordic,nrf51-hfxo"

include: fixed-clock.yaml

properties:
  clock-frequency:
    const: 16000000

  startup-time-us:
    type: int
    required: true
    description: |
      Startup time in microseconds.

      The value can be obtained by first measuring the time between
      TASKS_HFCLKSTART and EVENTS_HFCLKSTARTED. Then multiply
      the value by 2 to account for temperature and supply variations.

      Note that the startup time will be longer usual on the first
      power-up and as such should not be used to determine
      startup-time-us.
```

## dts/bindings/clock/nordic,nrf52-hfxo.yaml
```yaml
# Copyright (c) 2025 Nordic Semiconductor ASA
# SPDX-License-Identifier: Apache-2.0

description: Nordic nRF high-frequency crystal oscillator (nRF52 series)

compatible: "nordic,nrf52-hfxo"

include: fixed-clock.yaml

properties:
  clock-frequency:
    const: 64000000

  startup-time-us:
    type: int
    description: |
      Startup time in microseconds.

      The value can be obtained by first measuring the time between
      TASKS_HFCLKSTART and EVENTS_HFCLKSTARTED. Then multiply
      the value by 2 to account for temperature and supply variations.

      Note that the startup time will be longer usual on the first
      power-up and as such should not be used to determine
      startup-time-us.
```

## dts/bindings/clock/nordic,nrf53-hfxo.yaml
```yaml
# Copyright (c) 2024 Nordic Semiconductor ASA
# SPDX-License-Identifier: Apache-2.0

description: Nordic nRF high-frequency crystal oscillator (nRF53 series)

compatible: "nordic,nrf53-hfxo"

include: fixed-clock.yaml

properties:
  clock-frequency:
    const: 32000000

  startup-time-us:
    type: int
    required: true
    description: |
      Startup time in microseconds.

      The value can be obtained by first measuring the time between
      TASKS_HFCLKSTART and EVENTS_HFCLKSTARTED. Then multiply
      the value by 2 to account for temperature and supply variations.

      Note that the startup time will be longer usual on the first
      power-up and as such should not be used to determine
      startup-time-us.

  load-capacitors:
    type: string
    enum:
      - "internal"
      - "external"
    description: |
      Type of load capacitors connected to the crystal.

  load-capacitance-femtofarad:
    type: int
    enum:
      - 7000
      - 7500
      - 8000
      - 8500
      - 9000
      - 9500
      - 10000
      - 10500
      - 11000
      - 11500
      - 12000
      - 12500
      - 13000
      - 13500
      - 14000
      - 14500
      - 15000
      - 15500
      - 16000
      - 16500
      - 17000
      - 17500
      - 18000
      - 18500
      - 19000
      - 19500
      - 20000
    description: |
      Load capacitance in femtofarads. This property is only used when
      load-capacitors is set to "internal".
```

## dts/bindings/clock/nordic,nrf53-lfxo.yaml
```yaml
# Copyright (c) 2024 Nordic Semiconductor ASA
# SPDX-License-Identifier: Apache-2.0

description: Nordic nRF low-frequency crystal oscillator (nRF53 series)

compatible: "nordic,nrf53-lfxo"

include: fixed-clock.yaml

properties:
  clock-frequency:
    const: 32768

  load-capacitors:
    type: string
    enum:
      - "internal"
      - "external"
    description: |
      Type of load capacitors connected to the crystal.

  load-capacitance-picofarad:
    type: int
    enum:
      - 6
      - 7
      - 9
    description: |
      Load capacitance in picofarads. This property is only used when
      load-capacitors is set to "internal".
```
