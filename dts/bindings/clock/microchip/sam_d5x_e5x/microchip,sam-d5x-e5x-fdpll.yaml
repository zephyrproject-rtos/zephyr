## dts/bindings/clock/microchip/sam_d5x_e5x/microchip,sam-d5x-e5x-fdpll.yaml
```yaml
# Copyright (c) 2025 Microchip Technology Inc.
# SPDX-License-Identifier: Apache-2.0

title: SAM_D5x_E5x FDPLL clock

description: |
  Digital Phase Locked Loop (FDPLL), 96 MHz to 200 MHz output frequency from a 32 kHz to 3.2 MHz
  reference clock.

include: [base.yaml]

compatible: "microchip,sam-d5x-e5x-fdpll"

child-binding:
  properties:
    subsystem:
      type: int
      required: true
      description: Clock subsystem

    fdpll-on-demand-en:
      type: int
      enum:
        - 0
        - 1
      default: 0
      description: |
        0: The oscillator is always on
        1: The oscillator is running when a peripheral is requesting the oscillator to be used as a
        clock source. The oscillator is not running if no peripheral is requesting the clock source.
        Important: Initializing it with 1, along with clock enabled, can lead to indefinite wait
        for the clock to be on, if there is no peripheral request for the clock in the sequence of
        clock Initialization. If required, better to turn on the clock using API, instead of
        enabling both during startup.

    fdpll-run-in-standby-en:
      type: int
      enum:
        - 0
        - 1
      default: 1
      description: |
        0: The DPLLn is not running in standby sleep mode if no peripheral requests the clock.
        1: The DPLLn is running in standby sleep mode.
        If ONDEMAND is one, the DPLLn will be running when a peripheral is requesting the clock. If
        ONDEMAND is false, the clock source will always be running in standby sleep mode.

    fdpll-en:
      type: int
      enum:
        - 0
        - 1
      default: 0
      description: |
        Oscillator Enable

    fdpll-divider-ratio-int:
      type: int
      default: 0
      description: |
        Set the integer part of the frequency multiplier. (0 - 4095)

    fdpll-divider-ratio-frac:
      type: int
      default: 0
      description: |
        Set the fractional part of the frequency multiplier. (0 - 31)

    fdpll-xosc-clock-divider:
      type: int
      default: 0
      description: |
        Set the XOSC clock division factor (0 - 2047)

    fdpll-dco-en:
      type: int
      enum:
        - 0
        - 1
      default: 0
      description: |
        DCO Filter Enable
        0: to disable, 1: to enable

    fdpll-dco-filter-select:
      type: string
      enum:
        - "3.21mhz"
        - "1.6mhz"
        - "1.1mhz"
        - "0.8mhz"
        - "0.64mhz"
        - "0.55mhz"
        - "0.45mhz"
        - "0.4mhz"
      default: "3.21mhz"
      description: |
        Sigma-Delta DCO Filter Selection, Bandwidth Fn (MHz)

    fdpll-lock-bypass-en:
      type: int
      enum:
        - 0
        - 1
      default: 0
      description: |
        Lock Bypass
        0: to disable, 1: to enable

    fdpll-src:
      type: string
      enum:
        - "gclk0"
        - "gclk1"
        - "gclk2"
        - "gclk3"
        - "gclk4"
        - "gclk5"
        - "gclk6"
        - "gclk7"
        - "gclk8"
        - "gclk9"
        - "gclk10"
        - "gclk11"
        - "xosc32k"
        - "xosc0"
        - "xosc1"
      default: "xosc0"
      description: |
        Reference source clock selection

    fdpll-wakeup-fast-en:
      type: int
      enum:
        - 0
        - 1
      default: 0
      description: |
        Wake Up Fast
        0: to disable, 1: to enable

    fdpll-pi-filter-type:
      type: string
      enum:
        - "92.7khz-0.76damp"
        - "131khz-1.08damp"
        - "46.4khz-0.38damp"
        - "65.6khz-0.54damp"
        - "131khz-0.56damp"
        - "185khz-0.79damp"
        - "65.6khz-0.28damp"
        - "92.7khz-0.39damp"
        - "46.4khz-1.49damp"
        - "65.6khz-2.11damp"
        - "23.2khz-0.75damp"
        - "32.8khz-1.06damp"
        - "65.6khz-1.07damp"
        - "92.7khz-1.51damp"
        - "32.8khz-0.53damp"
        - "46.4khz-0.75damp"
      default: "92.7khz-0.76damp"
      description: |
        Proportional Integral Filter Selection
```

## dts/bindings/clock/microchip/sam_d5x_e5x/microchip,sam-d5x-e5x-mclkcpu.yaml
```yaml
# Copyright (c) 2025 Microchip Technology Inc.
# SPDX-License-Identifier: Apache-2.0

title: SAM_D5x_E5x Main clock for CPU

description: |
  Main Clock Controller provides synchronous system clocks to the CPU.

include: [base.yaml]

compatible: "microchip,sam-d5x-e5x-mclkcpu"

properties:
  mclk-cpu-div:
    type: int
    enum:
      - 1
      - 2
      - 4
      - 8
      - 16
      - 32
      - 64
      - 128
    default: 1
    description: |
      CPU Clock Division Factor
```

## dts/bindings/clock/microchip/sam_d5x_e5x/microchip,sam-d5x-e5x-mclkperiph.yaml
```yaml
# Copyright (c) 2025 Microchip Technology Inc.
# SPDX-License-Identifier: Apache-2.0

title: SAM_D5x_E5x MCLK (Main Clock) peripheral

description: |
  Main Clock Controller provides synchronous system clocks to the modules
  connected to the AHBx and the APBx buses.

include: [base.yaml]

compatible: "microchip,sam-d5x-e5x-mclkperiph"

properties:
  "#clock-cells":
    const: 1
    type: int
    description: |
      The subsystem cell is to identify a clock controller sub-system.

      The subsystem can be referred from include\zephyr\dt-bindings\clock\mchp_sam_d5x_e5x_clock.h,
      under the MCLKPERIPH_TYPE section of ids.
      All clock control API use this value to specify the clock on which the API operates.
      Since subsystem is opaque to the user, it can be accessed from the devicetree node and used.

clock-cells:
  - subsystem

child-binding:
  properties:
    subsystem:
      type: int
      required: true
      description: Clock subsystem
    mclk-en:
      type: int
      enum:
        - 0
        - 1
      required: true
      description: |
        Enable mclk to the peripheral
        0: to disable, 1: to enable
```

## dts/bindings/clock/microchip/sam_d5x_e5x/microchip,sam-d5x-e5x-rtc.yaml
```yaml
# Copyright (c) 2025 Microchip Technology Inc.
# SPDX-License-Identifier: Apache-2.0

title: SAM_D5x_E5x RTC clock

description: |
  RTC clock configuration.

include: [base.yaml]

compatible: "microchip,sam-d5x-e5x-rtc"

properties:
  "#clock-cells":
    const: 1
    type: int

  rtc-src:
    type: int
    default: 0
    description: |
      RTC source clock selection
      0: ulp1k
      1: ulp32k
      4: xosc1k
      5: xosc32k

clock-cells:
  - subsystem
```

## dts/bindings/clock/microchip/sam_d5x_e5x/microchip,sam-d5x-e5x-xosc.yaml
```yaml
# Copyright (c) 2025 Microchip Technology Inc.
# SPDX-License-Identifier: Apache-2.0

title: SAM_D5x_E5x Crystal Oscillator (XOSC)

description: |
  8-48 MHz Crystal Oscillators (XOSC).

include: [base.yaml]

compatible: "microchip,sam-d5x-e5x-xosc"

child-binding:
  properties:
    subsystem:
      type: int
      required: true
      description: |
        Clock subsystem

    xosc-frequency:
      type: int
      default: 0
      description: |
        Crystal/External clock frequency for XOSC Controller

    xosc-startup-time:
      type: int
      enum:
        - 1
        - 2
        - 4
        - 8
        - 16
        - 32
        - 64
        - 128
        - 256
        - 512
        - 1024
        - 2048
        - 4096
        - 8192
        - 16384
        - 32768
      default: 1
      description: |
        XOSC start-up time. Select number of OSCULP32K oscillator clock cycles.

    xosc-clock-switch-en:
      type: int
      enum:
        - 0
        - 1
      default: 0
      description: |
        Switch back to the external clock or crystal oscillator for clock recovery
        0: The clock switch back is disabled.
        1: The clock switch back is enabled.

    xosc-clock-failure-detection-en:
      type: int
      enum:
        - 0
        - 1
      default: 0
      description: |
        Clock Failure Detector Enable
        0: to disable, 1: to enable

    xosc-automatic-loop-control-en:
      type: int
      enum:
        - 0
        - 1
      default: 0
      description: |
        Oscillator's amplitude automatically adjusted
        0: to disable, 1: to enable

    xosc-low-buffer-gain-en:
      type: int
      enum:
        - 0
        - 1
      default: 0
      description: |
        Increase the oscillator's amplitude by a factor of approximately 2.
        Use this setting to solve stability issues.
        0: to disable, 1: to enable

    xosc-on-demand-en:
      type: int
      enum:
        - 0
        - 1
      default: 0
      description: |
        0: The oscillator is always ON normally.
        In standby sleep mode, oscillator will be OFF if there is no peripheral request,
        unless run-in-standby-en is 1.
        1: In both normal and standby sleep mode, The oscillator is ON,
        when a peripheral is requesting the oscillator to be used as a clock source.
        The oscillator is OFF if no peripheral is requesting the clock source.
        Important: Initializing it with 1, along with clock enabled, can lead to indefinite wait
        for the clock to be on, if there is no peripheral request for the clock in the sequence of
        clock Initialization. If required, better to turn on the clock using API, instead of
        enabling both during startup.

    xosc-run-in-standby-en:
      type: int
      enum:
        - 0
        - 1
      default: 0
      description: |
        0: The XOSCn is OFF in standby sleep mode if no peripheral requests the clock.
        1: The XOSCn is always ON in standby sleep mode, unless on-demand-en is 1.
        If on-demand-en is 1, the XOSCn will be ON only when a peripheral is requesting
        the clock, even if run-in-standby-en is 1.

    xosc-xtal-en:
      type: int
      enum:
        - 0
        - 1
      default: 0
      description: |
        Selects external clock or crystal oscillator
        0 - External clock connected on XIN. XOUT can be used as general-purpose I/O.
        1 - Crystal connected to XIN/XOUT.

    xosc-en:
      type: int
      enum:
        - 0
        - 1
      default: 0
      description: |
        Oscillator Enable
        0: to disable, 1: to enable
```

## dts/bindings/clock/microchip/sam_d5x_e5x/microchip,sam-d5x-e5x-xosc32k.yaml
```yaml
# Copyright (c) 2025 Microchip Technology Inc.
# SPDX-License-Identifier: Apache-2.0

title: SAM_D5x_E5x External Crystal Oscillator (XOSC32K)

description: |
  32.768 kHz External Crystal Oscillator (XOSC32K) Control.

include: [base.yaml]

compatible: "microchip,sam-d5x-e5x-xosc32k"

properties:
  xosc32k-gain-mode:
    type: string
    enum:
      - "standard"
      - "highspeed"
    default: "standard"
    description: |
      control the gain of the external crystal oscillator

  xosc32k-write-lock-en:
    type: int
    enum:
      - 0
      - 1
    default: 0
    description: |
      Locks the XOSC32K register for future writes
      0: to disable, 1: to enable

  xosc32k-startup-time:
    type: int
    enum:
      - 62
      - 125
      - 500
      - 1000
      - 2000
      - 4000
      - 8000
    default: 62
    description: |
      Oscillator Start-Up Time in ms

  xosc32k-on-demand-en:
    type: int
    enum:
      - 0
      - 1
    default: 0
    description: |
      0: The oscillator is always on, if standby-en is true, else run in
         Standby Sleep mode if requested by a peripheral.
      1: Run if requested by peripheral
      Important: Initializing it with 1, along with clock enabled, can lead to indefinite wait for
      the clock to be on, if there is no peripheral request for the clock in the sequence of clock
      Initialization. If required, better to turn on the clock using API, instead of enabling both
      during startup.

  xosc32k-run-in-standby-en:
    type: int
    enum:
      - 0
      - 1
    default: 0
    description: |
      0: Run if requested by peripheral
      1: The oscillator is always on, if demand-en is false

  xosc32k-1khz-en:
    type: int
    enum:
      - 0
      - 1
    default: 0
    description: |
      1kHz Output Enable
      0: to disable, 1: to enable

  xosc32k-32khz-en:
    type: int
    enum:
      - 0
      - 1
    default: 0
    description: |
      32kHz output is enable
      0: to disable, 1: to enable

  xosc32k-xtal-en:
    type: int
    enum:
      - 0
      - 1
    default: 0
    description: |
      Selects external clock or crystal oscillator
      0 - External clock connected on XIN. XOUT can be used as general-purpose I/O.
      1 - Crystal connected to XIN/XOUT.

  xosc32k-en:
    type: int
    enum:
      - 0
      - 1
    default: 0
    description: |
      Oscillator Enable
      0: to disable, 1: to enable

  xosc32k-cf-backup-divideby2-en:
    type: int
    enum:
      - 0
      - 1
    default: 0
    description: |
      The CFD safe clock frequency is the OSCULP32K frequency divided by 2
      0: to disable, 1: to enable

  xosc32k-switch-back-en:
    type: int
    enum:
      - 0
      - 1
    default: 0
    description: |
      Controls the XOSC32K output switch back to the external clock or crystal scillator in case of
      clock recovery
      0: to disable, 1: to enable

  xosc32k-cfd-en:
    type: int
    enum:
      - 0
      - 1
    default: 0
    description: |
      Clock Failure Detector Enable
      0: to disable, 1: to enable
```

## dts/bindings/clock/nordic,nrf-aclk.yaml
```yaml
# Copyright (c) 2025 Nordic Semiconductor ASA
# SPDX-License-Identifier: Apache-2.0

description: Nordic Audio clock node

compatible: "nordic,nrf-aclk"

include: fixed-clock.yaml

properties:
  clock-frequency:
    type: int
    description: |
      Frequency of the Audio clock in Hz.
```

## dts/bindings/clock/nordic,nrf-auxpll.yaml
```yaml
# Copyright (c) 2024 Nordic Semiconductor ASA
# SPDX-License-Identifier: Apache-2.0

description: |
  Nordic Auxiliary PLL (Phase Locked Loop)

  The output frequency (f_out) of the auxiliary PLL is calculated as follows:

    f_out = ((R + A * 2^(-16)) * f_src) / B

  where:

    - A: nordic,frequency
    - B: nordic,outdiv
    - R: nordic,range (3=low, 4=mid, 5=high, 6=statichigh)
    - f_src: Source frequency, given by clocks

compatible: "nordic,nrf-auxpll"

include:
  - base.yaml
  - clock-controller.yaml
  - nordic-nrf-ficr-client.yaml

properties:
  reg:
    required: true

  interrupts:
    required: true

  clocks:
    required: true

  "#clock-cells":
    const: 0

  nordic,ficrs:
    required: true

  nordic,frequency:
    type: int
    required: true
    description: |
      Value used to set the fractional PLL divider ratio (can be set between
      divider ratios 4 to 5). Valid values range from 0 to 65535.

  nordic,out-div:
    type: int
    enum:
      - 1
      - 2
      - 3
      - 4
      - 6
      - 8
      - 12
      - 16
    description: PLL output divider.

  nordic,out-drive:
    type: int
    required: true
    enum:
      - 0
      - 1
      - 2
      - 3
    description: Output buffer drive strength.

  nordic,current-tune:
    type: int
    required: true
    description: Constant current tune for the ring oscillator

  nordic,sdm-disable:
    type: boolean
    description: Disable sigma-delta modulator

  nordic,dither-disable:
    type: boolean
    description: Disable dither in sigma-delta modulator

  nordic,range:
    type: string
    required: true
    enum:
      - "low"
      - "mid"
      - "high"
      - "statichigh"
    description: PLL loop divider range
```

## dts/bindings/clock/nordic,nrf-clock-hfclk.yaml
```yaml
# Copyright (c) 2025 Nordic Semiconductor ASA
# SPDX-License-Identifier: Apache-2.0

description: Nordic nRF HFCLK clock control node

compatible: "nordic,nrf-clock-hfclk"

include: base.yaml
```
