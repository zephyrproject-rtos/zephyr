## dts/bindings/clock/microchip/pic32cm_sg_gc/microchip,pic32cm-sg-gc-clock.yaml
```yaml
# Copyright (c) 2026 Microchip Technology Inc.
# SPDX-License-Identifier: Apache-2.0

title: Microchip PIC32CM_SG_GC SOC family clock

description: |
  Microchip PIC32CM_SG_GC SOC family clock support (OSCCTRL, OSC32KCTRL, GCLK, MCLK)

include:
  - name: base.yaml
  - name: pinctrl-device.yaml

compatible: "microchip,pic32cm-sg-gc-clock"

properties:
  on-timeout-ms:
    type: int
    default: 65
    description: |
      Timeout in milliseconds for clock to be on.

      Driver waits in clock on API to check if the clock is actually on,
      so that the waiting time is not indefinite. (XOSC32K startup 62.6ms)

  flash-auto-wait-state-en:
    type: int
    enum:
      - 0
      - 1
    default: 0
    description: |
      Automatic wait state enable
      0: to disable, 1: to enable

  flash-wait-states:
    type: int
    default: 0
    description: |
      Number of wait states for a flash read operation.

      Change this value based on the NVM access time and system frequency
      up to 15 wait states.

examples:
  - |
    #Example showing the configuration for CPU to be clocked by PLL0, at 180MHz

    &clock {
      compatible = "microchip,pic32cm-sg-gc-clock";

      xosc: xosc {
        compatible = "microchip,pic32cm-sg-gc-xosc";
        xosc-frequency = <12000000>;
        xosc-en = <1>;
        xosc-xtal-en = <1>;
      };

      dpll0: dpll0 {
        compatible = "microchip,pic32cm-sg-gc-dpll";
        dpll-bandwidth-sel = "4mhz-10mhz";
        dpll-ref-division-factor = <2>;
        dpll-feedback-divider-factor = <180>;
        dpll-src = "xosc";
        dpll-en = <1>;

        dpll0out0: dpll0out0 {
          subsystem = <CLOCK_MCHP_DPLL0_ID_OUT0>;
          dpll-output-division-factor = <6>;
          dpll-output-en = <1>;
        };
      };

      gclkgen: gclkgen {
        compatible = "microchip,pic32cm-sg-gc-gclkgen";

        gclkgen0 {
          subsystem = <CLOCK_MCHP_GCLKGEN_ID_GEN0>;
          gclkgen-div-factor = <1>;
          gclkgen-run-in-standby-en = <1>;
          gclkgen-src = "pll0-clkout0";
          gclkgen-en = <1>;
        };
      };
    };
```

## dts/bindings/clock/microchip/pic32cm_sg_gc/microchip,pic32cm-sg-gc-dpll.yaml
```yaml
# Copyright (c) 2026 Microchip Technology Inc.
# SPDX-License-Identifier: Apache-2.0

title: PIC32CM_SG_GC DPLL clock

description: |
  Digital Phase Locked Loop (DPLL), 12.7 MHz to 300 MHz output frequency or up to 1.6 GHz for
  fractional divider module use, from a 4 MHz to 48 MHz Reference Input Clock.

include: [base.yaml]

compatible: "microchip,pic32cm-sg-gc-dpll"

properties:
  dpll-bandwidth-sel:
    type: string
    enum:
      - "4mhz-10mhz"
      - "10mhz-20mhz"
      - "20mhz-30mhz"
      - "30mhz-60mhz"
    default: "4mhz-10mhz"
    description: |
      Select the PLL closed loop filter bandwidth.

      Depending on the frequency after the reference divider FPFD. Selecting the correct filter
      bandwidth is important to operate the PLL'VCO in its best range.

  dpll-src:
    type: string
    enum:
      - "gclk0"
      - "gclk1"
      - "gclk2"
      - "gclk3"
      - "gclk4"
      - "gclk5"
      - "gclk6"
      - "gclk7"
      - "gclk8"
      - "gclk9"
      - "gclk10"
      - "gclk11"
      - "xosc"
      - "dfll48m"
    default: "xosc"
    description: |
      Reference source clock selection

  dpll-on-demand-en:
    type: int
    enum:
      - 0
      - 1
    default: 0
    description: |
      0: The oscillator is always on
      1: The oscillator is running when a peripheral is requesting the oscillator to be used as a
      clock source. The oscillator is not running if no peripheral is requesting the clock source.
      Important: Initializing it with 1, along with clock enabled, can lead to indefinite wait
      for the clock to be on, if there is no peripheral request for the clock in the sequence of
      clock Initialization. If required, better to turn on the clock using API, instead of
      enabling both during startup.

  dpll-en:
    type: int
    enum:
      - 0
      - 1
    default: 0
    description: |
      Oscillator Enable
      0: to disable, 1: to enable

  dpll-feedback-divider-factor:
    type: int
    default: 0
    description: |
      This field determines the ratio of the PLL's VCO output frequency to the PLL Reference
      input frequency.

      Writing to the FBDIV(feedback-divider-factor) bits will cause lock to be lost.
      The value of FBDIV, (i.e. PLLFBDIV) must be within the range 21 ≤ FBDIV ≤ 1023.
      The frequency of the Voltage Controlled Oscillator (VCO) giving the PLL oscillation is
      given by the formula: FVCO = FCKR * (FBDIV / REFDIV), (i.e., Must be between 800 MHz and
      1600 MHz).
      fCKR(source clock), REFDIV(ref-division-factor) and FBDIV must be selected to satisfy this
      condition.

  dpll-ref-division-factor:
    type: int
    default: 0
    description: |
      This field determines the division factor of the PLL input reference frequency.

      Writing to the REFDIV bits will cause lock to be lost.
      REFDIV value must be in the range of 1 ≤ REFDIV ≤ 63.
      The frequency after the reference divider (FPFD) is given by the formula:
      FPFD = FCKR / REFDIV (i.e., FPFD must always be between 4 MHz to 48 MHz.

child-binding:
  description: DPLL output configuration

  properties:
    subsystem:
      type: int
      required: true
      description: Clock subsystem identifier

    dpll-output-en:
      type: int
      enum:
        - 0
        - 1
      default: 0
      description: |
        0: Output disabled
        1: Output enabled

    dpll-output-division-factor:
      type: int
      default: 0
      description: |
        This field determines the division factor of the PLL VCO frequency output.

examples:
  - |
    #Usage example:

    &clock {
      compatible = "microchip,pic32cm-sg-gc-clock";

      dpll0: dpll0 {
        compatible = "microchip,pic32cm-sg-gc-dpll";
        dpll-bandwidth-sel = "4mhz-10mhz";
        dpll-ref-division-factor = <2>;
        dpll-feedback-divider-factor = <180>;
        dpll-src = "xosc";
        dpll-en = <1>;

        dpll0out0: dpll0out0 {
          subsystem = <CLOCK_MCHP_DPLL0_ID_OUT0>;
          dpll-output-division-factor = <6>;
          dpll-output-en = <1>;
        };
      };
    };
```

## dts/bindings/clock/microchip/pic32cm_sg_gc/microchip,pic32cm-sg-gc-mclkdomain.yaml
```yaml
# Copyright (c) 2026 Microchip Technology Inc.
# SPDX-License-Identifier: Apache-2.0

title: PIC32CM_SG_GC Main clock domains

description: |
  Main Clock Controller provides synchronous system clocks to the CPU & peripherals.

include: [base.yaml]

compatible: "microchip,pic32cm-sg-gc-mclkdomain"

child-binding:
  properties:
    subsystem:
      type: int
      required: true
      description: Clock subsystem

    mclk-div:
      type: int
      enum:
        - 1
        - 2
        - 4
        - 8
        - 16
        - 32
        - 64
        - 128
      default: 1
      description: |
        Clock Division Factor

examples:
  - |
    #Usage example:

    &clock {
      compatible = "microchip,pic32cm-sg-gc-clock";

      mclkdomain: mclkdomain {
        compatible = "microchip,pic32cm-sg-gc-mclkdomain";

        mclkcpu {
          subsystem = <CLOCK_MCHP_MCLKDOMAIN_ID_CPU>;
          mclk-div = <1>;
        };
      };
    };
```

## dts/bindings/clock/microchip/pic32cm_sg_gc/microchip,pic32cm-sg-gc-mclkperiph.yaml
```yaml
# Copyright (c) 2026 Microchip Technology Inc.
# SPDX-License-Identifier: Apache-2.0

title: PIC32CM_SG_GC MCLK (Main Clock) peripheral

description: |
  Main Clock Controller provides synchronous system clocks to the modules
  connected to the AHBx and the APBx buses.

include: [base.yaml]

compatible: "microchip,pic32cm-sg-gc-mclkperiph"

properties:
  "#clock-cells":
    const: 1
    type: int
    description: |
      The subsystem cell is to identify a clock controller sub-system.

      The subsystem can be referred from include\zephyr\dt-bindings\clock\mchp_sam_d5x_e5x_clock.h,
      under the MCLKPERIPH_TYPE section of ids.
      All clock control API use this value to specify the clock on which the API operates.
      Since subsystem is opaque to the user, it can be accessed from the devicetree node and used.

clock-cells:
  - subsystem

child-binding:
  properties:
    subsystem:
      type: int
      required: true
      description: Clock subsystem
    mclk-en:
      type: int
      enum:
        - 0
        - 1
      required: true
      description: Enable mclk to the peripheral

examples:
  - |
    #Usage example:

    &clock {
      compatible = "microchip,pic32cm-sg-gc-clock";

      mclkperiph: mclkperiph {
        compatible = "microchip,pic32cm-sg-gc-mclkperiph";
        #clock-cells = <1>;

        sercom1 {
          subsystem = <CLOCK_MCHP_MCLKPERIPH_ID_SERCOM1>;
          mclk-en = <1>;
        };
      };
    };
```

## dts/bindings/clock/microchip/pic32cm_sg_gc/microchip,pic32cm-sg-gc-rtc.yaml
```yaml
# Copyright (c) 2026 Microchip Technology Inc.
# SPDX-License-Identifier: Apache-2.0

title: PIC32CM_SG_GC RTC clock

description: |
  RTC clock configuration.

include: [base.yaml]

compatible: "microchip,pic32cm-sg-gc-rtc"

properties:
  "#clock-cells":
    const: 1
    type: int

  rtc-src:
    type: int
    default: 0
    description: |
      RTC source clock selection
      0: ulp32k
      1: ulp1k
      2: xosc32k
      3: xosc1k

clock-cells:
  - subsystem

examples:
  - |
    #Usage example:

    &clock {
      compatible = "microchip,pic32cm-sg-gc-clock";

      rtcclock: rtcclock {
        compatible = "microchip,pic32cm-sg-gc-rtc";
        #clock-cells = <1>;
        rtc-src = <0>;
      };
    };
```

## dts/bindings/clock/microchip/pic32cx_bz/microchip,pic32cx-bz-dswdtclk.yaml
```yaml
# Copyright (c) 2025 Microchip Technology Inc.
# SPDX-License-Identifier: Apache-2.0

include: [base.yaml]

description: Deep Sleep Watchdog Timer Reference Clock configuration.
compatible: "microchip,pic32cx-bz-dswdtclk"

properties:
  dswdtclk-src-sel:
    type: string
    enum:
      - "sosc"
      - "lprc"
    default: "lprc"
    description: Deep Sleep Watchdog Timer Reference Clock Select
```

## dts/bindings/clock/microchip/pic32cx_bz/microchip,pic32cx-bz-gclkperiph.yaml
```yaml
# Copyright (c) 2025 Microchip Technology Inc.
# SPDX-License-Identifier: Apache-2.0

include: [base.yaml]

description: Peripheral clock (GCLKPERIPH) configuration.
compatible: "microchip,pic32cx-bz-gclkperiph"

properties:
  "#clock-cells":
    const: 1
    type: int

clock-cells:
  - subsystem

child-binding:
  properties:
    subsystem:
      type: int
      required: true
      description: Clock subsystem

    gclkperiph-src-sel:
      type: string
      enum:
        - "no_clock"
        - "refclk_1"
        - "refclk_2"
        - "refclk_3"
        - "refclk_4"
        - "refclk_5"
        - "refclk_6"
        - "lpclk"
      default: "no_clock"
      description: Peripheral clock source delection

    gclkperiph-en:
      type: int
      enum:
        - 0
        - 1
      default: 0
      description: Peripheral clock Enable
```

## dts/bindings/clock/microchip/pic32cx_bz/microchip,pic32cx-bz-lpclk.yaml
```yaml
# Copyright (c) 2025 Microchip Technology Inc.
# SPDX-License-Identifier: Apache-2.0

include: [base.yaml]

description: LPCLK Modifier configuration.
compatible: "microchip,pic32cx-bz-lpclk"

properties:
  lpclk-div-modifier:
    type: string
    enum:
      - "div_by_1"
      - "div_by_1.024"
    default: "div_by_1"
    description: LPCLK Modifier in Counter/Delay Mode
```

## dts/bindings/clock/microchip/pic32cx_bz/microchip,pic32cx-bz-pbclk.yaml
```yaml
# Copyright (c) 2025 Microchip Technology Inc.
# SPDX-License-Identifier: Apache-2.0

include: [base.yaml]

description: Peripheral Bus Clock (PBCLK) configuration.
compatible: "microchip,pic32cx-bz-pbclk"

child-binding:
  properties:
    subsystem:
      type: int
      required: true
      description: Clock subsystem

    pbclk-div:
      type: int
      default: 1
      description: Peripheral Clock Divisor Control value (1 - 128)

    pbclk-en:
      type: int
      enum:
        - 0
        - 1
      default: 1
      description: Pbclk Enable
```

## dts/bindings/clock/microchip/pic32cx_bz/microchip,pic32cx-bz-posc.yaml
```yaml
# Copyright (c) 2025 Microchip Technology Inc.
# SPDX-License-Identifier: Apache-2.0

include: [base.yaml]

description: Primary Oscillator (POSC) configuration.
compatible: "microchip,pic32cx-bz-posc"

properties:
  posc-en:
    type: int
    enum:
      - 0
      - 1
    default: 0
    description: Oscillator Enable
```

## dts/bindings/clock/microchip/pic32cx_bz/microchip,pic32cx-bz-refclk.yaml
```yaml
# Copyright (c) 2025 Microchip Technology Inc.
# SPDX-License-Identifier: Apache-2.0

include: [base.yaml]

description: Reference Clock (REFCLK) configuration.
compatible: "microchip,pic32cx-bz-refclk"

child-binding:
  properties:
    subsystem:
      type: int
      required: true
      description: Clock subsystem

    refclk-div:
      type: int
      default: 0
      description: Reference Clock Divider (0 = no divider, 2*1 - 2*32767)

    refclk-stop-in-idle-en:
      type: int
      enum:
        - 0
        - 1
      default: 0
      description: Stop peripheral in Idle Mode

    refclk-run-in-sleep-en:
      type: int
      enum:
        - 0
        - 1
      default: 0
      description: Continue to run oscillator in the Sleep mode

    refclk-pin-out-en:
      type: int
      enum:
        - 0
        - 1
      default: 0
      description: Output the reference clock to REFOx pin

    refclk-src-sel:
      type: string
      enum:
        - "frc"
        - "spll1"
        - "posc"
        - "sosc"
        - "lprc"
        - "spll3"
        - "pbclk1"
        - "sysclk"
        - "refipin"
      default: "frc"
      description: Reference Clock source oscillator Select

    refclk-trim-val:
      type: int
      default: 0
      description: Provide fractional additive to refclk_div value (0- 511) /512

    refclk-refi-freq:
      type: int
      default: 8000000
      description: Input reference clock frequency

    refclk-en:
      type: int
      enum:
        - 0
        - 1
      default: 0
      description: Enable Reference Oscillator Module
```

## dts/bindings/clock/microchip/pic32cx_bz/microchip,pic32cx-bz-rtcclk.yaml
```yaml
# Copyright (c) 2025 Microchip Technology Inc.
# SPDX-License-Identifier: Apache-2.0

include: [base.yaml]

description: RTC LPCLK configuration.
compatible: "microchip,pic32cx-bz-rtcclk"

properties:
  "#clock-cells":
    const: 1
    type: int

  rtcclk-counter-mode-sel:
    type: string
    enum:
      - "processed_32k"
      - "raw_32k"
    default: "raw_32k"
    description: RTCC Counter Mode Clock Select

  rtcclk-vbkp-div-sel:
    type: string
    enum:
      - "div_by_32"
      - "div_by_31.25"
    default: "div_by_31.25"
    description: VDDBUKPCORE LPCLK Clock Divider Selection

  rtcclk-vbkp-1k-32k-sel:
    type: string
    enum:
      - "32khz"
      - "div_by_vbkp_div"
    default: "32khz"
    description: VDDBUKPCORE LPCLK Clock Selection

clock-cells:
  - subsystem
```

## dts/bindings/clock/microchip/pic32cx_bz/microchip,pic32cx-bz-sosc.yaml
```yaml
# Copyright (c) 2025 Microchip Technology Inc.
# SPDX-License-Identifier: Apache-2.0

include: [base.yaml]

description: Secondary Oscillator (SOSC) configuration.
compatible: "microchip,pic32cx-bz-sosc"

properties:
  sosc-en:
    type: int
    enum:
      - 0
      - 1
    default: 0
    description: Oscillator Enable
```
