## dts/bindings/clock/microchip/pic32cx_bz/microchip,pic32cx-bz-sysclk.yaml
```yaml
# Copyright (c) 2025 Microchip Technology Inc.
# SPDX-License-Identifier: Apache-2.0

include: [base.yaml]

description: System Clock (SYSCLK) configuration.
compatible: "microchip,pic32cx-bz-sysclk"

properties:
  sysclk-frc-div:
    type: int
    enum:
      - 1
      - 2
      - 4
      - 8
      - 16
      - 32
      - 64
      - 256
    default: 1
    description: Fast RC Clock Divider

  sysclk-new-osc:
    type: string
    enum:
      - "frcdiv"
      - "spll1"
      - "posc"
      - "sosc"
      - "lprc"

    default: "frcdiv"
    description: New Oscillator Selection for SYSCLK
```

## dts/bindings/clock/microchip/pic32cx_bz/microchip,pic32cx-bz-vbkpclk.yaml
```yaml
# Copyright (c) 2025 Microchip Technology Inc.
# SPDX-License-Identifier: Apache-2.0

include: [base.yaml]

description: VDDBUKPCORE 32 KHz Clock configuration.
compatible: "microchip,pic32cx-bz-vbkpclk"

properties:
  vbkpclk-32kc-src-sel:
    type: string
    enum:
      - "frc"
      - "posc"
      - "sosc"
      - "lprc"
    default: "frc"
    description: VDDBUKPCORE 32 KHz Clock Source Selection
```

## dts/bindings/clock/microchip/pic32cx_bz/microchip,pic32cx-bz6-clock.yaml
```yaml
# Copyright (c) 2025 Microchip Technology Inc.
# SPDX-License-Identifier: Apache-2.0

include:
  - name: base.yaml

description: Binding for Microchip PIC32CX_BZ6 SOC family clock
compatible: "microchip,pic32cx-bz6-clock"

properties:
  frc-freq:
    type: int
    default: 8000000
    description: Fast RC oscillator frequency

  posc-freq:
    type: int
    default: 16000000
    description: Primary oscillator frequency

  on-timeout-ms:
    type: int
    default: 5
    description: Timeout in milliseconds for clock to be on
```

## dts/bindings/clock/microchip/pic32cz_ca/microchip,pic32cz-ca-clock.yaml
```yaml
# Copyright (c) 2025-2026 Microchip Technology Inc.
# SPDX-License-Identifier: Apache-2.0

title: Microchip PIC32CZ_CA SOC family clock

description: |
  Microchip PIC32CZ_CA SOC family clock (OSCCTRL, OSC32KCTRL, GCLK, MCLK)

include:
  - name: base.yaml
  - name: pinctrl-device.yaml

compatible: "microchip,pic32cz-ca-clock"

properties:
  on-timeout-ms:
    type: int
    default: 65
    description: |
      Timeout in milliseconds for clock to be on.

      Driver waits in clock on API to check if the clock is actually on,
      so that the waiting time is not indefinite. (XOSC32K startup 62.6ms)

  flash-auto-wait-state-en:
    type: int
    enum:
      - 0
      - 1
    default: 0
    description: |
      Automatic wait state enable
      0: to disable, 1: to enable

  flash-wait-states:
    type: int
    default: 0
    description: |
      Number of wait states for a flash read operation.

      Change this value based on the NVM access time and system frequency
      up to 15 wait states.
```

## dts/bindings/clock/microchip/pic32cz_ca/microchip,pic32cz-ca-dfll48m.yaml
```yaml
# Copyright (c) 2025-2026 Microchip Technology Inc.
# SPDX-License-Identifier: Apache-2.0

title: PIC32CZ_CA Internal Oscillator (OSC48M)

description: |
  Digital Frequency-Locked Loop (DFLL48M) configuration.

include: [base.yaml]

compatible: "microchip,pic32cz-ca-dfll48m"

properties:
  dfll48m-on-demand-en:
    type: int
    enum:
      - 0
      - 1
    default: 0
    description: |
      0: The oscillator is always on
      1: The oscillator is running when a peripheral is requesting the oscillator to be used as a
      clock source. The oscillator is not running if no peripheral is requesting the clock source.
      Important: Initializing it with 1, along with clock enabled, can lead to indefinite wait for
      the clock to be on, if there is no peripheral request for the clock in the sequence of clock
      Initialization. If required, better to turn on the clock using API, instead of enabling both
      during startup.

  dfll48m-en:
    type: int
    enum:
      - 0
      - 1
    default: 1
    description: |
      Oscillator Enable
      0: to disable, 1: to enable

  dfll48m-wait-lock-en:
    type: int
    enum:
      - 0
      - 1
    default: 0
    description: |
      If enabled, clock available only after DFLL is locked (Fine lock)

      0: Output clock before the DFLL is locked.
      1: Output clock when DFLL is locked.

  dfll48m-quick-lock-dis:
    type: int
    enum:
      - 0
      - 1
    default: 0
    description: |
      Disable quick lock

      0: Quick Lock is enabled.
      1: Quick Lock is disabled.

  dfll48m-chill-cycle-dis:
    type: int
    enum:
      - 0
      - 1
    default: 0
    description: |
      Disable chill cycle

      0: Chill Cycle is enabled.
      1: Chill Cycle is disabled.

  dfll48m-lose-lock-en:
    type: int
    enum:
      - 0
      - 1
    default: 0
    description: |
      Lose Lock After Wake

      0: Locks will not be lost after waking up from sleep modes
         if the DFLL clock has been stopped.
      1: Locks will be lost after waking up from sleep modes
         if the DFLL clock has been stopped.

  dfll48m-stable-freq-en:
    type: int
    enum:
      - 0
      - 1
    default: 0
    description: |
      Stable DFLL48M Frequency

      0: Tune register tracks changes in output frequency.
      1: Tune calibration register value will be fixed after a lock.

  dfll48m-closed-loop-en:
    type: int
    enum:
      - 0
      - 1
    default: 0
    description: |
      Operating Mode Selection

      0: The DFLL operates in open-loop operation.
      1: The DFLL operates in closed-loop operation.

  dfll48m-tune-max-step:
    type: int
    default: 1
    description: |
      Indicates the maximum step size allowed during fine adjustment in closed-loop mode (0 - 127)

  dfll48m-multiply-factor:
    type: int
    default: 0
    description: |
      Determines the ratio of the CLK_DFLL output frequency to the CLK_DFLL_REF input frequency
      (0 - 65535)

  dfll48m-src-gclk:
    type: string
    enum:
      - "gclk0"
      - "gclk1"
      - "gclk2"
      - "gclk3"
      - "gclk4"
      - "gclk5"
      - "gclk6"
      - "gclk7"
      - "gclk8"
      - "gclk9"
      - "gclk10"
      - "gclk11"
      - "gclk12"
      - "gclk13"
      - "gclk14"
      - "gclk15"
    default: "gclk0"
    description: |
      Reference source clock selection from gclk generator
```

## dts/bindings/clock/microchip/pic32cz_ca/microchip,pic32cz-ca-dpll.yaml
```yaml
# Copyright (c) 2025-2026 Microchip Technology Inc.
# SPDX-License-Identifier: Apache-2.0

title: PIC32CZ_CA DPLL clock

description: |
  Digital Phase Locked Loop (DPLL), 12.7 MHz to 300 MHz output frequency or up to 1.6 GHz for
  fractional divider module use, from a 4 MHz to 48 MHz Reference Input Clock.

include: [base.yaml]

compatible: "microchip,pic32cz-ca-dpll"

child-binding:
  properties:
    subsystem:
      type: int
      required: true
      description: Clock subsystem

    dpll-bandwidth-sel:
      type: string
      enum:
        - "4mhz-10mhz"
        - "10mhz-20mhz"
        - "20mhz-30mhz"
        - "30mhz-60mhz"
      default: "4mhz-10mhz"
      description: |
        Select the PLL closed loop filter bandwidth.

        Depending on the frequency after the reference divider FPFD. Selecting the correct filter
        bandwidth is important to operate the PLL'VCO in its best range.

    dpll-src:
      type: string
      enum:
        - "gclk0"
        - "gclk1"
        - "gclk2"
        - "gclk3"
        - "gclk4"
        - "gclk5"
        - "gclk6"
        - "gclk7"
        - "gclk8"
        - "gclk9"
        - "gclk10"
        - "gclk11"
        - "gclk12"
        - "gclk13"
        - "gclk14"
        - "gclk15"
        - "xosc"
        - "dfll48m"
      default: "xosc"
      description: |
        Reference source clock selection

    dpll-on-demand-en:
      type: int
      enum:
        - 0
        - 1
      default: 0
      description: |
        0: The oscillator is always on
        1: The oscillator is running when a peripheral is requesting the oscillator to be used as a
        clock source. The oscillator is not running if no peripheral is requesting the clock source.
        Important: Initializing it with 1, along with clock enabled, can lead to indefinite wait
        for the clock to be on, if there is no peripheral request for the clock in the sequence of
        clock Initialization. If required, better to turn on the clock using API, instead of
        enabling both during startup.

    dpll-en:
      type: int
      enum:
        - 0
        - 1
      default: 0
      description: |
        Oscillator Enable
        0: to disable, 1: to enable

    dpll-feedback-divider-factor:
      type: int
      default: 0
      description: |
        This field determines the ratio of the PLL's VCO output frequency to the PLL Reference
        input frequency.

        Writing to the FBDIV(feedback-divider-factor) bits will cause lock to be lost.
        The value of FBDIV, (i.e. PLLFBDIV) must be within the range 21 ≤ FBDIV ≤ 1023.
        The frequency of the Voltage Controlled Oscillator (VCO) giving the PLL oscillation is
        given by the formula: FVCO = FCKR * (FBDIV / REFDIV), (i.e., Must be between 800 MHz and
        1600 MHz).
        fCKR(source clock), REFDIV(ref-division-factor) and FBDIV must be selected to satisfy this
        condition.

    dpll-ref-division-factor:
      type: int
      default: 0
      description: |
        This field determines the division factor of the PLL input reference frequency.

        Writing to the REFDIV bits will cause lock to be lost.
        REFDIV value must be in the range of 1 ≤ REFDIV ≤ 63.
        The frequency after the reference divider (FPFD) is given by the formula:
        FPFD = FCKR / REFDIV (i.e., FPFD must always be between 4 MHz to 48 MHz.

  child-binding:
    properties:
      subsystem:
        type: int
        required: true
        description: Clock subsystem

      dpll-output-en:
        type: int
        enum:
          - 0
          - 1
        default: 0
        description: |
          0: Output disabled
          1: Output enabled

      dpll-output-division-factor:
        type: int
        default: 0
        description: |
          This field determines the division factor of the PLL VCO frequency output.

      dpll-fractional-divider-int:
        type: int
        default: 0
        description: |
          Fractional Frequency Divider integer part. Applicable only for PLL1 output 0 and 1.

          Only the PLL1 supplies the clocks to the fractional dividers. FRACDIV0 is fed by PLL1
          output 0 (under control of PLL1POSTDIVA[0]) and FRACDIV1 is fed by PLL1 output 1 (under
          control of PLL1POSTDIVA[1]).
          The maximum fractional divider input frequency is 1.6 GHz.
          The divided frequency is given by the integer and reminder part of the divider, INTDIV and
          REMDIV.
          The resulting frequency FFRACDIV is calculated using the following equation:
          FCLK_PLL1_FRC_CLKOUTn = FCLK_PLL/ (2 * (INTDIV + (REMDIV/ 512)))

      dpll-fractional-divider-rem:
        type: int
        default: 0
        description: |
          Fractional Frequency Divider reminder part. Applicable only for PLL1 output 0 and 1.
```

## dts/bindings/clock/microchip/pic32cz_ca/microchip,pic32cz-ca-gclkgen.yaml
```yaml
# Copyright (c) 2025-2026 Microchip Technology Inc.
# SPDX-License-Identifier: Apache-2.0

title: PIC32CZ_CA Generic clock generator

description: |
  The Generic Clock controller (GCLK) features 12 Generic Clock Generators [11:0] that can
  provide a wide range of clock frequencies.

include: [base.yaml]

compatible: "microchip,pic32cz-ca-gclkgen"

child-binding:
  properties:
    subsystem:
      type: int
      required: true
      description: |
        Clock subsystem

    gclkgen-div-factor:
      type: int
      default: 0
      description: |
        Represent a division value for the corresponding Generator. The actual division factor is
        dependent on the state of div-select (gclk1 0 - 65535, others 0 - 255)

    gclkgen-run-in-standby-en:
      type: int
      enum:
        - 0
        - 1
      default: 0
      description: |
        Keep the Generator running in Standby as long as it is configured to output to a dedicated
        GCLK_IOn pin. If output is not configured to a pin, this field has no effect and the
        generator will only be running if a peripheral requires the clock.

    gclkgen-div-select:
      type: string
      enum:
        - "div-factor"
        - "div-factor-power"
      default: "div-factor"
      description: |
        The Generator clock frequency equals the clock source frequency divided by div-factor
        DIV_FACTOR_POWER: The Generator clock frequency equals the clock source frequency divided
        by 2^(N+1), where N is the div-factor

    gclkgen-pin-output-en:
      type: int
      enum:
        - 0
        - 1
      default: 0
      description: |
        Generator clock output to the corresponding pin, if that pin is not configured as input
        source.

    gclkgen-pin-output-off-val:
      type: string
      enum:
        - "low"
        - "high"
      default: "low"
      description: |
        Output value of the corresponding pin, when the Generator is turned off or the output-en is
        false, as long as the pin is not source.

    gclkgen-duty-50-50-en:
      type: int
      enum:
        - 0
        - 1
      default: 0
      description: |
        Improve the duty cycle of the Generator output to 50/50 for odd division factors

    gclkgen-en:
      type: int
      enum:
        - 0
        - 1
      default: 0
      description: |
        Enable gclk generator

    gclkgen-src:
      type: string
      enum:
        - "xosc"
        - "gclk-pin"
        - "gclk1"
        - "osculp32k"
        - "xosc32k"
        - "dfll48m"
        - "pll0-clkout0"
        - "pll0-clkout1"
        - "pll0-clkout2"
        - "pll0-clkout3"
        - "pll1-frc-clkout0"
        - "pll1-frc-clkout1"
        - "pll1-clkout2"
        - "pll1-clkout3"
      default: "xosc"
      description: |
        Generator source clock selection

    gclkgen-pin-src-freq:
      type: int
      default: 0
      description: |
        External input clock frequency of the pin, when used as source. (0 - 200000000)
```

## dts/bindings/clock/microchip/pic32cz_ca/microchip,pic32cz-ca-mclkdomain.yaml
```yaml
# Copyright (c) 2025-2026 Microchip Technology Inc.
# SPDX-License-Identifier: Apache-2.0

title: PIC32CZ_CA Main clock domains

description: |
  Main Clock Controller provides synchronous system clocks to the CPU & peripherals.

include: [base.yaml]

compatible: "microchip,pic32cz-ca-mclkdomain"

child-binding:
  properties:
    subsystem:
      type: int
      required: true
      description: Clock subsystem

    mclk-div:
      type: int
      enum:
        - 1
        - 2
        - 4
        - 8
        - 16
        - 32
        - 64
        - 128
      default: 1
      description: |
        Clock Division Factor
```

## dts/bindings/clock/microchip/pic32cz_ca/microchip,pic32cz-ca-rtc.yaml
```yaml
# Copyright (c) 2025-2026 Microchip Technology Inc.
# SPDX-License-Identifier: Apache-2.0

title: PIC32CZ_CA RTC clock

description: |
  RTC clock configuration.

include: [base.yaml]

compatible: "microchip,pic32cz-ca-rtc"

properties:
  "#clock-cells":
    const: 1
    type: int

  rtc-src:
    type: int
    default: 0
    description: |
      RTC source clock selection
      0: ulp1k
      1: ulp32k
      4: xosc1k
      5: xosc32k

clock-cells:
  - subsystem
```
