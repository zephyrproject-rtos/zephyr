## dts/bindings/clock/microchip/pic32cz_ca/microchip,pic32cz-ca-xosc.yaml
```yaml
# Copyright (c) 2025-2026 Microchip Technology Inc.
# SPDX-License-Identifier: Apache-2.0

title: PIC32CZ_CA Crystal Oscillator (XOSC)

description: |
  Supports 4-48 MHz Crystal Oscillators (XOSC).

include: [base.yaml]

compatible: "microchip,pic32cz-ca-xosc"

properties:
  xosc-usb-ref-clock-div:
    type: string
    enum:
      - "dis"
      - "div1"
      - "div2"
      - "div4"
    default: "dis"
    description: |
      USBHS reference clock division

      Select the XOSC division factor for the USBHS PLL reference clock.
      dis: USBHSPLL reference XOSC clock is disabled
      div1: USBHSPLL reference XOSC clock is divided by 1
      div2: USBHSPLL reference XOSC clock is divided by 2
      div3: USBHSPLL reference XOSC clock is divided by 4

  xosc-startup-time:
    type: int
    enum:
      - 1
      - 2
      - 4
      - 8
      - 16
      - 32
      - 64
      - 128
      - 256
      - 512
      - 1024
      - 2048
      - 4096
      - 8192
      - 16384
      - 32768
    default: 1
    description: |
      XOSC start-up time. Select number of OSCULP32K oscillator clock cycles.

  xosc-on-demand-en:
    type: int
    enum:
      - 0
      - 1
    default: 0
    description: |
      0: The XOSC is always on.
      1: The XOSC is running when a peripheral is requesting the XOSC to be used as a clock source.

  xosc-clock-switch-back-en:
    type: int
    enum:
      - 0
      - 1
    default: 0
    description: |
      Switch back to the external clock or crystal oscillator for clock recovery

      0: The clock switch back is disabled.
      1: The clock switch back is enabled.

  xosc-clock-failure-detection-en:
    type: int
    enum:
      - 0
      - 1
    default: 0
    description: |
      Clock Failure Detector Enable
      0: to disable, 1: to enable

  xosc-xtal-en:
    type: int
    enum:
      - 0
      - 1
    default: 0
    description: |
      Selects external clock or crystal oscillator

      0: External clock connected on XIN. XOUT can be used as general-purpose I/O.
      1: Crystal connected to XIN/XOUT.

  xosc-auto-gain-control-loop-en:
    type: int
    enum:
      - 0
      - 1
    default: 0
    description: |
      The oscillator auto gain control loop enable

      0: to disable
      1: to enable
         the Primary Oscillator will automatically do a linear search to find the lowest
         power/gain setting to guarantee stable oscillation with the user’s crystal.

  xosc-en:
    type: int
    enum:
      - 0
      - 1
    default: 0
    description: |
      Oscillator Enable
      0: to disable, 1: to enable

  xosc-frequency:
    type: int
    default: 0
    description: |
      Crystal/External clock frequency for XOSC Controller
```

## dts/bindings/clock/microchip/pic32cz_ca/microchip,pic32cz-ca-xosc32k.yaml
```yaml
# Copyright (c) 2025-2026 Microchip Technology Inc.
# SPDX-License-Identifier: Apache-2.0

title: PIC32CZ_CA External Crystal Oscillator (XOSC32K)

description: |
  32.768 kHz External Crystal Oscillator (XOSC32K) Control.

include: [base.yaml]

compatible: "microchip,pic32cz-ca-xosc32k"

properties:
  xosc32k-control-gain-mode:
    type: string
    enum:
      - "lower-gain-mode-value"
      - "higher-than-cgm0"
      - "higher-than-cgm1"
      - "higher-than-cgm2"
      - "higher-than-cgm3"
      - "higher-than-cgm4"
      - "higher-than-cgm5"
      - "higher-than-cgm6"
      - "higher-than-cgm7"
      - "higher-than-cgm8"
      - "higher-than-cgm9"
      - "higher-than-cgm10"
      - "higher-than-cgm11"
      - "higher-than-cgm12"
      - "higher-than-cgm13"
      - "highest-gain-mode-value"
    default: "higher-than-cgm7"
    description: |
      control the gain of the external crystal oscillator

  xosc32k-startup-time:
    type: string
    enum:
      - "122-us"
      - "580-us"
      - "1.07-ms"
      - "62.6-ms"
      - "125.1-ms"
      - "500.1-ms"
      - "1-s"
      - "2-s"
      - "4-s"
      - "8-s"
    default: "62.6-ms"
    description: |
      Oscillator Start-Up Time

  xosc32k-on-demand-en:
    type: int
    enum:
      - 0
      - 1
    default: 0
    description: |
      0: The oscillator is always on, if standby-en is true, else run in
         Standby Sleep mode if requested by a peripheral.
      1: Run if requested by peripheral
      Important: Initializing it with 1, along with clock enabled, can lead to indefinite wait for
      the clock to be on, if there is no peripheral request for the clock in the sequence of clock
      Initialization. If required, better to turn on the clock using API, instead of enabling both
      during startup.

  xosc32k-xtal-en:
    type: int
    enum:
      - 0
      - 1
    default: 0
    description: |
      Selects external clock or crystal oscillator
      0 - External clock connected on XIN. XOUT can be used as general-purpose I/O.
      1 - Crystal connected to XIN/XOUT.

  xosc32k-en:
    type: int
    enum:
      - 0
      - 1
    default: 0
    description: |
      Oscillator Enable

  xosc32k-cfd-prescaler:
    type: int
    enum:
      - 0
      - 1
    default: 0
    description: |
      Clock Failure Detector Prescaler
      0: The CFD safe clock frequency is the OSCULP32K frequency
      1: The CFD safe clock frequency is the OSCULP32K frequency divided by 2

  xosc32k-cfd-switchback-en:
    type: int
    enum:
      - 0
      - 1
    default: 0
    description: |
      Clock Switch Back
      0: to disable, 1: to enable

  xosc32k-cfd-en:
    type: int
    enum:
      - 0
      - 1
    default: 0
    description: |
      Clock Failure Detector Enable
      0: to disable, 1: to enable
```

## dts/bindings/clock/microchip/sam_d5x_e5x/microchip,sam-d5x-e5x-dfll.yaml
```yaml
# Copyright (c) 2025 Microchip Technology Inc.
# SPDX-License-Identifier: Apache-2.0

title: SAM_D5x_E5x Internal Oscillator (OSC48M)

description: |
  Digital Frequency-Locked Loop (DFLL48M) configuration.

include: [base.yaml]

compatible: "microchip,sam-d5x-e5x-dfll"

properties:
  dfll-on-demand-en:
    type: int
    enum:
      - 0
      - 1
    default: 0
    description: |
      0: The oscillator is always on
      1: The oscillator is running when a peripheral is requesting the oscillator to be used as a
      clock source. The oscillator is not running if no peripheral is requesting the clock source.
      Important: Initializing it with 1, along with clock enabled, can lead to indefinite wait for
      the clock to be on, if there is no peripheral request for the clock in the sequence of clock
      Initialization. If required, better to turn on the clock using API, instead of enabling both
      during startup.

  dfll-run-in-standby-en:
    type: int
    enum:
      - 0
      - 1
    default: 0
    description: |
      0: The DFLL is not running in standby sleep mode if no peripheral requests the clock.
      1: The DFLL is running in standby sleep mode.
      If ONDEMAND is one, the DFLL will be running when a peripheral is requesting the clock. If
      ONDEMAND is false, the clock source will always be running in standby sleep mode.

  dfll-en:
    type: int
    enum:
      - 0
      - 1
    default: 1
    description: |
      Oscillator Enable
      0: to disable, 1: to enable

  dfll-wait-lock-en:
    type: int
    enum:
      - 0
      - 1
    default: 0
    description: |
      If enabled, clock available only after DFLL is locked (Fine lock)
      0: to disable, 1: to enable

  dfll-bypass-coarse-lock-en:
    type: int
    enum:
      - 0
      - 1
    default: 0
    description: |
      To bypass coarse lock procedure
      0: to disable, 1: to enable

  dfll-quick-lock-dis:
    type: int
    enum:
      - 0
      - 1
    default: 0
    description: |
      Disable quick lock
      1: to disable, 0: to enable

  dfll-chill-cycle-dis:
    type: int
    enum:
      - 0
      - 1
    default: 0
    description: |
      Disable chill cycle
      1: to disable, 0: to enable

      The time from selecting a new CLK_DFLL48M frequency until this frequency is output
      by the DFLL48M can be up to several microseconds. If the value of dfll-multiply-factor
      is small, this can lead to instability in the DFLL48M locking mechanism, which can prevent
      the DFLL48M from achieving locks. To avoid this, a chill cycle, during which the CLK_DFLL48M
      frequency is not measured, can be enabled. Enabling chill cycles might double the lock time.

  dfll-usb-recovery-en:
    type: int
    enum:
      - 0
      - 1
    default: 0
    description: |
      Enable USB Clock Recovery Mode
      0: to disable, 1: to enable

  dfll-lose-lock-en:
    type: int
    enum:
      - 0
      - 1
    default: 0
    description: |
      If enabled, locks will be lost after waking up from sleep modes,
      if the DFLL clock has been stopped
      0: Locks will not be lost after waking up from sleep modes
      1: Locks will be lost after waking up from sleep modes

  dfll-stable-freq-en:
    type: int
    enum:
      - 0
      - 1
    default: 0
    description: |
      0: FINE calibration tracks changes in output frequency.
      1: FINE calibration register value will be fixed after a fine lock.

  dfll-closed-loop-en:
    type: int
    enum:
      - 0
      - 1
    default: 0
    description: |
      0: The DFLL operates in open-loop operation.
      1: The DFLL operates in closed-loop operation.

  dfll-coarse-max-step:
    type: int
    default: 0
    description: |
      Indicates the maximum step size allowed during coarse adjustment in closed-loop mode (0 - 31)

  dfll-fine-max-step:
    type: int
    default: 0
    description: |
      Indicates the maximum step size allowed during fine adjustment in closed-loop mode (0 - 255)

  dfll-multiply-factor:
    type: int
    default: 0
    description: |
      Determines the ratio of the CLK_DFLL output frequency to the CLK_DFLL_REF input frequency (0
      - 65535)

  dfll-src-gclk:
    type: string
    enum:
      - "gclk0"
      - "gclk1"
      - "gclk2"
      - "gclk3"
      - "gclk4"
      - "gclk5"
      - "gclk6"
      - "gclk7"
      - "gclk8"
      - "gclk9"
      - "gclk10"
      - "gclk11"
    default: "gclk0"
    description: |
      Reference source clock selection from gclk generator
```
