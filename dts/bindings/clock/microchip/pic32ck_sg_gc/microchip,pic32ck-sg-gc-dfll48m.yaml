## dts/bindings/clock/microchip/pic32ck_sg_gc/microchip,pic32ck-sg-gc-xosc.yaml
```yaml
# Copyright (c) 2025-2026 Microchip Technology Inc.
# SPDX-License-Identifier: Apache-2.0

title: PIC32CK_SG_GC Crystal Oscillator (XOSC)

description: |
  Supports 4-48 MHz Crystal Oscillators (XOSC).

  Provides configuration for the automatic gain control loop,
  crystal/external-clock selection, start-up time, clock-failure detection
  with safe-clock fallback, and the USB HS PLL reference divider. The XOSC
  output can be used as a source for the PLL and the generic clock generators.

  Example:

    xosc: xosc {
      compatible = "microchip,pic32ck-sg-gc-xosc";
      xosc-enable = <1>;
      xosc-xtal-en = <1>;
      xosc-frequency = <12000000>;
      xosc-safe-clock-frequency = <48>
    };

include: [base.yaml]

compatible: "microchip,pic32ck-sg-gc-xosc"

properties:
  xosc-enable:
    type: int
    enum:
      - 0
      - 1
    default: 0
    description: |
      Oscillator Enable
      0: to disable, 1: to enable

  xosc-auto-gain-control-loop-en:
    type: int
    enum:
      - 0
      - 1
    default: 0
    description: |
      The oscillator auto gain control loop enable

      0: to disable
      1: to enable
        the Primary Oscillator will automatically do a linear search to find the lowest
        power/gain setting to guarantee stable oscillation with the user’s crystal.

  xosc-clock-switch-back-en:
    type: int
    enum:
      - 0
      - 1
    default: 0
    description: |
      Switch back to the external clock or crystal oscillator for clock recovery

      0: The clock switch back is disabled.
      1: The clock switch back is enabled.

  xosc-xtal-en:
    type: int
    enum:
      - 0
      - 1
    default: 0
    description: |
      Selects external clock or crystal oscillator

      0: External clock connected on XIN. XOUT can be used as general-purpose I/O.
      1: Crystal connected to XIN/XOUT.

  xosc-frequency:
    type: int
    default: 0
    description: |
      Crystal/External clock frequency  in MHz for XOSC Controller

  xosc-on-demand-en:
    type: int
    enum:
      - 0
      - 1
    default: 0
    description: |
      0: The XOSC is always on.
      1: The XOSC is running when a peripheral is requesting the XOSC to be used as a clock source.

  xosc-startup-time:
    type: int
    enum:
      - 31
      - 61
      - 122
      - 244
      - 488
      - 977
      - 1953
      - 3906
      - 7813
      - 15625
      - 31250
      - 62500
      - 125000
      - 250000
      - 500000
      - 1000000
    default: 31
    description: |
      XOSC start-up time in micro seconds

  xosc-clock-failure-detection-en:
    type: int
    enum:
      - 0
      - 1
    default: 0
    description: |
      Clock Failure Detector Enable
      0: to disable, 1: to enable

  xosc-safe-clock-frequency:
    type: int
    enum:
      - 0
      - 1
      - 2
      - 3
      - 6
      - 12
      - 24
      - 48
    default: 0
    description: |
      xosc safe clock frequency in MHz

  xosc-usbhs-ref-clock-div:
    type: string
    enum:
      - "usbhs-pll-ref-xosc-clock-disabled"
      - "usbhs-pll-ref-xosc-clock-div-1"
      - "usbhs-pll-ref-xosc-clock-div-2"
      - "usbhs-pll-ref-xosc-clock-div-4"
    default: "usbhs-pll-ref-xosc-clock-disabled"
    description: |
      usbhs pll reference xosc clock
```

## dts/bindings/clock/microchip/pic32ck_sg_gc/microchip,pic32ck-sg-gc-xosc32k.yaml
```yaml
# Copyright (c) 2025-2026 Microchip Technology Inc.
# SPDX-License-Identifier: Apache-2.0

title: PIC32CK_SG_GC External Crystal Oscillator (XOSC32K)

description: |
  32.768 kHz External Crystal Oscillator (XOSC32K) Control.

  Controls the low-frequency 32.768 kHz oscillator, which can be driven by an
  external crystal or an external clock input. Provides configuration for the
  gain mode, servo loop, gain boost, start-up time, clock-failure detection
  with safe-clock fallback, and RTC clock selection. The XOSC32K output is
  commonly used as a low-power and RTC clock source.

  Example:

    xosc32k: xosc32k {
      compatible = "microchip,pic32ck-sg-gc-xosc32k";
      xosc32k-enable = <1>;
      xosc32k-xtal-en = <1>;
      xosc32k-frequency = <32768>;
      xosc32k-startup-time = <1000>;
    };

include: [base.yaml]

compatible: "microchip,pic32ck-sg-gc-xosc32k"

properties:
  xosc32k-enable:
    type: int
    enum:
      - 0
      - 1
    default: 0
    description: |
      Oscillator Enable

  xosc32k-xtal-en:
    type: int
    enum:
      - 0
      - 1
    default: 0
    description: |
      Selects external clock or crystal oscillator
      0 - External clock connected on XIN. XOUT can be used as general-purpose I/O.
      1 - Crystal connected to XIN/XOUT.

  xosc32k-frequency:
    type: int
    default: 0
    description: |
      32.768 kHz frequency

  xosc32k-on-demand-en:
    type: int
    enum:
      - 0
      - 1
    default: 0
    description: |
      0: The oscillator is always on, if standby-en is true, else run in
         Standby Sleep mode if requested by a peripheral.
      1: Run if requested by peripheral
      Important: Initializing it with 1, along with clock enabled, can lead to indefinite wait for
      the clock to be on, if there is no peripheral request for the clock in the sequence of clock
      Initialization. If required, better to turn on the clock using API, instead of enabling both
      during startup.

  xosc32k-control-gain-mode:
    type: string
    enum:
      - "lower-gain-mode-value"
      - "higher-than-cgm0"
      - "higher-than-cgm1"
      - "higher-than-cgm2"
      - "higher-than-cgm3"
      - "higher-than-cgm4"
      - "higher-than-cgm5"
      - "higher-than-cgm6"
      - "higher-than-cgm7"
      - "higher-than-cgm8"
      - "higher-than-cgm9"
      - "higher-than-cgm10"
      - "higher-than-cgm11"
      - "higher-than-cgm12"
      - "higher-than-cgm13"
      - "highest-gain-mode-value"
    default: "higher-than-cgm7"
    description: |
      control the gain of the external crystal oscillator

  xosc32k-servo-loop-en:
    type: int
    enum:
      - 0
      - 1
    default: 0
    description: |
      xosc32k servo loop
      0 - enable
      1-  disable

  xosc32k-gain-boost:
    type: int
    enum:
      - 0
      - 1
    default: 0
    description: |
      xosc32k gain boost
      0 - enable
      1-  disable

  xosc32k-startup-time:
    type: int
    enum:
      - 0
      - 1
      - 2
      - 63
      - 125
      - 250
      - 500
      - 1000
      - 2000
      - 4000
      - 8000
    default: 1000
    description: |
      Oscillator Start-Up Time in ms

  xosc32k-rtc-clk-selection-en:
    type: int
    enum:
      - 0
      - 1
    default: 0
    description: |
      xosc RTC clock selection
      0 - enable
      1-  disable


  xosc32k-cfd-en:
    type: int
    enum:
      - 0
      - 1
    default: 0
    description: |
      Clock Failure Detector Enable
      0: to disable, 1: to enable

  xosc32k-cfd-prescaler:
    type: int
    enum:
      - 0
      - 1
    default: 0
    description: |
      Clock Failure Detector Prescaler
      0: The CFD safe clock frequency is the OSCULP32K frequency
      1: The CFD safe clock frequency is the OSCULP32K frequency divided by 2

  xosc32k-cfd-switchback-en:
    type: int
    enum:
      - 0
      - 1
    default: 0
    description: |
      Clock Switch Back
      0: to disable, 1: to enable
```

## dts/bindings/clock/microchip/pic32cm_jh/microchip,pic32cm-jh-clock.yaml
```yaml
# Copyright (c) 2025 Microchip Technology Inc.
# SPDX-License-Identifier: Apache-2.0

title: Microchip PIC32CM_JH SOC family clock

description: |
  Microchip PIC32CM_JH SOC family clock (OSCCTRL, OSC32KCTRL, GCLK, MCLK)

include:
  - name: base.yaml
  - name: pinctrl-device.yaml

compatible: "microchip,pic32cm-jh-clock"

properties:
  on-timeout-ms:
    type: int
    default: 5
    description: |
      Timeout in milliseconds for clock to be on.

      Driver waits in clock on API to check if the clock is actually on,
      so that the waiting time is not indefinite.

  flash-wait-states:
    type: int
    default: 0
    description: |
      Number of wait states for a flash read operation.

      Change this value based on the NVM access time and system frequency
      up to 15 wait states.
```

## dts/bindings/clock/microchip/pic32cm_jh/microchip,pic32cm-jh-fdpll.yaml
```yaml
# Copyright (c) 2025 Microchip Technology Inc.
# SPDX-License-Identifier: Apache-2.0

title: PIC32CM_JH FDPLL clock

description: |
  Digital Phase Locked Loop (FDPLL), 48 MHz to 96 MHz output frequency from a 32 kHz to 2 MHz
  reference clock.

include: [base.yaml]

compatible: "microchip,pic32cm-jh-fdpll"

properties:
  fdpll-on-demand-en:
    type: int
    enum:
      - 0
      - 1
    default: 0
    description: |
      0: The oscillator is always on
      1: The oscillator is running when a peripheral is requesting the oscillator to be used as a
      clock source. The oscillator is not running if no peripheral is requesting the clock source.
      Important: Initializing it with 1, along with clock enabled, can lead to indefinite wait
      for the clock to be on, if there is no peripheral request for the clock in the sequence of
      clock Initialization. If required, better to turn on the clock using API, instead of
      enabling both during startup.

  fdpll-run-in-standby-en:
    type: int
    enum:
      - 0
      - 1
    default: 1
    description: |
      0: The DPLLn is not running in standby sleep mode if no peripheral requests the clock.
      1: The DPLLn is running in standby sleep mode.
      If ONDEMAND is one, the DPLLn will be running when a peripheral is requesting the clock. If
      ONDEMAND is false, the clock source will always be running in standby sleep mode.

  fdpll-en:
    type: int
    enum:
      - 0
      - 1
    default: 0
    description: |
      Oscillator Enable
      0: to disable, 1: to enable

  fdpll-divider-ratio-frac:
    type: int
    default: 0
    description: |
      Set the fractional part of the frequency multiplier. (0 - 31)

  fdpll-divider-ratio-int:
    type: int
    default: 0
    description: |
      Set the integer part of the frequency multiplier. (0 - 4095)

  fdpll-xosc-clock-divider:
    type: int
    default: 0
    description: |
      Set the XOSC clock division factor (0 - 2047)

  fdpll-lock-bypass-en:
    type: int
    enum:
      - 0
      - 1
    default: 0
    description: |
      Lock Bypass
      0: to disable, 1: to enable

  fdpll-src:
    type: string
    enum:
      - "gclk0"
      - "gclk1"
      - "gclk2"
      - "gclk3"
      - "gclk4"
      - "gclk5"
      - "gclk6"
      - "gclk7"
      - "gclk8"
      - "xosc32k"
      - "xosc"
    default: "xosc32k"
    description: |
      Reference source clock selection

  fdpll-wakeup-fast-en:
    type: int
    enum:
      - 0
      - 1
    default: 0
    description: |
      Wake Up Fast
      0: to disable, 1: to enable

  fdpll-low-power-en:
    type: int
    enum:
      - 0
      - 1
    default: 0
    description: |
      When enabled, Time to Digital Converter is disabled (increase the output jitter).
      0: to disable, 1: to enable

  fdpll-pi-filter-type:
    type: string
    enum:
      - "default"
      - "low-bandwidth"
      - "high-bandwidth"
      - "high-damping"
    default: "default"
    description: |
      Proportional Integral Filter Selection

  fdpll-output-prescalar:
    type: string
    enum:
      - "div1"
      - "div2"
      - "div4"
    default: "div1"
    description: |
      Output prescalar divider.
```

## dts/bindings/clock/microchip/pic32cm_jh/microchip,pic32cm-jh-gclkgen.yaml
```yaml
# Copyright (c) 2025 Microchip Technology Inc.
# SPDX-License-Identifier: Apache-2.0

title: PIC32CM_JH Generic clock generator

description: |
  The Generic Clock controller (GCLK) features 9 Generic Clock Generators 0..8 that can
  provide a wide range of clock frequencies.

include: [base.yaml]

compatible: "microchip,pic32cm-jh-gclkgen"

child-binding:
  properties:
    subsystem:
      type: int
      required: true
      description: |
        Clock subsystem

    gclkgen-div-factor:
      type: int
      default: 0
      description: |
        Represent a division value for the corresponding Generator. The actual division factor is
        dependent on the state of div-select (gclk1 0 - 65535, others 0 - 255)

    gclkgen-run-in-standby-en:
      type: int
      enum:
        - 0
        - 1
      default: 0
      description: |
        Keep the Generator running in Standby as long as it is configured to output to a dedicated
        GCLK_IOn pin. If output is not configured to a pin, this field has no effect and the
        generator will only be running if a peripheral requires the clock.
        0: to disable, 1: to enable

    gclkgen-div-select:
      type: string
      enum:
        - "div-factor"
        - "div-factor-power"
      default: "div-factor"
      description: |
        The Generator clock frequency equals the clock source frequency divided by div-factor
        DIV_FACTOR_POWER: The Generator clock frequency equals the clock source frequency divided
        by 2^(N+1), where N is the div-factor

    gclkgen-pin-output-en:
      type: int
      enum:
        - 0
        - 1
      default: 0
      description: |
        Generator clock output to the corresponding pin, if that pin is not configured as input
        source.
        0: to disable, 1: to enable

    gclkgen-pin-output-off-val:
      type: string
      enum:
        - "low"
        - "high"
      default: "low"
      description: |
        Output value of the corresponding pin, when the Generator is turned off or the output-en is
        false, as long as the pin is not source.

    gclkgen-improve-duty-cycle-en:
      type: int
      enum:
        - 0
        - 1
      default: 0
      description: |
        Improve the duty cycle of the Generator output to 50/50 for odd division factors
        0: to disable, 1: to enable

    gclkgen-en:
      type: int
      enum:
        - 0
        - 1
      default: 0
      description: |
        Enable gclk generator
        0: to disable, 1: to enable

    gclkgen-src:
      type: string
      enum:
        - "xosc"
        - "gclk-pin"
        - "gclk1"
        - "osculp32k"
        - "osc32k"
        - "xosc32k"
        - "osc48m"
        - "fdpll"
      default: "xosc"
      description: |
        Generator source clock selection

    gclkgen-pin-src-freq:
      type: int
      default: 0
      description: |
        External input clock frequency of the pin, when used as source. (0 - 200000000)
```
