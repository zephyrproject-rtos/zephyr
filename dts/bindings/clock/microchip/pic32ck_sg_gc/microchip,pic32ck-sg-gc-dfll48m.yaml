## dts/bindings/clock/microchip/pic32cm_pl/microchip,pic32cm-pl-osc32k.yaml
```yaml
# Copyright (c) 2026 Microchip Technology Inc.
# SPDX-License-Identifier: Apache-2.0

title: PIC32CM_PL Internal Oscillator (OSC32K) Control

description: |
  32.768 kHz High Accuracy Internal Oscillator (OSC32K).

include: [base.yaml]

compatible: "microchip,pic32cm-pl-osc32k"

properties:
  osc32k-on-demand-en:
    type: int
    enum:
      - 0
      - 1
    default: 0
    description: |
      On Demand Configuration

      0: The oscillator is always on, if standby-en is true, else run in
         Standby Sleep mode if requested by a peripheral.
      1: Run if requested by peripheral
      Important: Initializing it with 1, along with clock enabled, can lead to indefinite wait for
      the clock to be on, if there is no peripheral request for the clock in the sequence of clock
      Initialization. If required, better to turn on the clock using API, instead of enabling both
      during startup.
```

## dts/bindings/clock/microchip/pic32cm_pl/microchip,pic32cm-pl-oschf.yaml
```yaml
# Copyright (c) 2026 Microchip Technology Inc.
# SPDX-License-Identifier: Apache-2.0

title: PIC32CM_PL Internal High-Frequency Oscillator (OSCHF)

description: |
  Internal High-Frequency Oscillator (OSCHF) with 1-24 MHz clock output

include: [base.yaml]

compatible: "microchip,pic32cm-pl-oschf"

properties:
  oschf-on-demand-en:
    type: int
    enum:
      - 0
      - 1
    default: 0
    description: |
      On-Demand Configuration

      0: The oscillator is always ON normally.
      In standby sleep mode, oscillator will be OFF if there is no peripheral request,
      unless run-in-standby-en is 1.
      1: In both normal and standby sleep mode, The oscillator is ON,
      when a peripheral is requesting the oscillator to be used as a clock source.
      The oscillator is OFF if no peripheral is requesting the clock source.
      Important: Initializing it with 1, along with clock enabled, can lead to indefinite wait
      for the clock to be on, if there is no peripheral request for the clock in the sequence of
      clock Initialization. If required, better to turn on the clock using API, instead of
      enabling both during startup.

  oschf-frequency:
    type: int
    enum:
      - 1000000
      - 2000000
      - 3000000
      - 4000000
      - 8000000
      - 12000000
      - 20000000
      - 24000000

    default: 24000000
    description: |
      oschf frequency

      Clock frequency for OSCHF Oscillator Controller in Hertz
      - 1000000 : 1MHz
      - 2000000 : 2MHz
      - 3000000 : 3MHz
      - 4000000 : 4MHz
      - 8000000 : 8MHz
      - 12000000 : 12MHz
      - 20000000 : 20MHz
      - 24000000 : 24MHz

  oschf-autotune-en:
    type: int
    enum:
      - 0
      - 1
    default: 0
    description: |
      Enable automatic tuning using 32.768 kHz from XOSC32K.

      0: Disable autotune
      1: Enable autotune
```

## dts/bindings/clock/microchip/pic32cm_pl/microchip,pic32cm-pl-rtc.yaml
```yaml
# Copyright (c) 2026 Microchip Technology Inc.
# SPDX-License-Identifier: Apache-2.0

title: PIC32CM_PL RTC clock

description: |
  RTC clock configuration.

include: [base.yaml]

compatible: "microchip,pic32cm-pl-rtc"

properties:
  "#clock-cells":
    const: 1
    type: int

  rtc-src:
    type: string
    enum:
      - "OSC1K"
      - "OSC32K"
      - "XOSC1K"
      - "XOSC32K"
    default: "XOSC1K"
    description: |
      RTC source clock selection

clock-cells:
  - subsystem
```

## dts/bindings/clock/microchip/pic32cm_pl/microchip,pic32cm-pl-xosc32k.yaml
```yaml
# Copyright (c) 2026 Microchip Technology Inc.
# SPDX-License-Identifier: Apache-2.0

title: PIC32CM_PL External Crystal Oscillator (XOSC32K)

description: |
  32.768 kHz External Crystal Oscillator (XOSC32K) Control.

include: [base.yaml]

compatible: "microchip,pic32cm-pl-xosc32k"

properties:
  xosc32k-startup-time:
    type: string
    enum:
      - "1K"
      - "16K"
      - "32K"
      - "64K"
    default: "1K"
    description: |
      Oscillator Start-Up Time

      1K : 1K XOSC32K cycles
      16K: 16K XOSC32K cycles
      32k: 32K XOSC32K cycles
      64K: 64K XOSC32K cycles

  xosc32k-on-demand-en:
    type: int
    enum:
      - 0
      - 1
    default: 0
    description: |
      On Demand Configuration

      0: The oscillator is always on, if standby-en is true, else run in
         Standby Sleep mode if requested by a peripheral.
      1: Run if requested by peripheral
      Important: Initializing it with 1, along with clock enabled, can lead to indefinite wait for
      the clock to be on, if there is no peripheral request for the clock in the sequence of clock
      Initialization. If required, better to turn on the clock using API, instead of enabling both
      during startup.

  xosc32k-xtal-en:
    type: int
    enum:
      - 0
      - 1
    default: 0
    description: |
      xosc32k source selection

      Selects external clock or crystal oscillator
      0 - External clock connected on XIN. XOUT can be used as general-purpose I/O.
      1 - Crystal connected to XIN/XOUT.

  xosc32k-en:
    type: int
    enum:
      - 0
      - 1
    default: 0
    description: |
      Oscillator Enable

      0: to disable, 1: to enable

  xosc32k-cfd-en:
    type: int
    enum:
      - 0
      - 1
    default: 0
    description: |
      Clock Failure Detector Enable

      0: to disable, 1: to enable

  low-power-en:
    type: int
    enum:
      - 0
      - 1
    default: 0
    description: |
      Run Oscillator in Low Power Mode

      0: to disable, 1: to enable
```
