## dts/bindings/clock/microchip/pic32ck_sg_gc/microchip,pic32ck-sg-gc-dfll48m.yaml
```yaml
# Copyright (c) 2025-26 Microchip Technology Inc.
# SPDX-License-Identifier: Apache-2.0

title: PIC32CK_SG_GC Internal Oscillator (OSC48M)

description: |
  Digital Frequency-Locked Loop (DFLL48M) configuration.

  Configures the DFLL48M, which generates a 48 MHz output clock from a
  reference clock supplied by one of the GCLK generators. The DFLL can run in
  open-loop or closed-loop mode and supports USB clock recovery, configurable
  lock behaviour, and tuning. It is used as a system clock source
  for the PIC32CK_SG_GC SoC family.

  Example:

    dfll48m: dfll48m {
      compatible = "microchip,pic32ck-sg-gc-dfll48m";
      dfll48m-src-gclk = "gclk0";
      dfll48m-enable = <1>;
      dfll48m-closed-loop-en = <1>;
    };

include: [base.yaml]

compatible: "microchip,pic32ck-sg-gc-dfll48m"

properties:
  dfll48m-src-gclk:
    type: string
    enum:
      - "gclk0"
      - "gclk1"
      - "gclk2"
      - "gclk3"
      - "gclk4"
      - "gclk5"
      - "gclk6"
      - "gclk7"
      - "gclk8"
      - "gclk9"
      - "gclk10"
      - "gclk11"
    default: "gclk0"
    description: |
      Reference source clock selection from gclk generator

  dfll48m-enable:
    type: int
    enum:
      - 0
      - 1
    default: 1
    description: |
      Oscillator Enable
      0: to disable, 1: to enable

  dfll48m-closed-loop-en:
    type: int
    enum:
      - 0
      - 1
    default: 1
    description: |
      The DFLL operated in open or close loop operation mode
        0: The DFLL operates in open-loop operation.
        1: The DFLL operates in closed-loop operation.

  dfll48m-on-demand-en:
    type: int
    enum:
      - 0
      - 1
    default: 1
    description: |
      0: The oscillator is always on
      1: The oscillator is running when a peripheral is requesting the oscillator to be used as a
      clock source. The oscillator is not running if no peripheral is requesting the clock source.
      Important: Initializing it with 1, along with clock enabled, can lead to indefinite wait for
      the clock to be on, if there is no peripheral request for the clock in the sequence of clock
      Initialization. If required, better to turn on the clock using API, instead of enabling both
      during startup.

  dfll48m-usb-clock-recovery-mode:
    type: int
    enum:
      - 0
      - 1
    default: 1
    description: |
      USB clock recovery mode
      0: enabled.
      1: disabled.

  dfll48m-wait-lock-en:
    type: int
    enum:
      - 0
      - 1
    default: 0
    description: |
      If enabled, clock available only after DFLL is locked (Fine lock)

      0: Output clock before the DFLL is locked.
      1: Output clock when DFLL is locked.

  dfll48m-quick-lock-dis:
    type: int
    enum:
      - 0
      - 1
    default: 0
    description: |
      Disable quick lock

      0: Quick Lock is enabled.
      1: Quick Lock is disabled.

  dfll48m-chill-cycle-dis:
    type: int
    enum:
      - 0
      - 1
    default: 0
    description: |
      Disable chill cycle

      0: Chill Cycle is enabled.
      1: Chill Cycle is disabled.

  dfll48m-lose-lock-en:
    type: int
    enum:
      - 0
      - 1
    default: 0
    description: |
      Lose Lock After Wake

      0: Locks will not be lost after waking up from sleep modes
         if the DFLL clock has been stopped.
      1: Locks will be lost after waking up from sleep modes
         if the DFLL clock has been stopped.

  dfll48m-stable-freq-en:
    type: int
    enum:
      - 0
      - 1
    default: 0
    description: |
      Stable DFLL48M Frequency

      0: Tune register tracks changes in output frequency.
      1: Tune calibration register value will be fixed after a lock.

  dfll48m-tune-max-step:
    type: int
    default: 1
    description: |
      Indicates the maximum step size allowed during fine adjustment in closed-loop mode (0 - 127)

  dfll48m-multiply-factor:
    type: int
    default: 0
    description: |
      Determines the ratio of the CLK_DFLL output frequency to the CLK_DFLL_REF input frequency
      (0 - 65535)
```

## dts/bindings/clock/microchip/pic32ck_sg_gc/microchip,pic32ck-sg-gc-gclkgen.yaml
```yaml
# Copyright (c) 2025-2026 Microchip Technology Inc.
# SPDX-License-Identifier: Apache-2.0

title: PIC32CK_SG_GC Generic clock generator

description: |
  The Generic Clock controller (GCLK) features 12 Generic Clock Generators
  [11:0] that derive a wide range of clock frequencies from the available
  oscillator sources (XOSC, XOSC32K, OSCULP32K, DFLL48M, PLL, etc.). Each
  generator can independently select its source, apply a division factor,
  and optionally output its clock to a GCLK_IO pin. The generated clocks are
  distributed to the SoC peripherals.

  Each generator is described by a child node.

  Example:

    gclkgen: gclkgen {
      compatible = "microchip,pic32ck-sg-gc-gclkgen";
      gclk0 {
        subsystem = <0>;
        gclkgen-en = <1>;
        gclkgen-src = "dfll48m";
        gclkgen-div-factor = <0>;
      };
    };

include: [base.yaml]

compatible: "microchip,pic32ck-sg-gc-gclkgen"

child-binding:
  properties:
    subsystem:
      type: int
      required: true
      description: |
        Clock subsystem

    gclkgen-en:
      type: int
      enum:
        - 0
        - 1
      default: 1
      description: |
        A Generator is enabled by writing a '1' to the Generator Enable bit
        in the Generator Control register
        A Generator is disabled by writing a '0'

    gclkgen-run-in-standby-en:
      type: int
      enum:
        - 0
        - 1
      default: 0
      description: |
        Keep the Generator running in Standby as long as it is configured to output to a dedicated
        GCLK_IOn pin. If output is not configured to a pin, this field has no effect and the
        generator will only be running if a peripheral requires the clock.
        0 - run in standby disable
        1 - run in standby enable

    gclkgen-ext-input-frequency:
      type: int
      default: 0
      description: |
        The output clock (GCLK_GEN) of each Generator can be sent to I/O pins (GCLK_IO).

    gclkgen-src:
      type: string
      enum:
        - "xosc"
        - "gclk-pin"
        - "gclk1"
        - "osculp32k"
        - "xosc32k"
        - "dfll48m"
        - "pll0_0"
        - "pll0_1"
        - "pll0_2"
        - "pll0_3"
        - "pll0_4"
        - "pll0_5"
      default: "xosc"
      description: |
        Generator source clock selection

    gclkgen-output-off-val:
      type: string
      enum:
        - "logic-level-0"
        - "logic-level-1"
      default: "logic-level-0"
      description: |
        Output value of the corresponding pin, when the Generator is turned off or the output-en is
        false, as long as the pin is not source.

    gclkgen-input-frequency:
      type: int
      default: 0
      description: |
        External input clock frequency of the pin, when used as source. (0 - 200000000)

    gclkgen-div-select:
      type: string
      enum:
        - "div-factor"
        - "div-factor-power"
      default: "div-factor"
      description: |
        The Generator clock frequency equals the clock source frequency divided by div-factor
        DIV_FACTOR_POWER: The Generator clock frequency equals the clock source frequency divided
        by 2^(N+1), where N is the div-factor

    gclkgen-div-factor:
      type: int
      default: 0
      description: |
        Represent a division value for the corresponding Generator. The actual division factor is
        dependent on the state of div-select (gclk1 0 - 65535, others 0 - 255)

    gclkgen-duty-50-50-en:
      type: int
      enum:
        - 0
        - 1
      default: 0
      description: |
        Improve the duty cycle of the Generator output to 50/50 for odd division factors

    gclkgen-out-clock-signal:
      type: int
      enum:
        - 0
        - 1
      default: 0
      description: |
        0 - No Generator clock signal on pin GCLK_IO.
        1 -The Generator clock signal is output on the corresponding GCLK_IO, unless
        GCLK_IO is selected as a generator source in the GENCTRLn.SRC bit field.

    gclkgen-clock-frequency:
      type: int
      default: 0
      description: |
        gclk Clock Frequency in 120 MHz
```

## dts/bindings/clock/microchip/pic32ck_sg_gc/microchip,pic32ck-sg-gc-mclkcpu.yaml
```yaml
# Copyright (c) 2026 Microchip Technology Inc.
# SPDX-License-Identifier: Apache-2.0

title: PIC32CK_SG_GC Main clock domains

description: |
  Main Clock Controller provides synchronous system clocks to the CPU & peripherals.

include: [base.yaml]

compatible: "microchip,pic32ck-sg-gc-mclkcpu"

properties:
  mclk-div:
    type: string
    enum:
      - "DIV1"
      - "DIV2"
      - "DIV4"
      - "DIV8"
      - "DIV16"
      - "DIV32"
      - "DIV64"
      - "DIV128"
    default: "DIV1"
    description: |
      CPU Clock Domain Division Factor
      These bits define the division ratio of the main clock (MCLK) prescaler
      related to the CPU Clock Domain controlled by the CLKDIVn register.
```

## dts/bindings/clock/microchip/pic32ck_sg_gc/microchip,pic32ck-sg-gc-mclkperiph.yaml
```yaml
# Copyright (c) 2026 Microchip Technology Inc.
# SPDX-License-Identifier: Apache-2.0

title: PIC32CK_SG_GC MCLK (Main Clock) peripheral

description: |
  Main Clock Controller provides synchronous system clocks to the modules
  connected to the AHBx and the APBx buses.

include: [base.yaml]

compatible: "microchip,pic32ck-sg-gc-mclkperiph"

properties:
  "#clock-cells":
    const: 1
    type: int
    description: |
      The subsystem cell is to identify a clock controller sub-system.

      The subsystem can be referred from include\zephyr\dt-bindings\clock\mchp_pic32ck_gc_clock.h,
      under the MCLKPERIPH_TYPE section of ids.
      All clock control API use this value to specify the clock on which the API operates.
      Since subsystem is opaque to the user, it can be accessed from the devicetree node and used.

clock-cells:
  - subsystem

child-binding:
  properties:
    subsystem:
      type: int
      required: true
      description: Clock subsystem

    mclk-en:
      type: int
      enum:
        - 0
        - 1
      default: 1
      description: |
        Enable mclk to the peripheral
        0 - disable
        1 - Enable
```

## dts/bindings/clock/microchip/pic32ck_sg_gc/microchip,pic32ck-sg-gc-pll.yaml
```yaml
# Copyright (c) 2025-2026 Microchip Technology Inc.
# SPDX-License-Identifier: Apache-2.0

title: PIC32CK_SG_GC PLL clock

description: |
  PIC32CK_SG_GC Phase-Locked Loop (PLL).

  Generates a high-frequency output clock (12.7 MHz to 200 MHz, or up to
  1.6 GHz when the fractional divider module is used) from a 4 MHz to 48 MHz
  reference input clock. The reference can be sourced from a GCLK generator,
  XOSC or DFLL48M.

  The PLL is described hierarchically: the PLL node contains a child node per
  PLL instance, which in turn contains a child node per PLL output.

  Example:

    pll: pll {
      compatible = "microchip,pic32ck-sg-gc-pll";

      pll0: pll0 {
        compatible = "microchip,pic32ck-sg-gc-pllchild";
        subsystem = <CLOCK_MCHP_PLL_ID_PLL0>;
        pll-enable = <1>;
        pll-src = "xosc";
        pll-ref-division-factor = <1>;
        pll-feedback-divider-factor = <50>;

        pll0out0: pll0out0 {
          compatible = "microchip,pic32ck-sg-gc-pll0out";
          subsystem = <CLOCK_MCHP_PLL0_ID_OUT0>;
          pll-output-en = <1>;
          pll-output-division-factor = <8>;
        };
      };
    };

include: [base.yaml]

compatible: "microchip,pic32ck-sg-gc-pll"

child-binding:
  compatible: "microchip,pic32ck-sg-gc-pllchild"
  properties:
    subsystem:
      type: int
      required: true
      description: Clock subsystem

    pll-enable:
      type: int
      enum:
        - 0
        - 1
      default: 0
      description: |
        Oscillator Enable
        0: to disable, 1: to enable

    pll-on-demand-en:
      type: int
      enum:
        - 0
        - 1
      default: 0
      description: |
        0: The oscillator is always on
        1: The oscillator is running when a peripheral is requesting the oscillator to be used as a
        clock source. The oscillator is not running if no peripheral is requesting the clock source.
        Important: Initializing it with 1, along with clock enabled, can lead to indefinite wait
        for the clock to be on, if there is no peripheral request for the clock in the sequence of
        clock Initialization. If required, better to turn on the clock using API, instead of
        enabling both during startup.

    pll-bandwidth-sel:
      type: string
      enum:
        - "bwsel-0"
        - "bwsel-1"
        - "bwsel-2"
        - "bwsel-3"
        - "bwsel-4"
        - "bwsel-5"
        - "bwsel-6"
        - "bwsel-7"
      default: "bwsel-0"
      description: |
        Select the pll0 closed loop filter bandwidth.

        Depending on the frequency after the reference divider FPFD. Selecting the correct filter
        bandwidth is important to operate the pll0'VCO in its best range.

    pll-src:
      type: string
      enum:
        - "gclk0"
        - "gclk1"
        - "gclk2"
        - "gclk3"
        - "gclk4"
        - "gclk5"
        - "gclk6"
        - "gclk7"
        - "gclk8"
        - "gclk9"
        - "gclk10"
        - "gclk11"
        - "xosc"
        - "dfll48m"
      default: "xosc"
      description: |
        Reference source clock selection

    pll-feedback-divider-factor:
      type: int
      default: 0
      description: |
        This field determines the ratio of the pll0's VCO output frequency to the pll0 Reference
        input frequency.

        Writing to the FBDIV(feedback-divider-factor) bits will cause lock to be lost.
        The value of FBDIV, (i.e. pll0FBDIV) must be within the range 21 ≤ FBDIV ≤ 1023.
        The frequency of the Voltage Controlled Oscillator (VCO) giving the pll0 oscillation is
        given by the formula: FVCO = FCKR * (FBDIV / REFDIV), (i.e., Must be between 800 MHz and
        1600 MHz).
        fCKR(source clock), REFDIV(ref-division-factor) and FBDIV must be selected to satisfy this
        condition.

    pll-ref-division-factor:
      type: int
      default: 0
      description: |
        This field determines the division factor of the pll0 input reference frequency.

        Writing to the REFDIV bits will cause lock to be lost.
        REFDIV value must be in the range of 1 ≤ REFDIV ≤ 63.
        The frequency after the reference divider (FPFD) is given by the formula:
        FPFD = FCKR / REFDIV (i.e., FPFD must always be between 4 MHz to 48 MHz.

    pll-freq-division-factor-int:
      type: int
      default: 0
      description: |
        This field determines the ratio of the pll0's VCO output frequency to the pll0 Reference
        input frequency.

    pll-freq-division-factor-rem:
      type: int
      default: 0
      description: |
        This field determines the ratio of the pll0's VCO output frequency to the pll0 Reference
        input frequency.

  child-binding:
    compatible: "microchip,pic32ck-sg-gc-pll0out"
    properties:
      subsystem:
        type: int
        required: true
        description: Clock subsystem

      pll-output-en:
        type: int
        enum:
          - 0
          - 1
        default: 0
        description: |
          0: Output disabled
          1: Output enabled

      pll-output-division-factor:
        type: int
        default: 0
        description: |
          This field determines the division factor of the PLL0 FVCO output that
          creates FCLK_PLL0 and CLK_PLL0_CLKOUTn.
          The POSTDIV value must be between 1 ≤ POSTDIV ≤ 63.
```
