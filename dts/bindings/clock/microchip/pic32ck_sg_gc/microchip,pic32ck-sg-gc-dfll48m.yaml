## dts/bindings/clock/microchip/pic32cm_jh/microchip,pic32cm-jh-gclkperiph.yaml
```yaml
# Copyright (c) 2025 Microchip Technology Inc.
# SPDX-License-Identifier: Apache-2.0

title: PIC32CM_JH Generic clock peripheral

description: |
  Peripheral channel gclk clock configuration. The outputs from the Generators are used as sources
  for the Peripheral Channels, which provide the Generic Clock (GCLK_PERIPH) to the peripheral
  modules.

include: [base.yaml]

compatible: "microchip,pic32cm-jh-gclkperiph"

properties:
  "#clock-cells":
    const: 1
    type: int
    description: |
      The subsystem cell is to identify a clock controller sub-system.

      The subsystem can be referred from include\zephyr\dt-bindings\clock\mchp_pic32cm_jh_clock.h,
      under the GCLKPERIPH_TYPE section of ids.
      All clock control API use this value to specify the clock on which the API operates.
      Since subsystem is opaque to the user, it can be accessed from the devicetree node and used.

clock-cells:
  - subsystem

child-binding:
  properties:
    subsystem:
      type: int
      required: true
      description: Clock subsystem

    gclkperiph-src:
      type: string
      enum:
        - "gclk0"
        - "gclk1"
        - "gclk2"
        - "gclk3"
        - "gclk4"
        - "gclk5"
        - "gclk6"
        - "gclk7"
        - "gclk8"
      default: "gclk0"
      description: |
        Generator to be used as the source of a peripheral clock

    gclkperiph-en:
      type: int
      enum:
        - 0
        - 1
      default: 0
      description: |
        Enable a peripheral channel
        0: to disable, 1: to enable
```

## dts/bindings/clock/microchip/pic32cm_jh/microchip,pic32cm-jh-mclkcpu.yaml
```yaml
# Copyright (c) 2025 Microchip Technology Inc.
# SPDX-License-Identifier: Apache-2.0

title: PIC32CM_JH Main clock for CPU

description: |
  Main Clock Controller provides synchronous system clocks to the CPU.

include: [base.yaml]

compatible: "microchip,pic32cm-jh-mclkcpu"

properties:
  mclk-cpu-div:
    type: int
    enum:
      - 1
      - 2
      - 4
      - 8
      - 16
      - 32
      - 64
      - 128
    default: 1
    description: |
      CPU Clock Division Factor
```

## dts/bindings/clock/microchip/pic32cm_jh/microchip,pic32cm-jh-mclkperiph.yaml
```yaml
# Copyright (c) 2025 Microchip Technology Inc.
# SPDX-License-Identifier: Apache-2.0

title: PIC32CM_JH MCLK (Main Clock) peripheral

description: |
  Main Clock Controller provides synchronous system clocks to the modules
  connected to the AHBx and the APBx buses.

include: [base.yaml]

compatible: "microchip,pic32cm-jh-mclkperiph"

properties:
  "#clock-cells":
    const: 1
    type: int
    description: |
      The subsystem cell is to identify a clock controller sub-system.

      The subsystem can be referred from include\zephyr\dt-bindings\clock\mchp_pic32cm_jh_clock.h,
      under the MCLKPERIPH_TYPE section of ids.
      All clock control API use this value to specify the clock on which the API operates.
      Since subsystem is opaque to the user, it can be accessed from the devicetree node and used.

clock-cells:
  - subsystem

child-binding:
  properties:
    subsystem:
      type: int
      required: true
      description: |
        Clock subsystem

    mclk-en:
      type: int
      enum:
        - 0
        - 1
      required: true
      description: |
        Enable mclk to the peripheral
        0: to disable, 1: to enable
```

## dts/bindings/clock/microchip/pic32cm_jh/microchip,pic32cm-jh-osc32k.yaml
```yaml
# Copyright (c) 2025 Microchip Technology Inc.
# SPDX-License-Identifier: Apache-2.0

title: PIC32CM_JH Internal Oscillator (OSC32K) Control

description: |
  32.768 kHz High Accuracy Internal Oscillator (OSC32K).

include: [base.yaml]

compatible: "microchip,pic32cm-jh-osc32k"

properties:
  osc32k-startup-time:
    type: string
    enum:
      - "183-us"
      - "214-us"
      - "275-us"
      - "397-us"
      - "641-us"
      - "1129-us"
      - "2106-us"
      - "4059-us"
    default: "183-us"
    description: |
      Oscillator Start-Up Time

  osc32k-on-demand-en:
    type: int
    enum:
      - 0
      - 1
    default: 0
    description: |
      0: The oscillator is always on, if standby-en is true, else run in
         Standby Sleep mode if requested by a peripheral.
      1: Run if requested by peripheral
      Important: Initializing it with 1, along with clock enabled, can lead to indefinite wait for
      the clock to be on, if there is no peripheral request for the clock in the sequence of clock
      Initialization. If required, better to turn on the clock using API, instead of enabling both
      during startup.

  osc32k-run-in-standby-en:
    type: int
    enum:
      - 0
      - 1
    default: 0
    description: |
      0: Run if requested by peripheral
      1: The oscillator is always on, if demand-en is false

  osc32k-1khz-en:
    type: int
    enum:
      - 0
      - 1
    default: 0
    description: |
      1kHz Output Enable
      0: to disable, 1: to enable

  osc32k-32khz-en:
    type: int
    enum:
      - 0
      - 1
    default: 0
    description: |
      32kHz output is enable
      0: to disable, 1: to enable

  osc32k-en:
    type: int
    enum:
      - 0
      - 1
    default: 0
    description: |
      Oscillator Enable
      0: to disable, 1: to enable
```

## dts/bindings/clock/microchip/pic32cm_jh/microchip,pic32cm-jh-osc48m.yaml
```yaml
# Copyright (c) 2025 Microchip Technology Inc.
# SPDX-License-Identifier: Apache-2.0

title: PIC32CM_JH Internal Oscillator (OSC48M)

description: |
  48MHz Internal Oscillator (OSC48M).

include: [base.yaml]

compatible: "microchip,pic32cm-jh-osc48m"

properties:
  osc48m-on-demand-en:
    type: int
    enum:
      - 0
      - 1
    default: 0
    description: |
      0: The oscillator is always on
      1: The oscillator is running when a peripheral is requesting the oscillator to be used as a
      clock source. The oscillator is not running if no peripheral is requesting the clock source.
      Important: Initializing it with 1, along with clock enabled, can lead to indefinite wait for
      the clock to be on, if there is no peripheral request for the clock in the sequence of clock
      Initialization. If required, better to turn on the clock using API, instead of enabling both
      during startup.

  osc48m-run-in-standby-en:
    type: int
    enum:
      - 0
      - 1
    default: 0
    description: |
      0: The OSC48M is not running in standby sleep mode if no peripheral requests the clock.
      1: The OSC48M is running in standby sleep mode.
      If ONDEMAND is one, the OSC48M will be running when a peripheral is requesting the clock. If
      ONDEMAND is false, the clock source will always be running in standby sleep mode.

  osc48m-en:
    type: int
    enum:
      - 0
      - 1
    default: 1
    description: |
      Oscillator Enable
      0: to disable, 1: to enable

  osc48m-post-divider-freq:
    type: string
    enum:
      - "48-mhz"
      - "24-mhz"
      - "16-mhz"
      - "12-mhz"
      - "9.6-mhz"
      - "8-mhz"
      - "6.86-mhz"
      - "6-mhz"
      - "5.33-mhz"
      - "4.8-mhz"
      - "4.36-mhz"
      - "4-mhz"
      - "3.69-mhz"
      - "3.43-mhz"
      - "3.2-mhz"
      - "3-mhz"
    default: "4-mhz"
    description: |
      Control the oscillator frequency range by adjusting the division ratio.
```

## dts/bindings/clock/microchip/pic32cm_jh/microchip,pic32cm-jh-rtc.yaml
```yaml
# Copyright (c) 2025 Microchip Technology Inc.
# SPDX-License-Identifier: Apache-2.0

title: PIC32CM_JH RTC clock

description: |
  RTC clock configuration.

include: [base.yaml]

compatible: "microchip,pic32cm-jh-rtc"

properties:
  "#clock-cells":
    const: 1
    type: int

  rtc-src:
    type: string
    enum:
      - "ULP1K"
      - "ULP32K"
      - "OSC1K"
      - "OSC32K"
      - "XOSC1K"
      - "XOSC32K"
    default: "ULP1K"
    description: |
      RTC source clock selection

clock-cells:
  - subsystem
```

## dts/bindings/clock/microchip/pic32cm_jh/microchip,pic32cm-jh-xosc.yaml
```yaml
# Copyright (c) 2025 Microchip Technology Inc.
# SPDX-License-Identifier: Apache-2.0

title: PIC32CM_JH Crystal Oscillator (XOSC)

description: |
  0.4-32 MHz Crystal Oscillator (XOSC).

include: [base.yaml]

compatible: "microchip,pic32cm-jh-xosc"

properties:
  xosc-startup-time:
    type: int
    enum:
      - 1
      - 2
      - 4
      - 8
      - 16
      - 32
      - 64
      - 128
      - 256
      - 512
      - 1024
      - 2048
      - 4096
      - 8192
      - 16384
      - 32768
    default: 1
    description: |
      XOSC start-up time. Select number of OSCULP32K oscillator clock cycles.

  xosc-automatic-amplitude-gain-control-en:
    type: int
    enum:
      - 0
      - 1
    default: 0
    description: |
      Amplitude gain will be automatically adjusted during Crystal Oscillator operation
      0: to disable, 1: to enable

  xosc-on-demand-en:
    type: int
    enum:
      - 0
      - 1
    default: 0
    description: |
      0: The oscillator is always ON normally.
      In standby sleep mode, oscillator will be OFF if there is no peripheral request,
      unless run-in-standby-en is 1.
      1: In both normal and standby sleep mode, The oscillator is ON,
      when a peripheral is requesting the oscillator to be used as a clock source.
      The oscillator is OFF if no peripheral is requesting the clock source.
      Important: Initializing it with 1, along with clock enabled, can lead to indefinite wait
      for the clock to be on, if there is no peripheral request for the clock in the sequence of
      clock Initialization. If required, better to turn on the clock using API, instead of
      enabling both during startup.

  xosc-run-in-standby-en:
    type: int
    enum:
      - 0
      - 1
    default: 0
    description: |
      0: The XOSCn is OFF in standby sleep mode if no peripheral requests the clock.
      1: The XOSCn is always ON in standby sleep mode, unless on-demand-en is 1.
      If on-demand-en is 1, the XOSCn will be ON only when a peripheral is requesting
      the clock, even if run-in-standby-en is 1.

  xosc-clock-failure-detection-en:
    type: int
    enum:
      - 0
      - 1
    default: 0
    description: |
      Clock Failure Detector Enable
      0: to disable, 1: to enable

  xosc-xtal-en:
    type: int
    enum:
      - 0
      - 1
    default: 0
    description: |
      Selects external clock or crystal oscillator
      0 - External clock connected on XIN. XOUT can be used as general-purpose I/O.
      1 - Crystal connected to XIN/XOUT.

  xosc-en:
    type: int
    enum:
      - 0
      - 1
    default: 0
    description: |
      Oscillator Enable
      0: to disable, 1: to enable

  xosc-frequency:
    type: int
    default: 0
    description: |
      Crystal/External clock frequency for XOSC Controller
```

## dts/bindings/clock/microchip/pic32cm_jh/microchip,pic32cm-jh-xosc32k.yaml
```yaml
# Copyright (c) 2025 Microchip Technology Inc.
# SPDX-License-Identifier: Apache-2.0

title: PIC32CM_JH External Crystal Oscillator (XOSC32K)

description: |
  32.768 kHz External Crystal Oscillator (XOSC32K) Control.

include: [base.yaml]

compatible: "microchip,pic32cm-jh-xosc32k"

properties:
  xosc32k-startup-time:
    type: string
    enum:
      - "122-us"
      - "1.06-ms"
      - "62.6-ms"
      - "125-ms"
      - "500-ms"
      - "1-s"
      - "2-s"
      - "4-s"
    default: "122-us"
    description: |
      Oscillator Start-Up Time

  xosc32k-on-demand-en:
    type: int
    enum:
      - 0
      - 1
    default: 0
    description: |
      0: The oscillator is always on, if standby-en is true, else run in
         Standby Sleep mode if requested by a peripheral.
      1: Run if requested by peripheral
      Important: Initializing it with 1, along with clock enabled, can lead to indefinite wait for
      the clock to be on, if there is no peripheral request for the clock in the sequence of clock
      Initialization. If required, better to turn on the clock using API, instead of enabling both
      during startup.

  xosc32k-run-in-standby-en:
    type: int
    enum:
      - 0
      - 1
    default: 0
    description: |
      0: Run if requested by peripheral
      1: The oscillator is always on, if demand-en is false

  xosc32k-1khz-en:
    type: int
    enum:
      - 0
      - 1
    default: 0
    description: |
      1kHz Output Enable
      0: to disable, 1: to enable

  xosc32k-32khz-en:
    type: int
    enum:
      - 0
      - 1
    default: 0
    description: |
      32kHz output is enable
      0: to disable, 1: to enable

  xosc32k-xtal-en:
    type: int
    enum:
      - 0
      - 1
    default: 0
    description: |
      Selects external clock or crystal oscillator
      0 - External clock connected on XIN. XOUT can be used as general-purpose I/O.
      1 - Crystal connected to XIN/XOUT.

  xosc32k-en:
    type: int
    enum:
      - 0
      - 1
    default: 0
    description: |
      Oscillator Enable
      0: to disable, 1: to enable

  xosc32k-cfd-en:
    type: int
    enum:
      - 0
      - 1
    default: 0
    description: |
      Clock Failure Detector Enable
      0: to disable, 1: to enable
```

## dts/bindings/clock/microchip/pic32cm_pl/microchip,pic32cm-pl-clock.yaml
```yaml
# Copyright (c) 2026 Microchip Technology Inc.
# SPDX-License-Identifier: Apache-2.0

title: Microchip PIC32CM_PL SOC family clock

description: |
  Microchip PIC32CM_PL SOC family clock (OSCCTRL, OSC32KCTRL, GCLK, MCLK)

include:
  - name: base.yaml
  - name: pinctrl-device.yaml

compatible: "microchip,pic32cm-pl-clock"

properties:
  on-timeout-ms:
    type: int
    default: 5
    description: |
      Timeout in milliseconds for clock to be on.

      Driver waits in clock on API to check if the clock is actually on,
      so that the waiting time is not indefinite.
```

## dts/bindings/clock/microchip/pic32cm_pl/microchip,pic32cm-pl-mclkcpu.yaml
```yaml
# Copyright (c) 2026 Microchip Technology Inc.
# SPDX-License-Identifier: Apache-2.0

title: PIC32CM_PL Main clock for CPU

description: |
  Main Clock Controller provides synchronous system clocks to the CPU.

include: [base.yaml]

compatible: "microchip,pic32cm-pl-mclkcpu"

properties:
  mclk-cpu-div:
    type: int
    enum:
      - 1
      - 2
      - 4
      - 8
      - 16
      - 32
      - 64
      - 128
    default: 1
    description: |
      CPU Clock Division Factor
```

## dts/bindings/clock/microchip/pic32cm_pl/microchip,pic32cm-pl-mclkperiph.yaml
```yaml
# Copyright (c) 2026 Microchip Technology Inc.
# SPDX-License-Identifier: Apache-2.0

title: PIC32CM_PL MCLK (Main Clock) peripheral

description: |
  Main Clock Controller provides synchronous system clocks to the modules
  connected to the AHBx and the APBx buses.

include: [base.yaml]

compatible: "microchip,pic32cm-pl-mclkperiph"

properties:
  "#clock-cells":
    const: 1
    type: int
    description: |
      The subsystem cell is to identify a clock controller sub-system.

      The subsystem can be referred from include\zephyr\dt-bindings\clock\mchp_pic32cm_pl_clock.h,
      under the MCLKPERIPH_TYPE section of ids.
      All clock control API use this value to specify the clock on which the API operates.
      Since subsystem is opaque to the user, it can be accessed from the devicetree node and used.

clock-cells:
  - subsystem

child-binding:
  properties:
    subsystem:
      type: int
      required: true
      description: |
        Clock subsystem

    mclk-en:
      type: int
      enum:
        - 0
        - 1
      required: true
      description: |
        Enable mclk to the peripheral

        0: to disable, 1: to enable
```
