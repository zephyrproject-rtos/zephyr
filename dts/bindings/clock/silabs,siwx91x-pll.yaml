## dts/bindings/clock/st,stm32f0-pll-clock.yaml
```yaml
# Copyright (c) 2021, Linaro ltd
# SPDX-License-Identifier: Apache-2.0

description: |
  Main PLL node binding for STM32F0 and STM32F3 devices.

  Takes one of clk_hse or clk_hsi as input clock.

  Note: Some STM32F0 SoC variants (STM32072 for instance) may also support HSI48
  as input clock. This case is not supported yet.

  Frequency calculation for output clock is as follows:

    f(PLLCLK) = f(PLLIN) x PLLMUL   --> SYSCLK (System Clock)

    with, depending on the case:
            If input_clk = clk_hse
              f(PLLIN) = f(input_clk) / PREDIV
            If input_clk = clk_hsi
              On STM32F3, STM32F03x, STM32F05x, STM32F030x4, STM32F030x6 and STM32F030x8
                f(PLLIN) = f(input_clk) / 2
              On STM32F04x, STM32F07x, STM32F09x, STM32F070x6, STM32F070xB and STM32F030xC
                f(PLLIN) = f(input_clk) / PREDIV

  The PLL output frequency must be set in range 16-48MHz

compatible: "st,stm32f0-pll-clock"

include:
  - name: st,stm32f105-pll-clock.yaml
    property-blocklist:
      - mul
      - otgfspre

properties:
  mul:
    type: int
    required: true
    description: |
        PLL multiplication factor for output clock
        Valid range: 2 - 16
```

## dts/bindings/clock/st,stm32f0-rcc.yaml
```yaml
# Copyright (c) 2021, Linaro ltd
# SPDX-License-Identifier: Apache-2.0

description: |
  STM32F0 and G0 Reset and Clock controller node.
  For more description confere st,stm32-rcc.yaml

compatible: "st,stm32f0-rcc"

include:
  - name: st,stm32-rcc.yaml
    property-blocklist:
      - apb2-prescaler
```

## dts/bindings/clock/st,stm32f1-clock-mco.yaml
```yaml
#
# Copyright (c) 2024, Joakim Andersson
#
# SPDX-License-Identifier: Apache-2.0
#

compatible: "st,stm32f1-clock-mco"

description: |
        STM32 F1 series Microcontroller Clock Output (MCO)

        The STM32F1 MCO is similar to other series but has no configurable
        prescaler before the output. However, note that certain inputs of
        the MCO are fitted with a fixed prescaler, making it possible to
        output a slowed down variation of certain clocks.

        Example:
                &mco1 {
                        clocks = <&rcc STM32_SRC_LSE MCO1_SEL(7)>;
                        pinctrl-0 = <&rcc_mco_pa8>;
                        pinctrl-names = "default";
                        status = "okay";
                };

        Note: in the `clocks` property, the domain clock source cell should
        use the value representing the base clock, regardless of whether or
        not the selected input is fitted with a prescaler.

        Example:
                /* PLL3 clock divided by 2 */
                clocks = <&rcc STM32_SRC_PLL3CLK MCO1_SEL(9)>;
                /* PLL3 clock */
                clocks = <&rcc STM32_SRC_PLL3CLK MCO1_SEL(11)>;

include:
  - name: st,stm32-clock-mco.yaml
    property-blocklist:
      - prescaler
```

## dts/bindings/clock/st,stm32f1-pll-clock.yaml
```yaml
# Copyright (c) 2021, Linaro ltd
# SPDX-License-Identifier: Apache-2.0

description: |
  Main PLL node binding for low-, medium-, high- and XL-density STM32F1 devices.

  Takes one of 'clk_hse', 'clk_hse / 2' (when 'xtpre' is set) or 'clk_hsi / 2'
  as input clock.

  Output clock frequency can be computed with the following formula:

    f(PLLCLK) = f(input clk) x PLLMUL  --> SYSCLK (System Clock)

  The PLL output frequency must not exceed 72 MHz.


compatible: "st,stm32f1-pll-clock"

include: [clock-controller.yaml, base.yaml]

properties:
  "#clock-cells":
    const: 0

  clocks:
    required: true

  mul:
    type: int
    required: true
    description: |
        Main PLL multiplication factor for VCO
        Valid range: 2 - 16

  xtpre:
    type: boolean
    description: |
        Optional HSE divider for PLL entry

  usbpre:
    type: boolean
    description: |
        Optional PLL output divisor to generate a 48MHz USB clock.
        When set, PLL clock is not divided.
        Otherwise, PLL output clock is divided by 1.5.
```

## dts/bindings/clock/st,stm32f1-rcc.yaml
```yaml
# Copyright (c) 2023 STMicroelectronics
# SPDX-License-Identifier: Apache-2.0

description: |
  STM32F1 and STM32F37x Reset and Clock controller node.
  Adds the ADC prescaler to the standard generic STM32 RCC.
  For more description confere st,stm32-rcc.yaml

compatible: "st,stm32f1-rcc"

include: st,stm32-rcc.yaml

properties:
  adc-prescaler:
    type: int
    enum:
      - 2
      - 4
      - 6
      - 8
    description: |
        ADC prescaler. Defines ADC core clock frequency
        based on APB2 frequency input.
```

## dts/bindings/clock/st,stm32f100-pll-clock.yaml
```yaml
# Copyright (c) 2021, Linaro ltd
# SPDX-License-Identifier: Apache-2.0

description: |
  Main PLL node binding for STM32F100 devices

  Takes one of clk_hse or clk_hsi as input clock.
  When clk_hsi is used a fixed prescaler is applied. When input clock is hse or
  pll2, configurable prescaler is used.

  Up to 2 output clocks could be supported and for each output clock, the
  frequency can be computed with the following formula:

    f(PLLCLK) = f(PLLIN) x PLLMUL       --> SYSCLK (System Clock)

    with, depending on the case:
            f(PLLIN) = f(input_clk) / 2       if input_clk = clk_hsi
            f(PLLIN) = f(input_clk) / PREDIV  if input_clk = clk_hse

  The PLL output frequency must not exceed 24 MHz.


compatible: "st,stm32f100-pll-clock"

include:
  - name: st,stm32f105-pll-clock.yaml
    property-blocklist:
      - mul

properties:
    mul:
      type: int
      required: true
      description: |
          PLL multiplication factor for output clock
          Valid range: 2 - 16
```

## dts/bindings/clock/st,stm32f105-pll-clock.yaml
```yaml
# Copyright (c) 2021, Linaro ltd
# SPDX-License-Identifier: Apache-2.0

description: |
  Main PLL node binding for Connectivity line devices (STM32F105/STM32F107)

  Takes one of clk_hse, pll2 or clk_hsi as input clock.
  When clk_hsi is used a fixed prescaler is applied. When input clock is hse or
  pll2, configurable prescaler is used.

  Up to 2 output clocks could be supported and for each output clock, the
  frequency can be computed with the following formula:

    f(PLLCLK) = f(PLLIN) x PLLMUL       --> SYSCLK (System Clock)
    f(USBCLK) = f(PLLCLK) * 2 / USBPRE  --> USB

    with, depending on the case:
            f(PLLIN) = f(input_clk) / 2       if input_clk = clk_hsi
            f(PLLIN) = f(input_clk) / PREDIV  if input_clk = clk_hse or pll2

  The PLL output frequency must not exceed 72 MHz.


compatible: "st,stm32f105-pll-clock"

include: [clock-controller.yaml, base.yaml]

properties:
    "#clock-cells":
      const: 0

    clocks:
      required: true

    mul:
      type: int
      required: true
      description: |
          Main PLL multiplication factor for VCO.
          Note: For x6.5 multiplier value, please use "mul = <15>;"
      enum:
        - 4   # x4
        - 5   # x5
        - 6   # x6
        - 7   # x7
        - 8   # x8
        - 9   # x9
        - 15  # x6.5

    prediv:
      type: int
      required: false
      description: |
          Configurable prescaler
          Valid range: 1 - 16
```

## dts/bindings/clock/st,stm32f105-pll2-clock.yaml
```yaml
# Copyright (c) 2021, Linaro ltd
# SPDX-License-Identifier: Apache-2.0

description: |
  PLL2 node binding for Connectivity line devices (STM32F105/STM32F107)

  Takes clk_hse as input clock, using prediv as prescaler.

  Each PLL as its own output clock.

    f(PLL2CLK) = f(PLL2IN) / PREDIV * PLLMUL --> PLL (System Clock)


compatible: "st,stm32f105-pll2-clock"

include:
  - name: st,stm32f105-pll-clock.yaml
    property-blocklist:
      - mul

properties:
  mul:
    type: int
    required: true
    description: |
        PLL multiplication factor for output clock
    enum:
      - 8
      - 9
      - 10
      - 11
      - 12
      - 13
      - 14
      - 16
      - 20
```

## dts/bindings/clock/st,stm32f3-rcc.yaml
```yaml
# Copyright (c) 2023 STMicroelectronics
# SPDX-License-Identifier: Apache-2.0

description: |
  STM32F3 Reset and Clock controller node.
  Adds the STM32F3 ADC prescaler to the standard generic STM32 RCC.
  For more description confere st,stm32-rcc.yaml

compatible: "st,stm32f3-rcc"

include: st,stm32-rcc.yaml

properties:
  adc12-prescaler:
    type: int
    enum:
      - 0 # Synchronous mode
      - 1 # not divided
      - 2
      - 4
      - 6
      - 8
      - 10
      - 12
      - 16
      - 32
      - 64
      - 128
      - 256
    description: |
        ADC 1 and 2 prescaler
        - 0: Disables the clock so the ADC can use AHB clock (synchronous mode)
        - Other values n: The ADC can use the PLL clock divided by n
        On STM32F37x, only 2/4/6/8 are allowed.

  adc34-prescaler:
    type: int
    enum:
      - 0 # Synchronous mode
      - 1 # not divided
      - 2
      - 4
      - 6
      - 8
      - 10
      - 12
      - 16
      - 32
      - 64
      - 128
      - 256
    description: |
        ADC 3 and 4 prescaler
        - 0: Disables the clock so the ADC can use AHB clock (synchronous mode)
        - Other values n: The ADC can use the PLL clock divided by n
        Check RefMan for availability.
```

## dts/bindings/clock/st,stm32f4-pll-clock.yaml
```yaml
# Copyright (c) 2021, Linaro ltd
# SPDX-License-Identifier: Apache-2.0

description: |
  STM32L4 Main PLL node binding:

  Takes one of clk_hse or clk_hsi as input clock, with an
  input frequency from 1 to 2 MHz. PLLM factor is used to set the input clock
  in this acceptable range.

  Up to 2 output clocks could be supported and for each output clock, the
  frequency can be computed with the following formula:

    f(PLL_P) = f(VCO clock) / PLLP  --> PLLCLK (System Clock)
    f(PLL_Q) = f(VCO clock) / PLLQ  --> PLL48CLK (Optional)

      with f(VCO clock) = f(PLL clock input) × (PLLN / PLLM)

  The PLL output frequency must not exceed 80 MHz.


compatible: "st,stm32f4-pll-clock"

include: [clock-controller.yaml, base.yaml]

properties:
    "#clock-cells":
      const: 0

    clocks:
      required: true

    div-m:
      type: int
      required: true
      description: |
          Division factor for the PLL input clock
          Valid range: 2 - 63

    mul-n:
      type: int
      required: true
      description: |
          Main PLL multiplication factor for VCO
          Valid range: 50 - 432

    div-p:
      type: int
      required: true
      description: |
          Main PLL division factor for PLLSAI2CLK
      enum:
        - 2
        - 4
        - 6
        - 8

    div-q:
      type: int
      required: false
      description: |
          Main PLL (PLL) division factor for USB OTG FS, SDMMC and random number
          generator clocks.
          Valid range: 2 - 15
```

## dts/bindings/clock/st,stm32f4-plli2s-clock.yaml
```yaml
# Copyright (c) 2023, Linaro ltd
# SPDX-License-Identifier: Apache-2.0

description: |
  STM32F4 PLL I2S.

  Takes same input as Main PLL. PLLM factor and PLL source are common with Main PLL

  1 output clocks supported, the frequency can be computed with the following formula:

    f(PLL_R) = f(VCO clock) / PLLR  --> PLLI2S

      with f(VCO clock) = f(PLL clock input) × (PLLNI2S / PLLM)


compatible: "st,stm32f4-plli2s-clock"

include: [clock-controller.yaml, base.yaml]

properties:
  "#clock-cells":
    const: 0

  mul-n:
    type: int
    required: true
    description: |
        PLLI2S multiplication factor for VCO
        Valid range may vary between parts: 50 - 432 , 192 - 432

  div-r:
    type: int
    required: true
    description: |
        PLLI2S division factor for I2S Clocks
    enum:
      - 2
      - 3
      - 4
      - 5
      - 6
      - 7
```
