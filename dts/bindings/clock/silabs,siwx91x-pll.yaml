## dts/bindings/clock/silabs,siwx91x-pll.yaml
```yaml
# Copyright (c) 2026 Silicon Laboratories Inc.
# SPDX-License-Identifier: Apache-2.0

description: |
  SiWx91x PLL output description.

  Models the three HP-domain PLL outputs: SoC PLL, INTF PLL, and I2S PLL.
  These nodes provide devicetree defaults consumed by the SiWx91x HP clock
  driver.

compatible: "silabs,siwx91x-pll"

include: [clock-controller.yaml, base.yaml]

properties:
  clocks:
    type: phandle-array
    required: true
    description: |
      Must reference the shared HP PLL reference route
      (silabs,siwx91x-clock-route child, e.g. ref_pll_mux). All PLLs share
      the same hardware reference mux; do not point each PLL at xtal/rc directly.

  clock-frequency:
    type: int
    required: true
    description: Target PLL output frequency in Hz.

  "#clock-cells":
    const: 0
```

## dts/bindings/clock/st,stm32-clock-mco.yaml
```yaml
#
# Copyright (c) 2024, Joakim Andersson
#
# SPDX-License-Identifier: Apache-2.0
#

compatible: "st,stm32-clock-mco"

description: |
        STM32 Microcontroller Clock Output (MCO)

        Used to output a clock signal from the MCU to a GPIO pin.
        The selected signal goes through a configurable prescaler before output.

        Example:
                &mco1 {
                        clocks = <&rcc STM32_SRC_LSE MCO1_SEL(7)>;
                        prescaler = <MCO1_PRE(MCO_PRE_DIV_5)>;
                        pinctrl-0 = <&rcc_mco_pa8>;
                        pinctrl-names = "default";
                        status = "okay";
                };

include: [base.yaml, pinctrl-device.yaml]

properties:

  clocks:
    required: true

  prescaler:
    type: int
    required: true

  pinctrl-0:
    required: true

  pinctrl-names:
    required: true
```

## dts/bindings/clock/st,stm32-clock-mux.yaml
```yaml
# Copyright (c) 2022, Linaro ltd
# SPDX-License-Identifier: Apache-2.0

description: |
        STM32 Clock multiplexer

        Describes a clock multiplexer, such as per_ck on STM32H7 or
        CLK48 on STM32WB.
        The only property of this node is to select a clock input.
        For instance:
                &perck {
                        clocks = <&rcc STM32_SRC_HSI_KER CKPER_SEL(0)>;
                        status = "okay";
                };

compatible: "st,stm32-clock-mux"

include:
  - name: base.yaml
    property-allowlist:
      - status
      - compatible
      - clocks

properties:

  clocks:
    required: true
```

## dts/bindings/clock/st,stm32-hse-clock.yaml
```yaml
# Copyright (c) 2021, Linaro ltd
# SPDX-License-Identifier: Apache-2.0

description: STM32 HSE Clock

compatible: "st,stm32-hse-clock"

include: [fixed-clock.yaml]

properties:
  hse-bypass:
    type: boolean
    description: |
      HSE crystal oscillator bypass
      Set to the property to by-pass the oscillator with an external clock.

  css-enabled:
    type: boolean
    description: |
      HSE clock security system enabled
      Set the property to enable the clock security system (CSS) for the HSE clock.

      If a failure is detected on the HSE clock, the HSE oscillator is automatically disabled,
      a clock failure event is sent to timers, and a non-maskable interrupt is generated to
      inform the software about the failure, allowing the MCU to perform rescue operations.
      See the MCU reference manual for details.

      The interaction of CSS and low-power modes is unclear from the documentation.
      For at least some devices Zephyr will reconfigure the clocks on resuming from low-power
      modes; this will include re-enabling CSS. However it is important that you verify
      this for your own hardware.
```

## dts/bindings/clock/st,stm32-hsi48-clock.yaml
```yaml
# Copyright (c) 2023, Aurelien Jarno
# SPDX-License-Identifier: Apache-2.0

description: STM32 HSI48 Clock

compatible: "st,stm32-hsi48-clock"

include: [fixed-clock.yaml]

properties:
  crs-usb-sof:
    type: boolean
    description: |
      Clock Recovery System using USB SOF packet reception
      Set the property to enable clock recovery of the HSI48 oscillator using
      the USB SOF packet reception as a reference.
```

## dts/bindings/clock/st,stm32-lse-clock.yaml
```yaml
# Copyright (c) 2022, SILA Embedded Solutions GmbH
# SPDX-License-Identifier: Apache-2.0

description: STM32 LSE Clock

compatible: "st,stm32-lse-clock"

include: [fixed-clock.yaml]

properties:
  driving-capability:
    type: int
    required: true
    description: |
      LSE driving capability, within the range 0 to 3.
      0 represents the lowests driving capability, 3
      the highest.
    enum:
      - 0
      - 1
      - 2
      - 3

  lse-bypass:
    type: boolean
    description: |
      LSE crystal oscillator bypass
      Set the property to by-pass the oscillator with an external clock.
```

## dts/bindings/clock/st,stm32-lsi-clock.yaml
```yaml
# Copyright (c) 2022, STMicroelectronics
# SPDX-License-Identifier: Apache-2.0

description: STM32 LSI Clock

compatible: "st,stm32-lsi-clock"

include: [fixed-clock.yaml]

properties:
    max-clock-frequency:
      type: int
      required: false
      description: |
        LSI RC oscillator max frequency as stated by the stm32 datasheet
        This characteristic in Hz is higher than <clock-frequency> and maybe
        used by any driver when the (typical) LSI <clock-frequency> is too low.
```

## dts/bindings/clock/st,stm32-mco-clock.yaml
```yaml
# Copyright (c) 2023 Benjamin Björnsson <benjamin.bjornsson@gmail.com>
# SPDX-License-Identifier: Apache-2.0

description: STM32 MCO Clock

compatible: "st,stm32-mco-clock"

include: [pinctrl-device.yaml, base.yaml]

properties:

  pinctrl-0:
    required: true

  pinctrl-names:
    required: true
```

## dts/bindings/clock/st,stm32-msi-clock.yaml
```yaml
# Copyright (c) 2021, Linaro ltd
# SPDX-License-Identifier: Apache-2.0

description: STM32 MSI Clock

compatible: "st,stm32-msi-clock"

include: [clock-controller.yaml, base.yaml]

properties:
  msi-range:
    required: true
    type: int
    default: 6
    description: |
      MSI clock ranges:
      0: around 100 kHz
      1: around 200 kHz
      2: around 400 kHz
      3: around 800 kHz
      4: around 1 MHz
      5: around 2 MHz
      6: around 4 MHz (reset value)
      7: around 8 MHz
      8: around 16 MHz
      9: around 24 MHz
      10: around 32 MHz
      11: around 48 MHz
    min: 0
    max: 11

  msi-pll-mode:
    type: boolean
    description: |
      MSI clock PLL enable
      Enables the PLL part of the MSI clock source.
```

## dts/bindings/clock/st,stm32-rcc.yaml
```yaml
# Copyright (c) 2021, Linaro ltd
# SPDX-License-Identifier: Apache-2.0

description: |
  STM32 RCC (Reset and Clock controller).

  This node is in charge of system clock ('SYSCLK') source selection and controlling
  clocks for AHB (Advanced High Performance) and APB (Advanced Peripheral) bus domains.

  Configuring STM32 Reset and Clock controller node:

  System clock source should be selected amongst the clock nodes available in "clocks"
  node (typically 'clk_hse, clk_hsi', 'pll', ...).
  Core clock frequency should also be defined, using "clock-frequency" property.
  Note:
          Core clock frequency  = SYSCLK / AHB prescaler
  Last, peripheral bus clocks (typically PCLK1, PCLK2) should be configured using matching
  prescaler properties.
  Here is an example of correctly configured rcc node:
  &rcc {
           clocks = <&pll>;  /* Select 80MHz pll as SYSCLK source */
           ahb-prescaler = <2>;
           clock-frequency = <DT_FREQ_M(40)>; /* = SYSCLK / AHB prescaler */
           apb1-prescaler = <1>;
           apb2-prescaler = <1>;
  }

  Specifying a gated clock:

  To specify a gated clock, a peripheral should define a "clocks" property such as:
  ... {
           ...
           clocks = <&rcc STM32_CLOCK(APB2, 5)>;
           ...
  }

  After the phandle referring to rcc node, use the STM32_CLOCK() macro which accepts
  two parameters: the first specifies the bus on which the peripheral is attached, and
  the second indicates the bit number controlling the peripheral clock gate in that
  bus's control register in RCC. As an example, the snippet above indicates that the
  peripheral gate is controlled by bit 5 in RCC_APB2ENR (USART6EN on STM32F401).
  The gated clock is required when accessing to the peripheral controller is needed
  (generally for configuring the device). If dual clock domain is not used, it is
  also used for peripheral operation.

  Note: in situations where more than one bit is required, use the explicit form:
  ... {
           ...
           clocks = <&rcc STM32_CLOCK_BUS_APB2 ((1 << 14) | (1 << 7))>;
           ...
  }
  where 14 and 7 are the bits that control the peripheral clock gate.
  (You can have more than two bits, and they do not have to be contiguous).

  Specifying a domain clock source:

  Specifying a domain source clock could be done by adding a clock specifier to the
  clock property:
  ... {
           ...
           clocks = <&rcc STM32_CLOCK(APB2, 5)>,
                        <&rcc STM32_SRC_HSI I2C1_SEL(2)>;
           ...
  }
  In this example, I2C1 device is assigned HSI as domain clock source.
  Domain clock is independent from the bus/gated clock and allows access to the device's
  register while the gated clock is off. As it doesn't feed the peripheral's controller, it
  allows peripheral operation, but can't be used for peripheral configuration.
  It is peripheral driver's responsibility to query and use clock source information in
  accordance with clock_control API specifications.

  Since the peripheral subsystem rate is dictated by the clock used for peripheral
  operation, same clock should be used in calls to `clock_control_get_rate()`

  Note 1: No additional specifier means gating clock is also the clock source (ie
          'PCLK/PCLK1/PCLK2' depending on the device). There is no need to add a second
          cell to explicitly set it.
  Note 2: Default peripheral clock configuration (ie the one provided in *.dsti files)
          should be the one matching SoC reset state. Confere reference manual to check
          what is the reset value of the clock source for each peripheral.

  Specifying a divided domain clock source:

  Some peripherals are sourced through fixed clock dividers. For such cases there is
  STM32_CLOCK_DIV() macro, which allows to specify such divider value. Selecting HSE/2 (HSE
  frequency divided by 2) is done with following clock property:
  ... {
           ...
           clocks = <&rcc (STM32_SRC_HSE | STM32_CLOCK_DIV(2)) ...>;
           ...
  }

compatible: "st,stm32-rcc"

include: [clock-controller.yaml, base.yaml]

properties:
  reg:
    required: true

  "#clock-cells":
    const: 2

  clock-frequency:
    required: true
    type: int
    description: |
      default frequency in Hz for clock output

  ahb-prescaler:
    type: int
    required: true
    enum:
      - 1
      - 2
      - 4
      - 8
      - 16
      - 64
      - 128
      - 256
      - 512
    description: |
        AHB prescaler. Defines actual core clock frequency (HCLK)
        based on system frequency input.
        The HCLK clocks CPU, AHB, memories and DMA.

  apb1-prescaler:
    type: int
    required: true
    enum:
      - 1
      - 2
      - 4
      - 8
      - 16

  apb2-prescaler:
    type: int
    required: true
    enum:
      - 1
      - 2
      - 4
      - 8
      - 16

  undershoot-prevention:
    type: boolean
    description: |
      On some parts, it could be required to set up highest core frequencies
      (>80MHz) in two steps in order to prevent undershoot.
      This is done by applying an intermediate AHB prescaler before switching
      System Clock source to PLL. Once done, prescaler is set back to expected
      value.

clock-cells:
  - bus
  - bits
```

## dts/bindings/clock/st,stm32-shsi-clock.yaml
```yaml
# Copyright (c) 2026 Vossloh AG
# SPDX-License-Identifier: Apache-2.0

description: STM32 Secure-HSI (48 MHz) Clock

compatible: "st,stm32-shsi-clock"

include: [fixed-clock.yaml]
```

## dts/bindings/clock/st,stm32c0-hsi-clock.yaml
```yaml
# Copyright (c) 2023 Benjamin Björnsson <benjamin.bjornsson@gmail.com>.
# SPDX-License-Identifier: Apache-2.0

description: |
  STM32C0 HSI Clock.

  On STM32C0, HSI is a 48MHz fixed clock.

  It also produces a HSISYS secondary clk which can be used as system clock
  source. In that case, a HSI divisor (ranges from 1 to 128) can be applied:
  SYSCLK = HSI48 / HSI DIV
        enum:
        - 1 ==> HSISYS = 48MHZ
        - 2 ==> HSISYS = 24MHZ
        - 4 ==> HSISYS = 12MHZ
        - 8 ==> HSISYS = 6MHZ
        - 16 ==> HSISYS = 3MHZ
        - 32 ==> HSISYS = 1.5MHz
        - 64 ==> HSISYS = 0.75MHZ
        - 128 ==> HSISYS = 0.375MHz

compatible: "st,stm32c0-hsi-clock"

include: [fixed-clock.yaml]

properties:
  hsi-div:
    type: int
    required: true
    description: |
      HSI clock divider. Configures the output HSI clock frequency (HSISYS).
    enum:
      - 1
      - 2
      - 4
      - 8
      - 16
      - 32
      - 64
      - 128
```

## dts/bindings/clock/st,stm32c5-rcc.yaml
```yaml
# Copyright (c) 2026 STMicroelectronics
# SPDX-License-Identifier: Apache-2.0

title: STM32C5 RCC (Reset and Clock controller).

description: |
  This node is in charge of system clock ('SYSCLK') source selection and controlling
  clocks for AHB (Advanced High Performance) and APB (Advanced Peripheral) bus domains.

  It also allows the configuration of the different PSI clocks (PSIS, PSIK, PSIDIV3).

  When using any of the PSI clocks, it is necessary to configure the PSI target
  frequency (PSIFREQ register) and the PSI source clock (PSIREFSRC register).
  From these two values, the value of the PSIREF register is automatically calculated.

  Refer to st,stm32-rcc.yaml for more details.

compatible: "st,stm32c5-rcc"

include:
  - name: st,stm32-rcc.yaml
    property-blocklist:
      - undershoot-prevention

properties:
  apb3-prescaler:
    type: int
    required: true
    enum:
      - 1
      - 2
      - 4
      - 8
      - 16

  st,psi-frequency:
    type: int
    description: |
      PSI target frequency configuration, in MHz.
    enum:
      - 100
      - 144
      - 160

  st,psi-source:
    type: string
    description: |
      Clock source for PSI clock.
    enum:
      - "HSE"
      - "LSE"
      - "HSIDIV18"
```

## dts/bindings/clock/st,stm32c5-xsik-clock.yaml
```yaml
# Copyright (c) 2026 STMicroelectronics
# SPDX-License-Identifier: Apache-2.0

title: STM32C5 PSIK and HSIK Clock.

description: |
  On STM32C5, PSIK and HSIK are two clocks respectively derived from PSI (160,
  144 or 100 MHz) and HSI (144 MHz) with an additional divider ranging from 1 to
  8, by 0.5 increment. For example, with a source clock of 144 MHz
  xSIK = xSI / xSI_DIV
        enum:
        - 1   ==> xSIK = 144MHZ
        - 1.5 ==> xSIK = 96MHZ
        - 2   ==> xSIK = 72MHZ
        - 2.5 ==> xSIK = 57.6MHZ
        - 3   ==> xSIK = 48MHZ
        - 3.5 ==> xSIK = ~41.14MHz
        - 4   ==> xSIK = 36MHZ
        - 4.5 ==> xSIK = 32MHz
        - 5   ==> xSIK = 28.8MHZ
        - 5.5 ==> xSIK = ~26.18MHz
        - 6   ==> xSIK = 24MHZ
        - 6.5 ==> xSIK = ~22.15MHz
        - 7   ==> xSIK = ~20.57MHZ
        - 7.5 ==> xSIK = 19.2MHz
        - 8   ==> xSIK = 18MHZ

compatible: "st,stm32c5-xsik-clock"

include: [fixed-clock.yaml]

properties:
  xsik-div:
    type: string
    required: true
    description: |
      xSI clock divider. Configures the xSIK clock frequency.
    enum:
      - "1"
      - "1.5"
      - "2"
      - "2.5"
      - "3"
      - "3.5"
      - "4"
      - "4.5"
      - "5"
      - "5.5"
      - "6"
      - "6.5"
      - "7"
      - "7.5"
      - "8"
```
