## dts/bindings/clock/st,stm32wba-hse-clock.yaml
```yaml
# Copyright (c) 2023, STMicroelectronics
# SPDX-License-Identifier: Apache-2.0

description: STM32WBA HSE Clock

compatible: "st,stm32wba-hse-clock"

include: [fixed-clock.yaml]

properties:
  hse-div2:
    type: boolean
    description: |
      When set HSE output clock is divided by 2.
      Otherwise, no prescaler is used.
```

## dts/bindings/clock/st,stm32wba-pll-clock.yaml
```yaml
# Copyright (c) 2023, STMicroelectronics
# SPDX-License-Identifier: Apache-2.0

description: |
  PLL node binding for STM32WBA devices

  It can be used to describe PLL1

  This PLL could take one of clk_hse or clk_hsi as input clock, with
  an input frequency from 4 to 16 MHz. PLLM factor is used to set the input
  clock in this acceptable range.

  PLL1 can have up to 3 output clocks and for each output clock, the
  frequency can be computed with the following formula:

    f(PLL_P) = f(VCO clock) / PLLP
    f(PLL_Q) = f(VCO clock) / PLLQ
    f(PLL_R) = f(VCO clock) / PLLR

      with f(VCO clock) = f(PLL clock input) × (PLLN / PLLM)

  Note: VCOx frequency range is 128 to 544 MHz. To reduce the power consumption,
        it is recommended to configure the VCO to the lowest frequency.

  The PLL output frequency must not exceed 100 MHz.

compatible: "st,stm32wba-pll-clock"

include: [clock-controller.yaml, base.yaml]

properties:

  "#clock-cells":
    const: 0

  clocks:
    required: true

  div-m:
    type: int
    required: true
    description: |
        Prescaler for PLLx
        input clock
        Valid range: 1 - 8

  mul-n:
    type: int
    required: true
    description: |
        PLLx multiplication factor for VCO
        Valid range: 4 - 512

  div-q:
    type: int
    description: |
        PLLx DIVQ division factor
        Valid range: 1 - 128

  div-r:
    type: int
    required: true
    description: |
        PLLx DIVR division factor
        Valid range: 1 - 128
```

## dts/bindings/clock/st,stm32wba-rcc.yaml
```yaml
# Copyright (c) 2023, STMicroelectronics
# SPDX-License-Identifier: Apache-2.0

description: |
  STM32WBA RCC (Reset and Clock controller).

  This node is in charge of system clock ('SYSCLK') source selection and controlling
  clocks for AHB (Advanced High Performance) and APB (Advanced Peripheral) bus domains.

  Configuring STM32 Reset and Clock controller node:

  System clock source should be selected amongst the clock nodes available in "clocks"
  node (typically 'clk_hse, clk_hsi', 'pll').
  Core clock frequency should also be defined, using "clock-frequency" property.
  Note:
          Core clock frequency  = SYSCLK / AHB prescaler
  Last, peripheral bus clocks (typically PCLK1, PCLK2, PCLK7) should be configured using
  matching prescaler properties.
  Here is an example of correctly configured rcc node:
  &rcc {
           clocks = <&pll>;                   /* Select pll as SYSCLK source */
           ahb-prescaler = <2>;
           clock-frequency = <DT_FREQ_M(40)>; /* = SYSCLK / AHB prescaler */
           apb1-presacler = <1>;
           apb2-presacler = <1>;
           apb7-presacler = <7>;
  }

  Specifying a gated clock:

  To specify a gated clock, a peripheral should define a "clocks" property encoded
  in the following way:
  ... {
           ...
           clocks = <&rcc STM32_CLOCK_BUS_APB2 0x00000020>;
           ...
  }
  After the phandle referring to rcc node, the first index specifies the registers of
  the bus controlling the peripheral and the second index specifies the bit used to
  control the peripheral clock in that bus register.

  Specifying an alternate clock source:

  Specifying an alternate source clock could be done by adding a clock specifier to the
  clock property:
  ... {
           ...
           clocks = <&rcc STM32_CLOCK_BUS_APB2 0x00000020>,
                        <&rcc STM32_SRC_HSI I2C1_SEL(2)>;
           ...
  }
  In this example I2C1 device is assigned HSI as clock source.
  It is device driver's responsibility to query and use clock source information in
  accordance with clock_control API specifications.

compatible: "st,stm32wba-rcc"

include: [clock-controller.yaml, base.yaml]

properties:
  reg:
    required: true

  "#clock-cells":
    const: 2

  clock-frequency:
    required: true
    type: int
    description: |
      default frequency in Hz for clock output (HCLK1)

  ahb-prescaler:
    type: int
    required: true
    enum:
      - 1
      - 2
      - 4
      - 8
      - 16
    description: |
        Common AHB1, AHB2, AHB4 prescaler. Defines actual core clock frequency
        (HCLK) based on system frequency input. AKA HPRE.
        The HCLK clocks CPU, AHB1, AHB2, memories and DMA.

  ahb5-prescaler:
    type: int
    enum:
      - 1
      - 2
      - 3
      - 4
      - 6
    description: |
        AHB5 prescaler. Defines actual core clock frequency (HCLK5) based on
        system frequency input. It is used to limit HCLK5 below 32MHz.
        Only required when SysClock source is PLL1.
        AKA HPRE5.

  apb1-prescaler:
    type: int
    required: true
    enum:
      - 1
      - 2
      - 4
      - 8
      - 16

  apb2-prescaler:
    type: int
    required: true
    enum:
      - 1
      - 2
      - 4
      - 8
      - 16

  apb7-prescaler:
    type: int
    required: true
    enum:
      - 1
      - 2
      - 4
      - 8
      - 16

  ahb5-div:
    type: boolean
    description: |
      AHB5 divider. Applies only when SysClock source is HSI16 or HSE32.
      When enabled, AHB5 clock is SysClock / 2.
      When disabled, SysClock is not divided.

clock-cells:
  - bus
  - bits
```

## dts/bindings/clock/st,stm32wl-hse-clock.yaml
```yaml
# Copyright (c) 2021, Linaro ltd
# SPDX-License-Identifier: Apache-2.0

description: STM32WL HSE Clock

compatible: "st,stm32wl-hse-clock"

include: [fixed-clock.yaml]

properties:
    hse-tcxo:
      type: boolean
      required: false
      description: |
        When set, TCXO is selected as external source clock for HSE.
        Otherwise, external cyrstal is selected as HSE source clock.

    hse-div2:
      type: boolean
      required: false
      description: |
        When set HSE output clock is divided by 2.
        Otherwise, no prescaler is used.
```

## dts/bindings/clock/st,stm32wl-rcc.yaml
```yaml
# Copyright (c) 2021, Linaro ltd
# SPDX-License-Identifier: Apache-2.0

description: |
  STM32WL RCC (Reset and Clock controller).

  For more description confere st,stm32-rcc.yaml

compatible: "st,stm32wl-rcc"

include:
  - name: st,stm32wb-rcc.yaml
    property-blocklist:
      - ahb4-prescaler
      - cpu2-prescaler

properties:
  cpu2-prescaler:
    type: int
    enum:
      - 1
      - 2
      - 4
      - 8
      - 16
      - 32
      - 64
      - 128
      - 256
      - 512
    description: |
        CPU2 prescaler. Sets HCLK2 frequency which clocks CPU2.
        (A.K.A C2HPRE)

  ahb3-prescaler:
    type: int
    required: true
    enum:
      - 1
      - 2
      - 4
      - 8
      - 16
      - 32
      - 64
      - 128
      - 256
      - 512
    description: |
        HCLK3 shared prescaler (AHB3, Flash memory, SRAM1 and SRAM2).
        (A.K.A SHDHPRE)

clock-cells:
  - bus
  - bits
```

## dts/bindings/clock/syna,gcr.yaml
```yaml
# Copyright (c) 2025 Synaptics, Inc.
# SPDX-License-Identifier: Apache-2.0

description: Synaptics Clock Controller

compatible: "syna,gcr"

include: [clock-controller.yaml, base.yaml]

properties:
  reg:
    required: true

  "#clock-cells":
    const: 1

clock-cells:
  - clkid
```

## dts/bindings/clock/syna,sr100-clock.yaml
```yaml
# Copyright (c) 2025 Synaptics, Inc.
# SPDX-License-Identifier: Apache-2.0

description: Synaptics SR100 Clock Controller

compatible: "syna,sr100-clock"

include: [clock-controller.yaml, base.yaml]

properties:
  reg:
    required: true

  "#clock-cells":
    const: 1

clock-cells:
  - clkid
```

## dts/bindings/clock/tcc,ccu.yaml
```yaml
# Copyright 2024 Hounjoung Rim <hounjoung@tsnlab.com>
# SPDX-License-Identifier: Apache-2.0

description: Telechips TCP70xx Clock Controller

compatible: "tcc,ccu"

include: [clock-controller.yaml, base.yaml]

properties:
  "#clock-cells":
    const: 1

clock-cells:
  - clk_id
```

## dts/bindings/clock/ti,am62-epwm-tbclk.yaml
```yaml
# Copyright (c) 2025 Texas Instrumetns
# SPDX-License-Identifier: Apache-2.0

description: Syscon backed gate-clock driver

compatible: "ti,am62-epwm-tbclk"

include: ["ti,am654-ehrpwm-tbclk.yaml"]
```

## dts/bindings/clock/ti,am654-ehrpwm-tbclk.yaml
```yaml
# Copyright (c) 2025 Texas Instrumetns
# SPDX-License-Identifier: Apache-2.0

description: Syscon backed gate-clock driver

compatible: "ti,am654-ehrpwm-tbclk"

include: [base.yaml, clock-controller.yaml]

properties:
  reg:
    required: true

  "#clock-cells":
    const: 1

clock-cells:
  - clk-id
```

## dts/bindings/clock/ti,cc23x0-lf-xosc.yaml
```yaml
# Copyright (c) 2024 Baylibre, SAS
# SPDX-License-Identifier: Apache-2.0

description: TI CC23X0 external low-frequency oscillator

compatible: "ti,cc23x0-lf-xosc"

include: base.yaml
```

## dts/bindings/clock/ti,k2g-sci-clk.yaml
```yaml
# Copyright 2025 Texas Instruments Incorporated.
# SPDX-License-Identifier: Apache-2.0

description: TI-SCI clock controller

compatible: "ti,k2g-sci-clk"

include:
  - clock-controller.yaml
  - base.yaml

properties:
  "#clock-cells":
    type: int
    required: true
    description: >
      Number of cells required to specify a clock provided by this controller.
    const: 2

clock-cells:
  - devid
  - clkid
```
