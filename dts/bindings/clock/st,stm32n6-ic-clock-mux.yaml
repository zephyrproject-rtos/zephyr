## dts/bindings/clock/st,stm32n6-ic-clock-mux.yaml
```yaml
# Copyright (c) 2024 STMicroelectronics
# SPDX-License-Identifier: Apache-2.0

description: |
  STM32N6 Divider IC multiplexer.

  This node selects a clock input and a divider.

  For instance:
    &ic6 {
      pll-src = <2>;
      div = <16>;
      status = "okay";
    };

compatible: "st,stm32n6-ic-clock-mux"

properties:
  pll-src:
    type: int
    required: true
    description: |
        PLL clock source
    enum:
      - 1
      - 2
      - 3
      - 4

  ic-div:
    type: int
    description: |
        ICx integer division factor
        The input ICx frequency is divided by the specified value
        Valid range: 1 - 256
```

## dts/bindings/clock/st,stm32n6-msi-clock.yaml
```yaml
# SPDX-License-Identifier: Apache-2.0

description: STM32N6 Multi Speed Internal Clock

compatible: "st,stm32n6-msi-clock"

include:
  - name: st,stm32-msi-clock.yaml
    property-blocklist:
      - msi-range

properties:
  msi-range:
    required: true
    type: int
    description: |
        MSI clock ranges:
        0: around 4 MHz (reset value)
        1: around 16 MHz
    enum: [0, 1]
```

## dts/bindings/clock/st,stm32n6-pll-clock.yaml
```yaml
# Copyright (c) 2024 STMicroelectronics
# SPDX-License-Identifier: Apache-2.0

description: |
  STM32N6 main PLL.

  It can be used to describe 4 different PLLs: PLL1, PLL2, PLL3 and PLL4.

  These PLLs can take one of clk_hse, clk_hsi or clk_msi as input clock, with
  an input frequency from 5 to 50 MHz. PLLM factor is used to set the input
  clock in this acceptable range.

  Each PLL has one output clock whose frequency can be computed with the
  following formula:

    f(PLL_P) = f(VCO clock) / (PLLP1 × PLLP2)

      with f(VCO clock) = f(PLL clock input) × (PLLN / PLLM)

  Note: To reduce the power consumption, it is recommended to configure the VCOx
        clock output to the lowest frequency.

  The PLL output frequency must not exceed 3200 MHz.

compatible: "st,stm32n6-pll-clock"

include: [clock-controller.yaml, base.yaml]

properties:

  "#clock-cells":
    const: 0

  clocks:
    required: true

  div-m:
    type: int
    required: true
    description: |
        Prescaler for PLLx
        input clock
        Valid range: 1 - 63

  mul-n:
    type: int
    required: true
    description: |
        PLLx multiplication factor for VCO
        Valid range: 16 - 2500

  div-p1:
    type: int
    description: |
        PLLx DIVP1 division factor
        Valid range: 1 - 7

  div-p2:
    type: int
    description: |
        PLLx DIVP2 division factor
        Valid range: 1 - 7
```

## dts/bindings/clock/st,stm32n6-rcc.yaml
```yaml
# Copyright (c) 2024 STMicroelectronics
# SPDX-License-Identifier: Apache-2.0

description: |
  STM32N6 RCC (Reset and Clock controller).

  This node is in charge of system clock ('SYSCLK') source selection and
  System Clock Generation.

  Configuring STM32 Reset and Clock controller node:

  System clock source should be selected amongst the clock nodes available in "clocks"
  node (typically 'clk_hse, clk_csi', 'pll', ...).
  As part of this node configuration, SYSCLK frequency should also be defined, using
  "clock-frequency" property.
  Last, bus clocks (typically HCLK, PCLK1, PCLK2) should be configured using matching
  prescaler properties.
  Here is an example of correctly configured rcc node:
  &rcc {
    clocks = <&ic2>;
    clock-frequency = <DT_FREQ_M(400)>;
    ahb-prescaler = <2>;
    apb1-prescaler = <1>;
    apb2-prescaler = <1>;
    apb4-prescaler = <1>;
    apb5-prescaler = <1>;
  }

  Confere st,stm32-rcc binding for information about domain clocks configuration.

compatible: "st,stm32n6-rcc"

include: [clock-controller.yaml, base.yaml]

properties:
  reg:
    required: true

  "#clock-cells":
    const: 2

  clock-frequency:
    required: true
    type: int
    description: |
      default frequency in Hz for clock output

  ahb-prescaler:
    type: int
    required: true
    description: |
        AHB clock prescaler
    enum:
      - 1
      - 2
      - 4
      - 8
      - 16
      - 32
      - 64
      - 128

  apb1-prescaler:
    type: int
    required: true
    description: |
        CPU domain APB1 prescaler
    enum:
      - 1
      - 2
      - 4
      - 8
      - 16
      - 32
      - 64
      - 128

  apb2-prescaler:
    type: int
    required: true
    description: |
        CPU domain APB2 prescaler
    enum:
      - 1
      - 2
      - 4
      - 8
      - 16
      - 32
      - 64
      - 128

  apb4-prescaler:
    type: int
    required: true
    description: |
        CPU domain APB4 prescaler
    enum:
      - 1
      - 2
      - 4
      - 8
      - 16
      - 32
      - 64
      - 128

  apb5-prescaler:
    type: int
    required: true
    description: |
        CPU domain APB5 prescaler
    enum:
      - 1
      - 2
      - 4
      - 8
      - 16
      - 32
      - 64
      - 128


clock-cells:
  - bus
  - bits
```

## dts/bindings/clock/st,stm32u0-pll-clock.yaml
```yaml
# Copyright (c) 2024 STMicroelectronics
# SPDX-License-Identifier: Apache-2.0

description: |
  STM32U0 Main PLL.

  Takes one of clk_hse, clk_hsi or clk_msi as input clock, with
  an input frequency from 2.66 to 16 MHz. PLLM factor is used to set the input
  clock in this acceptable range.

  PLL can have up to 3 output clocks and for each output clock, the
  frequency can be computed with the following formulae:

    f(PLL_P) = f(VCO clock) / PLLP  --> to ADC
    f(PLL_Q) = f(VCO clock) / PLLQ  --> to RNG
    f(PLL_R) = f(VCO clock) / PLLR  --> PLLCLK (System Clock)

      with f(VCO clock) = f(PLL clock input) × (PLLN / PLLM)

  The PLL output frequency must not exceed 122 MHz.

compatible: "st,stm32u0-pll-clock"

include: [clock-controller.yaml, base.yaml]

properties:
  "#clock-cells":
    const: 0

  clocks:
    required: true

  div-m:
    type: int
    required: true
    description: |
        Division factor M of the PLL
        input clock divider
        Valid range: 1 - 8

  mul-n:
    type: int
    required: true
    description: |
        PLL frequency multiplication factor N
        Valid range: 4 - 127

  div-p:
    type: int
    description: |
        PLL VCO division factor P
        Valid range: 2 - 32

  div-q:
    type: int
    description: |
        PLL VCO division factor Q
        Valid range: 2 - 8

  div-r:
    type: int
    required: true
    description: |
        PLL VCO division factor R
        Valid range: 2 - 8
```

## dts/bindings/clock/st,stm32u3-msi-clock.yaml
```yaml
# Copyright (c) 2025 STMicroelectronics
# SPDX-License-Identifier: Apache-2.0

description: STM32U3 Multi Speed Internal Clock

compatible: "st,stm32u3-msi-clock"

include:
  - name: st,stm32-msi-clock.yaml
    property-blocklist:
      - msi-range

properties:

  msi-range:
    default: 0
    type: int
    description: |
        MSI clock ranges:
        range 0 around 96 MHz
        range 1 around 48 MHz
        range 2 around 24 MHz from 96MHz oscillator
        range 3 around 12 MHz from 96MHz oscillator
        range 4 around 24 MHz from 24MHz oscillator
        range 5 around 12 MHz from 24MHz oscillator
        range 6 around 6 MHz
        range 7 around 3 MHz
    enum:
      - 0
      - 1
      - 2
      - 3
      - 4
      - 5
      - 6
      - 7
```

## dts/bindings/clock/st,stm32u5-msi-clock.yaml
```yaml
# Copyright (c) 2021, Linaro Limited
# SPDX-License-Identifier: Apache-2.0

description: STM32U5 Multi Speed Internal Clock

compatible: "st,stm32u5-msi-clock"

include:
  - name: st,stm32-msi-clock.yaml
    property-blocklist:
      - msi-range

properties:

  msi-range:
    default: 4
    required: true
    type: int
    description: |
      MSI clock ranges:
      0: around 48 MHz
      1: around 24 MHz
      2: around 16 MHz
      3: around 12 MHz
      4: around 4 MHz (reset value)
      5: around 2 MHz
      6: around 1.33 MHz
      7: around 1 MHz
      8: around 3.072 MHz
      9: around 1.536 MHz
      10: around 1.024 MHz
      11: around 768 KHz
      12: around 400 KHz
      13: around 200 KHz
      14: around 133 KHz
      15: around 100 KHz
    min: 0
    max: 15
```

## dts/bindings/clock/st,stm32u5-pll-clock.yaml
```yaml
# Copyright (c) 2021, Linaro Limited
# SPDX-License-Identifier: Apache-2.0

description: |
  PLL node binding for STM32U5 devices

  It can be used to describe 3 different PLLs: PLL1, PLL2 and PLL3.

  These PLLs could take one of clk_hse, clk_hsi or clk_msis as input clock, with
  an input frequency from 4 to 16 MHz. PLLM factor is used to set the input
  clock in this acceptable range.

  Each PLL can have up to 3 output clocks and for each output clock, the
  frequency can be computed with the following formulae:

    f(PLL_P) = f(VCO clock) / PLLP
    f(PLL_Q) = f(VCO clock) / PLLQ
    f(PLL_R) = f(VCO clock) / PLLR

      with f(VCO clock) = f(PLL clock input) × (PLLN / PLLM)

  Note: To reduce the power consumption, it is recommended to configure the VCOx
        clock output to the lowest frequency.

  The PLL output frequency must not exceed 160 MHz.

compatible: "st,stm32u5-pll-clock"

include: [clock-controller.yaml, base.yaml]

properties:

    "#clock-cells":
      const: 0

    clocks:
      required: true

    div-m:
      type: int
      required: true
      description: |
          Prescaler for PLLx
          input clock
          Valid range: 1 - 16

    mul-n:
      type: int
      required: true
      description: |
          PLLx multiplication factor for VCO
          Valid range: 4 - 512

    div-p:
      type: int
      required: false
      description: |
          PLLx DIVP division factor
          Valid range: 1 - 128

    div-q:
      type: int
      required: false
      description: |
          PLLx DIVQ division factor
          Valid range: 1 - 128

    div-r:
      type: int
      required: true
      description: |
          PLLx DIVR division factor
          On PLL1, only division by 1 and even division values are allowed.
          No restrictions for PLL2 and PLL3
          Valid range: 1 - 128
```

## dts/bindings/clock/st,stm32u5-rcc.yaml
```yaml
# Copyright (c) 2021, Linaro Limited
# SPDX-License-Identifier: Apache-2.0

description: |
  STM32U5 Reset and Clock controller node.
  For more description confere st,stm32-rcc.yaml

compatible: "st,stm32u5-rcc"

include:
  - name: st,stm32-rcc.yaml
    property-blocklist:
      - undershoot-prevention

properties:

  apb3-prescaler:
    type: int
    required: true
    enum:
      - 1
      - 2
      - 4
      - 8
      - 16
```

## dts/bindings/clock/st,stm32wb-pll-clock.yaml
```yaml
# Copyright (c) 2021, Linaro ltd
# SPDX-License-Identifier: Apache-2.0

description: |
  STM32WB and STM32WL PLL node.

  It can be used to describe 2 different PLLs: PLL, PLLSAI1.
  Only main PLL is supported for now.

  These PLLs could take one of clk_hse, clk_hsi or clk_msi as input clock, with
  an input frequency from 2.66 to 16 MHz. PLLM factor is used to set the input
  clock in this acceptable range.

  Each PLL can have up to 3 output clocks and for each output clock, the
  frequency can be computed with the following formulae:

    f(PLL_P) = f(VCO clock) / PLLP  --> PLLPCLK
    f(PLL_Q) = f(VCO clock) / PLLQ  --> PLLQCLK
    f(PLL_R) = f(VCO clock) / PLLR  --> PLLRCLK (System Clock)

      with f(VCO clock) = f(PLL clock input) × (PLLN / PLLM)

  The PLL output frequency must not exceed:
          - 64 MHz on STM32WB
          - 62 MHz on STM32WL

compatible: "st,stm32wb-pll-clock"

include: [clock-controller.yaml, base.yaml]

properties:
    "#clock-cells":
      const: 0

    clocks:
      required: true

    div-m:
      type: int
      required: true
      description: |
          Main PLL division factor for PLL input clock
          Valid range: 1 - 8

    mul-n:
      type: int
      required: true
      description: |
          Main PLL multiplication factor for VCO
          Valid range: 6 - 127

    div-p:
      type: int
      required: false
      description: |
          Main PLL division factor for PLLPCLK
          Valid range: 2 - 32

    div-q:
      type: int
      required: false
      description: |
          Main PLL division factor for PLLQCLK
          Valid range: 2 - 8

    div-r:
      type: int
      required: true
      description: |
          Main PLL division factor for PLLRCLK (system clock)
          Valid range: 2 - 8
```

## dts/bindings/clock/st,stm32wb-rcc.yaml
```yaml
# Copyright (c) 2021, Linaro ltd
# SPDX-License-Identifier: Apache-2.0

description: |
  STM32WB Reset and Clock controller node.
  For more description confere st,stm32-rcc.yaml

compatible: "st,stm32wb-rcc"

include:
  - name: st,stm32-rcc.yaml
    property-blocklist:
      - ahb-prescaler

properties:
    cpu1-prescaler:
      type: int
      required: true
      enum:
        - 1
        - 2
        - 3
        - 4
        - 5
        - 6
        - 8
        - 10
        - 16
        - 32
        - 64
        - 128
        - 256
        - 512
      description: |
          CPU1 prescaler. Sets a HCLK1 frequency (Core frequency)
          lower than SYSCLK frequency.
          The HCLK1 clocks CPU1, AHB1, AHB2, AHB3 and SRAM1.

    cpu2-prescaler:
      type: int
      required: true
      enum:
        - 1
        - 2
        - 4
        - 8
        - 16
        - 32
        - 64
        - 128
        - 256
        - 512
      description: |
          CPU2 prescaler. Sets HCLK2 frequency which clocks CPU2.
          (A.K.A C2HPRE)

    ahb4-prescaler:
      type: int
      required: true
      enum:
        - 1
        - 2
        - 4
        - 8
        - 16
        - 32
        - 64
        - 128
        - 256
        - 512
      description: |
          HCLK4 shared prescaler (AHB4, Flash memory and SRAM2).
          (A.K.A SHDHPRE)

clock-cells:
  - bus
  - bits
```

## dts/bindings/clock/st,stm32wb0-lsi-clock.yaml
```yaml
# Copyright (c) 2024 STMicroelectronics
# SPDX-License-Identifier: Apache-2.0

description: |
  STM32WB0 LSI Clock

  The STM32WB0 MCUs are equipped with a regular RC LSI clock with a frequency of 24~40kHz.
  The SoCs are also equipped with hardware to perform LSI frequency measurement, which
  allows to adapt all frequency-based calculations to a somewhat accurate value, ensuring
  that the software does not get too much out of sync with real-world time.

  Several LSI frequency measurement options can be configured via Kconfig.

compatible: "st,stm32wb0-lsi-clock"

include: [fixed-clock.yaml]
```

## dts/bindings/clock/st,stm32wb0-rcc.yaml
```yaml
# Copyright (c) 2024 STMicroelectronics
# SPDX-License-Identifier: Apache-2.0

description: |
  STM32WB0 Reset and Clock controller node for STM32WB0 devices
  This node is in charge of the system clock ('SYSCLK') source
  selection and generation.

compatible: "st,stm32wb0-rcc"

include: [clock-controller.yaml, base.yaml]

properties:
  reg:
    required: true

  "#clock-cells":
    const: 2

  clock-frequency:
    required: true
    type: int
    description: |
      default frequency in Hz for clock output

  slow-clock:
    type: phandle
    description: |
      Slow clock source selection.
      On STM32WB0, all slow clock devices are clocked from the same
      slow clock source, which is selected by this property.

      The slow clock can be either clk_lsi, clk_lse, or clk_16mhz_div512.

  clksys-prescaler:
    type: int
    required: true
    enum:
      - 1
      - 2
      - 4
      - 8
      - 16
      - 32
      - 64
    description: |
      CLK_SYS prescaler. Defines actual core clock frequency (CLK_SYS) based
      on system frequency input (SYSCLK).
      The CLK_SYS is used to clock the CPU, AHB, APB, memories and PKA.

      NOTE: if the 32MHz HSE is used as SYSCLK source, the prescaler cannot
      be set to 64.

clock-cells:
  - bus
  - bits
```
