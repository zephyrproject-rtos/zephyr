## dts/bindings/clock/nxp,mcxc-osc.yaml
```yaml
# Copyright 2024 NXP
# SPDX-License-Identifier: Apache-2.0

description: NXP MCXC oscillator

compatible: "nxp,mcxc-osc"

include: fixed-clock.yaml

properties:
  load-capacitance-picofarads:
    type: int
    enum:
      - 0
      - 2
      - 4
      - 6
      - 8
      - 10
      - 12
      - 14
      - 16
      - 18
      - 20
      - 22
      - 24
      - 26
      - 28
      - 30
    description: |
      Oscillator load capacitance in picofarads.

  mode:
    type: string
    enum:
      - "external"
      - "low-power"
      - "high-gain"
    description: |
      Oscillator Mode Selection
```

## dts/bindings/clock/nxp,mcxw-clock.yaml
```yaml
# Copyright 2025 NXP
# SPDX-License-Identifier: Apache-2.0

description: NXP MCXW series clock controller

compatible: "nxp,mcxw-clock"

include: [clock-controller.yaml, base.yaml]

properties:

  osc32k-mode:
    type: int
    required: true
    description: |
      32 kHz clock source selection.
    enum:
      - 0
      - 1
      - 3

  osc32k-xtal-cap:
    type: int
    required: true
    description: |
      internal capacitance value for 32 kHz OSC XTAL.
      0: The internal capacitance for XTAL pin is 0pF.
      1: The internal capacitance for XTAL pin is 2pF.
      2: The internal capacitance for XTAL pin is 4pF.
      3: The internal capacitance for XTAL pin is 6pF.
      4: The internal capacitance for XTAL pin is 8pF.
      5: The internal capacitance for XTAL pin is 10pF.
      6: The internal capacitance for XTAL pin is 12pF.
      7: The internal capacitance for XTAL pin is 14pF.
      8: The internal capacitance for XTAL pin is 16pF.
      9: The internal capacitance for XTAL pin is 18pF.
      10: The internal capacitance for XTAL pin is 20pF.
      11: The internal capacitance for XTAL pin is 22pF.
      12: The internal capacitance for XTAL pin is 24pF.
      13: The internal capacitance for XTAL pin is 26pF.
      14: The internal capacitance for XTAL pin is 28pF.
      15: The internal capacitance for XTAL pin is 30pF.
    enum:
      - 0
      - 1
      - 2
      - 3
      - 4
      - 5
      - 6
      - 7
      - 8
      - 9
      - 10
      - 11
      - 12
      - 13
      - 14
      - 15

  osc32k-extal-cap:
    type: int
    required: true
    description: |
      internal capacitance value for 32 kHz OSC EXTAL.
      0: The internal capacitance for EXTAL pin is 0pF.
      1: The internal capacitance for EXTAL pin is 2pF.
      2: The internal capacitance for EXTAL pin is 4pF.
      3: The internal capacitance for EXTAL pin is 6pF.
      4: The internal capacitance for EXTAL pin is 8pF.
      5: The internal capacitance for EXTAL pin is 10pF.
      6: The internal capacitance for EXTAL pin is 12pF.
      7: The internal capacitance for EXTAL pin is 14pF.
      8: The internal capacitance for EXTAL pin is 16pF.
      9: The internal capacitance for EXTAL pin is 18pF.
      10: The internal capacitance for EXTAL pin is 20pF.
      11: The internal capacitance for EXTAL pin is 22pF.
      12: The internal capacitance for EXTAL pin is 24pF.
      13: The internal capacitance for EXTAL pin is 26pF.
      14: The internal capacitance for EXTAL pin is 28pF.
      15: The internal capacitance for EXTAL pin is 30pF.
    enum:
      - 0
      - 1
      - 2
      - 3
      - 4
      - 5
      - 6
      - 7
      - 8
      - 9
      - 10
      - 11
      - 12
      - 13
      - 14
      - 15

  firc-mode:
    type: int
    required: true
    description: |
      FIRC (Fast Internal Reference Clock) mode selection.
      0: FIRC is disabled.
      1: FIRC is enabled in normal mode.
      2: FIRC is enabled in low power mode.
    enum:
      - 0
      - 1
      - 2

  firc-range:
    type: int
    required: true
    description: |
      FIRC frequency range selection.

  enable-sirc-in-lp-mode:
    type: boolean
    description: |
     Enable/disable SIRC(FRO 6M) in low power mode.

  sys-clk-src:
    type: int
    required: true
    description: |
      System clock source selection.

  sys-clk-div-bus:
    type: int
    required: true
    description: |
      System clock divider for bus clock.
      Valid range: 1 to 16.

  sys-clk-div-slow:
    type: int
    required: true
    description: |
      System clock divider for slow clock.
      Valid range: 1 to 16.

  sys-clk-div-core:
    type: int
    required: true
    description: |
      System clock divider for core clock.
      Valid range: 1 to 16.

  enable-sosc:
    type: boolean
    description: |
      Enable/disable SOSC (System Oscillator).

  sosc-freq:
    type: int
    required: true
    description: |
      SOSC (System Oscillator) frequency in Hz.

  "#clock-cells":
    type: int
    const: 1

clock-cells:
  - name
```

## dts/bindings/clock/nxp,mcxw7x-clock.yaml
```yaml
description: NXP MCXW7X series clock controller

compatible: "nxp,mcxw7x-clock"

include: [clock-controller.yaml, base.yaml]

properties:

  osc32k-mode:
    type: int
    required: true
    description: |
      32 kHz clock source selection.
      0: Disable 32 kHz crystal oscillator.
      1: Enable 32 kHz crystal oscillator.
      3: Bypass 32 kHz oscillator (use external clock input).
    enum:
      - 0
      - 1
      - 3

  osc32k-xtal-cap:
    type: int
    required: true
    description: |
      internal capacitance value for 32 kHz OSC XTAL.
      0: The internal capacitance for XTAL pin is 0pF.
      1: The internal capacitance for XTAL pin is 2pF.
      2: The internal capacitance for XTAL pin is 4pF.
      3: The internal capacitance for XTAL pin is 6pF.
      4: The internal capacitance for XTAL pin is 8pF.
      5: The internal capacitance for XTAL pin is 10pF.
      6: The internal capacitance for XTAL pin is 12pF.
      7: The internal capacitance for XTAL pin is 14pF.
      8: The internal capacitance for XTAL pin is 16pF.
      9: The internal capacitance for XTAL pin is 18pF.
      10: The internal capacitance for XTAL pin is 20pF.
      11: The internal capacitance for XTAL pin is 22pF.
      12: The internal capacitance for XTAL pin is 24pF.
      13: The internal capacitance for XTAL pin is 26pF.
      14: The internal capacitance for XTAL pin is 28pF.
      15: The internal capacitance for XTAL pin is 30pF.
    enum:
      - 0
      - 1
      - 2
      - 3
      - 4
      - 5
      - 6
      - 7
      - 8
      - 9
      - 10
      - 11
      - 12
      - 13
      - 14
      - 15

  osc32k-extal-cap:
    type: int
    required: true
    description: |
      internal capacitance value for 32 kHz OSC EXTAL.
      0: The internal capacitance for EXTAL pin is 0pF.
      1: The internal capacitance for EXTAL pin is 2pF.
      2: The internal capacitance for EXTAL pin is 4pF.
      3: The internal capacitance for EXTAL pin is 6pF.
      4: The internal capacitance for EXTAL pin is 8pF.
      5: The internal capacitance for EXTAL pin is 10pF.
      6: The internal capacitance for EXTAL pin is 12pF.
      7: The internal capacitance for EXTAL pin is 14pF.
      8: The internal capacitance for EXTAL pin is 16pF.
      9: The internal capacitance for EXTAL pin is 18pF.
      10: The internal capacitance for EXTAL pin is 20pF.
      11: The internal capacitance for EXTAL pin is 22pF.
      12: The internal capacitance for EXTAL pin is 24pF.
      13: The internal capacitance for EXTAL pin is 26pF.
      14: The internal capacitance for EXTAL pin is 28pF.
      15: The internal capacitance for EXTAL pin is 30pF.
    enum:
      - 0
      - 1
      - 2
      - 3
      - 4
      - 5
      - 6
      - 7
      - 8
      - 9
      - 10
      - 11
      - 12
      - 13
      - 14
      - 15

  firc-mode:
    type: int
    required: true
    description: |
      FIRC (Fast Internal Reference Clock) mode selection.
      0: FIRC is disabled.
      1: FIRC is enabled in normal mode.
      2: FIRC is enabled in low power mode.
    enum:
      - 0
      - 1
      - 2

  firc-range:
    type: int
    required: true
    description: |
      FIRC frequency range selection.

  enable-sirc-in-lp-mode:
    type: boolean
    description: |
     Enable/disable SIRC(FRO 6M) in low power mode.

  sys-clk-src:
    type: int
    required: true
    description: |
      System clock source selection.

  sys-clk-div-bus:
    type: int
    required: true
    description: |
      System clock divider for bus clock.
      Valid range: 1 to 16.

  sys-clk-div-slow:
    type: int
    required: true
    description: |
      System clock divider for slow clock.
      Valid range: 1 to 16.

  sys-clk-div-core:
    type: int
    required: true
    description: |
      System clock divider for core clock.
      Valid range: 1 to 16.

  sys-clk-div-plat:
    type: int
    description: |
      System clock divider for platform clock.
      This property is only applicable to MCXW70 SoC which has an
      additional platform clock divider in the SCG system clock
      configuration.

  enable-sosc:
    type: boolean
    description: |
      Enable/disable SOSC (System Oscillator).

  sosc-freq:
    type: int
    required: true
    description: |
      SOSC (System Oscillator) frequency in Hz.

  core-clock-frequency:
    type: int
    required: true
    description: |
      Expected core clock frequency in Hz after clock configuration.
      Used to configure voltage levels before clock setup (e.g., 96 MHz
      requires raising core voltage) and to verify the clock configuration
      is correct at init time.

  "#clock-cells":
    type: int
    const: 1

clock-cells:
  - name
```

## dts/bindings/clock/nxp,plldig.yaml
```yaml
# Copyright 2025 NXP
# SPDX-License-Identifier: Apache-2.0

description: Phase-locked loop

compatible: "nxp,plldig"

include: [base.yaml]

properties:
  reg:
    required: true

  workmode:
    required: true
    type: string
    description: PLL work mode setting
    enum: ["Integer", "Fractional", "SSCG"]

  prediv:
    required: true
    type: int
    description: Input Clock Predivider

  postdiv:
    required: true
    type: int
    description: VCO clock post divider for driving the PHI output clock.

  multiplier:
    required: true
    type: int
    description: Multiplication factor applied to the reference frequency

  fracloopdiv:
    required: true
    type: int
    description: Numerator Of Fractional Loop Division Factor.
        Value should less than 18432.

  stepsize:
    required: true
    type: int
    description: For SSCG mode. Frequency Modulation Step Size

  stepnum:
    required: true
    type: int
    description: |
      For SSCG mode. Number Of Steps Of Modulation Period Or Frequency Modulation

  accuracy:
    required: true
    type: string
    description: PLL unlock accuracy
    enum: ["Accuracy9", "Accuracy17", "Accuracy33", "Accuracy5"]

  outdiv:
    required: true
    type: array
    description: PLL Output Divider
```

## dts/bindings/clock/nxp,s32-clock.yaml
```yaml
# Copyright 2023 NXP
# SPDX-License-Identifier: Apache-2.0

description: NXP S32 clock generator IP node

compatible: "nxp,s32-clock"

include: [clock-controller.yaml, base.yaml]

properties:
  reg:
    required: true

  "#clock-cells":
    const: 1

clock-cells:
  - name
```

## dts/bindings/clock/nxp,scg-k4.yaml
```yaml
# Copyright 2023 NXP
# SPDX-License-Identifier: Apache-2.0

description: NXP K4 Generation SCG (System Clock Generator) IP node

compatible: "nxp,scg-k4"

include: [clock-controller.yaml, base.yaml]

properties:
  reg:
    required: true

  "#clock-cells":
    const: 2

clock-cells:
  - name
  - mrcc_offset # See fsl_clock.h clock IP names, 0 if N/A
```

## dts/bindings/clock/pll-config.yaml
```yaml
# Copyright NXP 2022
# SPDX-License-Identifier: Apache-2.0

description: Generic fixed-rate clock provider

compatible: "pll-config"

properties:
    pll-ctrl-seli:
      type: int
      description: Bandwidth select I value
      required: true

    pll-ctrl-selp:
      type: int
      description: Bandwidth select P value
      required: true

    pll-ndec-ndiv:
      type: int
      description: PLL 550m Pre Divider
      required: true

    pll-pdec-pdiv:
      type: int
      description: PPL 550m Post Divider
      required: true

    pll-sscg1-mdiv:
      type: int
      description: PLL0 Spread Spectrum Control
      required: false

    pll-mdec-mdiv:
      type: int
      description: PLL1 Feddback ratio
      required: false

    pll-rate:
      type: int
      description: PLL clock frequency (Hz)
      required: true
```

## dts/bindings/clock/pwm-clock.yaml
```yaml
# Copyright (c) 2023 Andriy Gelman
# SPDX-License-Identifier: Apache-2.0

description: |
  An external clock signal driven by a PWM pin.

  The devicetree must define a clock node:

  pwmclock: pwmclock {
      status = "okay";
      compatible = "pwm-clock";
      #clock-cells = <1>;
      pwms = <&pwm_ccu40 2 PWM_HZ(1000000) PWM_POLARITY_NORMAL>;
  };

  This will create a device node with a clock-controller
  API. Internally the device node will use PWM API to start the
  clock signals at 1MHz. Note that the PWM_HZ() macro converts the
  frequency to time (nanoseconds units). This may result in rounding
  errors if the clock frequency is not an integer number of nanoseconds.
  The clock frequency can be explicitly set using the clock-frequency
  property.

  The PWM node may need to be properly configured to generate
  the target period (i.e. using prescaler options). See the documentation
  for the target PWM driver.

compatible: "pwm-clock"

include: [clock-controller.yaml, base.yaml]

properties:
  pwms:
    type: phandle-array
    required: true

  clock-frequency:
    type: int
    description: |
      Exact output frequency, in case the PWM period is not exact
      but was rounded to nanoseconds. This property is optional.

  pwm-on-delay:
    type: int
    default: 0
    description:
      Optional blocking delay in micro seconds to make sure that the PWM
      clock has started after returning from clock_control_on().

  "#clock-cells":
    const: 1

clock-cells:
  - id
```

## dts/bindings/clock/raspberrypi,pico-clock-controller.yaml
```yaml
# Copyright (c) 2022 Andrei-Edward Popa
# SPDX-License-Identifier: Apache-2.0

description: Raspberry Pi Pico clock controller node

compatible: "raspberrypi,pico-clock-controller"

include: [base.yaml, clock-controller.yaml, pinctrl-device.yaml]

properties:
  reg:
    required: true

  "#clock-cells":
    const: 1

clock-cells:
  - clk-id
```
