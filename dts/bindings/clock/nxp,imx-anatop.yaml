## dts/bindings/clock/nxp,imx-anatop.yaml
```yaml
# Copyright (c) 2021, NXP
# SPDX-License-Identifier: Apache-2.0

description: i.MX ANATOP (Analog Clock Controller Module) IP node

compatible: "nxp,imx-anatop"

include: [clock-controller.yaml, base.yaml]

properties:
    reg:
        required: true

    label:
        required: true

    "#clock-cells":
        type: int
        const: 4
        required: true
        description: Number of items to expect in a clock specifier

    "#pll-clock-cells":
        type: int
        const: 3
        required: true
        description: Number of items to expect in a PLL specifier

clock-cells:
    - name
    - offset
    - bits
    - value

pll-clock-cells:
    - offset
    - bits
    - value
```

## dts/bindings/clock/nxp,imx-ccm-rev2.yaml
```yaml
# Copyright (c) 2021, NXP
# SPDX-License-Identifier: Apache-2.0

description: i.MX CCM Rev2 (Clock Controller Module) IP node

compatible: "nxp,imx-ccm-rev2"

include: [clock-controller.yaml, base.yaml]

properties:
    reg:
      required: true

    label:
      required: true

    "#clock-cells":
      const: 3

clock-cells:
  - name
  - offset
  - bits
```

## dts/bindings/clock/nxp,imx-ccm.yaml
```yaml
# Copyright (c) 2017, NXP
# SPDX-License-Identifier: Apache-2.0

description: i.MX CCM (Clock Controller Module) IP node

compatible: "nxp,imx-ccm"

include: [clock-controller.yaml, base.yaml]

properties:
  reg:
    required: true

  "#clock-cells":
    const: 3

clock-cells:
  - name
  - offset
  - bits
```

## dts/bindings/clock/nxp,imx-clk-scmi.yaml
```yaml
# Copyright 2024 NXP
# SPDX-License-Identifier: Apache-2.0

description: i.MX SCMI clock node

compatible: "nxp,imx-clk-scmi"

include: [clock-controller.yaml, base.yaml]

properties:
  reg:
    required: true

  "#clock-cells":
    const: 1

clock-cells:
  - name
```

## dts/bindings/clock/nxp,imxrt-arm-pll-common.yaml
```yaml
# Copyright 2026 NXP
# SPDX-License-Identifier: Apache-2.0

description: |
  Common fields for i.MX RT ARM PLL clock providers.

  The ARM PLL output frequency is calculated as
  Fout = Fin * loop-div / (2 * post-div).

include: clock-controller.yaml

properties:
  "#clock-cells":
    const: 0

  loop-div:
    type: int
    min: 104
    max: 208
    description: ARM PLL loop divider

  post-div:
    type: int
    enum: [1, 2, 4, 8]
    description: ARM PLL post divider
```

## dts/bindings/clock/nxp,imxrt118x-arm-pll.yaml
```yaml
# Copyright 2026 NXP
# SPDX-License-Identifier: Apache-2.0

description: i.MX RT118x ARM PLL clock provider

compatible: "nxp,imxrt118x-arm-pll"

include: nxp,imxrt-arm-pll-common.yaml

properties:
  loop-div:
    required: true

  post-div:
    required: true
```

## dts/bindings/clock/nxp,imxrt11xx-arm-pll.yaml
```yaml
# Copyright 2026 NXP
# SPDX-License-Identifier: Apache-2.0

description: |
  i.MX RT11xx ARM PLL clock provider.

  New devicetree users should configure the ARM PLL using ``loop-div`` and
  ``post-div``. The legacy ``clock-mult`` and ``clock-div`` properties are
  still supported for compatibility, but are deprecated.

compatible: "nxp,imxrt11xx-arm-pll"

include: nxp,imxrt-arm-pll-common.yaml

properties:
  clock-div:
    type: int
    deprecated: true
    description: |
      Deprecated. Use post-div instead.

  clock-mult:
    type: int
    deprecated: true
    description: |
      Deprecated. Use loop-div instead. The legacy property represented half
      of the hardware loop divider, so loop-div = clock-mult * 2.
```

## dts/bindings/clock/nxp,kinetis-ke1xf-sim.yaml
```yaml
# Copyright (c) 2017, NXP
# SPDX-License-Identifier: Apache-2.0

description: Kinetis KE1xF System Integration Module (SIM) IP node

compatible: "nxp,kinetis-ke1xf-sim"

include: base.yaml

properties:
  reg:
    required: true

  clkout-source:
    type: int
    description: clkout clock source

  clkout-divider:
    type: int
    description: clkout divider
```

## dts/bindings/clock/nxp,kinetis-mcg.yaml
```yaml
# Copyright (c) 2019 Vestas Wind Systems A/S
# SPDX-License-Identifier: Apache-2.0

description: NXP Kinetis Multipurpose Clock generator (MCG) IP node

compatible: "nxp,kinetis-mcg"

include: [clock-controller.yaml, base.yaml]

properties:
  reg:
    required: true

  "#clock-cells":
    const: 1

  fcrdiv:
    type: int
    enum: [0, 1, 2, 3, 4, 5, 6, 7]
    description: |
      Internal Reference Clock Divider.
      Division factor is given as 2^fcrdiv.

  lircdiv2:
    type: int
    enum: [0, 1, 2, 3, 4, 5, 6, 7]
    description: |
      Second Low-frequency Internal Reference Clock Divider.
      Division factor is given as 2^lircdiv2.

clock-cells:
  - name
```

## dts/bindings/clock/nxp,kinetis-sim.yaml
```yaml
# Copyright (c) 2017, NXP
# SPDX-License-Identifier: Apache-2.0

description: Kinetis System Integration Module (SIM) IP node

compatible: "nxp,kinetis-sim"

include: base.yaml

properties:
  reg:
    required: true

  pllfll-select:
    type: int
    required: true
    description: pll/fll selection for clock system

  er32k-select:
    type: int
    required: true
    description: er32k selection for clock system

  clkout-source:
    type: int
    description: clkout clock source

  clkout-divider:
    type: int
    description: clkout divider

  "#clock-cells":
    type: int
    const: 3

clock-cells:
  - name
  - offset
  - bits
```

## dts/bindings/clock/nxp,lpc-clock-init.yaml
```yaml
description: LPC clock initialization using SDK APIs

compatible: "nxp,lpc-clock-init"

properties:
  enable-fro:
    type: boolean
    description: Power up the FRO oscillator.

  enable-froout:
    type: boolean
    description: Power up the FRO output.

  fro-freq:
    type: string
    enum: ["18M", "24M", "30M"]
    default: "30M"
    description: FRO oscillator output frequency.

  enable-sysosc:
    type: boolean
    description: Power up the system crystal oscillator (SYSOSC).

  extclk-src:
    type: string
    enum: ["sysosc", "clkin"]
    default: "sysosc"
    description: External clock source

  mainclk-src:
    type: string
    enum: ["fro", "extclk", "wdosc", "frodiv", "syspll"]
    default: "fro"
    description: Main clock source.
```

## dts/bindings/clock/nxp,lpc-syscon.yaml
```yaml
# Copyright (c) 2020, NXP
# SPDX-License-Identifier: Apache-2.0

description: LPC SYSCON & CLKCTL IP node

compatible: "nxp,lpc-syscon"

include: [clock-controller.yaml, base.yaml]

properties:
    reg:
      required: true

    label:
      required: true

    "#clock-cells":
      const: 1

clock-cells:
  - name
```

## dts/bindings/clock/nxp,lpc11u6x-syscon.yaml
```yaml
# Copyright (c) 2020, Seagate
# SPDX-License-Identifier: Apache-2.0

description: LPC11U6X clock controller node

compatible: "nxp,lpc11u6x-syscon"

include: [clock-controller.yaml, pinctrl-device.yaml, base.yaml]

properties:
    reg:
      required: true

    label:
      required: true

    pinctrl-0:
      required: true

    pinctrl-names:
      required: true

    "#clock-cells":
      const: 1

clock-cells:
  - clkid
```

## dts/bindings/clock/nxp,lpc55xxx-setpoint.yaml
```yaml
# Copyright 2023 NXP
# SPDX-License-Identifier: Apache-2.0

description: LPC55xxx SYSCON clock configuration

include: [base.yaml]

compatible: "nxp,lpc55xxx-setpoint"

properties:
  "#setpoint-cells":
    type: int
    const: 0
  fro-12m-enable:
    type: boolean
    description: 12 MHz divided down from the currently selected on-chip FRO oscillator
  pluglitch12mhzclk-enable:
    type: boolean
  xtal32m-freq:
    type: int
    description: External clock input
  clk-in-en-enable:
    type: boolean
    description: 32M clock output to cpu system gate
  clk-usb-en-enable:
    type: boolean
    description: 32M clock output to USB HS gate
  fro-1m-enable:
    type: boolean
    description: 1 MHz divided down from the currently selected on-chip FRO oscillator
  wdtclkdiv:
    type: int
    description: WDT clock divider
  utickclk-enable:
    type: boolean
  pluglitch1mhzclk-enable:
    type: boolean
  fro-hf-enable:
    type: boolean
    description: 96 MHz divided down from the currently selected on-chip FRO oscillator
  frohfdiv:
    type: int
    description: FRO HF clock divider
  fro-32k-enable:
    type: boolean
    description: 32 KHz clock output on-chip FRO oscillator
  xtal32k-freq:
    type: int
    description: RTC osc 32kHz output
  mclk-in-freq:
    type: int
    description: Master clock input
  plu-clkin-freq:
    type: int
    description: PLU clock input
  mainclksela:
    type: int
    description: Main clock source select A
  rtcosc32ksel:
    type: int
    description: RTC 32K clock source select
  ostimer32khzclk-enable:
    type: boolean
  rtcclk1hzdiv:
    type: int
    description: RTC 1Hz clock divider
  rtc-1hz-clk-enable:
    type: boolean
  rtcclk1khzdiv:
    type: int
    description: RTC 1KHz clock divider
  rtc-1khz-clk-enable:
    type: boolean
  pll0clksel:
    type: int
    description: PLL0 clock source select
  pll0:
    type: array
    description: PLL0
  pll0-directo:
    type: int
    description: Selects between PLL output divided by PDEC or direct output.
  pll0-bypass:
    type: int
    description: Selects between PLL output or bypass the PLL - input to the PLL is taken instead.
  pll0div:
    type: int
    description: PLL0 clock divider
  pll1clksel:
    type: int
    description: PLL1 clock source select
  pll1:
    type: array
    description: PLL1
  pll1-directo:
    type: int
    description: Selects between PLL output divided by PDEC or direct output.
  pll1-bypass:
    type: int
    description: Selects between PLL output or bypass the PLL - input to the PLL is taken instead.
  mainclkselb:
    type: int
    description: Main clock source select B
  traceclkdiv:
    type: int
    description: Trace clock divider
  systickclkdiv0:
    type: int
    description: Core0 SYSTICK clock divider
  systickclkdiv1:
    type: int
    description: Core1 SYSTICK clock divider
  ahbclkdiv:
    type: int
    description: System clock divider
  traceclksel:
    type: int
    description: Trace clock source select
  systickclksel0:
    type: int
    description: Core0 SYSTICK clock source select
  systickclksel1:
    type: int
    description: Core1 SYSTICK clock source select
  adcclksel:
    type: int
    description: ADC clock source select
  adcclkdiv:
    type: int
    description: ADC clock divider
  usb0clksel:
    type: int
    description: USB0 clock source select
  usb0clkdiv:
    type: int
    description: USB0 clock divider
  mclkclksel:
    type: int
    description: Master clock source select
  mclkdiv:
    type: int
    description: Master clock divider
  sctclksel:
    type: int
    description: SCT clock source select
  sctclkdiv:
    type: int
    description: SCT clock divider
  clkoutsel:
    type: int
    description: CLKOUT clock source select
  clkoutdiv:
    type: int
    description: CLKOUT clock divider
  sdioclksel:
    type: int
    description: SDIO clock source select
  sdioclkdiv:
    type: int
    description: SDIO clock divider
  ctimerclksel0:
    type: int
    description: CTIMER0 clock source select
  ctimerclksel1:
    type: int
    description: CTIMER1 clock source select
  ctimerclksel2:
    type: int
    description: CTIMER2 clock source select
  ctimerclksel3:
    type: int
    description: CTIMER3 clock source select
  ctimerclksel4:
    type: int
    description: CTIMER4 clock source select
  fcclksel0:
    type: int
    description: Flexcom 0 clock source select
  frgctrl0-div:
    type: int
    description: FRG0 division factor
  fcclksel1:
    type: int
    description: Flexcom 1 clock source select
  frgctrl1-div:
    type: int
    description: FRG1 division factor
  fcclksel2:
    type: int
    description: Flexcom 2 clock source select
  frgctrl2-div:
    type: int
    description: FRG2 division factor
  fcclksel3:
    type: int
    description: Flexcom 3 clock source select
  frgctrl3-div:
    type: int
    description: FRG3 division factor
  fcclksel4:
    type: int
    description: Flexcom 4 clock source select
  frgctrl4-div:
    type: int
    description: FRG4 division factor
  fcclksel5:
    type: int
    description: Flexcom 5 clock source select
  frgctrl5-div:
    type: int
    description: FRG5 division factor
  fcclksel6:
    type: int
    description: Flexcom 6 clock source select
  frgctrl6-div:
    type: int
    description: FRG6 division factor
  fcclksel7:
    type: int
    description: Flexcom 7 clock source select
  frgctrl7-div:
    type: int
    description: FRG7 division factor
  hslspiclksel:
    type: int
    description: HSLSPI clock source select
```

## dts/bindings/clock/nxp,lpc84x-clock.yaml
```yaml
# Copyright (c) 2026, Aerlync Labs Inc
# SPDX-License-Identifier: Apache-2.0

description: NXP LPC84x clock

compatible: "nxp,lpc84x-clock"

clock-cells:
  - name

properties:
  reg:
    type: array
    required: true
    description: SYSCON register base address and size.

  enable-fro:
    type: boolean
    description: Power up the FRO oscillator.

  enable-froout:
    type: boolean
    description: Power up the FRO output.

  fro-freq:
    type: string
    enum: ["18M", "24M", "30M"]
    default: "24M"
    description: FRO oscillator output frequency.

  enable-sysosc:
    type: boolean
    description: Power up the system crystal oscillator (SYSOSC).

  extclk-src:
    type: string
    enum: ["sysosc", "clkin"]
    default: "sysosc"
    description: External clock source

  fro-low-power-boot:
    type: boolean
    description: Enable low power boot for FRO.

  sysosc-freq:
    type: int
    description: System oscillator frequency in Hz. Required if enable-sysosc is true.

  extclk-freq:
    type: int
    description: External clock frequency in Hz. Required for extclk-clkin.

  ahb-clk-divider:
    type: int
    default: 1
    description: AHB clock divider.

  mainclk-src:
    type: string
    enum: ["fro", "extclk", "wdosc", "frodiv"]
    default: "fro"
    description: Main clock source.

  frg0-clk-src:
    type: string
    enum: ["fro", "mainclk"]
    description: FRG0 clock source.

  frg0-mult:
    type: int
    description: FRG0 multiplier (0-255).

  frg1-clk-src:
    type: string
    enum: ["fro", "mainclk"]
    description: FRG1 clock source.

  frg1-mult:
    type: int
    description: FRG1 multiplier (0-255).
```

## dts/bindings/clock/nxp,mc-cgm.yaml
```yaml
# Copyright 2025 NXP
# SPDX-License-Identifier: Apache-2.0

description: Glitchless clock switching Clock Generation module

compatible: "nxp,mc-cgm"

include: [clock-controller.yaml, base.yaml]

properties:
  reg:
    required: true

  max-ido-change:
    required: true
    type: int
    description: |
      Maximum variation of current per time (mA/microsec) -  max allowable
      IDD change is determined by the user's power supply design.

  step-duration:
    required: true
    type: int
    description: Step duration of each PCFS step (time per step in us).

  clk-src-freq:
    required: true
    type: int
    description: |
      Frequency of the clock source from which ramp-down and to which ramp-up are processed.

  mux-0-dc-0-div:
    type: int
    description: MUX_0_DC_0 divider setting

  mux-0-dc-1-div:
    type: int
    description: MUX_0_DC_1 divider setting

  mux-0-dc-2-div:
    type: int
    description: MUX_0_DC_2 divider setting

  mux-0-dc-3-div:
    type: int
    description: MUX_0_DC_3 divider setting

  mux-0-dc-4-div:
    type: int
    description: MUX_0_DC_4 divider setting

  mux-0-dc-5-div:
    type: int
    description: MUX_0_DC_5 divider setting

  mux-0-dc-6-div:
    type: int
    description: MUX_0_DC_6 divider setting

  mux-1-dc-0-div:
    type: int
    description: MUX_1_DC_0 divider setting

  mux-2-dc-0-div:
    type: int
    description: MUX_2_DC_0 divider setting

  "#clock-cells":
    type: int
    const: 1

clock-cells:
  - name
```
