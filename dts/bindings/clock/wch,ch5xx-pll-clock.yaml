## dts/bindings/comparator/nxp,lpacmp.yaml
```yaml
# SPDX-FileCopyrightText: Copyright 2026 NXP
# SPDX-License-Identifier: Apache-2.0

description: |
  NXP Low-Power Analog Comparator (LPACMP)

compatible: "nxp,lpacmp"

include: base.yaml

properties:
  reg:
    required: true

  interrupts:
    required: true

  clocks:
    required: true
    description: |
      Entry 0 is required and is the AON clock the sampling counter runs on. It
      must resolve to a node carrying a clock-frequency property: the driver
      reads that frequency to derive how long a fresh sample takes, and waits
      that long whenever it resamples the comparator output.

      Entry 1 is optional and is the peripheral clock gate, reached through
      syscon. Where the SoC gates the block (on MCXL255 the CGU
      PER_CLK_EN[COMP_CLK_EN] gate resets to disabled) this entry has to be
      present, or no register in the block responds. Where the block has no
      separate gate, leave it out.

  clock-names:
    type: string-array
    description: |
      Optional names for the clocks entries, for readability. When present, use
      "aon-clk" for the sampling clock and "gate" for the peripheral clock gate.
      The driver addresses both entries by index, so the names are
      documentation only.

  positive-input:
    type: string
    required: true
    enum:
      - "comp_in4"
      - "comp_in5"
      - "comp_in0"
      - "comp_in1"
      - "comp_in2"
      - "comp_in3"
    description: |
      Positive input selection for channel 0 (SEL0[INP_SEL]).

      The list is ordered by the register encoding, not by input number: the
      hardware encodes 0 as comp_in4 and 1 as comp_in5 before continuing with
      comp_in0 through comp_in3. The driver writes the enum index straight into
      SEL0[INP_SEL], so entries must stay in this order and must not be sorted.

  negative-input:
    type: int
    required: true
    min: 0
    max: 15
    description: |
      Negative (reference) input selection for channel 0 (SEL0[INN_SEL]).
      Values 0-13 select an internal reference of (value + 1) x AVDD / 15.
      Value 14 selects external input comp_in4 and value 15 selects external
      input comp_in5.

  sample-delay:
    type: int
    default: 0
    min: 0
    max: 65535
    description: |
      Channel 0 sample delay counter value (DELAY0[DEL]) in AON_CLK cycles.
      The comparator output is sampled every time this counter reaches zero,
      so the value sets the sampling period and must give the output enough
      time to become steady. The default is the register reset value; in the
      Continuous mode used by this driver the comparator is always powered,
      so sampling at every AON_CLK cycle is functional, but a non-zero value
      adds settling margin between samples.
```

## dts/bindings/comparator/ti,lpf3-lpcmp.yaml
```yaml
# Copyright 2026 Texas Instruments
# SPDX-License-Identifier: Apache-2.0

description: |
  Texas Instruments LPF3 family low-power comparator

compatible: "ti,lpf3-lpcmp"

include:
  - base.yaml
  - pinctrl-device.yaml

properties:
  reg:
    required: true

  interrupts:
    required: true

  positive-mux-input:
    type: string
    enum:
      - "VA_PAD_A1"
      - "VA_PAD_A2"
      - "VA_PAD_A3"
      - "VDDS"
    description: |
      Positive input selection.
      "VA_PAD_A1" routes to "DIO21_A10" in cc23xx devices
      and "DIO19_A6" in cc27xx devices.
      "VA_PAD_A2" routes to "DIO23_A8" in cc23xx devices
      and "DIO20_A5" in cc27xx devices.
      "VA_PAD_A3" routes to "DIO24_A7" in cc23xx devices
      and "DIO21_A4" in cc27xx devices.
      "VDDS" is the supply voltage.

  negative-mux-input:
    type: string
    enum:
      - "VA_PAD_A2"
      - "VA_PAD_A3"
      - "VDDS"
      - "VDDD"
    description: |
      Negative input selection.
      "VA_PAD_A2" routes to "DIO23_A8" in cc23xx devices
      and "DIO20_A5" in cc27xx devices.
      "VA_PAD_A3" routes to "DIO24_A7" in cc23xx devices
      and "DIO21_A4" in cc27xx devices.
      "VDDS" is the supply voltage.
      "VDDD" is the digital domain voltage.

  enable-output-pin:
    type: boolean
    description: |
      Enable the comparator output at the selected pin. Note that If
      this property is enabled, then, the last entry in the pinctrl will
      be considered as the output pin.

  input-division-factor:
    type: string
    enum:
      - "VIN_1_1"
      - "VIN_3_4"
      - "VIN_1_2"
      - "VIN_1_3"
      - "VIN_1_4"
    default: "VIN_1_1"
    description: |
      Division factor for the positive input or negative input
      of the comparator.

  division-input:
    type: string
    enum:
      - "DIVISION_INPUT_NEGATIVE"
      - "DIVISION_INPUT_POSITIVE"
    default: "DIVISION_INPUT_POSITIVE"
    description: |
      The LPCMP allows the volatge division to be applied either to
      the positive or negative input.

  "#io-channel-cells":
    type: int
    const: 2

io-channel-cells:
  - positive
  - negative
```

## dts/bindings/comparator/wch,ch5xx-comparator.yaml
```yaml
# SPDX-FileCopyrightText: 2026 SMILE (smile.eu)
# SPDX-License-Identifier: Apache-2.0

title: CH5xx Comparator

description: |
  Binding for the WCH CH5xx Comparator driver.

examples:
  - |
    &pinctrl {
      cmp0_pins: cmp0_pins {
        group {
          pinmux = <CMP_P_PA2_0 CMP_N_PA3_0>;
          /* It's recommended on CH57x to disable digital input
           * This configures the pin as analog input only */
          input-disable;
        };
      };
    };

    &cmp0 {
      compatible = "wch,ch5xx-comparator";
      status = "okay";
      pinctrl-0 = <&cmp0_pins>;
      pinctrl-names = "default";
      nref-voltage = <500>;
    };

compatible: "wch,ch5xx-comparator"

include:
  - name: base.yaml
  - name: pinctrl-device.yaml

properties:
  reg:
    required: true

  nref-voltage:
    description: "The negative input reference voltage in mV"
    type: int
    default: 50
    enum:
      - 50
      - 100
      - 150
      - 200
      - 250
      - 300
      - 350
      - 400
      - 450
      - 500
      - 550
      - 600
      - 650
      - 700
      - 750
      - 800
```

## dts/bindings/counter/adi,max32-rtc-counter.yaml
```yaml
# Copyright (c) 2024-2026 Analog Devices, Inc.
#
# SPDX-License-Identifier: Apache-2.0

description: ADI MAX32 compatible Counter RTC

compatible: "adi,max32-rtc-counter"

include: [base.yaml, pinctrl-device.yaml]

properties:
  reg:
    required: true

  sqw-frequency:
    type: int
    description: |
      Square wave output frequency value in Hz. Default is 0, which means that
      the square wave output is disabled.
    default: 0
    enum:
      - 0
      - 1
      - 512
      - 4096
      - 32768

examples:
  - |
    /*
     * Enable 32kHz square wave output on P3.1.
     */
    &rtc_counter {
        status = "okay";
        pinctrl-0 = <&sqwout_p3_1>;
        pinctrl-names = "default";
        sqw-frequency = <32768>;
    };

  - |
    /* Use INRO as clock source */
    &clk_32k {
            status = "okay";
            clocks = <&clk_inro>;
    };

  - |
    /* Use RTC_CLK_IN as clock source */
    &clk_rtc_in {
      status = "okay";
      pinctrl-0 = <&rtc_clk_in_p0_12>;
      pinctrl-names = "default";
    };

    &clk_32k {
      status = "okay";
      clocks = <&clk_rtc_in>;
    };

    &rtc_counter {
      status = "okay";
    };
```

## dts/bindings/counter/arm,cmsdk-timer.yaml
```yaml
description: ARM CMSDK timer

compatible: "arm,cmsdk-timer"

include: [base.yaml, wuc-device.yaml]

properties:
  reg:
    required: true

  interrupts:
    required: true
```

## dts/bindings/counter/microchip,sam-pit64b-counter.yaml
```yaml
# Copyright (C) 2025 Microchip Technology Inc. and its subsidiaries
#
# SPDX-License-Identifier: Apache-2.0
#

description: |
  Microchip SAM PIT64B Counter

  SAM PIT64B includes the following hardware peripheral:
    - module name="PIT64B" id="44117" version="103"

examples:
  - |
    Example devicetree configuration:

      &pit64b1 {
        top-alarm;
        prescaler-period = <15>;
        status = "okay";
      };

compatible: "microchip,sam-pit64b-counter"

include:
  - name: base.yaml
  - name: pinctrl-device.yaml

properties:
  reg:
    required: true

  interrupts:
    required: true

  clocks:
    required: true

  clock-selection:
    type: string
    default: "peripheral-clock"
    description: |
      Refer to PIT64B_MR.SGCLK in datasheet.
      Peripheral clock is used by default.
    enum:
      - "peripheral-clock"
      - "generic-clock"

  prescaler-period:
    type: int
    default: 0
    description: |
      Refer to PIT64B_MR.PRESCALER[3:0] in datasheet.
    enum: [0, 1, 2, 3, 4, 5, 6, 7, 8, 9, 10, 11, 12, 13, 14, 15]

  top-alarm:
    type: boolean
    description: |
      Reuse the top value channel as an alarm channel.
```

## dts/bindings/counter/microcrystal,rv3028-counter.yaml
```yaml
# Copyright (c) 2025 BayLibre, SAS
# Copyright (c) 2026 Janez Ugovsek <janez@ugovsek.info>
# SPDX-License-Identifier: Apache-2.0

description: Micro Crystal RV3028 RTC counter/timer driver

compatible: "microcrystal,rv3028-counter"

include: base.yaml

properties:
  frequency:
    type: int
    enum:
      - 4096
      - 64
      - 1
      - 0
    default: 4096
    description: |
      Clock frequency used for the timer/counter function. If omitted, the
      driver uses 4096 Hz.

        4096: 4096 Hz
        64:   64 Hz
        1:    1 Hz
        0:    1/60 Hz

  repeat-mode:
    type: boolean
    description: |
      Automatically reloads the value from the Timer Value registers upon
      reaching 0, and continues counting.

examples:
  - |
    /* Example node for an RV3028 RTC counter on the i2c0 bus. */
    &i2c0 {
      status = "okay";
      clock-frequency = <I2C_BITRATE_STANDARD>;

      rv3028: rv3028@52 {
        compatible = "microcrystal,rv3028";
        reg = <0x52>;
        int-gpios = <&gpiob 7 (GPIO_PULL_UP | GPIO_ACTIVE_LOW)>;
        backup-switch-mode = "disabled";
        status = "okay";

        rv3028_counter: rv3028_counter {
          compatible = "microcrystal,rv3028-counter";
          frequency = <64>;
          repeat-mode;
          status = "okay";
        };
      };
    };
```

## dts/bindings/counter/nxp,tpm-timer.yaml
```yaml
# Copyright 2023-2024, 2026 NXP
# SPDX-License-Identifier: Apache-2.0

description: |
  NXP Timer/PWM Module (TPM) used as timer

  A TPM channel can also timestamp an edge on its TPMx_CHn pad (input capture).
  The capture input is the pad itself, so the pad must be muxed to the channel
  through the pinctrl "default" state, and the channel number in a
  "counter-captures" phandle-array selects which pad is sampled.

compatible: "nxp,tpm-timer"

include: [base.yaml, pinctrl-device.yaml]

properties:
  reg:
    required: true

  interrupts:
    required: true

  clocks:
    required: true

  prescaler:
    type: int
    required: true
    enum:
      - 1
      - 2
      - 4
      - 8
      - 16
      - 32
      - 64
      - 128
    description: Input clock prescaler

counter-capture-cells:
  - channel
  - flags
```

## dts/bindings/counter/nxp,tstmr.yaml
```yaml
# SPDX-FileCopyrightText: Copyright 2026 NXP
# SPDX-License-Identifier: Apache-2.0

description: NXP Time Stamp Timer (TSTMR)

compatible: "nxp,tstmr"

include: base.yaml

properties:
  reg:
    required: true

  clocks:
    description: |
      Clock of the time base the TSTMR reflects. Whether to set it depends on
      how the SoC implements the TSTMR:

        - On SoCs where the TSTMR is a snapshot of a System Counter (SCTR)
          that acts as the timing source and must be brought up in software
          (e.g. i.MX RT118x), set this. The driver then enables the clock via
          the clock-control driver and takes the counter frequency from it
          (clock-frequency is ignored).

        - On SoCs where the TSTMR is a self-contained, free-running counter
          that starts after system reset and needs no clock management
          (e.g. MCXW71), leave this unset. The driver touches no clock and
          clock-frequency supplies the rate.

  clock-frequency:
    type: int
    description: |
      TSTMR counter frequency in Hz. Used when 'clocks' is not present.
```

## dts/bindings/counter/st,stm32-counter.yaml
```yaml
# Copyright (c) 2021, Kent Hall
# SPDX-License-Identifier: Apache-2.0

description: STM32 counters

compatible: "st,stm32-counter"

include: [base.yaml, pinctrl-device.yaml]

properties:
  dmas:
    description: |
      DMA specifiers for buffered capture channels. Each entry streams one
      timer capture/compare register into an application timestamp buffer.

  dma-names:
    description: |
      Names matching the DMA specifiers. Use "cc1" through "cc4" to associate
      each DMA entry with a timer capture/compare channel.

counter-capture-cells:
  - channel
  - flags
```

## dts/bindings/counter/ti,cc27xx-lgpt.yaml
```yaml
# Copyright (c) 2025 Texas Instruments Incorporated
# SPDX-License-Identifier: Apache-2.0

description: CC27xx LGPT counter driver

properties:
  freq:
    type: int
    description: clock frequency (only used for external clock sources)

  interrupts:
    required: true

  clk-prescale:
    type: int
    required: true
    description: Counter clock prescale

  max-top-value:
    type: int
    required: true
    description: Max allowed value for counter

compatible: "ti,cc27xx-lgpt"

include: base.yaml
```

## dts/bindings/counter/ti,cc35xx-lgpt.yaml
```yaml
description: TI CC35XX LGPT counter driver

compatible: "ti,cc35xx-lgpt"

include: base.yaml

properties:
  interrupts:
    required: true

  clk-prescale:
    type: int
    required: true
    description: Counter clock prescale

  max-top-value:
    type: int
    required: true
    description: Max allowed value for counter
```

## dts/bindings/counter/zephyr,counter-gpio.yaml
```yaml
# SPDX-FileCopyrightText: Copyright RAKwireless Technology Limited
# SPDX-License-Identifier: Apache-2.0

title: Counter reading the kernel clock, capturing on GPIO

description: |
  Boards whose timer hardware does not reach the pin an event arrives on can
  still timestamp that event, at the cost of the interrupt latency. The ticks
  the capture reports are kernel ticks, so they need no conversion to be
  compared with anything else the system timestamps.

  Each entry in gpios is one capture channel, numbered in the order given:

    pps: counter-gpio {
        compatible = "zephyr,counter-gpio";
        gpios = <&gpio0 10 GPIO_ACTIVE_HIGH>;
        #counter-capture-cells = <2>;
    };

compatible: "zephyr,counter-gpio"

include: base.yaml

properties:
  gpios:
    type: phandle-array
    required: true
    description: |
      Lines to capture on, one per channel.

counter-capture-cells:
  - channel
  - flags
```

## dts/bindings/cpu/andestech,a25.yaml
```yaml
# Copyright (c) 2026 Andes Technology Corporation
# SPDX-License-Identifier: Apache-2.0

description: Andes Technology AndesCore A25 RISC-V core

compatible: "andestech,a25"

include: riscv-common.yaml
```
