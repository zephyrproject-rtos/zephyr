## dts/bindings/clock/wch,ch5xx-pll-clock.yaml
```yaml
# SPDX-FileCopyrightText: 2026 SMILE (smile.eu)
# SPDX-License-Identifier: Apache-2.0

description: WCH CH5xx PLL

compatible: "wch,ch5xx-pll-clock"

include: [clock-controller.yaml, base.yaml]

properties:
  "#clock-cells":
    const: 0

  clocks:
    type: phandle-array
    required: true

examples:
  - |
    pll {
      #clock-cells = <0>;
      compatible = "wch,ch5xx-pll-clock";
      clocks = <&clk_hse>; /* PLL source clock */
      status = "okay";
    };
```

## dts/bindings/clock/xlnx,clkx5-wiz-1.0.yaml
```yaml
# Copyright (C) 2026 Advanced Micro Devices, Inc.
# SPDX-License-Identifier: Apache-2.0

description: Xilinx Clocking Wizard (clkx5-wiz-1.0) for Versal2.

compatible: "xlnx,clkx5-wiz-1.0"

include: [clock-controller.yaml, base.yaml]

properties:
  reg:
    required: true
    description: Base address and size of the AXI-Lite register region.

  clocks:
    required: true
    min-len: 1
    max-len: 1
    description: Phandle to the input reference clock for the MMCM.

  "#clock-cells":
    const: 1
    description: |
      One clock specifier cell representing the output clock index
      (0-based, up to xlnx,num-out-clks - 1).

  xlnx,num-out-clks:
    type: int
    required: true
    description: |
      Number of active output clocks configured in the IP (1 to 7).
      Valid clock IDs passed to on/off/get_rate/set_rate are
      0 to (xlnx,num-out-clks - 1).
    enum: [1, 2, 3, 4, 5, 6, 7]

clock-cells:
  - clkid
```

## dts/bindings/clock/xlnx,ps7-clkc.yaml
```yaml
# SPDX-FileCopyrightText: Copyright The Zephyr Project Contributors
# SPDX-License-Identifier: Apache-2.0

description: |
  Xilinx Zynq-7000 clock controller, the clock part of the System Level
  Control Registers (SLCR).

  The node follows the Linux binding: it is a child of the SLCR node with
  the offset of the clock control registers, and the clock IDs are the
  output numbers of the Linux binding, named in
  include/zephyr/dt-bindings/clock/xlnx-zynq-clkc.h. The SLCR is accessed
  through its syscon node, the PS_CLK oscillator rate is a property of the
  board:

    slcr: slcr@f8000000 {
      compatible = "xlnx,zynq-slcr", "syscon";
      reg = <0xf8000000 0x1000>;
      ranges;

      clkc: clkc@100 {
        #clock-cells = <1>;
        compatible = "xlnx,ps7-clkc";
        reg = <0x100 0x100>;
        syscon = <&slcr>;
        ps-clk-frequency = <33333333>;
      };
    };

    gem0: ethernet@e000b000 {
      clocks = <&clkc ZYNQ_CLK_GEM0_APER>, <&clkc ZYNQ_CLK_GEM0_APER>,
               <&clkc ZYNQ_CLK_GEM0>;
      clock-names = "pclk", "hclk", "tx_clk";
    };

  The driver derives the rates from the registers as the boot firmware left
  them. It supports the PLLs (ZYNQ_CLK_ARMPLL, ZYNQ_CLK_DDRPLL,
  ZYNQ_CLK_IOPLL), the CPU clocks (ZYNQ_CLK_CPU_6OR4X to ZYNQ_CLK_CPU_1X),
  the GEM clocks (ZYNQ_CLK_GEM0 and ZYNQ_CLK_GEM1, gated, their rate set
  through the two dividers from the selected PLL) and the GEM AMBA clocks
  (ZYNQ_CLK_GEM0_APER and ZYNQ_CLK_GEM1_APER, gated). The other clocks and
  the EMIO clock sources are not supported.

compatible: "xlnx,ps7-clkc"

include: [base.yaml, clock-controller.yaml]

properties:
  reg:
    required: true
    description: Offset and size of the clock control registers in the SLCR.

  syscon:
    type: phandle
    required: true
    description: The SLCR syscon node through which the registers are accessed.

  ps-clk-frequency:
    type: int
    required: true
    description: Rate of the PS_CLK oscillator feeding the PLLs, in Hz.

  "#clock-cells":
    const: 1

clock-cells:
  - id
```

## dts/bindings/clock/xlnx,zynqmp-clk.yaml
```yaml
# SPDX-FileCopyrightText: Copyright The Zephyr Project Contributors
# SPDX-License-Identifier: Apache-2.0

description: |
  Xilinx ZynqMP clock controller.

  The node follows the Linux xlnx,zynqmp-clk binding: the same input
  clocks, and the clock IDs of the Linux binding, named in
  include/zephyr/dt-bindings/clock/xlnx-zynqmp-clk.h. Linux reaches the
  clocks through the platform firmware; Zephyr accesses the CRL_APB and
  CRF_APB registers directly, so the node also carries their register
  ranges:

    zynqmp_clk: clock-controller@ff5e0000 {
      compatible = "xlnx,zynqmp-clk";
      reg = <0xff5e0000 0x1000>, <0xfd1a0000 0x1000>;
      reg-names = "crl_apb", "crf_apb";
      clocks = <&pss_ref_clk>;
      clock-names = "pss_ref_clk";
      #clock-cells = <1>;
    };

    gem0: ethernet@ff0b0000 {
      clocks = <&zynqmp_clk LPD_LSBUS>, <&zynqmp_clk GEM0_REF>,
               <&zynqmp_clk GEM0_TX>, <&zynqmp_clk GEM0_RX>,
               <&zynqmp_clk GEM_TSU>;
      clock-names = "pclk", "hclk", "tx_clk", "rx_clk", "tsu_clk";
    };

  The driver derives the rates from the registers as the boot firmware
  left them. It supports the PLLs of the low power domain and the DPLL
  (IOPLL, RPLL, DPLL, DPLL_TO_LPD), the low power domain bus clock
  (LPD_LSBUS, gated), the GEM reference clocks (GEM0_REF to GEM3_REF,
  their rate set through the two dividers from the selected PLL), the
  GEM transmit and receive clock gates (GEM0_TX to GEM3_TX, GEM0_RX to
  GEM3_RX) and the clock of the 1588 time stamp unit (GEM_TSU_REF, gated,
  and GEM_TSU). The other clocks and the MIO and EMIO clock sources are not
  supported. Writes lift the CRL_APB write protection, which needs the
  registers at their physical address.

compatible: "xlnx,zynqmp-clk"

include: [base.yaml, clock-controller.yaml]

properties:
  reg:
    required: true

  reg-names:
    required: true
    description: |
      Names of the register ranges: "crl_apb" for the low power domain
      clock and reset registers and "crf_apb" for those of the full power
      domain.

  clocks:
    required: true

  clock-names:
    required: true
    description: |
      Names of the input clocks, as in the Linux binding. "pss_ref_clk" is
      required, "video_clk", "pss_alt_ref_clk", "aux_ref_clk" and
      "gt_crx_ref_clk" are only needed when a PLL is sourced from them.

  "#clock-cells":
    const: 1

clock-cells:
  - id
```

## dts/bindings/clock/zephyr,clock-controller-emul-clkid.yaml
```yaml
# SPDX-FileCopyrightText: Copyright (c) 2026 TOKITA Hiroshi
# SPDX-License-Identifier: Apache-2.0

description: |
  Clock controller emulation (cell:clkid)

  The subsystem selector is the cell value itself, carried in the
  clock_control_subsys_t pointer rather than pointed to by it. A consumer
  builds one with a plain cast:

      clock_control_on(dev, (clock_control_subsys_t)DT_CLOCKS_CELL(node, clkid));

  The driver recovers it with (uint32_t)(uintptr_t)sys and looks it up in
  clock-ids.

include: ["zephyr,clock-controller-emul-common.yaml"]

compatible: "zephyr,clock-controller-emul-clkid"

properties:
  "#clock-cells":
    const: 1

clock-cells:
  - clkid
```

## dts/bindings/clock/zephyr,clock-controller-emul-common.yaml
```yaml
# SPDX-FileCopyrightText: Copyright (c) 2026 TOKITA Hiroshi
# SPDX-License-Identifier: Apache-2.0

description: Clock controller emulation

include: [clock-controller.yaml, base.yaml]

properties:
  clock-ids:
    type: array
    description: |
      Clock identifiers supported by the controller. Each identifier consists
      of #clock-cells values, laid out in the same order as the clock-cells
      of a clocks phandle-array entry. How those cells reach the driver as a
      clock_control_subsys_t is described by each compatible.

  clock-initial-values:
    type: array
    description: Initial rate in Hz for each identifier in clock-ids.

  loose-check:
    type: boolean
    description: |
      A flag indicating not to check the validity of the operation (for example,
      the presence or absence of a clock ID) and not return an error response.
```

## dts/bindings/clock/zephyr,clock-controller-emul-rcar-cpg-mssr.yaml
```yaml
# SPDX-FileCopyrightText: Copyright (c) 2026 TOKITA Hiroshi
# SPDX-License-Identifier: Apache-2.0

description: |
  Renesas CPG/MSSR emulation

  The subsystem selector is a pointer to a struct rcar_cpg_clk holding both
  cells, as declared in
  include/zephyr/drivers/clock_control/renesas_cpg_mssr.h. A consumer keeps
  the descriptor alive for the duration of the call:

      struct rcar_cpg_clk clk = {
              .domain = DT_CLOCKS_CELL(node, domain),
              .module = DT_CLOCKS_CELL(node, module),
      };

      clock_control_on(dev, (clock_control_subsys_t)&clk);

  The driver dereferences it and matches domain and module against one
  clock-ids entry. Its rate member is not read; set_rate takes the rate
  through clock_control_subsys_rate_t instead.

include: ["zephyr,clock-controller-emul-common.yaml"]

compatible: "zephyr,clock-controller-emul-rcar-cpg-mssr"

properties:
  "#clock-cells":
    const: 2

clock-cells:
  - domain
  - module
```

## dts/bindings/comparator/adc-comparator.yaml
```yaml
# Copyright 2026 Google LLC
# SPDX-License-Identifier: Apache-2.0

description: ADC-backed voltage comparator

compatible: "adc-comparator"

include: base.yaml

properties:
  io-channels:
    required: true
    description:
      ADC channel used to measure the input voltage.

  output-ohms:
    type: int
    required: true
    description:
      Resistance of the lower leg of the voltage divider.

  full-ohms:
    type: int
    description:
      Resistance of the full path through the voltage divider. If omitted or
      zero, the measured ADC voltage is not scaled.

  threshold-mv:
    type: int
    required: true
    description:
      Voltage threshold in millivolts above which the comparator output is high.
```

## dts/bindings/comparator/microchip,ac-g2-comparator.yaml
```yaml
# SPDX-FileCopyrightText: Copyright The Zephyr Project Contributors
# SPDX-License-Identifier: Apache-2.0

title: Microchip AC G2 comparator

description: |
  One comparator of the AC pair on Microchip PIC32CM SG/GC, ATDF
  cmp_ac_u2501_v2. Must be a child of a microchip,ac-g2 node, which holds the
  register base, the clocks and the shared interrupt.

  The register layout differs from the one microchip,ac-g1-comparator drives:
  there is no SCALER and no CALIB on this die, COMPCTRL lives inside a
  CHANNEL group rather than at the top of the block, and the MUXNEG encodings
  are not the same. Hence a separate compatible.

  pinctrl-0 is not required: a comparator whose muxes name no pin needs no
  pin configuration.

compatible: "microchip,ac-g2-comparator"

include:
  - name: base.yaml
  - name: pinctrl-device.yaml

properties:
  reg:
    required: true
    description: |
      Comparator index within the block, 0 or 1. This is an index, not an
      address: the block has a single register file and both comparators are
      reached through it.

  positive-mux-input:
    type: string
    required: true
    enum:
      - "pin0"
      - "pin1"
      - "pin2"
      - "pin3"
      - "int0"
      - "int1"
      - "int2"
      - "dac"
    description: |
      COMPCTRL.MUXPOS. "pin0" to "pin3" are AC_AIN0 to AC_AIN3 and must then
      appear in pinctrl-0. "int0" to "int2" are on-die analog sources and
      "dac" is the block's own 7-bit reference DAC.

  negative-mux-input:
    type: string
    required: true
    enum:
      - "pin0"
      - "pin1"
      - "pin2"
      - "pin3"
      - "int0"
      - "bandgap"
      - "gnd"
      - "dac"
    description: |
      COMPCTRL.MUXNEG. "bandgap" is the internal 0.8 V reference, "gnd" is
      ground, and "dac" is the block's own 7-bit reference DAC. Note that the
      encodings differ from the positive mux and from the G1 block.

  dac-value:
    type: int
    default: 0
    description: |
      DACCTRL.VALUEn, the 7-bit reference DAC feeding this comparator when
      either mux selects "dac". The output is value / 128 of AVDD, so one
      step is 25.8 mV at 3.3 V. Range 0 to 127. Ignored when neither mux
      uses it.

  hysteresis-level:
    type: string
    default: "hyst10"
    enum:
      - "hyst10"
      - "hyst20"
      - "hyst40"
      - "hyst60"
    description: |
      COMPCTRL.HYST, the typical hysteresis band. Unlike the G1 block there
      is no enable bit: hysteresis is always applied and this only selects
      how much. The data sheet's minimum to maximum for each level is wider
      than the typical figures the names carry - 2 to 14 mV, 6 to 26 mV,
      20 to 56 mV and 32 to 86 mV.

  filter-length:
    type: string
    default: "off"
    enum:
      - "off"
      - "maj3"
      - "maj5"
    description: |
      COMPCTRL.FLEN. A majority filter over 3 or 5 samples of the comparator
      output, which costs latency and rejects glitches.

  swap-inputs:
    type: boolean
    description: |
      COMPCTRL.SWAP. Feeds MUXNEG to the positive input and MUXPOS to the
      negative one, inverting the output. Used for offset cancellation.

  low-speed:
    type: boolean
    description: |
      COMPCTRL.SPEED set. The comparator draws less current and responds
      more slowly. The default is the high-speed setting.

  run-in-standby:
    type: boolean
    description: |
      COMPCTRL.RUNSTDBY. Keeps the comparator running while the core sleeps.
```

## dts/bindings/comparator/microchip,ac-g2.yaml
```yaml
# SPDX-FileCopyrightText: Copyright The Zephyr Project Contributors
# SPDX-License-Identifier: Apache-2.0

title: Microchip AC G2

description: |
  The analog comparator block on Microchip PIC32CM SG/GC, ATDF cmp_ac_u2501_v2.
  It carries one register file, one clock pair and one interrupt line shared
  by two comparators, so the block itself is one node and each comparator is
  a child of it.

  This node has no driver of its own. The comparator driver reaches up to it
  for the register base, the clocks and the interrupt, and the first child to
  initialize resets and enables the block for both.

compatible: "microchip,ac-g2"

include: base.yaml

properties:
  reg:
    required: true

  interrupts:
    required: true

  clocks:
    required: true

  clock-names:
    required: true
    description: '"mclk" then "gclk".'

  "#address-cells":
    required: true
    const: 1

  "#size-cells":
    required: true
    const: 0
```
