## dts/bindings/clock/renesas,ra2-internal-clk.yaml
```yaml
# Copyright (c) 2023-2024 MUNIC SA
# SPDX-License-Identifier: Apache-2.0

description: RA2 internal clock (ICLK, PCLKB and PCLKD)

compatible: "renesas,ra2-internal-clk"

include:
  - name: fixed-factor-clock.yaml
    property-allowlist:
      - clock-div
      - "#clock-cells"
  - name: base.yaml
    property-allowlist:
      - reg
      - compatible
      - status

properties:
  reg:
    required: true

  clock-div:
    required: true
    default: 16
    enum:
      - 1
      - 2
      - 4
      - 8
      - 16
      - 32
      - 64

  max-clock-div:
    type: int
    required: true
    const: 64
    description: the highest allowed clock divisor
```

## dts/bindings/clock/renesas,ra2-main-osc.yaml
```yaml
# Copyright (c) 2023-2024 MUNIC SA
# SPDX-License-Identifier: Apache-2.0

description: RA2 Main Clock Oscillator

compatible: "renesas,ra2-main-osc"

include: ["renesas,ra2-root-osc.yaml"]

properties:
  stabilisation-time:
    required: true
    description: Stabilisation time (ns)
    enum:
      - 250
      - 128000
      - 256000
      - 512000
      - 1024000
      - 2048000
      - 4096000
      - 8192000
      - 16384000
      - 32768000

  clock-type:
    type: string
    required: true
    enum:
      - "xtal"
      - "external"
    description: |
      Defines whether the clock source is a xtal or an external clock
```

## dts/bindings/clock/renesas,ra2-root-osc.yaml
```yaml
# Copyright (c) 2023-2024 MUNIC SA
# SPDX-License-Identifier: Apache-2.0

description: RA2 root fixed frequency oscillator

include:
  - name: fixed-clock.yaml
  - name: renesas,ra2-common-osc.yaml
  - name: base.yaml
    property-allowlist:
      - reg
      - compatible
      - reg-names

compatible: "renesas,ra2-root-osc"

properties:
  reg:
    required: true

  trim:
    type: int
    description: |
      User Trimming Control Register

  stabilisation-time:
    type: int
    default: 0
    description: Stabilisation time (us)
```

## dts/bindings/clock/renesas,ra2-sysclk.yaml
```yaml
# Copyright (c) 2023-2024 MUNIC SA
# SPDX-License-Identifier: Apache-2.0

description: RA2 "virtual" source clock controller for ICLK, PCLKB and PCLKD

compatible: "renesas,ra2-sysclk"

include:
  - clock-controller.yaml
  - name: base.yaml
    property-allowlist:
      - reg
      - compatible
      - clocks
      - clock-names
      - status

properties:
  clocks:
    required: true

  "#clock-cells":
    const: 0
```

## dts/bindings/clock/renesas,ra8-cgc-external-clock.yaml
```yaml
# Copyright (c) 2024 Renesas Electronics Corporation
# SPDX-License-Identifier: Apache-2.0

description: Renesas RA8 Clock Generation Circuit external clock configuration

compatible: "renesas,ra8-cgc-external-clock"

include: [fixed-clock.yaml, base.yaml]

properties:
  mosel:
    type: int
    default: 0
    enum:
      - 0
      - 1
    description: |
      Choose the way for external Clock Oscillator supply
      0: Resonator
      1: External clock input
```

## dts/bindings/clock/renesas,ra8-cgc-pclk-block.yaml
```yaml
# Copyright (c) 2024 Renesas Electronics Corporation
# SPDX-License-Identifier: Apache-2.0

description: Renesas RA8 clock control node pclk block

compatible: "renesas,ra8-cgc-pclk-block"

include: [clock-controller.yaml, base.yaml]

properties:
  sysclock-src:
    required: true
    type: int
```

## dts/bindings/clock/renesas,ra8-cgc-pclk.yaml
```yaml
# Copyright (c) 2024 Renesas Electronics Corporation
# SPDX-License-Identifier: Apache-2.0

description: Renesas RA8 Clock Control Peripheral Clock

compatible: "renesas,ra8-cgc-pclk"

include: [clock-controller.yaml, base.yaml]

properties:
  clk_src:
    type: int

  clk_div:
    type: int
    required: true
    description: Prescale divider to calculate the subclock frequency from the
                 system clock frequency.

  "#clock-cells":
    const: 2

clock-cells:
  - mstp
  - stop_bit
```

## dts/bindings/clock/renesas,ra8-cgc-pll.yaml
```yaml
# Copyright (c) 2024 Renesas Electronics Corporation
# SPDX-License-Identifier: Apache-2.0

description: Renesas RA8 Clock Generation Circuit PLL Clock

compatible: "renesas,ra8-cgc-pll"

include: [clock-controller.yaml, base.yaml]

properties:
  source:
    required: true
    type: int
  div:
    required: true
    type: int
  mul:
    required: true
    type: array
  divp:
    required: true
    type: int
  freqp:
    required: true
    type: int
  divq:
    type: int
  freqq:
    type: int
  divr:
    type: int
  freqr:
    type: int

  "#clock-cells":
    const: 0
```

## dts/bindings/clock/renesas,rcar-cpg-mssr.yaml
```yaml
# Copyright (c) 2020, IoT.bzh
# SPDX-License-Identifier: Apache-2.0

description: Renesas Clock Pulse Generator / Module Standby and Software Reset

include: [clock-controller.yaml, base.yaml]

properties:
    reg:
      required: true

    "#clock-cells":
      const: 2

clock-cells:
  - domain
  - module
```

## dts/bindings/clock/renesas,rx-cgc-pclk-block.yaml
```yaml
# Copyright (c) 2024 Renesas Electronics Corporation
# SPDX-License-Identifier: Apache-2.0

description: Renesas RX clock control node pclk block

compatible: "renesas,rx-cgc-pclk-block"

include: [clock-controller.yaml, base.yaml]

properties:
  clocks:
    description: |
      Select the clock source for pclk block.
      If you want to use different clock source for child node,
      select it there
```

## dts/bindings/clock/renesas,rx-cgc-pclk.yaml
```yaml
# Copyright (c) 2024 Renesas Electronics Corporation
# SPDX-License-Identifier: Apache-2.0

description: Renesas RX Clock Control Peripheral Clock

compatible: "renesas,rx-cgc-pclk"

include: [clock-controller.yaml, base.yaml]

properties:
  clocks:
    description: Select the clock source

  div:
    type: int
    required: true
    description: Prescale divider to calculate the subclock frequency from the
                 system clock frequency.

  "#clock-cells":
    const: 2

clock-cells:
  - mstp
  - stop_bit
```

## dts/bindings/clock/renesas,rx-cgc-pll.yaml
```yaml
# Copyright (c) 2024 Renesas Electronics Corporation
# SPDX-License-Identifier: Apache-2.0

description: Renesas RX Clock Generation Circuit PLL Clock

compatible: "renesas,rx-cgc-pll"

include: [clock-controller.yaml, base.yaml]

properties:
  clocks:
    required: true

  div:
    required: true
    type: int

  mul:
    required: true
    type: int

  "#clock-cells":
    const: 0
```

## dts/bindings/clock/renesas,rx-cgc-root-clock.yaml
```yaml
# Copyright (c) 2024 Renesas Electronics Corporation
# SPDX-License-Identifier: Apache-2.0

description: Renesas RX Root Clock Generation Circuit

compatible: "renesas,rx-cgc-root-clock"

include: [fixed-clock.yaml, base.yaml]

properties:
  mosel:
    type: int
    enum:
      - 0
      - 1
    description: |
      Choose the way for external Clock Oscillator supply
      0: Resonator
      1: External clock input

  stabilization-time:
    type: int
    enum:
      - 0 # Wait time = 2 cycles (0.5 μs)
      - 1 # Wait time = 1024 cycles (256 μs)
      - 2 # Wait time = 2048 cycles (512 μs)
      - 3 # Wait time = 4096 cycles (1.024 ms)
      - 4 # Wait time = 8192 cycles (2.048 ms)
      - 5 # Wait time = 16384 cycles (4.096 ms)
      - 6 # Wait time = 32768 cycles (8.192 ms)
      - 7 # Wait time = 65536 cycles (16.384 ms)
    description: |
      Setting for main clock oscillator wait time

  sub-clk-osc:
    type: int
    default: 500
    description: |
      Sub-Clock stabilization time in milliseconds

  drive-capacity:
    type: int
    enum:
      - 0
      - 1
      - 2
      - 3
      - 4
    description: |
      Drive Capacity Control (for Sub-Clock Oscillator only)
      0: Drive capacity for standard CL
      1: Drive capacity for low CL (unsupported on rx261)
      2: High-drive output for the low CL
      3: Middle-drive output for the low CL
      4: Low-drive output for the low CL
```

## dts/bindings/clock/renesas,rz-cgc-pll.yaml
```yaml
# Copyright (c) 2025 Renesas Electronics Corporation
# SPDX-License-Identifier: Apache-2.0

description: Renesas RZ Clock Generator Circuit PLL Clock
compatible: "renesas,rz-cgc-pll"

include: [base.yaml]

properties:
  state:
    type: string
    default: initial
    enum:
    - initial
    - standby
    - normal
    description: PLL1 state
```

## dts/bindings/clock/renesas,rz-cgc-subclk.yaml
```yaml
# Copyright (c) 2025 Renesas Electronics Corporation
# SPDX-License-Identifier: Apache-2.0

description: Renesas RZ Clock Control Peripheral Sub-Clock

compatible: "renesas,rz-cgc-subclk"

include: [base.yaml]

properties:
  clock-frequency:
    type: int
    default: 96000000
    enum:
    - 75000000
    - 96000000
    description: |
      Select clock frequency (Hz) when asynchronous serial clock is selected in SPI and SCI

  xspi-clk-frequency:
    type: int
    default: 12500000
    enum:
    - 133333333
    - 100000000
    - 50000000
    - 25000000
    - 12500000
    - 75000000
    - 37500000
    description: Select clock frequency (Hz) supplied to xSPI

  canfd-source:
    type: int
    default: 1
    enum:
    - 0
    - 1
    - 2
    description: |
      Select clock source supplied to CANFD
      - 0: PCLKCAN 80MHz
      - 1: PCLKCAN 40MHz
      - 2: PCLKM 100MHz

  eth-phy-source:
    type: string
    default: main
    enum:
    - "pll1"
    - "main"
    description: |
      25 MHz reference clock to the external Ethernet PHY.
      Clock source is selectable from main clock or frequency-dividing clock for PLL1.
```

## dts/bindings/clock/renesas,rz-cgc-sys-clock.yaml
```yaml
# Copyright (c) 2025 Renesas Electronics Corporation
# SPDX-License-Identifier: Apache-2.0

description: Renesas RZ Clock Control System Clock

compatible: "renesas,rz-cgc-sys-clock"

include: [base.yaml]

properties:
  clock-frequency:
    type: int
    default: 200000000
    enum:
    - 200000000
    - 150000000
    description: Select frequency of iclk.

  div:
    type: int
    default: 4
    enum:
    - 2
    - 3
    - 4
    - 5
    - 6
    - 7
    - 8
    description: |
      Prescale divider to calculate the subclock frequency from the
      system clock frequency.

  mul:
    type: int
    default: 1
    description: |
      Multiplier to calculate the subclock frequency from the
      system clock frequency.
```

## dts/bindings/clock/renesas,rz-cgc.yaml
```yaml
# Copyright (c) 2025 Renesas Electronics Corporation
# SPDX-License-Identifier: Apache-2.0

description: |
  Renesas RZ Clock Generator Circuit

  Usage example:

    #include <zephyr/dt-bindings/clock/renesas_rztn_clock.h>

    sci0: sci@xxx {
        ...
        channel = <0>;
        /* Cell encodes HWIP, channel, clock source */
        clocks = <&cgc RZ_CLOCK(RZ_IP_SCI, 0, RZ_CLOCK_PCLKSCI0)>;
        ...
    }

compatible: "renesas,rz-cgc"

include: [base.yaml, clock-controller.yaml]

properties:
  "#clock-cells":
    const: 1

clock-cells:
  - clk-id
```

## dts/bindings/clock/renesas,rz-cpg-clock.yaml
```yaml
# Copyright (c) 2025 Renesas Electronics Corporation
# SPDX-License-Identifier: Apache-2.0

description: Renesas RZ Clock Pulse Generator Clock Output

compatible: "renesas,rz-cpg-clock"

include: [base.yaml, clock-controller.yaml]

properties:
  clocks:
    required: true

  div:
    type: int

  "#clock-cells":
    const: 0
```

## dts/bindings/clock/renesas,rz-cpg-pll.yaml
```yaml
# Copyright (c) 2025 Renesas Electronics Corporation
# SPDX-License-Identifier: Apache-2.0

description: Renesas RZ Clock Pulse Generator PLL Output

compatible: "renesas,rz-cpg-pll"

include: [clock-controller.yaml]

properties:
  clock-frequency:
    type: int
    description: PLL output clock frequency (Hz)
    required: true

  "#clock-cells":
    const: 1

clock-cells:
  - postscaler
```

## dts/bindings/clock/renesas,rz-cpg.yaml
```yaml
# Copyright (c) 2024-2025 Renesas Electronics Corporation
# SPDX-License-Identifier: Apache-2.0

description: |
  Renesas RZ Clock Pulse Generator

  Usage example:

    #include <zephyr/dt-bindings/clock/renesas_rz[agv]_clock.h>

    scif0: serial@xxx {
        ...
        channel = <0>;
        /* Cell encodes HWIP, channel, clock source and division */
        clocks = <&cpg RZ_CLOCK_SCIF(0)>;
        ...
    }

compatible: "renesas,rz-cpg"

include: [base.yaml, clock-controller.yaml]

properties:

  "#clock-cells":
    const: 1

clock-cells:
  - clk-id
```

## dts/bindings/clock/renesas,rz-cpg.yml
```yaml
# Copyright (c) 2024 Renesas Electronics Corporation24
# SPDX-License-Identifier: Apache-2.0

description: RZ Clock Pulse Generator
compatible: "renesas,rz-cpg"

include: [base.yaml, clock-controller.yaml]

properties:

  "#clock-cells":
    const: 1

clock-cells:
  - clk-id
```

## dts/bindings/clock/renesas,rza2m-cpg.yaml
```yaml
# Copyright (c) 2025 Renesas Electronics Corporation24
# SPDX-License-Identifier: Apache-2.0

description: RZ/A2M Clock Pulse Generator
compatible: "renesas,rza2m-cpg"

include: renesas,rz-cpg.yml
```

## dts/bindings/clock/renesas,smartbond-lp-clock.yaml
```yaml
# Copyright (c) 2022 Renesas Electronics Corporation
# SPDX-License-Identifier: Apache-2.0

description: Smartbond low power clock

compatible: "renesas,smartbond-lp-clk"

include:
  - name: base.yaml
    property-allowlist:
      - status
      - compatible

properties:
  clock-src:
    type: phandle
    description: |
      Low power clock source.
```

## dts/bindings/clock/renesas,smartbond-lp-osc.yaml
```yaml
# Copyright (c) 2023 Renesas Electronics Corporation
# SPDX-License-Identifier: Apache-2.0

description: Smartbond low power oscillator

compatible: "renesas,smartbond-lp-osc"

include:
  - name: fixed-clock.yaml
    property-allowlist:
      - status
      - compatible
      - clock-frequency

properties:
  settle-time:
    type: int
    default: 8000
    description: |
      This is only valid for XTAL32K. Time in ms needed to XTAL32K to settle.
  calibration-interval:
    type: int
    default: 1000
    description: |
      Time interval (ms) between oscillator calibrations.
      Setting this value to 0 disables calibration entirely.
      Calibration should only be disabled in tests that require strict thread
      scheduling, where even minimal unexpected CPU usage from calibration
      could cause failures.
```

## dts/bindings/clock/renesas,smartbond-sys-clock.yaml
```yaml
# Copyright (c) 2022 Renesas Electronics Corporation
# SPDX-License-Identifier: Apache-2.0

description: Smartbond system clock

compatible: "renesas,smartbond-sys-clk"

include:
  - name: base.yaml
    property-allowlist:
      - status
      - compatible

properties:
  clock-src:
    type: phandle
    description: |
      System clock source.
```
