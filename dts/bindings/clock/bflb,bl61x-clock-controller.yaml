## dts/bindings/clock/bflb,bl61x-clock-controller.yaml
```yaml
# Copyright (c) 2025 MASSDRIVER EI (massdriver.space)
# SPDX-License-Identifier: Apache-2.0

description: Bouffalolab BL61x Clock Controller

compatible: "bflb,bl61x-clock-controller"

include: [base.yaml, clock-controller.yaml, pinctrl-device.yaml]

properties:
  pinctrl-0:
    required: false

  pinctrl-names:
    required: false

  "#clock-cells":
    const: 1

clock-cells:
  - id
```

## dts/bindings/clock/bflb,bl808-clock-controller.yaml
```yaml
# Copyright The Zephyr Project Contributors
# SPDX-License-Identifier: Apache-2.0

title: Bouffalolab BL808 Clock Controller

description: Bouffalolab BL808 Clock Controller

compatible: "bflb,bl808-clock-controller"

include: [base.yaml, clock-controller.yaml]

properties:
  "#clock-cells":
    const: 1

  xtal-capcode:
    type: int
    description: |
      Crystal load capacitor trim, 0 to 63, applied to both the input and
      output capacitor codes. The reset default is used when absent.

clock-cells:
  - id
```

## dts/bindings/clock/fixed-clock.yaml
```yaml
# Copyright (c) 2019 Derek Hageman <hageman@inthat.cloud>
# SPDX-License-Identifier: Apache-2.0

description: Generic fixed-rate clock provider

compatible: "fixed-clock"

include: [base.yaml, clock-controller.yaml]

properties:
  clock-frequency:
    type: int
    description: output clock frequency (Hz)
    required: true

  startup-time-us:
    type: int
    description: |
      Oscillator or clock source startup time in microseconds.

      Useful for physical oscillators (crystal or RC) where consumers must
      wait after enabling before the clock is stable.

  "#clock-cells":
    const: 0
```

## dts/bindings/clock/gd,gd32-clock-ckout.yaml
```yaml
#
# Copyright (c) 2026 GigaDevice Semiconductor Inc.
#
# SPDX-License-Identifier: Apache-2.0
#

compatible: "gd,gd32-clock-ckout"

description: |
  GigaDevice GD32 CKOUT clock output.

  This node models a SoC clock-output resource (for example CK_OUT0).
  It configures the source multiplexer and output divider used to route
  an internal clock to the CK_OUT pin.

  Example:

    &ckout0 {
        clocks = <&cctl GD32_CKOUT0SRC_PLLP>;
        clock-names = "clksel";
        prescaler = <GD32_CKOUT0_DIV4>;
        pinctrl-0 = <&ckout0_default>;
        pinctrl-names = "default";
        status = "okay";
    };

include: [base.yaml, pinctrl-device.yaml]

properties:
  clocks:
    required: true
    description: |
      CKOUT source selector. Use one GD32_CKOUT0SRC_* macro from the
      SoC-specific dt-bindings clock header.

  clock-names:
    enum: ["clksel"]
    required: true

  prescaler:
    type: int
    required: true
    description: |
      CKOUT output divider. Use one GD32_CKOUT0_DIV* macro from the
      SoC-specific dt-bindings clock header.

  pinctrl-0:
    required: true

  pinctrl-names:
    required: true
```

## dts/bindings/clock/gd,gd32-hxtal-clock.yaml
```yaml
# Copyright (c) 2026 GigaDevice Semiconductor Inc.
# SPDX-License-Identifier: Apache-2.0

title: GigaDevice GD32 HXTAL External Crystal Clock

description: |
  GigaDevice GD32 external high-speed crystal oscillator (HXTAL).

  This node models the HXTAL as a fixed-rate clock source. It is referenced
  by the main PLL node through its "clocks" property to select HXTAL as the
  PLL input source.

compatible: "gd,gd32-hxtal-clock"

# fixed-clock provides clock-frequency and "#clock-cells" definitions.
include: [fixed-clock.yaml]

properties:
  hxtal-bypass:
    type: boolean
    description: |
      Enable HXTAL bypass mode. Set when an external clock signal is fed
      to the HXTAL pin instead of a crystal oscillator.
```

## dts/bindings/clock/gd,gd32-pll-clock.yaml
```yaml
# Copyright (c) 2026 GigaDevice Semiconductor Inc.
# SPDX-License-Identifier: Apache-2.0

title: GigaDevice GD32 Main PLL Clock

description: |
  GigaDevice GD32 main PLL clock node.

  This node models the main PLL used to generate the system clock. It takes
  the hxtal (gd,gd32-hxtal-clock) or irc16m (fixed-clock) node as input
  clock, and produces a single output clock (PLL_P).

  This binding applies to GD32 series that expose a dedicated RCU_PLL
  register with PSC/N/P/Q fields, such as GD32F527.

  The output frequency is computed as:

    f(CK_PLLP) = f(VCO clock) / PLLP

      with f(VCO clock) = f(PLL input clock) / PLLPSC * PLLN

  The PLL input clock source is selected by the "clocks" property: the
  hxtal node selects HXTAL, the irc16m node selects IRC16M.
  This maps to the RCU_PLLSRC_* bit in RCU_PLL.

  Property mapping to rcu_pll_config() arguments:
    pll-psc  : PLL VCO source clock prescaler (2..63)
    pll-n    : PLL VCO clock multiplication factor (64..500)
    pll-p    : PLLP output division factor (2, 4, 6, 8)
    pll-q    : PLLQ output division factor (2..15)

compatible: "gd,gd32-pll-clock"

include: [clock-controller.yaml, base.yaml]

properties:
  "#clock-cells":
    const: 0

  clocks:
    required: true
    description: |
      PLL input clock source. Reference the hxtal node (HXTAL) or the
      irc16m node (IRC16M).

  pll-psc:
    type: int
    required: true
    description: PLL VCO source clock prescaler.
    min: 2
    max: 63

  pll-n:
    type: int
    required: true
    description: PLL VCO clock multiplication factor.
    min: 64
    max: 500

  pll-p:
    type: int
    required: true
    description: PLLP output frequency division factor.
    enum:
      - 2
      - 4
      - 6
      - 8

  pll-q:
    type: int
    required: true
    description: PLLQ output frequency division factor.
    min: 2
    max: 15
```

## dts/bindings/clock/gd,gd32f527-rcu.yaml
```yaml
# Copyright (c) 2026 GigaDevice Semiconductor Inc.
# SPDX-License-Identifier: Apache-2.0

title: GigaDevice GD32F527 RCU Clock Tree Configuration

description: |
  GigaDevice GD32F527 Reset and Clock Unit (RCU) system clock tree
  configuration.

  This binding complements the MFD "gd,gd32-rcu" binding
  (mfd/gd,gd32-rcu.yaml) and models the GD32F527 system clock source
  selection and the AHB/APB bus prescalers. The RCU node keeps its MFD
  role (parent of the CCTL and RCTL child nodes) and additionally carries
  the clock tree configuration.

  GD32F527 exposes a dedicated RCU_PLL register with PSC/N/P/Q fields.
  The main PLL configuration is described by the gd,gd32-pll-clock node
  referenced from "clocks".

  Example:

    rcu: reset-clock-controller@40023800 {
        compatible = "gd,gd32f527-rcu", "gd,gd32-rcu";
        clocks = <&pll>;               /* Select PLL as SYSCLK source */
        clock-frequency = <DT_FREQ_M(200)>; /* = SYSCLK / AHB prescaler */
        ahb-prescaler = <1>;
        apb1-prescaler = <4>;
        apb2-prescaler = <2>;
    };

compatible: "gd,gd32f527-rcu"

include: gd,gd32-rcu.yaml

properties:
  clocks:
    description: |
      System clock source. Reference the pll, hxtal or irc16m node.
      IRC16M is used when absent.

  clock-frequency:
    type: int
    required: true
    description: |
      HCLK frequency (Hz) = SYSCLK / AHB prescaler. It is the single
      source for SYS_CLOCK_HW_CYCLES_PER_SEC and bus clock rates, and is
      checked at build time against the configured clock tree.

  ahb-prescaler:
    type: int
    default: 1
    enum:
      - 1
      - 2
      - 4
      - 8
      - 16
      - 64
      - 128
      - 256
      - 512
    description: |
      AHB prescaler. Defines actual core clock frequency (HCLK).
      SYSCLK must not exceed 200 MHz.

  apb1-prescaler:
    type: int
    default: 4
    enum:
      - 1
      - 2
      - 4
      - 8
      - 16
    description: APB1 prescaler. APB1 clock (HCLK / prescaler) must not exceed 50 MHz.

  apb2-prescaler:
    type: int
    default: 2
    enum:
      - 1
      - 2
      - 4
      - 8
      - 16
    description: APB2 prescaler. APB2 clock (HCLK / prescaler) must not exceed 100 MHz.
```

## dts/bindings/clock/hpmicro,hpm-pllv2.yaml
```yaml
# Copyright (c) 2024 HPMicro
# Copyright (c) 2026 Cody Gu <gujiaqi@iscas.ac.cn>
# SPDX-License-Identifier: Apache-2.0

description: HPMicro PLLv2 clock controller

compatible: "hpmicro,hpm-pllv2"

include: [clock-controller.yaml, base.yaml]

properties:
  reg:
    required: true

clock-cells:
  - name
  - source
  - divider
```

## dts/bindings/clock/infineon,aurix-ccu.yaml
```yaml
# SPDX-FileCopyrightText: Copyright (c) 2024 Infineon Technologies AG,
# SPDX-FileCopyrightText: or an affiliate of Infineon Technologies AG. All rights reserved.
# SPDX-FileCopyrightText: Copyright (c) 2026 Linumiz
#
# SPDX-License-Identifier: Apache-2.0

description: |
  Infineon AURIX clock control unit.

  The node holds the register-level clock configuration: the PLL dividers in
  the sys-pll and per-pll child nodes and the dividers of the clock domains.
  All frequencies are derived from them and from the input clocks. A PLL is
  used only if its child node is present; otherwise the domains it would
  feed run from the 100 MHz back-up clock. Divider properties that are
  absent leave the related register field at its current value.

  Consumers reference a clock domain by the identifiers in
  include/zephyr/dt-bindings/clock/infineon-aurix-ccu.h, for example
  clocks = <&ccu AURIX_CCU_ASCLINF>.

compatible: "infineon,aurix-ccu"

include: [base.yaml, clock-controller.yaml]

properties:
  reg:
    required: true

  "#clock-cells":
    const: 1

  clocks:
    description: |
      Crystal oscillator input (fOSC), a fixed-clock node. Required when a
      PLL is used.

  sri-div:
    type: int
    description: fSRI = fsource0 / sri-div.

  spb-div:
    type: int
    description: fSPB = fsource0 / spb-div.

  fsi-div:
    type: int
    description: FSI divider field value.

  stm-div:
    type: int
    description: fSTM = fsource0 / stm-div.

  asclinf-div:
    type: int
    description: fASCLINF = fsource2 / asclinf-div.

  mcan-div:
    type: int
    description: fMCAN = fsource1 / mcan-div.

  mcanh-div:
    type: int
    description: fMCANH = fsource0 / mcanh-div.

clock-cells:
  - id

child-binding:
  description: |
    PLL configuration, in a child node named sys-pll (system PLL) or per-pll
    (peripheral PLL).

  properties:
    p-div:
      type: int
      required: true
      description: P divider.

    n-div:
      type: int
      required: true
      description: N multiplier.

    k2-div:
      type: int
      required: true
      description: K2 divider.

    k3-div:
      type: int
      description: K3 divider (peripheral PLL).
```

## dts/bindings/clock/infineon,aurix-tc3x-ccu.yaml
```yaml
# SPDX-FileCopyrightText: Copyright (c) 2024 Infineon Technologies AG,
# SPDX-FileCopyrightText: or an affiliate of Infineon Technologies AG. All rights reserved.
# SPDX-FileCopyrightText: Copyright (c) 2026 Linumiz
#
# SPDX-License-Identifier: Apache-2.0

description: |
  Infineon AURIX TC3x clock control unit (SCU clock registers).

  fsource0, fsource1 and fsource2 switch between fBACK and the PLLs
  together, so sys-pll and per-pll are either both present or both absent.
  The peripheral PLL K3 output uses the fixed 1.6 pre-divider
  (PERPLLCON0.DIVBY = 0, erratum PER_PLL_TC.001) and k3-div must be 1 or 2
  (erratum PER_PLL_TC.002). fsi-div is the FSIDIV field: fFSI = fSRI /
  fsi-div for sri-div 1 or 2, else fFSI = fSRI.

compatible: "infineon,aurix-tc3x-ccu"

include: infineon,aurix-ccu.yaml
```

## dts/bindings/clock/infineon,aurix-tc4x-ccu.yaml
```yaml
# SPDX-FileCopyrightText: Copyright (c) 2024 Infineon Technologies AG,
# SPDX-FileCopyrightText: or an affiliate of Infineon Technologies AG. All rights reserved.
# SPDX-FileCopyrightText: Copyright (c) 2026 Linumiz
#
# SPDX-License-Identifier: Apache-2.0

description: |
  Infineon AURIX TC4x clock control unit (CLOCK module).

  When the system PLL is used, fsource0 is ramped up with the ramp oscillator
  before it is switched to fPLL0; ramp-upper-mhz sets the ramp end frequency.
  The per-pll node needs k3-div and k4-div.

compatible: "infineon,aurix-tc4x-ccu"

include: infineon,aurix-ccu.yaml

properties:
  ramp-upper-mhz:
    type: int
    description: |
      Ramp oscillator upper frequency limit in MHz: a multiple of 100 MHz and
      at most fPLL0 - 100 MHz. Required when the system PLL is used.

  tpb-div:
    type: int
    description: fTPB = fsource0 / tpb-div.

  cpb-div:
    type: int
    description: fCPB = fsource0 / cpb-div.

child-binding:
  properties:
    k3-prediv:
      type: int
      enum: [10, 11, 12, 14, 16, 17, 20]
      description: |
        Peripheral PLL K3 pre-divider in tenths (10 = 1.0 ... 20 = 2.0),
        fPLL2 = fDCO / (K3PRE * K3). Defaults to 1.0.

    k4-div:
      type: int
      description: Peripheral PLL K4 divider (fPLL3).
```

## dts/bindings/clock/infineon,clk-hf.yaml
```yaml
# SPDX-FileCopyrightText: Copyright (c) 2026 Linumiz
#
# SPDX-License-Identifier: Apache-2.0

description: Infineon High Frequency Clock(clk_hf)

compatible: "infineon,clk-hf"

include: [base.yaml, clock-controller.yaml]

properties:
  clocks:
    required: true
    description: HF CLock source

  divider:
    type: int
    description: Divider for High Frequency Clock
    default: 1
    enum: [1, 2, 4, 8]

  "#clock-cells":
    const: 0
```

## dts/bindings/clock/infineon,clk-osc.yaml
```yaml
# SPDX-FileCopyrightText: Copyright (c) 2026 Linumiz
#
# SPDX-License-Identifier: Apache-2.0

title: Infineon Clock Oscillators

description: Infineon Clock source Oscillators

compatible: "infineon,clk-osc"

include: [base.yaml, fixed-clock.yaml]

properties:
  reg:
    required: true

  eco-load-capacitance-pf:
    type: int
    description: Crystal load capacitance in picofarads.

  eco-esr-ohms:
    type: int
    description: Crystal equivalent series resistance in ohms.

  eco-drive-level-uw:
    type: int
    description: Crystal maximum drive level in microwatts.
```

## dts/bindings/clock/infineon,peri-clk.yaml
```yaml
# SPDX-FileCopyrightText: Copyright (c) 2026 Linumiz
#
# SPDX-License-Identifier: Apache-2.0

description: Infineon peripheral clock group

compatible: "infineon,peri-clk"

include: [base.yaml]

properties:
  clocks:
    type: phandle-array
    required: true
    description: Source CLK_HF feeding this peripheral group

  ifx,peri-clk-inst:
    type: int
    required: true
    description: PERI group and instance selector, IFX_PERI_GRP_INST_SEL(group, instance)
```

## dts/bindings/clock/infineon,peri.yaml
```yaml
# SPDX-FileCopyrightText: Copyright The Zephyr Project Contributors
#
# SPDX-License-Identifier: Apache-2.0

description: |
  Infineon peripheral clock (PERI) instance.

  Groups the programmable peripheral clock dividers belonging to one PERI
  instance. Divider child nodes use the "infineon,peri-div" compatible and are
  programmed by the driver bound to this node, so every "infineon,peri-div"
  node must be a child of an "infineon,peri" node.

  Peripherals reference an individual divider, not this node, for example:

      peri0: peri0 {
              compatible = "infineon,peri";

              peri0_group1_8bit_0: peri0_group1_8bit_0 {
                      compatible = "infineon,peri-div";
                      peri-group = [00 01];
                      div-type = <DIV_8_BIT>;
                      channel = <0>;
                      clock-div = <1>;
                      status = "okay";
              };
      };

      &uart0 {
              clocks = <&peri0_group1_8bit_0>;
      };

compatible: "infineon,peri"

include: [base.yaml]
```

## dts/bindings/clock/intel,agilex5-clock.yaml
```yaml
# Copyright (c) 2023, Intel Corporation
# SPDX-License-Identifier: Apache-2.0

description: Agilex5 clock controller node

compatible: "intel,agilex5-clock"

include: [clock-controller.yaml, base.yaml]

properties:
  reg:
    required: true

  sysmgr:
    type: phandle
    required: true
    description: phandle to the syscon node backing sysmgr registers

  "#clock-cells":
    const: 1

clock-cells:
  - clkid
```
