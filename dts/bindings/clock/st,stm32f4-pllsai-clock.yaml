## dts/bindings/clock/st,stm32h5-rcc.yaml
```yaml
# Copyright (c) 2025, STMicroelectronics
# SPDX-License-Identifier: Apache-2.0

description: |
  STM32H5 RCC (Reset and Clock controller).

  For more description confere st,stm32-rcc.yaml

compatible: "st,stm32h5-rcc"

include: st,stm32u5-rcc.yaml

properties:
  timpre:
    type: boolean
    description: |
        Timers clocks prescalers selection
        Used to control the clock frequency of all the timers connected to APB1 and APB2 domain.
        - When absent: If the APB prescaler (PPRE1, PPRE2 in the RCC_CFGR2 register) is configured
          to a division factor of 1, TIMxCLK = HCKL. Otherwise, the timer clock frequencies are set
          to twice to the frequency of the APB domain to which the timers are connected:
          TIMxCLK = 2xPCLKx.
        - When present: If the APB prescaler (PPRE1, PPRE2 in the RCC_CFGR2 register) is configured
          to a division factor of 1 or 2, TIMxCLK = HCKL. Otherwise, the timer clock frequencies are
          set to four times to the frequency of the APB domain to which the timers are connected:
          TIMxCLK = 4xPCLKx.
```

## dts/bindings/clock/st,stm32h7-hsi-clock.yaml
```yaml
# Copyright (c) 2021, Linaro ltd
# SPDX-License-Identifier: Apache-2.0

description: STM32 HSI Clock

compatible: "st,stm32h7-hsi-clock"

include: [fixed-clock.yaml]

properties:
  hsi-div:
    type: int
    required: true
    description: |
      HSI clock divider. Configures the output HSI clock frequency
      1: 64 MHz
      2: 32 MHz
      4: 16 MHz
      8: 8 MHz
    enum: [1, 2, 4, 8]
```

## dts/bindings/clock/st,stm32h7-rcc.yaml
```yaml
# Copyright (c) 2021, Linaro ltd
# SPDX-License-Identifier: Apache-2.0

description: |
  STM32H7 RCC (Reset and Clock controller).

  This node is in charge of system clock ('SYSCLK') source selection and
  System Clock Generation.

  Configuring STM32 Reset and Clock controller node:

  System clock source should be selected amongst the clock nodes available in "clocks"
  node (typically 'clk_hse, clk_csi', 'pll', ...).
  As part of this node configuration, SYSCLK frequency should also be defined, using
  "clock-frequency" property.
  Last, bus clocks (typically HCLK, PCLK1, PCLK2) should be configured using matching
  prescaler properties.
  Here is an example of correctly configured rcc node:
  &rcc {
           clocks = <&pll>;  /* Set pll as SYSCLK source */
           clock-frequency = <DT_FREQ_M(480)>; /* SYSCLK runs at 480MHz */
           d1cpre = <1>;
           hpre = <1>;
           d1ppre = <1>;
           d2ppre1 = <1>;
           d2ppre2 = <1>;
           d3ppre = <1>;
  }

  Confere st,stm32-rcc binding for information about domain clocks configuration.

compatible: "st,stm32h7-rcc"

include: [clock-controller.yaml, base.yaml]

properties:
  reg:
    required: true

  "#clock-cells":
    const: 2

  clock-frequency:
    required: true
    type: int
    description: |
      default frequency in Hz for clock output

  d1cpre:
    type: int
    required: true
    enum:
      - 1
    description: |
        D1 Domain, CPU1 clock prescaler. Sets a HCLK frequency (feeding Cortex-M Systick)
        lower than SYSCLK frequency (actual core frequency).
        Zephyr doesn't make a difference today between these two clocks.
        Changing this prescaler is not allowed until it is made possible to
        use them independently in Zephyr clock subsystem.

  hpre:
    type: int
    required: true
    description: |
        D2 domain, CPU2 core clock and AHB(1/2/3/4) peripheral prescaler
    enum:
      - 1
      - 2
      - 4
      - 8
      - 16
      - 64
      - 128
      - 256
      - 512

  d1ppre:
    type: int
    required: true
    description: |
        D1 domain, APB3 peripheral prescaler
    enum:
      - 1
      - 2
      - 4
      - 8
      - 16

  d2ppre1:
    type: int
    required: true
    description: |
        D2 domain, APB1 peripheral prescaler
    enum:
      - 1
      - 2
      - 4
      - 8
      - 16

  d2ppre2:
    type: int
    required: true
    description: |
        D2 domain, APB2 peripheral prescaler
    enum:
      - 1
      - 2
      - 4
      - 8
      - 16

  d3ppre:
    type: int
    required: true
    description: |
        D3 domain, APB4 peripheral prescaler
    enum:
      - 1
      - 2
      - 4
      - 8
      - 16

  timpre:
    type: boolean
    description: |
        Timers clocks prescalers selection
        Used to control the clock frequency of all the timers connected to APB1 and APB2 domain.
        - When absent: If the APB prescaler (D2PPRE1, D2PPRE2 in the RCC_D2CFGR register) is
          configured to a division factor of 1, TIMxCLK = HCKL. Otherwise, the timer clock
          frequencies are set to twice to the frequency of the APB domain to which the timers are
          connected: TIMxCLK = 2xPCLKx.
        - When present: If the APB prescaler (D2PPRE1, D2PPRE2 in the RCC_D2CFGR register) is
          configured to a division factor of 1 or 2, TIMxCLK = HCKL. Otherwise, the timer clock
          frequencies are set to four times to the frequency of the APB domain to which the timers
          are connected: TIMxCLK = 4xPCLKx.

clock-cells:
  - bus
  - bits
```

## dts/bindings/clock/st,stm32h7rs-pll-clock.yaml
```yaml
# Copyright (c) 2024 STMicroelectronics
# SPDX-License-Identifier: Apache-2.0

description: |
  PLL node binding for STM32H7RS devices

  It can be used to describe 3 different PLLs: PLL1 (Main PLL), PLL2 and PLL3.

  These PLLs could take one of clk_hse, clk_hsi or clk_csi as input clock, with
  an input frequency from 1 to 16 MHz. PLLM factor is used to set the input
  clock in this acceptable range.

  Each PLL can have up to 5 output clocks and for each output clock, the
  frequency can be computed with the following formulae:

    f(PLL_Px) = f(VCOx clock) / PLLPx   -> pllx_p_ck ((pll1_p_ck : sys_ck))
    f(PLL_Qx) = f(VCOx clock) / PLLQx   -> pllx_q_ck
    f(PLL_Rx) = f(VCOx clock) / PLLRx   -> pllx_r_ck
    f(PLL_Sx) = f(VCOx clock) / PLLSx   -> pllx_s_ck
    f(PLL_Tx) = f(VCOx clock) / PLLTx   -> pllx_t_ck (only for PLL2)

      with f(VCOx clock) = f(REFx_CK) × (PLLNx / PLLMx)


compatible: "st,stm32h7rs-pll-clock"

include: st,stm32h7-pll-clock.yaml

properties:
  div-s:
    type: int
    description: |
        PLL division factor for pllx_s_ck : valid for PLL1, 2, 3
        Valid range: 1 - 8

  div-t:
    type: int
    description: |
        PLL division factor for pllx_t_ck : valid for PLL2
        Valid range: 1 - 8
```

## dts/bindings/clock/st,stm32h7rs-rcc.yaml
```yaml
# Copyright (c) 2024, STMicroelectronics
# SPDX-License-Identifier: Apache-2.0

description: |
  STM32H7RS RCC (Reset and Clock controller).

  This node is in charge of system clock ('SYSCLK') source selection and
  System Clock Generation.

  Configuring STM32 Reset and Clock controller node:

  System clock source should be selected amongst the clock nodes available in "clocks"
  node (typically 'clk_hse, clk_csi', 'pll', ...).
  As part of this node configuration, SYSCLK frequency should also be defined, using
  "clock-frequency" property.
  Last, bus clocks (typically HCLK, PCLK1, PCLK2) should be configured using matching
  prescaler properties.
  Here is an example of correctly configured rcc node:
  &rcc {
           clocks = <&pll>;  /* Set pll as SYSCLK source */
           clock-frequency = <DT_FREQ_M(280)>; /* SYSCLK runs at 280MHz */
           dcpre = <1>;
           hpre = <1>;
           ppre1 = <1>;
           ppre2 = <1>;
           ppre4 = <1>;
           ppre5 = <1>;
  }

  Confere st,stm32-rcc binding for information about domain clocks configuration.

compatible: "st,stm32h7rs-rcc"

include: [clock-controller.yaml, base.yaml]

properties:
  reg:
    required: true

  "#clock-cells":
    const: 2

  clock-frequency:
    required: true
    type: int
    description: |
      default frequency in Hz for clock output

  dcpre:
    type: int
    required: true
    enum:
      - 1
      - 2
      - 4
      - 8
      - 16
      - 64
      - 128
      - 256
      - 512
    description: |
        CPU clock prescaler. Sets a HCLK frequency (feeding Cortex-M Systick)
        lower than SYSCLK frequency (actual core frequency).
        Zephyr doesn't make a difference today between these two clocks.
        Changing this prescaler is not allowed until it is made possible to
        use them independently in Zephyr clock subsystem.

  hpre:
    type: int
    required: true
    description: |
        peripheral clock to the Bus Matrix APB (1/2/4/5) and AHB(1/2/3/4/5) peripheral
        divider of the CPU clock by this  prescaler (BMPRE register)
    enum:
      - 1
      - 2
      - 4
      - 8
      - 16
      - 64
      - 128
      - 256
      - 512

  ppre1:
    type: int
    required: true
    description: |
        APB1 peripheral prescaler
    enum:
      - 1
      - 2
      - 4
      - 8
      - 16

  ppre2:
    type: int
    required: true
    description: |
        APB2 peripheral prescaler
    enum:
      - 1
      - 2
      - 4
      - 8
      - 16

  ppre4:
    type: int
    required: true
    description: |
        APB4 peripheral prescaler
    enum:
      - 1
      - 2
      - 4
      - 8
      - 16

  ppre5:
    type: int
    required: true
    description: |
        APB5 peripheral prescaler
    enum:
      - 1
      - 2
      - 4
      - 8
      - 16

  timpre:
    type: boolean
    description: |
        Timers clocks prescalers selection
        Used to control the clock frequency of all the timers connected to APB1 and APB2 domain.
        - When absent: If the APB prescaler (PPRE1, PPRE2 in the RCC_APBCFGR register) is configured
          to a division factor of 1, TIMxCLK = HCKL. Otherwise, the timer clock frequencies are set
          to twice to the frequency of the APB domain to which the timers are connected:
          TIMxCLK = 2xPCLKx.
        - When present: If the APB prescaler (PPRE1, PPRE2 in the RCC_APBCFGR register) is
          configured to a division factor of 1 or 2, TIMxCLK = HCKL. Otherwise, the timer clock
          frequencies are set to four times to the frequency of the APB domain to which the timers
          are connected: TIMxCLK = 4xPCLKx.

clock-cells:
  - bus
  - bits
```

## dts/bindings/clock/st,stm32l0-hsi-clock.yaml
```yaml
# Copyright (c) 2025 STMicroelectronics
# SPDX-License-Identifier: Apache-2.0

description: STM32L0 HSI Clock

compatible: "st,stm32l0-hsi-clock"

include: [fixed-clock.yaml]

properties:
  hsi-div:
    type: int
    required: true
    description: |
      HSI clock divider. Configures the output HSI clock frequency.
      In that case, the HSI clock can be divided as follows:
      hsi clk = 16MHz / hsi-div
    enum:
      - 1
      - 4
```

## dts/bindings/clock/st,stm32l0-msi-clock.yaml
```yaml
# Copyright (c) 2021, Linaro ltd
# SPDX-License-Identifier: Apache-2.0

description: STM32L0 and STM32L1 Multi Speed Internal Clock

compatible: "st,stm32l0-msi-clock"

include:
  - name: st,stm32-msi-clock.yaml
    property-blocklist:
      - msi-range

properties:
  msi-range:
    required: true
    type: int
    default: 5
    description: |
      MSI clock ranges
    enum:
      - 0 # range 0, around 65.536 kHz
      - 1 # range 1, around 131.072 kHz
      - 2 # range 2, around 262.144 kHz
      - 3 # range 3, around 524.288 kHz
      - 4 # range 4, around 1.048 MHz
      - 5 # range 5, around 2.097 MHz (reset value)
      - 6 # range 6, around 4.194 MHz
```

## dts/bindings/clock/st,stm32l0-pll-clock.yaml
```yaml
# Copyright (c) 2021, Linaro ltd
# SPDX-License-Identifier: Apache-2.0

description: |
  STM32L0/L1 Main PLL.

  Takes one of clk_hse, clk_hsi or clk_msi as input clock, with an
  input frequency from 2 to 24 MHz.

  The desired PLL frequency can be computed with the following formula:

    f(PLL) = f(VCO clock) / PLLDIV  --> PLLCLK (System Clock)

      with f(VCO clock) = f(PLL clock input) × PLLMUL --> PLLVCO

  The PLL output frequency must not exceed 32 MHz.

compatible: "st,stm32l0-pll-clock"

include: [clock-controller.yaml, base.yaml]

properties:
  "#clock-cells":
    const: 0

  clocks:
    required: true

  div:
    type: int
    required: true
    description: |
        PLL output division
    enum:
      - 2
      - 3
      - 4

  mul:
    type: int
    required: true
    description: |
        PLL multiplication factor for VCO
        The PLL VCO clock frequency must not exceed:
        - 96 MHz when the product is in Range 1
        - 48 MHz when the product is in Range 2
        - 24 MHz when the product is in Range 3
        If the USB uses the PLL as clock source, the PLL VCO clock must be
        programmed to output a 96 MHz frequency (USBCLK = PLLVCO/2).
    enum:
      - 3
      - 4
      - 6
      - 8
      - 12
      - 16
      - 24
      - 32
      - 48
```

## dts/bindings/clock/st,stm32l4-pll-clock.yaml
```yaml
# Copyright (c) 2021, Linaro ltd
# SPDX-License-Identifier: Apache-2.0

description: |
  PLL node binding for STM32L4 and L5 devices

  It can be used to describe 3 different PLLs: PLL, PLLSAI1 and PLLSAI2.

  These PLLs could take one of clk_hse, clk_hsi or clk_msi as input clock, with
  an input frequency from 4 to 16 MHz. PLLM factor is used to set the input
  clock in this acceptable range.

  Each PLL can have up to 3 output clocks and for each output clock, the
  frequency can be computed with the following formulae:

    f(PLLx_P) = f(VCO clock) / PLLxP
    f(PLLx_Q) = f(VCO clock) / PLLxQ
    f(PLLx_R) = f(VCO clock) / PLLxR

      with f(VCO clock) = f(PLL clock input) × (PLLxN / PLLxM)

  The PLL output frequency must not exceed 80 MHz.

compatible: "st,stm32l4-pll-clock"

include: [clock-controller.yaml, base.yaml]

properties:
  "#clock-cells":
    const: 0

  clocks:
    required: true

  div-m:
    type: int
    required: true
    description: |
        Division factor for the PLL input clock.
        On L4 series, the division factor M is shared between PLL, PLLSAI1
        and PLLSAI2. For these series, valid range is 1 - 8.
        On L4+ and L5 series, each PLL has an independent division factor M.
        For these series, valid range is 1 - 16.

  mul-n:
    type: int
    required: true
    description: |
        Multiplication factor for VCO. Valid range is 8 - 127 for L4+
        series and 8 - 86 for other series.

  div-p:
    type: int
    description: |
        Division factor for PLLx_P. Valid values are 2 - 31 for all
        series except L47x/48x for which valid values are 7 or 17.

  div-q:
    type: int
    description: |
        Division factor for PLLx_Q.
    enum:
      - 2
      - 4
      - 6
      - 8

  div-r:
    type: int
    description: |
        Division factor for PLLx_R.
    enum:
      - 2
      - 4
      - 6
      - 8

  post-div-r:
    type: int
    description: |
        Division factor after PLLSAI2_R for LTDC pixel clock. Only available
        on PLLSAI2 of STM32L4+ series. If available, this property must be
        provided when PLLSAI2_R is enabled (i.e., if `div-r` is provided).
    enum:
      - 2
      - 4
      - 8
      - 16
```
