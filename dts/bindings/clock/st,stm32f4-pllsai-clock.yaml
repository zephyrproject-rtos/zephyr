## dts/bindings/clock/st,stm32f4-pllsai-clock.yaml
```yaml
# Copyright (c) 2024, Move Innovation ApS.
# SPDX-License-Identifier: Apache-2.0

description: |
  STM32F4 PLLSAI node binding:

  Takes same input as Main PLL. PLLM factor and PLL source are common with Main PLL

  1 output clocks supported, the frequency can be computed with the following formula:

    f(PLL_R) = f(VCO clock) / (PLLR × PLLDIVR)  --> PLLSAI

      with f(VCO clock) = f(PLL clock input) × (PLLNSAI / PLLM)


compatible: "st,stm32f4-pllsai-clock"

include: [clock-controller.yaml, base.yaml]

properties:
  "#clock-cells":
    const: 0

  mul-n:
    type: int
    required: true
    description: |
        PLLSAI multiplication factor for VCO
        Valid range may vary between parts: 50 - 432 , 192 - 432

  div-r:
    type: int
    required: true
    description: |
        PLLSAIR division factor for SAI Clocks
    enum:
      - 2
      - 3
      - 4
      - 5
      - 6
      - 7

  div-divr:
    type: int
    required: true
    description: |
        PLLSAIDIVR division factor for SAI Clocks
    enum:
      - 2
      - 4
      - 8
      - 16
```

## dts/bindings/clock/st,stm32f411-plli2s-clock.yaml
```yaml
# Copyright (c) 2023, Linaro ltd
# SPDX-License-Identifier: Apache-2.0

description: |
  STM32F411 PLL I2S.

  Fully configurable I2S dedicated PLL.

  1 output clocks supported, the frequency can be computed with the following formula:

    f(PLLI2S_R) = f(VCO clock) / PLLI2S R  --> PLLI2S

      with f(VCO clock) = f(PLL I2S clock input) × (PLLI2S N / PLLI2S M)


compatible: "st,stm32f411-plli2s-clock"

include: st,stm32f4-plli2s-clock.yaml

properties:
  div-m:
    type: int
    required: true
    description: |
        Division factor for the PLL input clock
        Valid range: 2 - 63

  div-q:
    type: int
    description: |
        PLLI2S division factor for I2S Clocks to supply USB/SDIO/RNG
    enum:
      - 2
      - 3
      - 4
      - 5
      - 6
      - 7
      - 8
      - 9
      - 10
      - 11
      - 12
      - 13
      - 14
      - 15
```

## dts/bindings/clock/st,stm32f412-plli2s-clock.yaml
```yaml
# Copyright (c) 2023, Linaro ltd
# SPDX-License-Identifier: Apache-2.0

description: |
  STM32F412 PLL I2S node binding:

  Fully configurable I2S dedicated PLL.

  1 output clocks supported, the frequency can be computed with the following formula:

    f(PLLI2S_R) = f(VCO clock) / PLLI2S R  --> PLLI2S

      with f(VCO clock) = f(PLL I2S clock input) × (PLLI2S N / PLLI2S M)


compatible: "st,stm32f412-plli2s-clock"

include: st,stm32f4-plli2s-clock.yaml

properties:
  div-m:
    type: int
    required: true
    description: |
        Division factor for the PLL input clock
        Valid range: 2 - 63
```

## dts/bindings/clock/st,stm32f7-pll-clock.yaml
```yaml
# Copyright (c) 2021, Linaro ltd
# SPDX-License-Identifier: Apache-2.0

description: |
  STM32F7 Main PLL.

  Takes one of clk_hse or clk_hsi as input clock.

  Up to 2 output clocks could be supported and for each output clock, the
  frequency can be computed with the following formula:

    f(PLL_P) = f(VCO clock) / PLLP  --> PLLCLK (System Clock)
    f(PLL_Q) = f(VCO clock) / PLLQ  --> PLL48CLK (Optional)

      with f(VCO clock) = f(PLL clock input) × (PLLN / PLLM)


compatible: "st,stm32f7-pll-clock"

include: [clock-controller.yaml, base.yaml]

properties:
  "#clock-cells":
    const: 0

  clocks:
    required: true

  div-m:
    type: int
    required: true
    description: |
        Division factor for the PLL input clock
        Valid range: 2 - 63

  mul-n:
    type: int
    required: true
    description: |
        PLL multiplication factor for VCO
        Valid range: 50 - 432

  div-p:
    type: int
    required: true
    description: |
        PLL division factor for PLLCLK
    enum:
      - 2
      - 4
      - 6
      - 8

  div-q:
    type: int
    description: |
        PLL division factor for PLL48CK
        Valid range: 2 - 15
```

## dts/bindings/clock/st,stm32fx-pll-clock.yaml
```yaml
# Copyright (c) 2025, STMicroelectronics
# SPDX-License-Identifier: Apache-2.0

description: |
  PLL node binding for STM32F2, STM32F4 and STM32F7 device

  This binding can be used to describe any PLL present on these SoCs:
    - PLL
    - PLLI2S
    - PLLSAI

  Takes one of clk_hse or clk_hsi as input clock.

  The PLL can have up to 3 output clocks and for each output clock, the
  frequency can be computed with the following formulae:

    f(PLL_P) = f(VCO clock) / PLLP
    f(PLL_Q) = f(VCO clock) / PLLQ
    f(PLL_R) = f(VCO clock) / PLLR

      with f(VCO clock) = f(PLL clock input) × (PLLN / PLLM)

  An additional divisor is available on some SoCs for the Q and R outputs.

  The PLL clock input is shared between PLLs (PLL / PLLI2S / PLLSAI) of the
  SoC hence all PLLs must have the same source set.

compatible: "st,stm32fx-pll-clock"

include: [clock-controller.yaml, base.yaml]

properties:
  "#clock-cells":
    const: 0

  clocks:
    required: true

  div-m:
    type: int
    required: true
    description: |
        Division factor for the PLL input clock.
        On STM32F411, F412, F413, F423 and F446, the division M
        factor is independent from other PLLs.
        On all other SoCs, the division factor M is shared between
        PLL, PLLSAI and PLLI2S, hence same value must be used
        for those PLLs when used together.
        Valid range: 2 - 63

  mul-n:
    type: int
    required: true
    description: |
        Multiplication factor for VCO.
        Valid range:
          - 192 - 432 for STM32F2x and STM32F401
          - 50 - 432 for other STM32F4x and for STM32F7x

  div-p:
    type: int
    description: |
        Division factor for PLL_P.
        Available on all SoCs for main PLL.
        Available only on STM32F446 and on STM32F74x and higher for PLLI2S.
        Available only on STM32F446, F469, F479 and on all STM32F7x for PLLSAI.
    enum:
      - 2
      - 4
      - 6
      - 8

  div-q:
    type: int
    description: |
        Division factor for PLL_Q
        Available on all SoCs for main PLL.
        Available only on STM32F412, F413, F423, F427, F429, F437, F439, F446, F469, F479
        and on all STM32F7x for PLLI2S.
        Available only on STM32F427, F429, F437, F439, F446, F469, F479
        and on all STM32F7x for PLLSAI.
        Valid range: 2 - 15

  post-div-q:
    type: int
    description: |
        Division factor after PLL_Q.
        Available only on STM32F427, F429, F437, F439, F446, F469, F479
        and on all STM32F7x for PLLI2S.
        Available only on STM32F427, F429, F437, F439, F446, F469, F479
        and on all STM32F7x for PLLSAI.
        If the div-q property is used and this property is applicable for the SoC, then it is
        required to define it.
        Valid range: 1 - 32

  div-r:
    type: int
    description: |
        Division factor for PLL_R.
        Available only on STM32F410, F412, F413, F423, F446, F469, F479, F769 and F779 for main PLL.
        Available on all SoCs except STM32F410 for PLLI2S.
        Available only on STM32F427, F429, F437, F439, F469, F479
        and on STM32F74x and higher for PLLSAI.
        Valid range: 2 - 7

  post-div-r:
    type: int
    description: |
        Division factor after PLL_R.
        Available only on STM32F413 and F423 for main PLL.
        Available only on STM32F413 and F423 for PLLI2S.
        Available only on STM32F427, F429, F437, F439, F469, F479
        and on STM32F74x and higher for PLLSAI.
        If the div-r property is used and this property is applicable for the SoC, then it is
        required to define it.
    enum:
      - 2
      - 4
      - 8
      - 16
```

## dts/bindings/clock/st,stm32fx-pllsai-clock.yaml
```yaml
# Copyright (c) 2025, STMicroelectronics
# SPDX-License-Identifier: Apache-2.0

description: |
  PLLSAI node binding for STM32F4 and STM32F7 device

  Takes one of clk_hse or clk_hsi as input clock.

  The PLL can have up to 3 output clocks and for each output clock, the
  frequency can be computed with the following formulae:

    f(PLLSAI_P) = f(VCO clock) / PLLSAIP
    f(PLLSAI_Q) = f(VCO clock) / PLLSAIQ
    f(PLLSAI_R) = f(VCO clock) / PLLSAIR

      with f(VCO clock) = f(PLL clock input) × (PLLSAIN / PLLSAIM)

  The PLL clock input is shared with other PLLs (PLL / PLLI2S) of the
  SoC hence all PLLs must have the same source set.

compatible: "st,stm32fx-pllsai-clock"

include: [clock-controller.yaml, base.yaml]

properties:
  "#clock-cells":
    const: 0

  clocks:
    required: true

  div-m:
    type: int
    required: true
    description: |
        Division factor for PLLSAI input clock.
        On STM32F446xx, the division M factor is independent from
        other PLLs.
        On all other SoCs, the division factor M is shared between
        PLL, PLLSAI and PLLI2S, hence same value should be used
        for those PLLs when used together.
        Valid range: 2 - 63

  mul-n:
    type: int
    required: true
    description: |
        Multiplication factor for VCO.
        Valid range: 50 - 432

  div-p:
    type: int
    description: |
        Division factor for PLLSAI_P.
        Only available on STM32F446/STM32F469/STM32F479 and STM32F7 series.
    enum:
      - 2
      - 4
      - 6
      - 8

  div-q:
    type: int
    description: |
        Division factor for PLLSAI_Q
        Valid range: 2 - 15

  div-divq:
    type: int
    description: |
        Division factor after PLLSAI_Q for the SAI1 clock.
        Valid range: 1 - 32

  div-r:
    type: int
    description: |
        Division factor for PLLSAI_R.
        Only available on STM32F42x / STM32F43x / STM32F469 / STM32F479
        and on STM32F74x and higher.
        Valid range: 2 - 7

  div-divr:
    type: int
    description: |
        Division factor after PLLSAI_R for the LTDC pixel clock.
        Only available on STM32F42x / STM32F43x / STM32F469 / STM32F479
        and on STM32F74x and higher.
    enum:
      - 2
      - 4
      - 8
      - 16
```

## dts/bindings/clock/st,stm32g0-hsi-clock.yaml
```yaml
# Copyright (c) 2022 STMicroelectronics
# SPDX-License-Identifier: Apache-2.0

description: |
  STM32G0 HSI Clock.

  On STM32G0, HSI is a 16MHz fixed clock.

  It also produces a HSISYS secondary clk which can be used as system clock
  source. In that case, a HSI divisor (ranges from 1 to 128) can be applied:
  SYSCLK = HSI16 / HSI DIV
        enum:
        - 1 ==> HSISYS = 16MHZ
        - 2 ==> HSISYS = 8MHZ
        - 4 ==> HSISYS = 4MHZ
        - 8 ==> HSISYS = 2MHZ
        - 16 ==> HSISYS = 1MHZ
        - 32 ==> HSISYS = 0.5MHz
        - 64 ==> HSISYS = 0.25MHZ
        - 128 ==> HSISYS = 0.125MHz

compatible: "st,stm32g0-hsi-clock"

include: [fixed-clock.yaml]

properties:
  hsi-div:
    type: int
    required: true
    description: |
      HSI clock divider. Configures the output HSI clock frequency (HSISYS),
      It does not apply to HSI clk selected as peripheral source clock
      (eg: RNG clk driven by HSI)
    enum:
      - 1
      - 2
      - 4
      - 8
      - 16
      - 32
      - 64
      - 128
```

## dts/bindings/clock/st,stm32g0-pll-clock.yaml
```yaml
# Copyright (c) 2021, Linaro ltd
# SPDX-License-Identifier: Apache-2.0

description: |
  STM32G0 main PLL.

  It can take one of clk_hse or clk_hsi as input clock, with
  an input frequency from 2.66 to 16 MHz. PLLM factor is used to set the input
  clock in this acceptable range.

  PLL can have up to 3 output clocks and for each output clock, the
  frequency can be computed with the following formulae:

    f(PLL_P) = f(VCO clock) / PLLP  --> to I2S
    f(PLL_Q) = f(VCO clock) / PLLQ  --> to RNG
    f(PLL_R) = f(VCO clock) / PLLR  --> PLLCLK (System Clock)

      with f(VCO clock) = f(PLL clock input) × (PLLN / PLLM)

  The PLL output frequency must not exceed 64 MHz.

compatible: "st,stm32g0-pll-clock"

include: [clock-controller.yaml, base.yaml]

properties:
  "#clock-cells":
    const: 0

  clocks:
    required: true

  div-m:
    type: int
    required: true
    description: |
        Division factor for PLL input clock
    min: 1
    max: 8

  mul-n:
    type: int
    required: true
    description: |
        Main PLL multiplication factor for VCO
    min: 8
    max: 86

  div-p:
    type: int
    description: |
        PLL division factor for PLL P output
    min: 2
    max: 32

  div-q:
    type: int
    description: |
        PLL division factor for PLL Q output
    min: 2
    max: 8

  div-r:
    type: int
    required: true
    description: |
        PLL division factor for PLLCLK (system clock)
    min: 2
    max: 8
```

## dts/bindings/clock/st,stm32g4-pll-clock.yaml
```yaml
# Copyright (c) 2021, Linaro ltd
# SPDX-License-Identifier: Apache-2.0

description: |
  PLL node binding for STM32G4 devices

  It can take one of clk_hse or clk_hsi as input clock, with
  an input frequency from 2.66 to 16 MHz. PLLM factor is used to set the input
  clock in this acceptable range.

  PLL can have up to 3 output clocks and for each output clock, the
  frequency can be computed with the following formulae:

    f(PLL_P) = f(VCO clock) / PLLP  --> to ADC
    f(PLL_Q) = f(VCO clock) / PLLQ  --> PLL48MCLK (for USB, RNG)
    f(PLL_R) = f(VCO clock) / PLLR  --> PLLCLK (System Clock)

      with f(VCO clock) = f(PLL clock input) × (PLLN / PLLM)

  The PLL output frequency must not exceed 170 MHz.

compatible: "st,stm32g4-pll-clock"

include:
  - name: st,stm32l4-pll-clock.yaml
    property-blocklist:
      - div-m
      - mul-n
      - div-p

properties:

    div-m:
      type: int
      required: true
      description: |
          Division factor for PLL input clock
          Valid range: 1 - 16

    mul-n:
      type: int
      required: true
      description: |
          Main PLL multiplication factor for VCO
          Valid range: 8 - 127

    div-p:
      type: int
      required: false
      description: |
          Main PLL division factor for ADC
          Valid range: 2 - 31
```

## dts/bindings/clock/st,stm32h5-pll-clock.yaml
```yaml
# Copyright (c) 2026 STMicroelectronics
# SPDX-License-Identifier: Apache-2.0

title: STM32H5 PLL.

description: |
  It can be used to describe 3 different PLLs: PLL1 (Main PLL), PLL2 and PLL3.

  These PLLs could take one of clk_hse, clk_hsi or clk_csi as input clock, with
  an input frequency from 1 to 16 MHz. PLLM factor is used to set the input
  clock in this acceptable range.

  Each PLL can have up to 3 output clocks and for each output clock, the
  frequency can be computed with the following formulae:

    f(PLL_Px) = f(VCOx clock) / PLLPx   -> pllx_p_ck ((pll1_p_ck : sys_ck))
    f(PLL_Qx) = f(VCOx clock) / PLLQx   -> pllx_q_ck
    f(PLL_Rx) = f(VCOx clock) / PLLRx   -> pllx_r_ck

      with f(VCOx clock) = f(REFx_CK) × (PLLNx / PLLMx)

  f(VCOx clock) depends on the PLL. VCO1 maximum frequency is 560 MHz while
  VCO2 and VCO3 (if applicable) have a maximum frequency of 420 Mhz.

  The PLL output frequency must not exceed 420 MHz.

  PLL3 is not available on stm32h503.

compatible: "st,stm32h5-pll-clock"

include:
  - name: st,stm32h7-pll-clock.yaml
    property-blocklist:
      - div-p

properties:
  div-p:
    type: int
    description: |
        PLL division factor for pllx_p_ck
        Note: For PLL1, P division factor must be even.
    min: 1
    max: 128
```
