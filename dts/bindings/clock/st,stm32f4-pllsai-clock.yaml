## dts/bindings/clock/st,stm32l4-pllsai-clock.yaml
```yaml
# Copyright (c) 2025, STMicroelectronics
# SPDX-License-Identifier: Apache-2.0

description: |
  PLLSAI node binding for STM32L4 device

  It describes the PLLSAI1 and PLLSAI2 (for supporting devices) PLL.

  These PLL could take one of clk_hse, clk_hsi or clk_msi as input clock, with
  an input frequency from 4 to 16 MHz. PLLSAIM factor is used to set the input
  clock in this acceptable range.

  The PLL can have up to 3 output clocks and for each output clock, the
  frequency can be computed with the following formulae:

    f(PLLSAI_P) = f(VCO clock) / PLLSAIP
    f(PLLSAI_Q) = f(VCO clock) / PLLSAIQ
    f(PLLSAI_R) = f(VCO clock) / PLLSAIR

      with f(VCO clock) = f(PLL clock input) × (PLLSAIN / PLLSAIM)

  The VCO input frequency must be between 2.66 to 8 MHz and its output frequency
  must be between 64 and 344 MHz.


compatible: "st,stm32l4-pllsai-clock"

include: [clock-controller.yaml, base.yaml]

properties:
  "#clock-cells":
    const: 0

  clocks:
    required: true

  div-m:
    type: int
    required: true
    description: |
        Division factor for PLLSAI input clock. On series prior to L4+,
        the division factor M is shared between PLL, PLLSAI1 and PLLSAI2
        hence same value should be used for those PLLs when used together.
        Valid range in L4+ series is 1 - 16.

  mul-n:
    type: int
    required: true
    description: |
        Multiplication factor for VCO. Valid range is 8 - 127 for L4+
        series and 8 - 86 for other series.

  div-p:
    type: int
    description: |
        Division factor for PLLSAI_P. Valid values are 2 - 31 for all
        series except L47/48 for which valid values are 7 or 17

  div-q:
    type: int
    description: |
        Division factor for PLLSAI_Q
    enum:
      - 2
      - 4
      - 6
      - 8

  div-r:
    type: int
    description: |
        Division factor for PLLSAI_R
    enum:
      - 2
      - 4
      - 6
      - 8

  div-divr:
    type: int
    description: |
        Division factor after PLLSAI_R for the LTDC pixel clock. Only available
        on L4+ series.
    enum:
      - 2
      - 4
      - 8
      - 16
```

## dts/bindings/clock/st,stm32l4-pllsai2-clock.yaml
```yaml
# Copyright (c) 2025, STMicroelectronics
# SPDX-License-Identifier: Apache-2.0

description: |
  PLLSAI2 node binding for STM32L4 device

  It describes the PLLSAI2 PLL.

  These PLL could take one of clk_hse, clk_hsi or clk_msi as input clock, with
  an input frequency from 4 to 16 MHz. PLLSAIM factor is used to set the input
  clock in this acceptable range.

  The PLL can have up to 3 output clocks and for each output clock, the
  frequency can be computed with the following formulae:

    f(PLLSAI2_P) = f(VCO clock) / PLLSAIP  --> PLLSAI2CLK
    f(PLLSAI2_Q) = f(VCO clock) / PLLSAIQ  --> PLLDSICLK
    f(PLLSAI2_R) = f(VCO clock) / PLLSAIR  --> PLLLCDCLK

      with f(VCO clock) = f(PLL clock input) × (PLLSAIN / PLLSAIM)

  The VCO input frequency must be between 2.66 to 8 MHz and its output frequency
  must be between 64 and 344 MHz.


compatible: "st,stm32l4-pllsai2-clock"

include: [clock-controller.yaml, base.yaml]

properties:
  "#clock-cells":
    const: 0

  clocks:
    required: true

  div-m:
    type: int
    required: true
    description: |
        Division factor for PLLSAI2 input clock
        Valid range: 1 - 16

  mul-n:
    type: int
    required: true
    description: |
        PLLSAI2 multiplication factor for VCO
        Valid range: 8 - 127

  div-p:
    type: int
    description: |
        PLLSAI2 division factor for PLLSAI2CLK
    enum:
      - 2
      - 31

  div-q:
    type: int
    description: |
        PLLSAI2 division factor for PLLDSICLK
    enum:
      - 2
      - 4
      - 6
      - 8

  div-r:
    type: int
    description: |
        PLLSAI2 division factor for PLLLCDCLK (LTDC clock)
    enum:
      - 2
      - 4
      - 6
      - 8

  div-divr:
    type: int
    description: |
        PLLSAI2DIVR division factor for LTDC clock
    enum:
      - 2
      - 4
      - 8
      - 16
```

## dts/bindings/clock/st,stm32mp1-rcc.yaml
```yaml
# Copyright (c) 2021, Linaro ltd
# SPDX-License-Identifier: Apache-2.0

description: |
  STM32MP1 Reset and Clock controller node.
  On STM32MP1 platforms, clock control configuration is performed on A9 side.
  As a consequence, the only property to be set in devicetree node is the
  clock-frequency (mlhclk_ck).

compatible: "st,stm32mp1-rcc"

include:
  - name: st,stm32-rcc.yaml
    property-blocklist:
      - ahb-prescaler
      - apb1-prescaler
      - apb2-prescaler
```

## dts/bindings/clock/st,stm32mp13-cpu-clock-mux.yaml
```yaml
# Copyright (c) 2025, STMicroelectronics
# SPDX-License-Identifier: Apache-2.0

description: |
  STM32MP13 CPU Clock
  Describes the STM32MP13 CPU armv7 timer multiplexer.
  For the STM32MP13 the CPU armv7 timer input can either be the HSI or the HSE.
  For instance:
  cpusw: cpusw {
    #clock-cells = <0>;
    clocks = <&clk_hsi>;
    clock-frequency = <DT_FREQ_M(64)>;
    compatible = "st,stm32mp13-cpu-clock-mux", "st,stm32-clock-mux";
    status = "okay";
  };

compatible: "st,stm32mp13-cpu-clock-mux"

include:
  - name: base.yaml
    property-allowlist:
      - status
      - compatible
      - clocks

properties:
  clock-frequency:
    required: true
    type: int
    description: |
      default frequency in Hz for the timer
```

## dts/bindings/clock/st,stm32mp13-pll-clock.yaml
```yaml
# Copyright (c) 2025 STMicroelectronics
# SPDX-License-Identifier: Apache-2.0

description: |
  PLL node binding for STM32MP13 devices

  It can be used to describe 4 different PLLs: PLL1, PLL2, PLL3 and PLL4.

  These PLLs can take one of hse_ck, hsi_ck or csi_ck as input clock.
  PLLM factor is used to set the input clock in this acceptable range.

  Each PLL has one output clock whose frequency can be computed with the
  following formula:

    f(PLL_P) = f(VCO clock) / (DIVP × DIVR × DIVQ)

      with f(VCO clock) = f(PLL clock input) × 2 × (((DIVN + 1) + (FRACV / 8192)) / DIVM1)

  Note: To reduce the power consumption, it is recommended to configure the VCOx
        clock output to the lowest frequency.

  The PLL1 output frequency must not exceed 2000 MHz.
  The PLL2 output frequency must not exceed 1600 MHz.
  The PLL3 output frequency must not exceed 800 MHz.
  The PLL4 output frequency must not exceed 800 MHz.

  Note: The CPU clock should not exceed 1Ghz so avoid configuring the PLL1 to more
  than 1000 MHz or program the mpuss_ck mux to use the MPUDIV
  (refer to the stm32mp13 reference manual for details)

  div-m (aka DIVM1 + 1), div-p (aka DIVP + 1), div-q (aka DIVQ + 1),
  div-r (aka DIVR + 1) have identical valid ranges for all 4 PLLs.
  mul-n (aka DIVN + 1) valid range depends on the PLL
    PLL1: 31 - 125
    PLL2: 25 - 100
    PLL3: 25 - 200
    PLL4: 25 - 200

compatible: "st,stm32mp13-pll-clock"

include: [clock-controller.yaml, base.yaml]

properties:

  "#clock-cells":
    const: 0

  clocks:
    required: true

  div-m:
    type: int
    required: true
    description: |
        PLLx division factor (aka DIVM1 + 1) of the input clock divider
        Valid range: 1 - 64

  mul-n:
    type: int
    required: true
    description: |
        PLLx multiplication factor (aka DIVN + 1) for VCO
        Valid range: 25 - 200

  div-p:
    type: int
    description: |
        PLLx_P division factor (aka DIVP + 1)
        Valid range: 1 - 128

  div-q:
    type: int
    description: |
        PLLx_Q division factor (aka DIVQ + 1)
        Valid range: 1 - 128

  div-r:
    type: int
    description: |
        PLLx_R division factor (aka DIVR + 1)
        Valid range: 1 - 128

  fracn:
    type: int
    description: |
        PLLx FRACV fractional latch
        Valid range: 0 - 8191
```

## dts/bindings/clock/st,stm32n6-cpu-clock-mux.yaml
```yaml
# Copyright (c) 2025, STMicroelectronics
# SPDX-License-Identifier: Apache-2.0

description: |
  STM32N6 CPU Clock.

  Describes the STM32N6 CPU clock multiplexer. On STM32N6, this is the CPU
  clock that feeds the SysTick.

  For instance:
  &cpusw {
    clocks = <&rcc STM32_SRC_IC1 CPU_SEL(3)>;
    clock-frequency = <DT_FREQ_M(600)>;
    status = "okay";
  };

compatible: "st,stm32n6-cpu-clock-mux"

include:
  - name: base.yaml
    property-allowlist:
      - status
      - compatible
      - clocks

properties:
  clock-frequency:
    required: true
    type: int
    description: |
      default frequency in Hz for CPU clock (sysa_ck/sys_cpu_ck)
```
