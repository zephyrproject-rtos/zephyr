## dts/bindings/clock/nordic,nrf53-oscillators.yaml
```yaml
# Copyright (c) 2024 Nordic Semiconductor ASA
# SPDX-License-Identifier: Apache-2.0

description: Nordic nRF53X OSCILLATORS (Oscillator Control)

compatible: "nordic,nrf53-oscillators"

include: base.yaml

properties:
  reg:
    required: true
```

## dts/bindings/clock/nordic,nrf54h-hfxo.yaml
```yaml
# Copyright (c) 2024 Nordic Semiconductor ASA
# SPDX-License-Identifier: Apache-2.0

description: Nordic nRF54H Series high-frequency crystal oscillator

compatible: "nordic,nrf54h-hfxo"

include: fixed-clock.yaml

properties:
  clock-frequency:
    const: 32000000

  accuracy-ppm:
    type: int
    description: Clock accuracy in parts per million
    required: true
```

## dts/bindings/clock/nordic,nrf54h-lfxo.yaml
```yaml
# Copyright (c) 2024 Nordic Semiconductor ASA
# SPDX-License-Identifier: Apache-2.0

description: Nordic nRF54H Series low-frequency crystal oscillator

compatible: "nordic,nrf54h-lfxo"

include: fixed-clock.yaml

properties:
  clock-frequency:
    const: 32768
```

## dts/bindings/clock/nordic,nrf54l-hfxo.yaml
```yaml
# Copyright (c) 2024 Nordic Semiconductor ASA
# SPDX-License-Identifier: Apache-2.0

description: Nordic nRF high-frequency crystal oscillator (nRF54L series)

compatible: "nordic,nrf54l-hfxo"

include: fixed-clock.yaml

properties:
  clock-frequency:
    const: 32000000

  startup-time-us:
    type: int
    required: true
    description: |
      Startup time in microseconds.

      The value can be obtained by first measuring the time between
      TASKS_XOSTART and EVENTS_XOTUNED. Then multiply the value by 2 to
      account for temperature and supply variations.

      Note that the startup time will be longer usual on the first
      power-up and as such should not be used to determine
      startup-time-us.

  load-capacitors:
    type: string
    enum:
      - "internal"
      - "external"
    description: |
      Type of load capacitors connected to the crystal. If not specified,
      adjustments may still happen when the device trimming happens during
      system initialization.

  load-capacitance-femtofarad:
    type: int
    enum:
      - 4000
      - 4250
      - 4500
      - 4750
      - 5000
      - 5250
      - 5500
      - 5750
      - 6000
      - 6250
      - 6500
      - 6750
      - 7000
      - 7250
      - 7500
      - 7750
      - 8000
      - 8250
      - 8500
      - 8750
      - 9000
      - 9250
      - 9500
      - 9750
      - 10000
      - 10250
      - 10500
      - 10750
      - 11000
      - 11250
      - 11500
      - 11750
      - 12000
      - 12250
      - 12500
      - 12750
      - 13000
      - 13250
      - 13500
      - 13750
      - 14000
      - 14250
      - 14500
      - 14750
      - 15000
      - 15250
      - 15500
      - 15750
      - 16000
      - 16250
      - 16500
      - 16750
      - 17000
    description: |
      Load capacitance in femtofarads. This property is only used when
      load-capacitors is set to "internal".
```

## dts/bindings/clock/nordic,nrf54l-lfxo.yaml
```yaml
# Copyright (c) 2024 Nordic Semiconductor ASA
# SPDX-License-Identifier: Apache-2.0

description: Nordic nRF low-frequency crystal oscillator (nRF54L series)

compatible: "nordic,nrf54l-lfxo"

include: fixed-clock.yaml

properties:
  clock-frequency:
    const: 32768

  load-capacitors:
    type: string
    enum:
      - "internal"
      - "external"
    description: |
      Type of load capacitors connected to the crystal. If not specified,
      adjustments may still happen when the device trimming happens during
      system initialization.

  load-capacitance-femtofarad:
    type: int
    description: |
      Load capacitance in femtofarads, holding any value between 3000 and 18000. Configured
      capacitance is within 650 fF tolerance from the desired setting.
      This property is only used when load-capacitors is set to "internal".

  external-clock-source:
    type: boolean
    description: |
      The LFXO is designed to work with an external rail-to-rail 32768
      Hz clock source applied directly to the XL1 pin, leaving the XL2
      unconnected, and internal load capacitor disabled.
```

## dts/bindings/clock/nordic,nrf71-hfxo.yaml
```yaml
# Copyright (c) 2026 Nordic Semiconductor ASA
# SPDX-License-Identifier: Apache-2.0

description: Nordic nRF high-frequency crystal oscillator (nRF71 series)

compatible: "nordic,nrf71-hfxo"

include: fixed-clock.yaml

properties:
  clock-frequency:
    const: 64000000

  startup-time-us:
    type: int
    required: true
    description: |
      Startup time in microseconds.

      The value can be obtained by first measuring the time between
      TASKS_XOSTART and EVENTS_STARTED. Then multiply the value by 2 to
      account for temperature and supply variations.

      Note that the startup time will be longer than usual on the first
      power-up and as such should not be used to determine
      startup-time-us.
```

## dts/bindings/clock/nordic,nrf71-lfxo.yaml
```yaml
# Copyright (c) 2024 Nordic Semiconductor ASA
# SPDX-License-Identifier: Apache-2.0

description: Nordic nRF low-frequency crystal oscillator (nRF71 series)

compatible: "nordic,nrf71-lfxo"

include: fixed-clock.yaml

properties:
  clock-frequency:
    const: 32768

  load-capacitors:
    type: string
    enum:
      - "internal"
      - "external"
    description: |
      Type of load capacitors connected to the crystal. If not specified,
      adjustments may still happen when the device trimming happens during
      system initialization.

  load-capacitance-femtofarad:
    type: int
    enum:
      - 0
      - 1000
      - 2000
      - 3000
      - 4000
      - 5000
      - 6000
      - 7000
      - 8000
      - 9000
      - 10000
      - 11000
      - 12000
      - 13000
      - 14000
      - 15000
      - 16000
      - 17000
      - 18000
      - 19000
      - 20000
      - 21000
      - 22000
      - 23000
      - 24000
      - 25000

    description: |
      Load capacitance in femtofarads. This property is only used when
      load-capacitors is set to "internal".
```

## dts/bindings/clock/nordic,nrfs-audiopll.yaml
```yaml
# Copyright (c) 2024 Nordic Semiconductor ASA
# SPDX-License-Identifier: Apache-2.0

description: Nordic NRFS AudioPLL clock

compatible: "nordic,nrfs-audiopll"

include: base.yaml

properties:
  frequency:
    type: int
    required: true
    description: |
      Initial frequency in Hertz.

      See zephyr/include/zephyr/dt-bindings/nrfs_audiopll.h for
      predefined frequencies.
```

## dts/bindings/clock/nuvoton,m4-hclk-clock.yaml
```yaml
# Copyright (c) 2026, Fiona Behrens
# SPDX-License-Identifier: Apache-2.0

description: Nuvoton M4 HXT Clock

compatible: "nuvoton,m4-hclk-clock"

include: [clock-controller.yaml, base.yaml]

properties:
  "#clock-cells":
    const: 0

  clock-frequency:
    type: int
    description: output clock frequency (Hz)
    required: true

  clocks:
    type: phandle-array
    required: true

  div:
    type: int
    description: |
      HCLK Divider from HCLK Clock Source

      Note: If the HCLK clock source is PLL the HCLK should not be equal to PLL/2, so in that case this should not be 2.
    enum:
      - 1
      - 2
      - 3
      - 4
      - 5
      - 6
      - 7
      - 8
      - 9
      - 10
      - 11
      - 12
      - 13
      - 14
      - 15
      - 16

  pclk0-div:
    type: int
    required: true
    description: |
      Divider for PCLK0 from the HCLK

      Note: PCLK must be less then 96MHz

    enum:
      - 1
      - 2
      - 4
      - 8
      - 16

  pclk1-div:
    type: int
    required: true
    description: |
      Divider for PCLK1 from the HCLK

      Note: PCLK must be less then 96MHz
    enum:
      - 1
      - 2
      - 4
      - 8
      - 16
```

## dts/bindings/clock/nuvoton,m4-hxt-clock.yaml
```yaml
# Copyright (c) 2026, Fiona Behrens
# SPDX-License-Identifier: Apache-2.0

description: Nuvoton M4 HXT Clock

compatible: "nuvoton,m4-hxt-clock"

include: [fixed-clock.yaml]

# TODO: Clock detector enable
```

## dts/bindings/clock/nuvoton,m4-lxt-clock.yaml
```yaml
# Copyright (c) 2026, Fiona Behrens
# SPDX-License-Identifier: Apache-2.0

description: Nuvoton M4 LXT Clock

compatible: "nuvoton,m4-lxt-clock"

include: [fixed-clock.yaml]

# TODO: Clock detector enable
```

## dts/bindings/clock/nuvoton,m4-pll-clock.yaml
```yaml
# Copyright (c) 2026, Fiona Behrens
# SPDX-License-Identifier: Apache-2.0

description: Nuvoton M4 PLL Clock

compatible: "nuvoton,m4-pll-clock"

include: [clock-controller.yaml, base.yaml]

properties:
  "#clock-cells":
    const: 0

  clocks:
    type: phandle-array
    required: true

# TODO: frequency override
# TODO: Power Down Mode
# TODO: Stable Counter selection
# TODO: Bypass controll
# TODO: outdiv, indiv, fbdiv overrides
```

## dts/bindings/clock/nuvoton,npcm-pcc.yaml
```yaml
# Copyright (c) 2024 Nuvoton Technology Corporation.
# SPDX-License-Identifier: Apache-2.0

description: |
  Nuvoton, NPCM PCC (Power and Clock Controller) node.
  Besides power management, this node is also in charge of configuring the
  Oscillator Frequency Multiplier Clock (OFMCLK), which is derived from
  High-Frequency Clock Generator (HFCG), is the source clock of Cortex-M4 core
  and most of NPCM hardware modules.

  Here is an example of configuring OFMCLK and the other clock sources derived
  from it in board dts file.
  &pcc {
      clock-frequency = <DT_FREQ_M(96)>; /* OFMCLK runs at 96MHz */
      core-prescaler = <1>; /* CORE_CLK runs at 96MHz */
      apb1-prescaler = <8>; /* APB1_CLK runs at 12MHz */
      apb2-prescaler = <1>; /* APB2_CLK runs at 96MHz */
      apb3-prescaler = <1>; /* APB3_CLK runs at 96MHz */
      apb6-prescaler = <1>; /* APB6_CLK runs at 96MHz */
      fiu-prescaler = <1>; /* FIU_CLK runs at 96MHz */
      i3c-prescaler = <1>; /* I3C_CLK runs at 96MHz */
  };

compatible: "nuvoton,npcm-pcc"

include: [clock-controller.yaml, base.yaml]

properties:
  reg:
    required: true

  clock-frequency:
    required: true
    type: int
    description: |
      Default frequency in Hz for HFCG output clock (OFMCLK). Currently,
      only the following values are allowed:
        100000000, 100 MHz
        96000000, 96 MHz
        80000000, 80 MHz
        66000000, 66 MHz
        50000000, 50 MHz
        48000000, 48 MHz
        40000000, 40 MHz
        33000000, 33 MHz
    enum:
      - 100000000
      - 96000000
      - 80000000
      - 66000000
      - 50000000
      - 48000000
      - 40000000
      - 33000000

  core-prescaler:
    type: int
    required: true
    description: |
      Core clock prescaler (FPRED). It sets the Core frequency, CORE_CLK, by
      dividing OFMCLK(MCLK) and needs to meet the following requirements.
      - The maximum CLK frequency is either the MCLK frequency divided by 1 or 100 MHz.
      - Only the following values are allowed:
        1, CORE_CLK = OFMCLK
        2, CORE_CLK = OFMCLK / 2
        3, CORE_CLK = OFMCLK / 3
        4, CORE_CLK = OFMCLK / 4
        5, CORE_CLK = OFMCLK / 5
        6, CORE_CLK = OFMCLK / 6
        7, CORE_CLK = OFMCLK / 7
        8, CORE_CLK = OFMCLK / 8
        9, CORE_CLK = OFMCLK / 9
        10, CORE_CLK = OFMCLK / 10
    enum:
      - 1
      - 2
      - 3
      - 4
      - 5
      - 6
      - 7
      - 8
      - 9
      - 10

  apb1-prescaler:
    type: int
    required: true
    description: |
      APB1 prescaler. It sets the APB1 bus frequency, APB1_CLK, by dividing
      OFMCLK(MCLK) and needs to meet the following requirements.
      - The maximum APB1_CLK frequency is either the MCLK frequency divided by 1 or 100 MHz.
      - Only the following values are allowed:
        1, APB1_CLK = OFMCLK
        2, APB1_CLK = OFMCLK / 2
        3, APB1_CLK = OFMCLK / 3
        4, APB1_CLK = OFMCLK / 4
        5, APB1_CLK = OFMCLK / 5
        6, APB1_CLK = OFMCLK / 6
        7, APB1_CLK = OFMCLK / 7
        8, APB1_CLK = OFMCLK / 8
        9, APB1_CLK = OFMCLK / 9
        10, APB1_CLK = OFMCLK / 10
    enum:
      - 1
      - 2
      - 3
      - 4
      - 5
      - 6
      - 7
      - 8
      - 9
      - 10

  apb2-prescaler:
    type: int
    required: true
    description: |
      APB2 prescaler. It sets the APB2 bus frequency, APB2_CLK, by dividing
      OFMCLK(MCLK) and needs to meet the following requirements.
      - The maximum APB2_CLK frequency is either the MCLK frequency divided by 1 or 100 MHz.
      - Only the following values are allowed:
        1, APB2_CLK = OFMCLK
        2, APB2_CLK = OFMCLK / 2
        3, APB2_CLK = OFMCLK / 3
        4, APB2_CLK = OFMCLK / 4
        5, APB2_CLK = OFMCLK / 5
        6, APB2_CLK = OFMCLK / 6
        7, APB2_CLK = OFMCLK / 7
        8, APB2_CLK = OFMCLK / 8
        9, APB2_CLK = OFMCLK / 9
        10, APB2_CLK = OFMCLK / 10
    enum:
      - 1
      - 2
      - 3
      - 4
      - 5
      - 6
      - 7
      - 8
      - 9
      - 10

  apb3-prescaler:
    type: int
    required: true
    description: |
      APB3 prescaler. It sets the APB3 bus frequency, APB3_CLK, by dividing
      OFMCLK(MCLK) and needs to meet the following requirements.
      - The maximum APB3_CLK frequency is either the MCLK frequency divided by 1 or 100 MHz.
      - Only the following values are allowed:
        1, APB3_CLK = OFMCLK
        2, APB3_CLK = OFMCLK / 2
        3, APB3_CLK = OFMCLK / 3
        4, APB3_CLK = OFMCLK / 4
        5, APB3_CLK = OFMCLK / 5
        6, APB3_CLK = OFMCLK / 6
        7, APB3_CLK = OFMCLK / 7
        8, APB3_CLK = OFMCLK / 8
        9, APB3_CLK = OFMCLK / 9
        10, APB3_CLK = OFMCLK / 10
    enum:
      - 1
      - 2
      - 3
      - 4
      - 5
      - 6
      - 7
      - 8
      - 9
      - 10

  ahb6-prescaler:
    type: int
    required: true
    description: |
      AHB6 prescaler. The AHB6 bus clock (AHB6_CLK) is derived from the Core clock (CLK) via a
      programmable divider controlled by the AHB6DIV field in HFCGP register.
      Its frequency must be set according to the following rules:
      - The maximum AHB6_CLK frequency is either the CLK frequency divided by 1 or 100 MHz.
      - Only the following values are allowed:
        1, AHB6_CLK = CORE_CLK
        2, AHB6_CLK = CORE_CLK / 2
        4, AHB6_CLK = CORE_CLK / 4
    enum:
      - 1
      - 2
      - 4

  fiu-prescaler:
    type: int
    required: true
    description: |
      FIU prescaler. The FIU clock (FIUCLK) is derived from the Core clock (CLK) via a
      programmable divider controlled by the FIUDIV field in HFCBCD1 register.
      Its frequency must be set according to the following rules:
      - The maximum FIUCLK frequency is either the CLK frequency divided by 1 or 100MHz.
      - Only the following values are allowed:
        1, FIU_CLK = CORE_CLK
        2, FIU_CLK = CORE_CLK / 2
        4, FIU_CLK = CORE_CLK / 4
    enum:
      - 1
      - 2
      - 4

  i3c-prescaler:
    type: int
    required: true
    description: |
      I3C prescaler. It sets the I3C clk_slow_tc frequency, by dividing
      APB3_CLK and it can be up to 100 MHz.
    enum:
      - 1
      - 2
      - 4

clock-cells:
  - clk_id
```
