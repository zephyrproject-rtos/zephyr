## dts/bindings/clock/nuvoton,npcx-pcc.yaml
```yaml
# Copyright (c) 2020 Nuvoton Technology Corporation.
# SPDX-License-Identifier: Apache-2.0

description: |
  Nuvoton, NPCX PCC (Power and Clock Controller) node.
  Besides power management, this node is also in charge of configuring the
  Oscillator Frequency Multiplier Clock (OFMCLK), which is derived from
  High-Frequency Clock Generator (HFCG), is the source clock of Cortex-M4 core
  and most of NPCX hardware modules.

  Here is an example of configuring OFMCLK and the other clock sources derived
  from it in board dts file.
  &pcc {
      clock-frequency = <DT_FREQ_M(100)>; /* OFMCLK runs at 100MHz */
      core-prescaler = <5>; /* CORE_CLK runs at 20MHz */
      apb1-prescaler = <5>; /* APB1_CLK runs at 20MHz */
      apb2-prescaler = <5>; /* APB2_CLK runs at 20MHz */
      apb3-prescaler = <5>; /* APB3_CLK runs at 20MHz */
  };

compatible: "nuvoton,npcx-pcc"

include: [clock-controller.yaml, base.yaml]

properties:
    reg:
        required: true

    clock-frequency:
        required: true
        type: int
        description: |
          Default frequency in Hz for HFCG output clock (OFMCLK). Currently,
          only the following values are allowed:
            100000000, 100 MHz
            96000000, 96 MHz
            90000000, 90 MHz
            80000000, 80 MHz
            66000000, 66 MHz
            50000000, 50 MHz
            48000000, 48 MHz
            40000000, 40 MHz (default value after reset)
            33000000, 33 MHz
        enum:
          - 100000000
          - 96000000
          - 90000000
          - 80000000
          - 66000000
          - 50000000
          - 48000000
          - 40000000
          - 33000000

    core-prescaler:
        type: int
        required: true
        description: |
          Core clock prescaler (FPRED). It sets the Core frequency, CORE_CLK, by
          dividing OFMCLK(MCLK) and needs to meet the following requirements.
          - CORE_CLK must be set to 4MHz <= CORE_CLK <= 100MHz.
          = Only the following values are allowed:
            1, CORE_CLK = OFMCLK
            2, CORE_CLK = OFMCLK / 2
            3, CORE_CLK = OFMCLK / 3
            4, CORE_CLK = OFMCLK / 4
            5, CORE_CLK = OFMCLK / 5
            6, CORE_CLK = OFMCLK / 6
            7, CORE_CLK = OFMCLK / 7
            8, CORE_CLK = OFMCLK / 8
            9, CORE_CLK = OFMCLK / 9
            10, CORE_CLK = OFMCLK / 10
        enum:
          - 1
          - 2
          - 3
          - 4
          - 5
          - 6
          - 7
          - 8
          - 9
          - 10

    apb1-prescaler:
        type: int
        required: true
        description: |
          APB1 prescaler. It sets the APB1 bus frequency, APB1_CLK, by dividing
          OFMCLK(MCLK) and needs to meet the following requirements.
          - APB1_CLK must be set to 4MHz <= APB1_CLK <= 50MHz.
          - APB1_CLK must be an integer division (including 1) of CORE_CLK.
          = Only the following values are allowed:
            1, APB1_CLK = OFMCLK
            2, APB1_CLK = OFMCLK / 2
            3, APB1_CLK = OFMCLK / 3
            4, APB1_CLK = OFMCLK / 4
            5, APB1_CLK = OFMCLK / 5
            6, APB1_CLK = OFMCLK / 6
            7, APB1_CLK = OFMCLK / 7
            8, APB1_CLK = OFMCLK / 8
            9, APB1_CLK = OFMCLK / 9
            10, APB1_CLK = OFMCLK / 10
        enum:
          - 1
          - 2
          - 3
          - 4
          - 5
          - 6
          - 7
          - 8
          - 9
          - 10

    apb2-prescaler:
        type: int
        required: true
        description: |
          APB2 prescaler. It sets the APB2 bus frequency, APB2_CLK, by dividing
          OFMCLK(MCLK) and needs to meet the following requirements.
          - APB2_CLK must be set to 8MHz <= APB2_CLK <= 50MHz.
          - APB2_CLK must be an integer division (including 1) of CORE_CLK.
          = Only the following values are allowed:
            1, APB2_CLK = OFMCLK
            2, APB2_CLK = OFMCLK / 2
            3, APB2_CLK = OFMCLK / 3
            4, APB2_CLK = OFMCLK / 4
            5, APB2_CLK = OFMCLK / 5
            6, APB2_CLK = OFMCLK / 6
            7, APB2_CLK = OFMCLK / 7
            8, APB2_CLK = OFMCLK / 8
            9, APB2_CLK = OFMCLK / 9
            10, APB2_CLK = OFMCLK / 10
        enum:
          - 1
          - 2
          - 3
          - 4
          - 5
          - 6
          - 7
          - 8
          - 9
          - 10

    apb3-prescaler:
        type: int
        required: true
        description: |
          APB3 prescaler. It sets the APB3 bus frequency, APB3_CLK, by dividing
          OFMCLK(MCLK) and needs to meet the following requirements.
          - APB3_CLK must be set to 12.5MHz <= APB3_CLK <= 50MHz.
          - APB3_CLK must be an integer division (including 1) of CORE_CLK.
          = Only the following values are allowed:
            1, APB3_CLK = OFMCLK
            2, APB3_CLK = OFMCLK / 2
            3, APB3_CLK = OFMCLK / 3
            4, APB3_CLK = OFMCLK / 4
            5, APB3_CLK = OFMCLK / 5
            6, APB3_CLK = OFMCLK / 6
            7, APB3_CLK = OFMCLK / 7
            8, APB3_CLK = OFMCLK / 8
            9, APB3_CLK = OFMCLK / 9
            10, APB3_CLK = OFMCLK / 10
        enum:
          - 1
          - 2
          - 3
          - 4
          - 5
          - 6
          - 7
          - 8
          - 9
          - 10

    apb4-prescaler:
        type: int
        required: false
        description: |
          APB4 prescaler. It sets the APB4 bus frequency, APB4_CLK, by dividing
          OFMCLK(MCLK) and needs to meet the following requirements.
          - APB4_CLK must be set to 8MHz <= APB4_CLK <= 50MHz.
          - APB4_CLK must be an integer division (including 1) of CORE_CLK.
          = Only the following values are allowed:
            1, APB4_CLK = OFMCLK
            2, APB4_CLK = OFMCLK / 2
            3, APB4_CLK = OFMCLK / 3
            4, APB4_CLK = OFMCLK / 4
            5, APB4_CLK = OFMCLK / 5
            6, APB4_CLK = OFMCLK / 6
            7, APB4_CLK = OFMCLK / 7
            8, APB4_CLK = OFMCLK / 8
            9, APB4_CLK = OFMCLK / 9
            10, APB4_CLK = OFMCLK / 10
        enum:
          - 1
          - 2
          - 3
          - 4
          - 5
          - 6
          - 7
          - 8
          - 9
          - 10

    ram-pd-depth:
        required: false
        type: int
        enum:
          - 12
          - 15
        description: |
          Valid bit-depth of RAM block Power-Down control (RAM_PD) registers.
          Each bit in RAM_PDn can power down the relevant RAM block by setting
          itself to 1 for better power consumption and this valid bit-depth
          varies in different NPCX series.

clock-cells:
    - bus
    - ctl
    - bit
```

## dts/bindings/clock/nuvoton,numaker-pcc.yaml
```yaml
# Copyright (c) 2023 Nuvoton Technology Corporation
# SPDX-License-Identifier: Apache-2.0

description: Nuvoton NuMaker Peripheral Clock Controller (PCC)

compatible: "nuvoton,numaker-pcc"

include: [clock-controller.yaml, base.yaml]

properties:
  "#clock-cells":
    const: 3

clock-cells:
  - clock-module-index  # Same as u32ModuleIdx on invoking BSP CLK driver CLK_SetModuleClock()
  - clock-source        # Same as u32ClkSrc on invoking BSP CLK driver CLK_SetModuleClock()
  - clock-divider       # Same as u32ClkDiv on invoking BSP CLK driver CLK_SetModuleClock()
```

## dts/bindings/clock/nuvoton,numaker-scc.yaml
```yaml
# Copyright (c) 2023 Nuvoton Technology Corporation
# SPDX-License-Identifier: Apache-2.0

description: Nuvoton NuMaker System Clock Controller (SCC)

compatible: "nuvoton,numaker-scc"

include: [clock-controller.yaml, base.yaml]

properties:
  reg:
    required: true

  hxt:
    type: string
    description: |
      Enable/disable 4~24 MHz external crystal oscillator (HXT)
    enum:
      - "untouched"
      - "enable"
      - "disable"

  lxt:
    type: string
    description: |
      Enable/disable 32.768 kHz low-speed external crystal oscillator (LXT)
    enum:
      - "untouched"
      - "enable"
      - "disable"

  hirc48m:
    type: string
    description: |
      Enable/disable 48 MHz high-speed internal RC oscillator (HIRC48)
    enum:
      - "untouched"
      - "enable"
      - "disable"

  clk-pclkdiv:
    type: int
    description: |
      Configure APB Clock Divider register

  core-clock:
    type: int
    description: |
      Configure core clock (HCLK)

  powerdown-mode:
    type: int
    description: |
      Configure power down mode, please choose one of NUMAKER_CLK_PMUCTL_PDMSEL_XXX
      from numaker_xxx_clock.h
```

## dts/bindings/clock/nuvoton,numicro-m4-pcc.yaml
```yaml
# Copyright (c) 2026, Fiona Behrens
# SPDX-License-Identifier: Apache-2.0

description: Nuvoton NuMicro M4 Peripheral Clock Controller (PCC)

compatible: "nuvoton,numicro-m4-pcc"

include: [clock-controller.yaml, base.yaml]

properties:
  "#clock-cells":
    const: 3

clock-cells:
  - clock-module-index
  - clock-source
  - clock-divider
```

## dts/bindings/clock/nuvoton,numicro-m4-scc.yaml
```yaml
# Copyright (c) 2026, Fiona Behrens
# SPDX-License-Identifier: Apache-2.0

description: |
  Nuvoton NuMicro SCC (System Clock Controller).

compatible: "nuvoton,numicro-m4-scc"

include: [clock-controller.yaml, base.yaml]

properties:
  reg:
    required: true

  flash-access-cycles:
    type: int
    description: |
      Specifies the flash CPU access wait cycles. If left undefined a default is caluclated from the HCLK speed.

      See FMC_CYCTL register for more informations about optimal values
    enum:
      - 0
      - 1
      - 2
      - 3
      - 4
      - 5
      - 6
      - 7
      - 8
```

## dts/bindings/clock/nxp,clock-div.yaml
```yaml
# Copyright 2023 NXP
# SPDX-License-Identifier: Apache-2.0

description: |
  NXP clock divider. The parent node of a divider will be the clock source
  this divider applies to.


compatible: "nxp,clock-div"

include: [clock-controller.yaml, base.yaml]

properties:
  div:
    type: int
    required: true
    description: |
      Divider for clock source. A value of 1 indicates the clock will not be
      divided.

  "#clock-cells":
    const: 0
```

## dts/bindings/clock/nxp,clock-gate.yaml
```yaml
# Copyright 2023 NXP
# SPDX-License-Identifier: Apache-2.0

description: NXP Clock Gate.


compatible: "nxp,lpc-syscon-gate"

include: [clock-controller.yaml, base.yaml]

properties:
  "#clock-cells":
    const: 0
```

## dts/bindings/clock/nxp,clock-multipler.yaml
```yaml
# Copyright 2023 NXP
# SPDX-License-Identifier: Apache-2.0

description: |
  NXP clock multipler. The parent node of a multipler will be the clock source
  this multipler applies to.


compatible: "nxp,clock-multiplier"

include: [clock-controller.yaml, base.yaml]

properties:
  mult:
    type: int
    required: true
    description: |
      Multiplier for clock source. A value of 1 indicates the clock will not be
      multiplied.

  "#clock-cells":
    const: 0
```

## dts/bindings/clock/nxp,clock-mux.yaml
```yaml
# Copyright 2023 NXP
# SPDX-License-Identifier: Apache-2.0

description: NXP clock multiplexor definition

compatible: "nxp,clock-mux"

include: [clock-controller.yaml, base.yaml]

properties:
  input-sources:
    type: phandles
    required: true
    description: |
      MUX input source options. Each of the input sources may be a div node,
      mux node, or fixed clock node.
  sel:
    type: phandle
    required: true
    description: |
      MUX source selection. This should be set to one of the phandles within
      the "input-sources" property, and determines which clock source this mux
      will use.

  "#clock-cells":
    const: 0
```

## dts/bindings/clock/nxp,clock-pll.yaml
```yaml
# Copyright 2023 NXP
# SPDX-License-Identifier: Apache-2.0

description: NXP PLL Definition

compatible: "nxp,clock-pll"

include: [clock-controller.yaml, base.yaml]

properties:
  mult:
    type: int
    description: |
      PLL multiplier factor. The PLL output frequency
      will be multiplied by this value

  div:
    type: int
    description: |
      PLL division factor. The PLL output frequency
      will be divided by this value

  "#clock-cells":
    const: 0
```

## dts/bindings/clock/nxp,firc.yaml
```yaml
# Copyright 2025 NXP
# SPDX-License-Identifier: Apache-2.0

description: Fast internal RC oscillator

compatible: "nxp,firc"

include: [base.yaml]

properties:
  reg:
    required: true

  firc-div:
    required: true
    type: string
    description: FIRC_DIV_SEL
    enum: ["NULL", "DivBy2", "DivBy16", "UnDiv"]
```

## dts/bindings/clock/nxp,fxosc.yaml
```yaml
# Copyright 2025 NXP
# SPDX-License-Identifier: Apache-2.0

description: Fast external crystal oscillator

compatible: "nxp,fxosc"

include: [base.yaml]

properties:
  reg:
    required: true

  freq:
    required: true
    type: int
    description: FXOSC output clock frequency in Hz

  workmode:
    required: true
    type: string
    description: FXOSC work mode setting
    enum: ["crystal", "bypass"]

  delay:
    required: true
    type: int
    description: FXOSC startup delay in counts

  overdrive:
    required: true
    type: int
    description: FXOSC overdrive protection setting
```
