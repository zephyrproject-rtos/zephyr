## dts/bindings/clock/raspberrypi,pico-clock.yaml
```yaml
# Copyright (c) 2023 TOKITA Hiroshi
# SPDX-License-Identifier: Apache-2.0

description: |
  The representation of Raspberry Pi Pico's clock

compatible: "raspberrypi,pico-clock"

include: fixed-clock.yaml

properties:
  clocks:
    type: phandle-array
    description: Clock gate information

  clock-names:
    type: string-array
    description: name of each clock
```

## dts/bindings/clock/raspberrypi,pico-clocks.yaml
```yaml
# Copyright (c) 2022 Andrei-Edward Popa
# SPDX-License-Identifier: Apache-2.0

description: Raspberry Pi Pico clock controller node

compatible: "raspberrypi,pico-clocks"

include: [base.yaml, clock-controller.yaml]

properties:
  reg:
    required: true

  ref-frequency:
    type: int
    description: Frequency for clk-ref
    required: true

  sys-frequency:
    type: int
    description: Frequency for clk-sys
    required: true

  peri-frequency:
    type: int
    description: Frequency for clk-peri
    required: true

  usb-frequency:
    type: int
    description: Frequency for clk-usb
    required: true

  adc-frequency:
    type: int
    description: Frequency for clk-adc
    required: true

  rtc-frequency:
    type: int
    description: Frequency for clk-rtc
    required: true

  "#clock-cells":
    const: 1

clock-cells:
  - clk-id
```

## dts/bindings/clock/raspberrypi,pico-pll.yaml
```yaml
# Copyright (c) 2023 TOKITA Hiroshi
# SPDX-License-Identifier: Apache-2.0

description: |
  The representation of Raspberry Pi Pico's PLL.

compatible: "raspberrypi,pico-pll"

include: [base.yaml, fixed-factor-clock.yaml]

properties:
  fb-div:
    type: int
    required: true
    description: |
      The feedback divider value.
    min: 16
    max: 320

  post-div1:
    type: int
    required: true
    description: |
      The post clock divider.
    min: 1
    max: 49

  post-div2:
    type: int
    required: true
    description: |
      The post clock divider.
    min: 1
    max: 49
```

## dts/bindings/clock/raspberrypi,pico-rosc.yaml
```yaml
# Copyright (c) 2023 TOKITA Hiroshi
# SPDX-License-Identifier: Apache-2.0

description: |
  The representation of Raspberry Pi Pico ring oscillator.

compatible: "raspberrypi,pico-rosc"

include: [fixed-clock.yaml, fixed-factor-clock.yaml]

properties:
  range:
    type: int
    required: true
    description: |
      Specify the number of ring oscillator stages to use.
        - LOW: 8 (default)
        - MEDIUM: 6
        - HIGH: 4
        - TOOHIGH: 2

  stage-drive-strength:
    type: array
    required: true
    description: |
      Specifies the drive strength of the eight stages of the ring oscillator.
      The valid range of each value is between 0 and 7.

  phase-flip:
    type: boolean
    description: |
      Flipping phase-shifter output.

  phase:
    type: int
    description: |
      The phase-shift value.
      The valid range is 0 to 3
```

## dts/bindings/clock/raspberrypi,pico-xosc.yaml
```yaml
# Copyright (c) 2024 Xudong Zheng
# SPDX-License-Identifier: Apache-2.0

description: |
  The representation of Raspberry Pi Pico external oscillator

compatible: "raspberrypi,pico-xosc"

include: raspberrypi,pico-clock.yaml

properties:
  startup-delay-multiplier:
    type: int
    default: 6
    description: |
      Startup delay multiplier. The default value matches the Pico SDK used
      as the basis for hal_rpi_pico (currently v2.1.1).
```

## dts/bindings/clock/realtek,ameba-rcc.yaml
```yaml
# Copyright (c) 2026 Realtek Semiconductor Corp.
# SPDX-License-Identifier: Apache-2.0

description: |
  Ameba Reset and Clock controller node

compatible: "realtek,ameba-rcc"

include: [clock-controller.yaml, base.yaml]

properties:
  reg:
    required: true

  "#clock-cells":
    const: 1

clock-cells:
  - idx
```

## dts/bindings/clock/realtek,bee-cctl.yaml
```yaml
# Copyright (c) 2026, Realtek Semiconductor Corporation
# SPDX-License-Identifier: Apache-2.0

description: |
  Bee clock controller.
  To specify the clocks in a peripheral, the standard clocks property needs
  to be used, e.g.:

    gpioa: gpio@xxx {
        ...
        /* cell encodes related clock bit for specified peripheral */
        clocks = <&cctl APB_CLK(GPIOA)>;
        ...
    }

  Predefined clock cells are available in
  include/zephyr/dts-bindings/clock/rtlxxxx-clocks.h header files.

compatible: "realtek,bee-cctl"

include: [clock-controller.yaml, base.yaml]

properties:
  "#clock-cells":
    const: 1

clock-cells:
  - id
```

## dts/bindings/clock/realtek,rts5817-clock.yaml
```yaml
# Copyright (c) 2024 Realtek Semiconductor, Inc.
# SPDX-License-Identifier: Apache-2.0

description: Realtek RTS5817 clock

compatible: "realtek,rts5817-clock"

include: [clock-controller.yaml, base.yaml]

properties:
  reg:
    required: true

  "#clock-cells":
    const: 1

clock-cells:
  - clkid
```

## dts/bindings/clock/realtek,rts5912-sccon.yaml
```yaml
# SPDX-License-Identifier: Apache-2.0
#
# Copyright (c) 2024 Realtek Semiconductor Corporation, SIBG-SD7
#

description: Realtek RTS5912 System Clock Controller (SCCON)

compatible: "realtek,rts5912-sccon"

include: [clock-controller.yaml, base.yaml]

properties:
  reg:
    required: true

  "#clock-cells":
    const: 2

clock-cells:
  - clk-grp
  - clk-idx
```

## dts/bindings/clock/refsoc,clock-control.yaml
```yaml
#
# Copyright (c) 2018, Linaro Limited
#
# SPDX-License-Identifier: Apache-2.0
#
---
title: Reference SOC Clock control
type: clock-control
version: 0.1

description: >
    This binding gives a base representation of the Reference SoC Clock control

properties:
    compatible:
      type: string
      category: required
      description: compatible strings
      constraint: "refsoc,clock-control"
      generation: define

    reg:
      type: array
      description: mmio register space
      generation: define
      category: required

"#cells":
  - bus
  - bits

...
```

## dts/bindings/clock/renesas,r8a7795-cpg-mssr.yaml
```yaml
# Copyright (c) 2022, IoT.bzh
# SPDX-License-Identifier: Apache-2.0

description: Renesas R8A7795 SoC Clock Pulse Generator / Module Standby and Software Reset

compatible: "renesas,r8a7795-cpg-mssr"

include: renesas,rcar-cpg-mssr.yaml
```

## dts/bindings/clock/renesas,r8a779f-cpg-mssr.yaml
```yaml
# Copyright (c) 2023 EPAM Systems
# SPDX-License-Identifier: Apache-2.0

description: Renesas R8A779F SoC Clock Pulse Generator / Module Standby and Software Reset

compatible: "renesas,r8a779f-cpg-mssr"

include: renesas,rcar-cpg-mssr.yaml
```

## dts/bindings/clock/renesas,r8a779f0-cpg-mssr.yaml
```yaml
# Copyright (c) 2023 EPAM Systems
# SPDX-License-Identifier: Apache-2.0

description: Renesas R8A779F0 SoC Clock Pulse Generator / Module Standby and Software Reset

compatible: "renesas,r8a779f0-cpg-mssr"

include: renesas,rcar-cpg-mssr.yaml
```

## dts/bindings/clock/renesas,ra-cgc-busclk.yaml
```yaml
# Copyright (c) 2024 Renesas Electronics Corporation
# SPDX-License-Identifier: Apache-2.0

description: Renesas RA External Bus Clock

compatible: "renesas,ra-cgc-busclk"

include: [clock-controller.yaml, base.yaml]

properties:
  clk-out-div:
    type: int
    enum:
    - 0
    - 1
    - 2
    description: |
      Select EBCLK division ratio from BCLK
      - 0: disable
      - 1: EBCLK div/1
      - 2: EBCLK div/2

  sdclk:
    type: int
    enum:
    - 0
    - 1
    description: |
      SDCLK enable or disable
      - 0: disable
      - 1: enable
```

## dts/bindings/clock/renesas,ra-cgc-external-clock.yaml
```yaml
# Copyright (c) 2024 Renesas Electronics Corporation
# SPDX-License-Identifier: Apache-2.0

description: Renesas RA Clock Generation Circuit external clock configuration

compatible: "renesas,ra-cgc-external-clock"

include: [fixed-clock.yaml, base.yaml]

properties:
  mosel:
    type: int
    default: 0
    enum:
      - 0
      - 1
    description: |
      Choose the way for external Clock Oscillator supply
      0: Resonator
      1: External clock input
```

## dts/bindings/clock/renesas,ra-cgc-pclk-block.yaml
```yaml
# Copyright (c) 2024 Renesas Electronics Corporation
# SPDX-License-Identifier: Apache-2.0

description: Renesas RA Clock Control node pclk block

compatible: "renesas,ra-cgc-pclk-block"

include: [clock-controller.yaml, base.yaml]

properties:
  sysclock-src:
    required: true
    type: int
```

## dts/bindings/clock/renesas,ra-cgc-pclk.yaml
```yaml
# Copyright (c) 2024 Renesas Electronics Corporation
# SPDX-License-Identifier: Apache-2.0

description: Renesas RA Clock Control Peripheral Clock

compatible: "renesas,ra-cgc-pclk"

include: [clock-controller.yaml, base.yaml]

properties:
  clk-src:
    type: int

  clk-div:
    type: int
    required: true
    description: Prescale divider to calculate the subclock frequency from the
                 system clock frequency.

  "#clock-cells":
    const: 2

clock-cells:
  - mstp
  - stop_bit
```

## dts/bindings/clock/renesas,ra-cgc-pll-out.yaml
```yaml
# Copyright (c) 2024 Renesas Electronics Corporation
# SPDX-License-Identifier: Apache-2.0

description: Renesas RA Clock Generation Circuit PLL Clock out line

compatible: "renesas,ra-cgc-pll-out"

include: [clock-controller.yaml, base.yaml]

properties:
  div:
    required: true
    type: int
  freq:
    required: true
    type: int

  "#clock-cells":
    const: 0
```

## dts/bindings/clock/renesas,ra-cgc-pll.yaml
```yaml
# Copyright (c) 2024 Renesas Electronics Corporation
# SPDX-License-Identifier: Apache-2.0

description: Renesas RA Clock Generation Circuit PLL Clock

compatible: "renesas,ra-cgc-pll"

include: [clock-controller.yaml, base.yaml]

properties:
  clocks:
    required: true
  div:
    required: true
    type: int
  mul:
    required: true
    type: array

  "#clock-cells":
    const: 0
```

## dts/bindings/clock/renesas,ra-cgc-pllrtc.yaml
```yaml
# Copyright (c) 2025 Renesas Electronics Corporation
# SPDX-License-Identifier: Apache-2.0

description: Renesas RA Clock Generation Circuit PLLRTC Clock

compatible: "renesas,ra-cgc-pllrtc"

include: [clock-controller.yaml, base.yaml]

properties:
  clocks:
    required: true
  mul:
    required: true
    type: array

  "#clock-cells":
    const: 0
```

## dts/bindings/clock/renesas,ra-cgc-subclk.yaml
```yaml
# Copyright (c) 2024 Renesas Electronics Corporation
# SPDX-License-Identifier: Apache-2.0

description: Renesas RA Sub-Clock

compatible: "renesas,ra-cgc-subclk"

include: fixed-clock.yaml

properties:
  drive-capability:
    type: int
    default: 0
    enum:
    - 0
    - 1
    - 2
    - 3
    description: |
      Sub-Clock Oscillator Drive Capability Switching
      - 0: Standard (12.5pf)
      - 1: Lowpower mode 1 (9pf)
      - 2: Lowpower mode 2 (7pf)
      - 3: Lowpower mode 3 (4pf)

  stabilization-time:
    type: int
    default: 1000
    description: |
      Sub-Clock stabilization time in micro seconds
```

## dts/bindings/clock/renesas,ra-cgc-utasel.yaml
```yaml
# Copyright (c) 2025 Renesas Electronics Corporation
# SPDX-License-Identifier: Apache-2.0

description: Renesas RA Clock Generation Circuit UTASEL Clock

compatible: "renesas,ra-cgc-utasel"

include: [clock-controller.yaml, base.yaml]

properties:
  clocks:
    required: true

  "#clock-cells":
    const: 0
```

## dts/bindings/clock/renesas,ra-clock-generation-circuit.yaml
```yaml
# Copyright (c) 2023 TOKITA Hiroshi <tokita.hiroshi@fujitsu.com>
# SPDX-License-Identifier: Apache-2.0

description: Renesas RA series Clock Generation Circuit

compatible: "renesas,ra-clock-generation-circuit"

include: [clock-controller.yaml, base.yaml]

properties:
  reg:
    required: true

  iclk-div:
    type: int
    description: Division factor for ICLK

  fclk-div:
    type: int
    description: Division factor for FCLK

  pclka-div:
    type: int
    description: Division factor for PCLKA

  pclkb-div:
    type: int
    description: Division factor for PCLKB

  pclkc-div:
    type: int
    description: Division factor for PCLKC

  pclkd-div:
    type: int
    description: Division factor for PCLKD

  clock-source:
    type: phandle
    description: System clock source

  "#clock-cells":
    const: 1

clock-cells:
  - id
```

## dts/bindings/clock/renesas,ra2-common-osc.yaml
```yaml
# Copyright (c) 2023-2024 MUNIC SA
# SPDX-License-Identifier: Apache-2.0
#
# Common fields for R2L clocks

properties:
  clock-source:
    type: boolean
    description: |
      Defines that the clock (aka 'oscillator' in the datasheet) is the source
      for the others clock generators
```

## dts/bindings/clock/renesas,ra2-hoco-osc.yaml
```yaml
# Copyright (c) 2023-2024 MUNIC SA
# SPDX-License-Identifier: Apache-2.0

description: RA2 High-speed on-chip oscillator

compatible: "renesas,ra2-hoco-osc"

include: ["renesas,ra2-root-osc.yaml"]

properties:
  clock-frequency:
    enum:
      - 24000000
      - 32000000
      - 48000000
      - 64000000

  enable-after-reset:
    type: boolean
    description: |
      Enable HOCO oscillation after a reset
```
