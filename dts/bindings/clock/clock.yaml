## dts/bindings/clock/clock.yaml
```yaml
#
# Copyright (c) 2019, Linaro Limited
#
# SPDX-License-Identifier: Apache-2.0
#

title: Clock Controller Base Structure

description: >
    This binding gives the base structure for all Clock Controller devices

properties:
    "#clock-cells":
      type: int
      category: required
      description: Number of items to expect in a Clock specifier
```

## dts/bindings/clock/elan,em32-ahb.yaml
```yaml
# Copyright (c) 2025 Elan Microelectronics Corp.
# SPDX-License-Identifier: Apache-2.0

description: |
  Elan EM32 AHB Clock Controller.

  The clock specifier has one cell, gate-id, which selects the peripheral
  clock gate to control. Gate IDs are defined in
  include/zephyr/dt-bindings/clock/em32_clock.h.

compatible: "elan,em32-ahb"

include: [base.yaml, clock-controller.yaml]

properties:
  clock-source:
    type: int
    description: ID of output clock source
    required: true

  clock-frequency:
    type: int
    description: ID of output clock frequency
    required: true

  clock-divider:
    type: int
    description: ID of output clock divider
    required: true

  "#clock-cells":
    const: 1

clock-cells:
  - gate-id

examples:
  - |
    clk_ahb: clk-ahb {
        compatible = "elan,em32-ahb";
        #clock-cells = <1>;
        clock-source = <EM32_CLK_SRC_IRCHIGH>;
        clock-frequency = <EM32_CLK_FREQ_IRCHIGH96>;
        clock-divider = <EM32_AHB_CLK_DIV1>;
        status = "okay";
    };

    gpioa: gpio@40004000 {
        compatible = "elan,em32-gpio";
        reg = <0x40004000 0x1000>;
        clocks = <&clk_ahb EM32_GATE_HCLKG_GPIOA>;
        status = "okay";
    };
```

## dts/bindings/clock/elan,em32-apb.yaml
```yaml
# Copyright (c) 2025 Elan Microelectronics Corp.
# SPDX-License-Identifier: Apache-2.0

description: |
  Elan EM32 APB Clock Controller.

  The clock specifier has one cell, gate-id, which selects the APB
  peripheral clock gate. Use EM32_GATE_NONE as gate-id when only a parent
  clock reference is needed and no hardware gate exists.

compatible: "elan,em32-apb"

include: [base.yaml, clock-controller.yaml]

properties:
  clocks:
    type: phandle-array
    description: Clock reference source
    required: true

  "#clock-cells":
    const: 1

clock-cells:
  - gate-id

examples:
  - |
    clk_apb: clk-apb {
        compatible = "elan,em32-apb";
        #clock-cells = <1>;
        clocks = <&clk_ahb EM32_GATE_NONE>;
        status = "okay";
    };

    pwm0: pwm@40006000 {
        compatible = "elan,em32-pwm";
        reg = <0x40006000 0x1000>;
        clocks = <&clk_apb EM32_GATE_PCLKG_PWM>;
        status = "okay";
    };
```

## dts/bindings/clock/espressif,esp32-cam-clk.yaml
```yaml
#
# Copyright (c) 2024 espros photonics Co.
#
# SPDX-License-Identifier: Apache-2.0
#

description: esp32 camera clock

compatible: "espressif,esp32-cam-clk"

include: [base.yaml, pinctrl-device.yaml]

properties:
  pinctrl-0:
    required: true

  pinctrl-names:
    required: true

  cam_clk:
    type: int
```

## dts/bindings/clock/espressif,esp32-rtc.yaml
```yaml
# Copyright (c) 2020, Mohamed ElShahawi
# SPDX-License-Identifier: Apache-2.0

description: ESP32 RTC (Power & Clock Controller Module) Module

compatible: "espressif,esp32-rtc"

include: [clock-controller.yaml, base.yaml]

properties:
  reg:
    required: true

  fast-clk-src:
    type: int
    required: true
    description: |
      RTC fast clock source.
      - 0: ESP32_RTC_FAST_CLK_SRC_XTAL_D2 - Main XTAL divided by 2 (C3/S3)
      ESP32_RTC_FAST_CLK_SRC_XTAL_D4 Main XTAL divided by 4 (ESP32/S2)
      - 1: ESP32_RTC_FAST_CLK_SRC_RC_FAST - 8 MHz
    enum:
      - 0
      - 1

  slow-clk-src:
    type: int
    required: true
    description: |
      RTC slow clock source. Default to
      - 0: ESP32_RTC_SLOW_CLK_SRC_RC_SLOW - 136 KHz (C3/S3) - 90 kHz (S2) - 150 kHz (ESP32)
      - 1: ESP32_RTC_SLOW_CLK_SRC_XTAL32K - 32,768U KHz
      - 2: ESP32_RTC_SLOW_CLK_SRC_RC_FAST_D256 - 17,5 MHz
      - 9: ESP32_RTC_SLOW_CLK_32K_EXT_OSC - External 32k oscillator connected to 32K_XP pin
    enum:
      - 0
      - 1
      - 2
      - 9

  "#clock-cells":
    const: 1

clock-cells:
  - offset  # Index of the peripheral in esp32 modules list (Check esp32_clock.h)
```

## dts/bindings/clock/fixed-factor-clock.yaml
```yaml
# Copyright (c) 2021 Prevas A/S
# SPDX-License-Identifier: Apache-2.0

description: Generic fixed factor clock provider

compatible: "fixed-factor-clock"

include: clock-controller.yaml

properties:
  clock-div:
    type: int
    description: fixed clock divider

  clock-mult:
    type: int
    description: fixed clock multiplier

  clocks:
    type: phandle-array
    description: input clock source

  "#clock-cells":
    const: 0
```

## dts/bindings/clock/focaltech,ft9001-cpm.yaml
```yaml
# Copyright (c) 2025, FocalTech Systems CO.,Ltd
# SPDX-License-Identifier: Apache-2.0

description: |
  FocalTech FT9001 Clock & Power Manager (CPM) specifiers use the packed IDs
  defined in include/zephyr/dt-bindings/clock/focaltech_ft9001_clock.h

compatible: "focaltech,ft9001-cpm"

include: [clock-controller.yaml, base.yaml]

properties:
  "#clock-cells":
    const: 1

clock-cells:
  - id
```

## dts/bindings/clock/gd,gd32-cctl.yaml
```yaml
# Copyright (c) 2022, Teslabs Engineering S.L.
# SPDX-License-Identifier: Apache-2.0

description: |
  Gigadevice Reset and Clock Unit (RCU) if a multi-function peripheral in
  charge of reset control (RCTL) and clock control (CCTL) for all SoC
  peripherals. This binding represents the clock controller (CCTL).

  To specify the clocks in a peripheral, the standard clocks property needs
  to be used, e.g.:

    gpioa: gpio@xxx {
        ...
        /* cell encodes RCU register offset and control bit position */
        clocks = <&cctl GD32_CLOCK_GPIOA>;
        ...
    }

  Predefined RCU clock cells are available in
  include/zephyr/dts-bindings/clock/gd32{xxx}-clocks.h header files, where {xxx}
  corresponds to the SoC series, e.g. f4xx.

compatible: "gd,gd32-cctl"

include: [clock-controller.yaml, base.yaml]

properties:
  "#clock-cells":
    const: 1

clock-cells:
  - id
```

## dts/bindings/clock/gd,gd32-hse-clock.yaml
```yaml
# Copyright (c) 2021, Linaro ltd
# SPDX-License-Identifier: Apache-2.0

description: GD32 HSE Clock

compatible: "gd,gd32-hse-clock"

include: [fixed-clock.yaml]

properties:
    hse-bypass:
      type: boolean
      required: false
      description: |
        HSE crystal oscillator bypass
        Set to the property to by-pass the oscillator with an external clock.
```

## dts/bindings/clock/gd,gd32-rcu.yaml
```yaml
# Copyright (c) 2022, Teslabs Engineering S.L.
# SPDX-License-Identifier: Apache-2.0

description: |
  Gigadevice Reset and Clock Unit (RCU).

  Reset control controls three kinds of reset: power reset, system reset and
  backup domain reset. Clock control unit is in charge of the configuration
  of all system clocks, including system clock (CK_SYS) and peripheral bus
  clocks (CK_APB1, CK_APB1, etc.). It provides a range of clock sources,
  including:

  - Internal 16M RC oscillator (IRC16M)
  - Internal 48M RC oscillator (IRC48M)
  - High Speed crystal oscillator (HXTAL)
  - Low Speed Internal 32K RC oscillator (IRC32K)
  - Low Speed crystal oscillator (LXTAL)
  - Three Phase Lock Loop (PLL, PLLI2S, PLLSAI)

  Clocks should be configured at board level as shown in the example below:

    &rcc {
        /* specify clock source (pll, irc16m...) */
        clocks = <&pll>;
        /* specify system clock frequency (as given by selected clock) */
        clock-frequency = <DT_FREQ_M(200)>;
        ahb-prescaler = <1>;
        apb1-presacler = <4>;
        apb2-presacler = <2>;
    }

  To specify a gated clock, a peripheral should define a "clocks" property
  encoded as shown below:

    gpioa: gpio@xxx {
        ...
        /* cell encodes RCU register offset and control bit position */
        clocks = <&rcu GD32_RCU_GPIOA>;
        ...
    }

  Predefined RCU clock cells are available in
  include/dts-bindings/clock/gd32_rcu_{xxx}.h header files, where {xxx}
  corresponds to the SoC series, e.g. f4xx.

compatible: "gd,gd32-rcu"

include: [clock-controller.yaml, base.yaml]

properties:
    reg:
      required: true

    "#clock-cells":
      const: 1

    ahb-prescaler:
      type: int
      required: true
      enum:
        - 1
        - 2
        - 4
        - 8
        - 16
        - 64
        - 128
        - 256
        - 512
      description: APB1 prescaler (sets CH_AHB frequency)

    apb1-prescaler:
      type: int
      required: true
      enum:
        - 1
        - 2
        - 4
        - 8
        - 16
      description: APB1 prescaler (sets CH_APB1 frequency)

    apb2-prescaler:
      type: int
      required: true
      enum:
        - 1
        - 2
        - 4
        - 8
        - 16
      description: APB2 prescaler (sets CH_APB2 frequency)

clock-cells:
  - id
```

## dts/bindings/clock/gd,gd32e103-pll-clock.yaml
```yaml
# Copyright (c) 2021, Linaro ltd
# SPDX-License-Identifier: Apache-2.0

description: |
  Main PLL node binding for Connectivity line devices (STM32F105/STM32F107)

  Takes one of clk_hse, pll2 or clk_hsi as input clock.
  When clk_hsi is used a fixed prescaler is applied. When input clock is hse or
  pll2, configurable prescaler is used.

  Up to 2 output clocks could be supported and for each output clock, the
  frequency can be computed with the following formula:

    f(PLLCLK) = f(PLLIN) x PLLMUL       --> SYSCLK (System Clock)
    f(USBCLK) = f(PLLCLK) * 2 / USBPRE  --> USB

    with, depending on the case:
            f(PLLIN) = f(input_clk) / 2       if input_clk = clk_hsi
            f(PLLIN) = f(input_clk) / PREDIV  if input_clk = clk_hse or pll2

  The PLL output frequency must not exceed 72 MHz.


compatible: "gd,gd32e103-pll-clock"

include: [clock-controller.yaml, base.yaml]

properties:
    "#clock-cells":
      const: 0

    clocks:
      required: true

    mul:
      type: int
      required: true
      description: |
          Configurable mul
          Valid range: 2 - 31

    prediv:
      type: int
      required: false
      description: |
          Configurable prescaler
          Valid range: 1 - 16
```

## dts/bindings/clock/gd,gd32f4xx-pll-clock.yaml
```yaml
# Copyright (c) 2022, Teslabs Engineering S.L.
# SPDX-License-Identifier: Apache-2.0

description: |
  GD32F4XX PLL.

  The PLL input (CK_PLLSRC) can be selected (PLLSEL) to be either IRC16M or
  HXTAL generate 2 outputs: CK_PLLP and CK_PLLQ. CK_PLLP can be used to feed the
  system clock (CK_SYSCLK). The generated clock frequencies can be calculated
  using the following formulae:

    CK_PLLVCOSRC = CK_PLLSRC / PLLPSC
    CK_PLLVCO = CK_PLLVCOSRC * PLLN

    CK_PLLP = CK_PLLVCO / PLLP
    CK_PLLQ = CK_PLLVCO / PLLQ

  The PLL output frequency must not exceed 200 MHz.

compatible: "gd,gd32f4xx-pll-clock"

include: [clock-controller.yaml, base.yaml]

properties:
    "#clock-cells":
      const: 0

    clocks:
      required: true

    prescaler:
      type: int
      required: true
      description: |
        The PLL VCO source clock prescaler.
        Valid range: 2 - 63

    mul-n:
      type: int
      required: true
      description: |
        The PLL VCO clock multiplication factor.
        Valid range: 64 - 500.

    div-p:
      type: int
      required: true
      description: |
        The PLLP output frequency division factor from PLL VCO clock.
        Defaults to 2 (SoC default).
      enum:
        - 2
        - 4
        - 6
        - 8

    div-q:
      type: int
      default: 4
      description: |
        The PLL Q output frequency division factor from PLL VCO clock.
        Valid range: 2 - 15. Defaults to 4 (SoC default).
```

## dts/bindings/clock/gigadevice,gd32-rcu.yaml
```yaml
# Copyright (c) 2021 Tokita, Hiroshi <tokita.hiroshi@gmail.com>
# SPDX-License-Identifier: Apache-2.0

description: |
    This binding gives a base representation of the GD32 reset control unit

compatible: "gigadevice,gd32-rcu"

include: [clock-controller.yaml, base.yaml]

properties:
    reg:
      required: true

    "#clock-cells":
      const: 2

clock-cells:
  - bus
  - bits
```

## dts/bindings/clock/hpmicro,hpm-clock.yaml
```yaml
# Copyright (c) 2022 HPMicro
# SPDX-License-Identifier: Apache-2.0

description: HPMicro Clock

compatible: "hpmicro,hpm-clock"

include: [clock-controller.yaml, base.yaml]

properties:
  reg:
    required: true

  clock-sys-core:
    required: true
    type: int
    description: Configuring the core of the clock. HPM_CLOCK_CPU0 or HPM_CLOCK_CPU1

  ram-up-time:
    required: true
    type: int
    description: Configure the External OSC ramp-up time. 32KHZ clock

  sysctl-present:
    type: int
    required: true
    description: |
      Clock presets
      1: 24 MHz clock
      2: Recommended Settings
    enum:
      - 1
      - 2

  clock-frequency:
    required: true
    type: int
    description: Clock Frequency HZ

  "#clock-cells":
    const: 3

clock-cells:
  - name
  - src
  - div
```

## dts/bindings/clock/infineon,aurix-clock-mux.yaml
```yaml
# Copyright (c) Infineon Technologies AG
# SPDX-License-Identifier: Apache-2.0

description: Aurix Soc Clock Mux

compatible: "infineon,aurix-clock-mux"

include: clock-controller.yaml

properties:

  clocks:
    type: phandle-array
    description: input clock source

  clock-names:
    type: string-array
    description: name of each clock

  "#clock-cells":
    const: 0
```

## dts/bindings/clock/infineon,aurix-clock.yaml
```yaml
# Copyright (c) Infineon Technologies AG
# SPDX-License-Identifier: Apache-2.0

description: Aurix SoC Clock

compatible: "infineon,aurix-clock"

include: fixed-clock.yaml

properties:

  clocks:
    type: phandle-array
    description: input clock source

  clock-names:
    type: string-array
    description: name of each clock

  "#clock-cells":
    const: 0
```

## dts/bindings/clock/infineon,aurix-pll-clock.yaml
```yaml
# Copyright (c) Infineon Technologies AG
# SPDX-License-Identifier: Apache-2.0

description: Aurix Soc PLL Clock

compatible: "infineon,aurix-pll-clock"

include: clock-controller.yaml

properties:
  reg:
    type: int
    required: true

  k-div:
      type: int
      required: true

  k-pre-div:
      type: string
      enum: ["1.0", "1.1", "1.2", "1.4", "1.6", "1.7", "2.0"]

  clocks:
    type: phandle-array
    description: input clock source

  "#clock-cells":
    const: 0
```

## dts/bindings/clock/infineon,aurix-pll.yaml
```yaml
# Copyright (c) Infineon Technologies AG
# SPDX-License-Identifier: Apache-2.0

description: Aurix PLL

compatible: "infineon,aurix-pll"

include: clock-controller.yaml

properties:
  n-div:
      type: int
      required: true

  p-div:
      type: int
      required: true

  clocks:
    type: phandle-array
    description: input clock source

  "#clock-cells":
    required: true
    const: 0

  "#address-cells":
    type: int
    const: 1

  "#size-cells":
    type: int
    const: 0
```

## dts/bindings/clock/infineon,cat1-hf-clock.yaml
```yaml
# Copyright (c) 2025 Linumiz GmbH 
#
# SPDX-License-Identifier: Apache-2.0

description: Infineon CAT1 High Frequency Clock Driver

compatible: "infineon,cat1-hf-clock"

include: [base.yaml, clock-controller.yaml]

properties:
  clocks:
    required: true
    description: HF CLock source

  divider:
    type: int
    description: Divider for High Frequency Clock 
    default: 1
    enum: [0, 1, 2, 4, 8]
  
  "#clock-cells":
    const: 0
```
