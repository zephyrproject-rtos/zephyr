## dts/bindings/clock/infineon,cat1-peri-div.yaml
```yaml
# Copyright (c) 2025 Cypress Semiconductor Corporation (an Infineon company) or
# an affiliate of Cypress Semiconductor Corporation
#
# SPDX-License-Identifier: Apache-2.0

description: infineon cat1 peripheral divider 8bit.

compatible: "infineon,cat1-peri-div"

include: [clock-controller.yaml, base.yaml]

properties:
  clk-dst:
    type: uint8-array
    description: |
      Clock Connections. PDL uses the target IP to identify the peri group

  div-type:
    type: int
    description: |
      Clock divider type.

  div-num:
    type: int
    description: |
     Programmable clock divider types: DIV_8_BIT, DIV_16_BIT, DIV_16_5_BIT, DIV_24_5_BIT

  div-value:
    type: int
    description: |
      For non-fractional clock dividers (div-type: DIV_8_BIT, DIV_16_BIT)
      Causes integer division of (divider value + 1), or division by 1 to 256
      (8-bit divider) or 1 to 65536 (16-bit divider).

      For fractional clock dividers (div-type: DIV_16_5_BIT, DIV_24_5_BIT):
      The integer divider value. The source of the divider is peri_clk, which is a
      divided version of hf_clk[0]. The divider value causes integer division of
      (divider value + 1), or division by 1 to 65536 (16-bit divider) or 1 to 16777216
      (24-bit divider).

  div-frac-value:
    type: int
    description: |
      The fraction part of the divider. The fractional divider can be 0-31, thus
      it divides the clock by 1/32 for each count. To divide the clock by 11/32nds
      set this value to 11.

  scb-block:
    type: int
    required: true
    description: |
      SCB device instance peripheral clock is assigned to:
      &scb0 : scb-block = <0>
      &scb3 : scb-block = <3>
      &scb5 : scb-block = <5>
```

## dts/bindings/clock/infineon,cat2-fixed-factor-clock.yaml
```yaml
# Copyright (c) 2025 Cypress Semiconductor Corporation (an Infineon company) or
# an affiliate of Cypress Semiconductor Corporation
#
# SPDX-License-Identifier: Apache-2.0

description: Generic fixed-rate clock provider

compatible: "infineon,fixed-factor-clock"

include: [base.yaml, clock-controller.yaml]

properties:
  clocks:
    type: phandle-array
    description: input clock source

  clock-block:
    type: int
    description: Clock HW block number (refer to ifx_cat1_clock_block in clock_control_ifx_cat1.h)
    required: true

  clock-instance:
    type: int
    description: TEMP
    required: true

  clock-divider:
    type: int
    description: TEMP

  source-path:
    type: int
    description: TEMP

  "#clock-cells":
    const: 0
```

## dts/bindings/clock/infineon,cat2-peri-div.yaml
```yaml
# Copyright (c) 2025 Infineon Technologies AG,
# or an affiliate of Infineon Technologies AG.
#
# SPDX-License-Identifier: Apache-2.0

description: infineon cat2 peripheral divider 8bit.

compatible: "infineon,cat2-peri-div"

include: [clock-controller.yaml, base.yaml]

properties:
  clk-dst:
    type: uint8-array
    description: |
      Clock Connections. PDL uses the target IP to identify the peri group
  div-type:
    type: int
    description: |
      Clock divider type.
  div-num:
    type: int
    description: |
      Programmable clock divider types: DIV_16_BIT, DIV_16_5_BIT, DIV_24_5_BIT
  div-value:
    type: int
    description: |
      For non-fractional clock dividers (div-type: DIV_16_BIT)
        Causes integer division of (divider value + 1), 1 to 65536 (16-bit divider).
      For fractional clock dividers (div-type: DIV_16_5_BIT, DIV_24_5_BIT):
        The integer divider value. The source of the divider is peri_clk, which is a
        divided version of hf_clk[0]. The divider value causes integer division of
        (divider value + 1), or division by 1 to 65536 (16-bit divider) or 1 to 16777216
        (24-bit divider).
  div-frac-value:
    type: int
    description: |
      The fraction part of the divider. The fractional divider can be 0-31, thus
      it divides the clock by 1/32 for each count. To divide the clock by 11/32nds
      set this value to 11.
  scb-block:
    type: int
    required: true
    description: |
      SCB device instance peripheral clock is assigned to:
      &scb0 : scb-block = <0>
      &scb1 : scb-block = <1>
      &scb2 : scb-block = <2>
      &scb3 : scb-block = <3>
      &scb4 : scb-block = <4>
```

## dts/bindings/clock/infineon,clk-peri.yaml
```yaml
# Copyright (c) 2026 Linumiz
#
# SPDX-License-Identifier: Apache-2.0


description: Infineon Peripheral Clock

compatible: "infineon,clk-peri"

include: [clock-controller.yaml, base.yaml]

properties:
  ifx,8-bit-max-divider:
    type: int
    description: Maximum number of 8-bit dividers in peri group
    required: true

  ifx,16-bit-max-divider:
    type: int
    description: Maximum number of 16-bit dividers in peri group
    required: true

  ifx,16-5-bit-max-divider:
    type: int
    description: Maximum number of 16.5-bit dividers in peri group
    required: true

  ifx,24-5-bit-max-divider:
    type: int
    description: Maximum number of 24.5-bit dividers in peri group
    required: true

  ifx,peri-clk-inst:
    type: int
    description: peripheral clock divider instance
    required: true

  "#clock-cells":
    const: 3

clock-cells:
  - rootclk-id
  - divider-type
  - divider-inst
```

## dts/bindings/clock/infineon,clk-pll.yaml
```yaml
# Copyright (c) 2026 Linumiz
# Copyright (c) 2026 Infineon Technologies AG
#
# SPDX-License-Identifier: Apache-2.0

title: Infineon PLL

description: Infineon PLL Clock

compatible: "infineon,clk-pll"

include: [base.yaml, clock-controller.yaml]

properties:
  reg:
    required: true

  clocks:
    required: true
    description: |
      Clock reference source

  p-div:
    type: int
    required: true
    description: |
      pdiv is the feedback-divider of the output.

  q-div:
    type: int
    required: true
    description: |
      qdiv functions as a refernce-divider value.

  frac-div:
    type: int
    description: |
      Fractional divider value. The final fraction divider value is 1/2^24 of
      this setting. Set to 0 if fractional division is not used.

  output-div:
    type: int
    description: |
      Output Divider of the pll clock out.

  "#clock-cells":
    const: 0
```

## dts/bindings/clock/infineon,fixed-clock.yaml
```yaml
# Copyright (c) 2025 Cypress Semiconductor Corporation (an Infineon company) or
# an affiliate of Cypress Semiconductor Corporation
#
# SPDX-License-Identifier: Apache-2.0

description: Generic fixed-rate clock provider

compatible: "infineon,fixed-clock"

include: fixed-clock.yaml

properties:
  system-clock:
    type: int
    required: true
    description: |
      The type of clock (refer to include/.../dt-bindings/clock/ifx_clock_source_common.h):
      clk_iho  : system-clock = <IFX_IHO>
      clk_pilo : system-clock = <IFX_PILO>

  feedback-div:
    type: int

  reference-div:
    type: int

  output-div:
    type: int

  fraction-div:
    type: int

  dco-mode-enable:
    type: boolean

  div-p:
    type: int

  div-n:
    type: int

  div-k:
    type: int

  freq-mode-sel:
    type: int

  flock-enable-threshold:
    type: int

  lf-beta-value:
    type: int
```
