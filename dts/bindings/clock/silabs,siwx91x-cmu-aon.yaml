## dts/bindings/clock/st,stm32n6-hse-clock.yaml
```yaml
# Copyright (c) 2024 STMicroelectronics
# SPDX-License-Identifier: Apache-2.0

description: STM32N6 HSE Clock

compatible: "st,stm32n6-hse-clock"

include: [fixed-clock.yaml]

properties:
  hse-bypass:
    type: boolean
    description: |
      HSE crystal oscillator bypass
      Set to the property to by-pass the oscillator with an external clock.

  hse-div2:
    type: boolean
    description: |
      Enable hse_div2_osc_ck prescaler.

      If this property is present, the div2 prescaler is enabled and
      hse_div2_osc_ck = hse_osc_ck / 2; otherwise, hse_div2_osc_ck = hse_osc_ck.

      hse_osc_ck is equal to the value of this node's `clock-frequency` property.
```

## dts/bindings/clock/st,stm32wl3-rcc.yaml
```yaml
# Copyright (c) 2024 STMicroelectronics
# Copyright (c) 2026 Anders Frandsen <anfran@anfran.dk>
# SPDX-License-Identifier: Apache-2.0

description: |
  STM32WL3x RCC (Reset and Clock Controller).

  This node is in charge of the system clock ('SYSCLK') source
  selection and generation.

  The SYSCLK source is selected with the 'clocks' property pointing to one of:

    - clk_hsi: RC64MPLL in RC mode (64 MHz internal RC).
    - pll:     RC64MPLL in PLL mode (Equal to HSE x 4/3).
    - clk_hse: Direct HSE.

  Sub-GHz radio operation requires either 'pll' or 'clk_hse' as SYSCLK source.

compatible: "st,stm32wl3-rcc"

include: [clock-controller.yaml, base.yaml]

properties:
  reg:
    required: true

  "#clock-cells":
    const: 2

  clock-frequency:
    required: true
    type: int
    description: |
      Resulting CLK_SYS frequency in Hz.
      Must equal the CLK_ROOT source frequency divided by 'clksys-prescaler'.
      The driver verifies this at build time.

  clksys-prescaler:
    type: int
    required: true
    enum: [1, 2, 3, 4, 6, 8, 12, 16, 24, 32, 48, 64]
    description: |
      CLK_SYS prescaler. Defines the actual core clock frequency (CLK_SYS)
      based on the system clock (CLK_ROOT).

      Available division factors depend on the SYSCLK source:
        - clk_hsi / pll (RC64MPLL): 1, 2, 4, 8, 16, 32, 64
        - clk_hse (Direct HSE):     1, 2, 3, 6, 12, 24, 48

  slow-clock:
    type: phandle
    description: |
      Slow clock source selection.
      On STM32WL3, all slow clock devices are clocked from the same
      slow clock source which is selected by this property.

      The slow clock can be either clk_lsi, clk_lse or CLK_ROOT_DIV / 512.

clock-cells:
  - bus
  - bits
```

## dts/bindings/clock/ti,cc27xx-lf-xosc.yaml
```yaml
# Copyright (c) 2025 Texas Instruments Incorporated
# Copyright (c) 2024 Baylibre, SAS
# SPDX-License-Identifier: Apache-2.0

description: TI CC27XX external low-frequency oscillator

compatible: "ti,cc27xx-lf-xosc"

include: base.yaml
```

## dts/bindings/clock/ti,cdce913.yaml
```yaml
# Copyright (c) 2026 Carl Zeiss Meditec AG
# SPDX-License-Identifier: Apache-2.0

description: TI CDCE913 clock generator driver.

compatible: "ti,cdce913"

include: ["ti,cdce9xx.yaml", i2c-device.yaml]
```

## dts/bindings/clock/ti,cdce925.yaml
```yaml
# Copyright (c) 2026 Carl Zeiss Meditec AG
# SPDX-License-Identifier: Apache-2.0

description: TI CDCE925 clock generator driver.

compatible: "ti,cdce925"

include: ["ti,cdce9xx.yaml", i2c-device.yaml]
```

## dts/bindings/clock/ti,cdce937.yaml
```yaml
# Copyright (c) 2026 Carl Zeiss Meditec AG
# SPDX-License-Identifier: Apache-2.0

description: TI CDCE937 clock generator driver.

compatible: "ti,cdce937"

include: ["ti,cdce9xx.yaml", i2c-device.yaml]
```

## dts/bindings/clock/ti,cdce949.yaml
```yaml
# Copyright (c) 2026 Carl Zeiss Meditec AG
# SPDX-License-Identifier: Apache-2.0

description: TI CDCE949 clock generator driver.

compatible: "ti,cdce949"

include: ["ti,cdce9xx.yaml", i2c-device.yaml]
```

## dts/bindings/clock/ti,cdce9xx.yaml
```yaml
# Copyright (c) 2026 Carl Zeiss Meditec AG
# SPDX-License-Identifier: Apache-2.0

properties:
  input-clock-type:
    type: string
    required: true
    enum:
      - "crystal"
      - "vcxo"
      - "lvcmos"

  input-frequency:
    type: int
    required: true
    min: 8000000
    max: 160000000
    description: |
      Input frequency in Hz to the CDCE9xx (8000000 Hz - 32000000 Hz for the crystal,
      up to 160000000 Hz for a lvcmos clock).

  xtal-load-pf:
    type: int
    min: 0
    max: 20
    default: 10
    description: |
      Crystal load-capacitor value to fine-tune performance on a board, or to compensate
      for external influences.

  keep-y1-enabled:
    type: boolean
    description: |
      Ensure that output Y1 is never disabled. Important if the MCU is clocked by this output.

  pdiv1:
    type: int
    min: 1
    max: 1023
    description: |
      Divider for output Y1 (input is always input clock)

child-binding:
  description: |
    PLL configuration. Each PLL needs at least one output divider child node
    (see nested child-binding below).
  properties:
    clock-mult:
      type: int
      min: 1
      max: 4095
      required: true
      description: |
        N multiplier for this PLL.

    clock-div:
      type: int
      min: 1
      max: 511
      required: true
      description: |
        M divider (pre-divider) for this PLL.

    ssc:
      type: string
      enum:
        - "off"
        - "down-0.25"
        - "down-0.5"
        - "down-0.75"
        - "down-1"
        - "down-1.25"
        - "down-1.5"
        - "down-2"
        - "center-0.25"
        - "center-0.5"
        - "center-0.75"
        - "center-1"
        - "center-1.25"
        - "center-1.5"
        - "center-2"
      default: "off"
      description: |
        Spread spectrum clocking configuration for this PLL.

    first-divider:
      type: int
      description: |
        Output divider for the first output (Pdiv2, Pdiv4,...).

    second-divider:
      type: int
      description: |
        Output divider for the first output (Pdiv3, Pdiv5,...).

on-bus: i2c
```

## dts/bindings/clock/ti,mspm0-ckm.yaml
```yaml
# Copyright (c) 2026 Texas Instruments Inc.
# SPDX-License-Identifier: Apache-2.0

description: TI MSPM0 Clock Control Module

compatible: "ti,mspm0-ckm"

include: [clock-controller.yaml, base.yaml]

properties:
  "#clock-cells":
    const: 1

clock-cells:
  - clk
```

## dts/bindings/clock/wch,ch32-clock-mco.yaml
```yaml
#
# SPDX-FileCopyrightText: Copyright The Zephyr Project Contributors
# SPDX-License-Identifier: Apache-2.0
#

description: |
  CH32 Microcontroller Clock Output (MCO)

  Used to output a clock signal from the MCU to a GPIO pin.

  Example:
      &mco {
              source = "sysclk";
              pinctrl-0 = <&rcc_mco_pa8>;
              pinctrl-names = "default";
              status = "okay";
      };

include: [base.yaml, pinctrl-device.yaml]

properties:
  clocks:
    required: true

  source:
    type: string
    required: true

  pinctrl-0:
    required: true

  pinctrl-names:
    required: true
```

## dts/bindings/clock/wch,ch32h417-clock-mco.yaml
```yaml
#
# SPDX-FileCopyrightText: Copyright The Zephyr Project Contributors
# SPDX-License-Identifier: Apache-2.0
#

compatible: "wch,ch32h417-clock-mco"

description: |
  CH32 Microcontroller Clock Output (MCO)

  Used to output a clock signal from the MCU to a GPIO pin.

include:
  - name: "wch,ch32-clock-mco.yaml"

properties:
  source:
    type: string
    required: true
    description: |
      Clock Source to output onto the mco pin
    enum:
      - "sysclk"
      - "hsi"
      - "hse"
      - "pll/2"
      - "utmi"
      - "usbss"
      - "eth"
      - "serdes"
```

## dts/bindings/clock/wch,ch32v20x_30x-clock-mco.yaml
```yaml
#
# SPDX-FileCopyrightText: Copyright The Zephyr Project Contributors
# SPDX-License-Identifier: Apache-2.0
#

compatible: "wch,ch32v20x_30x-clock-mco"

description: |
  CH32 Microcontroller Clock Output (MCO)

  Used to output a clock signal from the MCU to a GPIO pin.

  This driver offers different clock soures for the ch32v20x_30x SoC family: `sysclk`, `hsi`,
  `hse`, `pll/2`.

include:
  - name: "wch,ch32-clock-mco.yaml"

properties:
  source:
    type: string
    required: true
    description: |
      Clock Source to output onto the mco pin
    enum:
      - "sysclk"
      - "hsi"
      - "hse"
      - "pll/2"
```

## dts/bindings/clock/wch,ch32v305_7_v317-clock-mco.yaml
```yaml
#
# SPDX-FileCopyrightText: Copyright The Zephyr Project Contributors
# SPDX-License-Identifier: Apache-2.0
#

compatible: "wch,ch32v305_7_v317-clock-mco"

description: |
  CH32 Microcontroller Clock Output (MCO)

  Used to output a clock signal from the MCU to a GPIO pin.

  For the device:
    - CH32V305
    - CH32V307
    - CH32V317
    - CH32F205
    - CH32F207

include:
  - name: "wch,ch32-clock-mco.yaml"

properties:
  source:
    type: string
    required: true
    description: |
      Clock Source to output onto the mco pin
    enum:
      - "sysclk"
      - "hsi"
      - "hse"
      - "pll/2"
      - "pll2"
      - "pll3/2"
      - "xt1"
      - "pll3"
```

## dts/bindings/clock/wch,ch570-clkctrl.yaml
```yaml
# SPDX-FileCopyrightText: 2026 SMILE (smile.eu)
# SPDX-License-Identifier: Apache-2.0

description: WCH CH570/CH572 Clock Control

compatible: "wch,ch570-clkctrl"

include: [clock-controller.yaml, base.yaml]

properties:
  "#clock-cells":
    const: 1

  clock-divider:
    default: 5
    type: int
    enum: [2, 3, 4, 5, 6, 7, 8, 9, 10, 11, 12, 13, 14, 15, 16, 17, 18, 19,
           20, 21, 22, 23, 24, 25, 26, 27, 28, 29, 30, 31, 32]
    description: |
      Clock division factor. The resulting clock frequency must not exceed 100 MHz.
      Note: Only used when the PLL or HSE is selected as the source clock.
      When the LSI is selected, the clock divider is ignored.

  hse-bias-current-percent:
    default: 100
    type: int
    enum:
      - 75
      - 100
      - 125
      - 150
    description: |
      External crystal oscillator bias current as a percentage of the nominal value.

  hse-load-capacitance-pf:
    type: int
    default: 16
    enum:
      - 6
      - 8
      - 10
      - 12
      - 14
      - 16
      - 18
      - 20
    description: |
      Internal load capacitance for the external crystal oscillator, in pF.

clock-cells:
  - id

examples:
  - |
    clkctrl {
      #clock-cells = <1>;
      compatible = "wch,ch570-clkctrl";
      reg = <0x40001008 0x100>;
      clocks = <&pll>; /* PLL source clock */
      clock-divider = <6>; /* 100 MHz maximum */
      hse-bias-current-percent = <125>;
      hse-load-capacitance-pf = <18>;
      status = "okay";
    };
  - |
    clkctrl {
      #clock-cells = <1>;
      compatible = "wch,ch570-clkctrl";
      reg = <0x40001008 0x100>;
      clocks = <&clk_hse>; /* HSE source clock (32 MHz) */
      clock-divider = <32>; /* final system frequency: 1 MHz */
      hse-bias-current-percent = <125>;
      hse-load-capacitance-pf = <6>;
      status = "okay";
    };
  - |
    clkctrl {
      #clock-cells = <1>;
      compatible = "wch,ch570-clkctrl";
      reg = <0x40001008 0x100>;
      clocks = <&clk_lsi>; /* LSI source clock (between 24 KHz and 42 KHz) */
      status = "okay";
    };
```
