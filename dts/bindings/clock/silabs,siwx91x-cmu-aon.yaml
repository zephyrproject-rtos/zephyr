## dts/bindings/clock/silabs,siwx91x-cmu-aon.yaml
```yaml
# Copyright (c) 2024-2026 Silicon Laboratories Inc.
# SPDX-License-Identifier: Apache-2.0

description: |
  SiWx91x Always-On (AON) / UULP (Ultra Ultra Low-Power) clock manager.

  Controls clocks for the always-on domain: RTC, watchdog timer, and the
  reference clock selection for the HP and ULP domains during sleep
  and wake transitions.

  SIWX91X_CLK_RTC and SIWX91X_CLK_WATCHDOG use a fixed UULP LF
  reference; do not add clock-route children for them.
  SIWX91X_CLK_SYSRTC is owned by the sleeptimer stack, not by
  clock-route children here.

compatible: "silabs,siwx91x-cmu-aon"

include: [clock-controller.yaml, base.yaml]

properties:
  reg:
    required: true

  reg-names:
    required: true
    enum:
      - mcu_aon
      - mcu_fsm
    description: |
      Register blocks for the AON/NPSS clock manager:
        - mcu_aon: MCU AON/NPSS power and low-frequency clock control
        - mcu_fsm: MCU clock source and sleep-state machine control

  silabs,external-xtal-khz-pin:
    type: int
    enum: [1, 2, 3, 4]
    description: |
      UULP GPIO receiving an external 32 kHz oscillator signal.
      When this property is present, clock-frequency on the xtal_khz
      fixed-clock node describes the frequency of that external signal.
      The GPIO must be reserved from normal use with gpio-reserved-ranges
      in the UULP GPIO controller node.

  "#clock-cells":
    const: 1

clock-cells:
  - clkid
```

## dts/bindings/clock/silabs,siwx91x-cmu-hp.yaml
```yaml
# Copyright (c) 2024-2026 Silicon Laboratories Inc.
# SPDX-License-Identifier: Apache-2.0

description: |
  SiWx91x High Power (HP) clock manager.

  Controls clocks for the HP (High Power) subsystem: UARTs, I2Cs, SPI,
  I2S, DMA, PWM, QSPI, GPDMA, and RNG.

compatible: "silabs,siwx91x-cmu-hp"

include: [clock-controller.yaml, base.yaml, pinctrl-device.yaml]

properties:
  reg:
    required: true

  reg-names:
    required: true
    enum:
      - m4clk
      - misc_config
    description: |
      Register blocks for the HP clock manager:
        - m4clk: M4SS (HP) peripheral clock enable and configuration
        - misc_config: HP miscellaneous control registers (e.g. I2S master mode)

  clocks:
    required: true
    description: |
      Parent AON domain reference used by this manager
      (typically SIWX91X_CLK_REF_HP). Establishes the DT dependency so
      AON initializes before HP when both use the same init priority.

  "#clock-cells":
    const: 1

clock-cells:
  - clkid
```

## dts/bindings/clock/silabs,siwx91x-cmu-ulp.yaml
```yaml
# Copyright (c) 2024-2026 Silicon Laboratories Inc.
# SPDX-License-Identifier: Apache-2.0

description: |
  SiWx91x Ultra Low Power (ULP) clock manager.

  Controls clocks for the ULP subsystem: ULP UART, ULP I2C, ULP DMA,
  ULP I2S, ULP ADC, ULP SSI, and ULP peripheral reference paths.

compatible: "silabs,siwx91x-cmu-ulp"

include: [clock-controller.yaml, base.yaml]

properties:
  reg:
    required: true

  reg-names:
    required: true
    enum:
      - ulpclk
    description: |
      Register block for the ULP clock manager:
        - ulpclk: ULPSS peripheral clock enable and configuration

  clocks:
    required: true
    description: |
      Parent AON domain reference used by this manager
      (typically SIWX91X_CLK_REF_ULP). Establishes the DT dependency so
      AON initializes before ULP when both use the same init priority.

  "#clock-cells":
    const: 1

clock-cells:
  - clkid
```

## dts/bindings/clock/silabs,socpll.yaml
```yaml
# Copyright (c) 2026 Silicon Laboratories Inc.
# SPDX-License-Identifier: Apache-2.0

compatible: "silabs,socpll"

title: Silicon Labs SOCPLL (System-on-Chip Phase-Locked Loop)

description: |
  SoC PLL peripheral on Silicon Labs Series 3 SoCs. Used to generate the high-frequency clock for
  the core SYSCLK branch. It accepts an input frequency of 34 to 44 MHz and produces an output of
  150 MHz. It may be used in open-loop mode to generate a 145 MHz clock (+/- 3%) for the system
  without using a reference oscillator.

  To enable the PLL, set the `clocks` property to the source oscillator (hfxo or hfrcodpll) and set
  `clock-frequency` to `DT_FREQ_M(150)`. To use in open-loop mode, set `clock-frequency` to
  `DT_FREQ_M(145)` and delete the `clocks` property.

include: fixed-clock.yaml

properties: {}
```

## dts/bindings/clock/st,stm32f4-rcc.yaml
```yaml
# Copyright (c) 2025 STMicroelectronics
# SPDX-License-Identifier: Apache-2.0

description: |
  STM32F4 RCC (Reset and Clock controller).

  Adds the STM32F4 Timer prescaler to the standard generic STM32 RCC.
  For more description confere st,stm32-rcc.yaml

compatible: "st,stm32f4-rcc"

include: st,stm32-rcc.yaml

properties:
  timpre:
    type: boolean
    description: |
        Timers clocks prescalers selection
        Used to control the clock frequency of all the timers connected to APB1 and APB2 domain.
        - When absent: If the APB prescaler (PPRE1, PPRE2 in the RCC_CFGR register) is configured to
          a division factor of 1, TIMxCLK = HCKL. Otherwise, the timer clock frequencies are set to
          twice to the frequency of the APB domain to which the timers are connected:
          TIMxCLK = 2xPCLKx.
        - When present: If the APB prescaler (PPRE1, PPRE2 in the RCC_CFGR register) is configured
          to a division factor of 1 or 2, TIMxCLK = HCKL. Otherwise, the timer clock frequencies are
          set to four times to the frequency of the APB domain to which the timers are connected:
          TIMxCLK = 4xPCLKx.

  st,supply-microvolt:
    type: int
    description: |
      Actual board VDD supply to the MCU, in microvolts. Must be the
      minimum VDD over tolerance and ripple, not the nominal value -- the
      wait-state table below is only safe at the worst-case (lowest)
      voltage the board can see. Optional; when absent, flash wait-states
      are computed from VOS alone as before (unchanged behavior).

      Only consumed on STM32F405xx/407xx/415xx/417xx, where it is used to
      compute wait-states from RM0090's voltage-banded Table 11 (HCLK and
      actual VDD, not VOS) -- the only sub-family this table covers -- and
      fails the build if the clock-frequency/supply-microvolt combination
      falls outside Table 11's characterized range. The build also fails
      if this is set below 2.1V while CONFIG_STM32_FLASH_PREFETCH is
      enabled, since Table 11's 1.8-2.1V column is characterized by ST
      with the flash prefetch buffer disabled (RM0090 Section 3.5.1).

      Useful for boards that run below the nominal 2.7-3.6V range by
      design (e.g. level-shifted to match a companion SoC's logic level),
      where VOS alone cannot express the actual latency requirement.
```

## dts/bindings/clock/st,stm32g5-pll-clock.yaml
```yaml
# Copyright (c) 2026 STMicroelectronics
# SPDX-License-Identifier: Apache-2.0

title: STM32G5 PLL

description: |
  STM32G5 devices have PLL1 and, on supported devices, PLL2. Each PLL uses
  HSI or HSE as its input, with an M prescaler and an integer or fractional N
  multiplier to generate the VCO clock. P, Q and R dividers produce the PLL
  outputs. The R output feeds an additional divider for IC1 or IC2.

  The VCO and PLL output frequencies are given by:

    f(VCO) = f(PLL input) / M * (N + FRACN / 8192)
    f(PLLx_P) = f(VCO) / P
    f(PLLx_Q) = f(VCO) / Q
    f(PLLx_R) = f(VCO) / R

  The intermediate clocks are derived from the corresponding R output:

    f(IC1) = f(PLL1_R) / ICLK1DIV
    f(IC2) = f(PLL2_R) / ICLK2DIV

  The iclk-div property selects a division ratio of 3 or 5 for each PLL.

compatible: "st,stm32g5-pll-clock"

include: st,stm32u5-pll-clock.yaml

properties:
  iclk-div:
    type: int
    default: 5
    enum: [3, 5]
    description: |
      Additional division ratio for the PLL intermediate clock output (PLLx_R).
      STM32G5 supports only division by 3 or 5.
```

## dts/bindings/clock/st,stm32g5-rcc.yaml
```yaml
# Copyright (c) 2026 STMicroelectronics
# SPDX-License-Identifier: Apache-2.0

title: STM32G5 RCC (Reset and Clock controller).

description: |
  This node controls system clock source selection and AHB/APB domain clocks
  on STM32G5 series MCUs.

  Refer to st,stm32-rcc.yaml for STM32 clock specifier details.

compatible: "st,stm32g5-rcc"

include: [clock-controller.yaml, base.yaml]

properties:
  reg:
    required: true

  "#clock-cells":
    const: 2

  clock-frequency:
    type: int
    required: true
    description: Core clock frequency (rcc_cpu_ck) in Hz.

  hpre:
    type: int
    required: true
    enum: [1, 2, 4, 8, 16, 64, 128, 256, 512]
    description: AHB prescaler (HPRE).

  ppre1:
    type: int
    required: true
    enum: [1, 2, 4, 8, 16]
    description: APB1 prescaler (PPRE1).

  ppre2:
    type: int
    required: true
    enum: [1, 2, 4, 8, 16]
    description: APB2 prescaler (PPRE2).

  ppre3:
    type: int
    required: true
    enum: [1, 2, 4, 8, 16]
    description: APB3 prescaler (PPRE3).

clock-cells:
  - bus
  - bits
```

## dts/bindings/clock/st,stm32h7-pll-clock.yaml
```yaml
# Copyright (c) 2021, Linaro ltd
# SPDX-License-Identifier: Apache-2.0

description: |
  STM32H7 main PLL.

  It can be used to describe 3 different PLLs: PLL1 (Main PLL), PLL2 and PLL3.
  Only PLL1 and PLL3 are supported for now.

  These PLLs could take one of clk_hse, clk_hsi or clk_csi as input clock, with
  an input frequency from 1 to 16 MHz. PLLM factor is used to set the input
  clock in this acceptable range.

  Each PLL can have up to 3 output clocks and for each output clock, the
  frequency can be computed with the following formulae:

    f(PLL_Px) = f(VCOx clock) / PLLPx   -> pllx_p_ck ((pll1_p_ck : sys_ck))
    f(PLL_Qx) = f(VCOx clock) / PLLQx   -> pllx_q_ck
    f(PLL_Rx) = f(VCOx clock) / PLLRx   -> pllx_r_ck

      with f(VCOx clock) = f(REFx_CK) × (PLLNx / PLLMx)

  The maximum PLL output frequency is device-dependent.
  Refer to your product's Reference Manual and Data Sheet for more details.

compatible: "st,stm32h7-pll-clock"

include: [clock-controller.yaml, base.yaml]

properties:
  "#clock-cells":
    const: 0

  clocks:
    required: true

  div-m:
    type: int
    required: true
    description: |
        Division factor for PLLx
        input clock
    min: 1
    max: 63

  mul-n:
    type: int
    required: true
    description: |
        Main PLL multiplication factor for VCOx
    min: 4
    max: 512

  div-p:
    type: int
    description: |
        PLL division factor for pllx_p_ck
        Note: For PLL1, P division factor must be 1 or even.
    min: 1
    max: 128

  div-q:
    type: int
    description: |
        PLL division factor for pllx_q_ck
    min: 1
    max: 128

  div-r:
    type: int
    description: |
        PLL division factor for pllx_r_ck
    min: 1
    max: 128

  fracn:
    type: int
    description: |
        PLLx FRACN value
    min: 0
    max: 8191

  no-auto-enable:
    type: boolean
    description: |
      Configure the PLL but do not enable it.

      The clock control driver programs the PLL source, dividers,
      multiplier and output enables at boot and on every exit from
      low-power modes, but leaves the PLL disabled. The application is
      responsible for enabling and disabling the PLL, and for keeping
      the voltage scale, flash latency and every clock derived from
      the PLL outputs within specification while doing so.

      Until the application enables the PLL, its outputs are stopped
      and peripherals clocked from them do not operate.

      A PLL with this property cannot be the system clock source.
      Not supported on dual-core SoCs.
```

## dts/bindings/clock/st,stm32h7p-rcc.yaml
```yaml
# SPDX-FileCopyrightText: Copyright (c) 2026 STMicroelectronics
# SPDX-License-Identifier: Apache-2.0

title: STM32H7P Reset and Clock Controller (RCC)

description: |
  The STM32H7P RCC is responsible for managing the on-chip clock generators,
  selecting the System Clock (SYSCLK / sys_ck) as well as controlling the
  various peripheral clocks.

  Refer to st,stm32-rcc for information about peripheral gate and domain clock
  configuration.

compatible: "st,stm32h7p-rcc"

include: [clock-controller.yaml, base.yaml]

properties:
  reg:
    required: true

  "#clock-cells":
    const: 2

  clock-frequency:
    type: int
    required: true
    description: CPU clock frequency in Hz (rcc_cpu_ck)

  cpre:
    type: int
    required: true
    description: CPU domain core prescaler
    enum: [1, 2, 4, 8, 16, 64, 128, 256, 512]

  bmpre:
    type: int
    required: true
    description: Bus matrix prescaler
    enum: [1, 2]

  ppre1:
    type: int
    required: true
    description: APB1 prescaler
    enum: [1, 2, 4, 8, 16]

  ppre2:
    type: int
    required: true
    description: APB2 prescaler
    enum: [1, 2, 4, 8, 16]

  ppre4:
    type: int
    required: true
    description: APB4 prescaler
    enum: [1, 2, 4, 8, 16]

  st,clock-sources:
    type: phandles
    dependency-mode: ignore
    description: |
      List of nodes representing intermediate clock muxes.
      These nodes should have compatible "st,stm32-clock-mux".

  st,clock-source-identifiers:
    type: array
    description: |
      List of identifiers for the intermediate clock mux nodes specified in
      property "st,clock-sources"; element at index N is mapped to the Nth
      cell of that property and should be the STM32_SRC_xxx value defined
      in `stm32h7p_clock.h` which corresponds to that clock mux.

clock-cells:
  - bus
  - bits
```

## dts/bindings/clock/st,stm32mp13-rcc.yaml
```yaml
# SPDX-FileCopyrightText: Copyright The Zephyr Project Contributors
# SPDX-License-Identifier: Apache-2.0

description: STM32MP13 RCC (Reset and Clock Control) peripheral

compatible: "st,stm32mp13-rcc"

include: st,stm32-rcc.yaml

properties:
  axi-prescaler:
    type: int
    enum:
      - 1
      - 2
      - 3
      - 4

  apb3-prescaler:
    type: int
    enum:
      - 1
      - 2
      - 4
      - 8
      - 16

  apb4-prescaler:
    type: int
    enum:
      - 1
      - 2
      - 4
      - 8
      - 16

  apb5-prescaler:
    type: int
    enum:
      - 1
      - 2
      - 4
      - 8
      - 16

  apb6-prescaler:
    type: int
    enum:
      - 1
      - 2
      - 4
      - 8
      - 16
```

## dts/bindings/clock/st,stm32mp2-rcc.yaml
```yaml
# Copyright (C) 2025 Savoir-faire Linux, Inc.
# SPDX-License-Identifier: Apache-2.0

description: |
  STM32MP2 RCC (Reset and Clock controller).

  As for the peripherals, the clocks are configured per peripheral in the
  corresponding device tree node. The clock controller is responsible for
  enabling/disabling the clocks for the peripherals, when allowed by the
  Resource Isolation Framework (RIF) configuration.

  To declare a peripheral "PERx" clock in the dtsi, you can follow the example
  below, where the second entry is the clock crossbar (flexgen) channel that
  feeds the peripheral kernel clock. Declaring it lets the clock controller
  resolve the peripheral rate without any peripheral-specific code:
    PERx {
      ...
      clocks = <&rcc STM32_CLOCK(PERx, STM32_CLK)>,
               <&rcc STM32_SRC_FLEXGEN(12) NO_SEL>;
      ...
    };

compatible: "st,stm32mp2-rcc"

include:
  - name: st,stm32-rcc.yaml
    property-blocklist:
      - ahb-prescaler
      - apb1-prescaler
      - apb2-prescaler
      - undershoot-prevention
```
