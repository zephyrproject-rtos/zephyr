## dts/bindings/clock/atmel,saml2x-gclk.yaml
```yaml
# Copyright (c) 2021 Argentum Systems Ltd.
# SPDX-License-Identifier: Apache-2.0

description: Atmel SAML2x Generic Clock Controller (GCLK)

compatible: "atmel,saml2x-gclk"

include: [clock-controller.yaml, base.yaml]

properties:
    reg:
      required: true

    "#clock-cells":
      const: 1

clock-cells:
  - periph_ch
```

## dts/bindings/clock/atmel,saml2x-mclk.yaml
```yaml
# Copyright (c) 2021 Argentum Systems Ltd.
# SPDX-License-Identifier: Apache-2.0

description: Atmel SAML2x Generic Clock Controller (MCLK)

compatible: "atmel,saml2x-mclk"

include: [clock-controller.yaml, base.yaml]

properties:
  reg:
    required: true

  "#clock-cells":
    const: 2

clock-cells:
  - offset
  - bit
```

## dts/bindings/clock/bflb,bclk.yaml
```yaml
# Copyright (c) 2025-2026 MASSDRIVER EI (massdriver.space)
# SPDX-License-Identifier: Apache-2.0

description: |
  The BCLK clock, or peripheral clock
  Source -> / divider -> This Clock

compatible: "bflb,bclk"

include: [base.yaml, clock-controller.yaml]

properties:
  divider:
    type: int
    required: true
    description: Divide root clock by this 8-bits value.

  "#clock-cells":
    const: 0
```

## dts/bindings/clock/bflb,bl60x-clock-controller.yaml
```yaml
# Copyright (c) 2025 MASSDRIVER EI (massdriver.space)
# SPDX-License-Identifier: Apache-2.0

description: Bouffalolab BL60x Clock Controller

compatible: "bflb,bl60x-clock-controller"

include: [base.yaml, clock-controller.yaml]

properties:
  "#clock-cells":
    const: 1

clock-cells:
  - id
```

## dts/bindings/clock/bflb,bl60x-pll.yaml
```yaml
# Copyright (c) 2025 MASSDRIVER EI (massdriver.space)
# SPDX-License-Identifier: Apache-2.0

description: The BL60x PLL

compatible: "bflb,bl60x-pll"

include: [base.yaml, clock-controller.yaml]

properties:
  clocks:
    type: phandle-array
    required: true
    description: source

  "#clock-cells":
    const: 1

clock-cells:
  - select
```

## dts/bindings/clock/bflb,bl60x-root-clk.yaml
```yaml
# Copyright (c) 2025 MASSDRIVER EI (massdriver.space)
# SPDX-License-Identifier: Apache-2.0

description: |
  The BL60x Root Clock

compatible: "bflb,bl60x-root-clk"

include: [base.yaml, clock-controller.yaml]

properties:
  clocks:
    type: phandle-array
    required: true
    description: source

  pll-select:
    type: int
    required: true
    enum:
      - 0
      - 1
      - 2
      - 3
    description: |
      Select PLL divider ID
      0 = 48M, 1 = 120M, 2 = 160M, 3 = 192M

  divider:
    type: int
    required: true
    description: Divide source clock by this 8-bits value. Typically 1.
```

## dts/bindings/clock/bflb,bl616cl-clock-controller.yaml
```yaml
# Copyright (c) 2026 MASSDRIVER EI (massdriver.space)
# SPDX-License-Identifier: Apache-2.0

description: Bouffalolab BL616CL Clock Controller

compatible: "bflb,bl616cl-clock-controller"

include: [base.yaml, clock-controller.yaml]

properties:
  "#clock-cells":
    const: 1

clock-cells:
  - id
```

## dts/bindings/clock/bflb,bl61x-aupll.yaml
```yaml
# Copyright (c) 2025 MASSDRIVER EI (massdriver.space)
# SPDX-License-Identifier: Apache-2.0

description: The BL61x Audio PLL

compatible: "bflb,bl61x-aupll"

include: [base.yaml, clock-controller.yaml]

properties:
  clocks:
    type: phandle-array
    required: true
    description: source

  "#clock-cells":
    const: 1

clock-cells:
  - select
```

## dts/bindings/clock/bflb,bl61x-flash-clk.yaml
```yaml
# Copyright (c) 2025 MASSDRIVER EI (massdriver.space)
# SPDX-License-Identifier: Apache-2.0

description: |
  The BL61x Flash Clock
  Source -> divider -> CLK
  Only has settings for Bank 1 (boot flash) at the moment.

compatible: "bflb,bl61x-flash-clk"

include: [base.yaml, clock-controller.yaml]

properties:
  clocks:
    type: phandle-array
    required: true
    description: Source clocks.
      Using WIFIPLL results in WIFIPLL x 0.375 (120M).
      When using RC32M main clock, use BCLK.

  divider:
    type: int
    default: 1
    description: Divide source clock by this 3-bits value (1 to 8). Typically 1.

  read-delay:
    type: int
    default: 0
    enum:
      - 0
      - 1
      - 2
      - 3
    description: Flash Read delay. This is a flash controller setting.
      This may be necessary to achieve flash clock higher than XCLK.

  clock-invert:
    type: boolean
    description: Invert Clock Signal. This is a flash controller setting.
      This may be necessary to achieve flash clock higher than XCLK.

  rx-clock-invert:
    type: boolean
    description: Invert RX Clock Signal. This is a flash controller setting.
      This may be necessary to achieve flash clock higher than XCLK.

  "#clock-cells":
    const: 0
```

## dts/bindings/clock/bflb,bl61x-root-clk.yaml
```yaml
# Copyright (c) 2025 MASSDRIVER EI (massdriver.space)
# SPDX-License-Identifier: Apache-2.0

description: |
  The BL61x Root Clock
  Represents both FCLK and HCLK, which should be kept the same.
  Source -> FCLK / divider -> HCLK / divider -> BCLK

  'clocks' take the form of:
  clocks = <&clk_wifipll BL61X_WIFIPLL_320MHz>;
  Where the phandle is one of clk_wifipll, clk_aupll (Unsupported), clk_crystal, or clk_rc32m.
  The second argument is from include/zephyr/dt-bindings/clock/bflb_bl61x_clock.h


compatible: "bflb,bl61x-root-clk"

include: [base.yaml, clock-controller.yaml]

properties:
  clocks:
    type: phandle-array
    required: true
    description: source

  divider:
    type: int
    required: true
    description: Divide source clock by this 8-bits value (FCLK divider). Typically 1.

  "#clock-cells":
    const: 0
```

## dts/bindings/clock/bflb,bl61x-wifipll.yaml
```yaml
# Copyright (c) 2025 MASSDRIVER EI (massdriver.space)
# SPDX-License-Identifier: Apache-2.0

description: The BL61x WIFI PLL

compatible: "bflb,bl61x-wifipll"

include: [base.yaml, clock-controller.yaml]

properties:
  clocks:
    type: phandle-array
    required: true
    description: source

  "#clock-cells":
    const: 1

clock-cells:
  - select
```

## dts/bindings/clock/bflb,bl70x-clock-controller.yaml
```yaml
# Copyright (c) 2025 MASSDRIVER EI (massdriver.space)
# SPDX-License-Identifier: Apache-2.0

description: Bouffalolab BL70x Clock Controller

compatible: "bflb,bl70x-clock-controller"

include: [base.yaml, clock-controller.yaml]

properties:
  "#clock-cells":
    const: 1

clock-cells:
  - id
```

## dts/bindings/clock/bflb,bl70x-dll.yaml
```yaml
# Copyright (c) 2025 MASSDRIVER EI (massdriver.space)
# SPDX-License-Identifier: Apache-2.0

description: The BL70x DLL

compatible: "bflb,bl70x-dll"

include: [base.yaml, clock-controller.yaml]

properties:
  clocks:
    type: phandle-array
    required: true
    description: source

  "#clock-cells":
    const: 1

clock-cells:
  - select
```

## dts/bindings/clock/bflb,bl70x-root-clk.yaml
```yaml
# Copyright (c) 2025 MASSDRIVER EI (massdriver.space)
# SPDX-License-Identifier: Apache-2.0

description: |
  The BL70x Root Clock

compatible: "bflb,bl70x-root-clk"

include: [base.yaml, clock-controller.yaml]

properties:
  clocks:
    type: phandle-array
    required: true
    description: source

  divider:
    type: int
    required: true
    description: Divide source clock by this 8-bits value. Typically 1.

  "#clock-cells":
    const: 0
```

## dts/bindings/clock/bflb,bl70x_l-clock-controller.yaml
```yaml
# Copyright (c) 2025-2026 MASSDRIVER EI (massdriver.space)
# SPDX-License-Identifier: Apache-2.0

description: Bouffalolab BL70x(L) Clock Controller

compatible: "bflb,bl70x_l-clock-controller"

include: [base.yaml, clock-controller.yaml]

properties:
  "#clock-cells":
    const: 1

clock-cells:
  - id
```

## dts/bindings/clock/bflb,bl70x_l-dll.yaml
```yaml
# Copyright (c) 2025-2026 MASSDRIVER EI (massdriver.space)
# SPDX-License-Identifier: Apache-2.0

description: The BL70x/L DLL

compatible: "bflb,bl70x_l-dll"

include: [base.yaml, clock-controller.yaml]

properties:
  clocks:
    type: phandle-array
    required: true
    description: source

  "#clock-cells":
    const: 1

clock-cells:
  - select
```

## dts/bindings/clock/bflb,clock-controller.yaml
```yaml
# Copyright (c) 2025 MASSDRIVER EI (massdriver.space)
# SPDX-License-Identifier: Apache-2.0

description: Bouffalolab Clock Controller for Drivers

compatible: "bflb,clock-controller"

include: [base.yaml, clock-controller.yaml]
```

## dts/bindings/clock/bflb,crystal.yaml
```yaml
# Copyright (c) 2025 MASSDRIVER EI (massdriver.space)
# SPDX-License-Identifier: Apache-2.0

description: Bouffalolab crystal Oscillator

compatible: "bflb,crystal"

include: [base.yaml, fixed-clock.yaml]
```

## dts/bindings/clock/bflb,f32k.yaml
```yaml
# Copyright (c) 2026 MASSDRIVER EI (massdriver.space)
# SPDX-License-Identifier: Apache-2.0

description: Bouffalolab F32K clock

compatible: "bflb,f32k"

include: fixed-clock.yaml

properties:
  clocks:
    type: phandle-array
    required: true
    description: |
      Source of the F32K. RC32K, XTAL32K, or DIG32K (unimplemented).
```

## dts/bindings/clock/bflb,flash-clk.yaml
```yaml
# Copyright (c) 2025 MASSDRIVER EI (massdriver.space)
# SPDX-License-Identifier: Apache-2.0

description: |
  BFLB Flash Clock
  Source -> divider -> CLK
  Only has settings for Bank 1 on BL61x (boot flash) at the moment.

compatible: "bflb,flash-clk"

include: [base.yaml, clock-controller.yaml]

properties:
  clocks:
    type: phandle-array
    required: true
    description: Source clocks.
      Using PLL as source results in using the 120M output on BL61x and BL60x,
      and 144M output on BL70x
      When using RC32M main clock, use BCLK.

  divider:
    type: int
    default: 1
    description: Divide source clock by this 3-bits value (1 to 8). Typically 1.

  read-delay:
    type: int
    default: 0
    enum:
      - 0
      - 1
      - 2
      - 3
    description: Flash Read delay. This is a flash controller setting.
      This may be necessary to achieve flash clock higher than XCLK.

  clock-invert:
    type: boolean
    description: Invert Clock Signal. This is a flash controller setting.
      This may be necessary to achieve flash clock higher than XCLK.

  rx-clock-invert:
    type: boolean
    description: Invert RX Clock Signal. This is a flash controller setting.
      This may be necessary to achieve flash clock higher than XCLK.

  "#clock-cells":
    const: 0
```

## dts/bindings/clock/bflb,mm-clk.yaml
```yaml
# Copyright (c) 2026 MASSDRIVER EI (massdriver.space)
# SPDX-License-Identifier: Apache-2.0

title: Bouffalolab MM (Multimedia) Subsystem Clock

description: |
  Bouffalolab MM (Multimedia) Subsystem Clock
  Controls the clock for the MM subsystem (DSP core, VRAM, DRAM, peripherals).
  Source -> / divider -> MM CLK

  The MM subsystem clock has its own root mux at MM_GLB_BASE.
  XCLK source (RC32M or crystal) is always safe.
  PLL sources require the corresponding PLL to be enabled.

compatible: "bflb,mm-clk"

include: [base.yaml, clock-controller.yaml]

properties:
  clocks:
    type: phandle-array
    required: true
    description: |
      Source clock for MM subsystem.
      Use RC32M or crystal for XCLK source.
      Use a PLL phandle (e.g. wifipll) for PLL source.

  divider:
    type: int
    default: 1
    description: Divide source clock by this value (1 to 256).

  "#clock-cells":
    const: 0
```

## dts/bindings/clock/bflb,pll.yaml
```yaml
# Copyright (c) 2026 MASSDRIVER EI (massdriver.space)
# SPDX-License-Identifier: Apache-2.0

description: Bouffalolab PLL settings

compatible: "bflb,pll"

include: [base.yaml, clock-controller.yaml]

properties:
  clocks:
    type: phandle-array
    required: true
    description: |
      Source of the PLL, phandle pointing to either crystal, or RC32M clock.

  top-frequency:
    type: int
    description: |
      Targeted highest output clock frequency (Hz)
    required: true

  "#clock-cells":
    const: 1

clock-cells:
  - select # SoC-Specific PLL source ID
```

## dts/bindings/clock/bflb,rc32m.yaml
```yaml
# Copyright (c) 2025 MASSDRIVER EI (massdriver.space)
# SPDX-License-Identifier: Apache-2.0

description: Bouffalolab Internal 32 MHz Oscillator

compatible: "bflb,rc32m"

include: [base.yaml, clock-controller.yaml]

properties:
  clock-frequency:
    type: int
    const: 32000000
```

## dts/bindings/clock/bflb,root-clk.yaml
```yaml
# Copyright (c) 2026 MASSDRIVER EI (massdriver.space)
# SPDX-License-Identifier: Apache-2.0

description: |
  Bouffalolab Root Clock
  Represents both FCLK and HCLK depending on their presence, which should be kept the same.
  Source -> / divider -> This Clock
  Please refer to the SoC datasheet's clock diagram for more details

examples:
  - |
    &clk_root {
      clocks = <&clk_pll BL60X_PLL_ID_DIV5_3>;
      divider = <1>;
    };

  - |
    &clk_root {
      clocks = <&clk_wifipll BL61X_WIFIPLL_ID_DIV1>;
      divider = <1>;
    };

  - |
    &clk_root {
      clocks = <&clk_crystal>;
      divider = <1>;
    };

  - |
    &clk_root {
      clocks = <&clk_rc32m>;
      divider = <1>;
    };

compatible: "bflb,root-clk"

include: [base.yaml, clock-controller.yaml]

properties:
  clocks:
    type: phandle-array
    required: true
    description: source

  divider:
    type: int
    required: true
    description: Divide source clock by this 8-bits value. Typically 1.

  "#clock-cells":
    const: 0
```

## dts/bindings/clock/clock-controller.yaml
```yaml
# Copyright (c) 2019, Linaro Limited
# SPDX-License-Identifier: Apache-2.0

# Common fields for clock controllers

properties:
  "#clock-cells":
    type: int
    required: true
    description: Number of items to expect in a Clock specifier
```
