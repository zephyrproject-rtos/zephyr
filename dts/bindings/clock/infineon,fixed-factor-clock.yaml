## dts/bindings/clock/infineon,fixed-factor-clock.yaml
```yaml
# Copyright (c) 2025 Cypress Semiconductor Corporation (an Infineon company) or
# an affiliate of Cypress Semiconductor Corporation
#
# SPDX-License-Identifier: Apache-2.0

description: Generic fixed-rate clock provider

compatible: "infineon,fixed-factor-clock"

include: fixed-factor-clock.yaml

properties:
  system-clock:
    type: int
    required: true
    description: |
      The type of clock (refer to include/.../dt-bindings/clock/ifx_clock_source_common.h):
      path_mux5 : system-clock = <IFX_PATHMUX>
      clk_hf0   : system-clock = <IFX_HF>

  instance:
    type: int
    required: true
    description: |
      Instance of a given clock type.
      path_mux5 : instance = <5>
      clk_hf0   : instance = <0>

  source-path:
    type: int
    description: Path that indicates source clock.
```

## dts/bindings/clock/infineon,peri-div.yaml
```yaml
# Copyright (c) 2025 Infineon Technologies AG,
# or an affiliate of Infineon Technologies AG.
#
# SPDX-License-Identifier: Apache-2.0

description: infineon peripheral divider

compatible: "infineon,peri-div"

include: [clock-controller.yaml, base.yaml]

properties:
  peri-group:
    type: uint8-array
    description: |
      Peri instance and group of given peripheral divider:
      peri0_group1_... : peri-group = [00 01]
      peri1_group3_... : peri-group = [01 03]

  div-type:
    type: int
    description: |
      Programmable clock divider types: DIV_8_BIT, DIV_16_BIT, DIV_16_5_BIT, DIV_24_5_BIT

  channel:
    type: int
    description: |
      Channel of given peripheral divider.

  clock-div:
    type: int
    description: |
      For non-fractional clock dividers (div-type: DIV_8_BIT, DIV_16_BIT)
      Causes integer division of (divider value + 1), or division by 1 to 256
      (8-bit divider) or 1 to 65536 (16-bit divider).

      For fractional clock dividers (div-type: DIV_16_5_BIT, DIV_24_5_BIT):
      The integer divider value. The source of the divider is peri_clk, which is a
      divided version of hf_clk[0]. The divider value causes integer division of
      (divider value + 1), or division by 1 to 65536 (16-bit divider) or 1 to 16777216
      (24-bit divider).

  div-frac-value:
    type: int
    description: |
      The fraction part of the divider. The fractional divider can be 0-31, thus
      it divides the clock by 1/32 for each count. To divide the clock by 11/32nds
      set this value to 11.

  resource-type:
    type: int
    required: true
    description: |
      Resource type that the peripheral clock is assigned to:
      &scb3     : resource-type = IFX_RSC_SCB
      &tcpwm0_0 : resource-type = IFX_RSC_TCPWM

  resource-instance:
    type: int
    required: true
    description: |
      Resource instance that the peripheral clock is assigned to:
      &scb0 : resource-instance = <0>
      &scb3 : resource-instance = <3>
      &scb5 : resource-instance = <5>
```

## dts/bindings/clock/infineon,tc3x-ccu.yaml
```yaml
# Copyright (c) Infineon Technologies AG
# SPDX-License-Identifier: Apache-2.0

description: TC3X Clock Control Unit

compatible: "infineon,tc3x-ccu"

include: [base.yaml, clock-controller.yaml]

properties:
  reg:
    required: true

  "#clock-cells":
    const: 1

clock-cells:
  - id
```

## dts/bindings/clock/infineon,tc4x-ccu.yaml
```yaml
# Copyright (c) Infineon Technologies AG
# SPDX-License-Identifier: Apache-2.0

description: TC4X Clock Control Unit

compatible: "infineon,tc4x-ccu"

include: [base.yaml, clock-controller.yaml]

properties:
  reg:
    required: true

  "#clock-cells":
    const: 1

clock-cells:
  - id
```

## dts/bindings/clock/intel,adsp-shim-clkctl.yaml
```yaml
# Copyright (c) 2022 Intel Corporation. All rights reserved.
# SPDX-License-Identifier: Apache-2.0

description: Intel ADSP clock controlling related constants.

compatible: "intel,adsp-shim-clkctl"

properties:
    adsp-clkctl-clk-wovcro:
        type: int
        required: false
        description: Index of WOVCRO clock encoding in the encoding array (if wovcro-supported is true).

    adsp-clkctl-clk-lpro:
        type: int
        required: false
        description: Index of LPRO clock encoding in the encoding array.

    adsp-clkctl-clk-hpro:
        type: int
        required: false
        description: Index of HPRO clock encoding in the encoding array.

    adsp-clkctl-freq-enc:
        type: array
        required: true
        description: Array that encodes what is needed to enable each clock.

    adsp-clkctl-freq-mask:
        type: array
        required: false
        description: Array that encodes needed masks to enable each clock.

    adsp-clkctl-freq-default:
        type: int
        required: true
        description: Index for the default clock.

    adsp-clkctl-freq-lowest:
        type: int
        required: true
        description: Index for the lowest frequency clock.

    wovcro-supported:
        type: boolean
        description: |
          If WoV clock ring oscillator is supported.
```

## dts/bindings/clock/intel,agilex-clock.yaml
```yaml
# Copyright (c) 2022, Intel Corporation
# SPDX-License-Identifier: Apache-2.0

description: Agilex clock controller node

compatible: "intel,agilex-clock"

include: [clock-controller.yaml, base.yaml]

properties:
  reg:
    required: true

  "#clock-cells":
    const: 1

clock-cells:
  - clkid
```

## dts/bindings/clock/intel,cavs-shim-clkctl.yaml
```yaml
# Copyright (c) 2022 Intel Corporation. All rights reserved.
# SPDX-License-Identifier: Apache-2.0

description: Intel cAVS clock controlling related constants.

compatible: "intel,cavs-shim-clkctl"

properties:
    cavs-clkctl-clk-wovcro:
        type: int
        required: false
        description: Index of WOVCRO clock encoding in the encoding array (if wovcro-supported is true).

    cavs-clkctl-clk-lpro:
        type: int
        required: false
        description: Index of LPRO clock encoding in the encoding array.

    cavs-clkctl-clk-hpro:
        type: int
        required: false
        description: Index of HPRO clock encoding in the encoding array.

    cavs-clkctl-freq-enc:
        type: array
        required: true
        description: Array that encodes what is needed to enable each clock.

    cavs-clkctl-freq-mask:
        type: array
        required: false
        description: Array that encodes needed masks to enable each clock.

    cavs-clkctl-freq-default:
        type: int
        required: true
        description: Index for the default clock.

    cavs-clkctl-freq-lowest:
        type: int
        required: true
        description: Index for the lowest frequency clock.

    wovcro-supported:
        type: boolean
        description: |
          If WoV clock ring oscillator is supported.
```

## dts/bindings/clock/ite,it51xxx-ecpm.yaml
```yaml
# Copyright (c) 2025 ITE Corporation. All Rights Reserved.
# SPDX-License-Identifier: Apache-2.0

description: ITE it51xxx ECPM (EC Clock and Power Management Controller) node

compatible: "ite,it51xxx-ecpm"

include: [clock-controller.yaml, base.yaml]

properties:
  reg:
    required: true

  pll-frequency:
    type: int
    required: true
    enum:
      - 0
      - 1
      - 2
      - 3
    description: |
      0 = PLL_18400_KHZ,
      1 = PLL_32300_KHZ,
      2 = PLL_64500_KHZ,
      3 = PLL_48000_KHZ,

  "#clock-cells":
    const: 2

clock-cells:
  - ctrl
  - bits
```

## dts/bindings/clock/ite,it8xxx2-ecpm.yaml
```yaml
# Copyright (c) 2022 ITE Corporation. All Rights Reserved.
# SPDX-License-Identifier: Apache-2.0

description: ITE it8xxx2 ECPM (EC Clock and Power Management Controller) node

compatible: "ite,it8xxx2-ecpm"

include: [clock-controller.yaml, base.yaml]

properties:
  reg:
    required: true

  pll-frequency:
    type: int
    required: true
    enum:
      - 0
      - 1
      - 2
    description: |
      0 = PLL_48_MHZ,
      1 = PLL_96_MHZ,
      2 = PLL_DEFAULT,

  "#clock-cells":
    const: 3

clock-cells:
  - offset
  - bitmask
  - always_on_bitmask
```

## dts/bindings/clock/litex,clk.yaml
```yaml
# Copyright (c) 2020 Antmicro <www.antmicro.com>
# SPDX-License-Identifier: Apache-2.0

include: [clock-controller.yaml, base.yaml]

description: |
  LiteX Mixed Mode Clock Manager
  Common clock driver with MMCM unit for dynamic reconfiguration
  of up to 7 clock outputs with ability to change frequency, duty
  cycle and phase offset

compatible: "litex,clk"

clock-cells:
  - id

properties:

  reg:
    description: Base address and lengths of the register space

  "#clock-cells":
    required: true
    const: 1

  clock-output-names:
    required: true
    type: string-array
    description: |
      List of strings of clock output signal names indexed
      by the first cell in the clock specifier.

  litex,lock-timeout:
    required: true
    type: int
    description: |
      Number of ms to wait for MMCM to assert LOCK signal
  litex,drdy-timeout:
    required: true
    type: int
    description: |
      Number of ms to wait for MMCM to assert DRDY signal
  litex,divclk-divide-min:
    required: true
    type: int
    description: |
      minimal global divider
  litex,divclk-divide-max:
    required: true
    type: int
    description: |
      maximal global divider
  litex,clkfbout-mult-min:
    required: true
    type: int
    description: |
      minimal global multiplier
  litex,clkfbout-mult-max:
    required: true
    type: int
    description: |
      maximal global multiplier
  litex,vco-freq-min:
    required: true
    type: int
    description: |
      minimal frequency after global divider and multiplier
  litex,vco-freq-max:
    required: true
    type: int
    description: |
      maximal frequency after global divider and multiplier
  litex,clkout-divide-min:
    required: true
    type: int
    description: |
      minimal clock output divider
  litex,clkout-divide-max:
    required: true
    type: int
    description: |
      maximal clock output divider
  litex,vco-margin:
    required: true
    type: int
    description: |
      tolerancy for vco frequency
    const: 0
```

## dts/bindings/clock/litex,clkout.yaml
```yaml
# Copyright (c) 2020 Antmicro <www.antmicro.com>
# SPDX-License-Identifier: Apache-2.0

include: base.yaml

description: |
  LiteX Mixed Mode Clock Manager clock output binding

compatible: "litex,clkout"

properties:

  "#clock-cells":
    required: true
    type: int
    description: |
      Number of cells in a clock specifier;
      Typically 0 for nodes with a single clock output
      and 1 for nodes with multiple clock outputs.
    const: 1

  clock-output-names:
    required: true
    type: string
    description: |
      string of clock output signal name.

  litex,clock-frequency:
    required: true
    type: int
    description: |
      default frequency in Hz for clock output

  litex,clock-phase:
    required: true
    type: int
    description: |
      default phase offset given in degrees

  litex,clock-duty-num:
    required: true
    type: int
    description: |
      default duty cycle numerator value

  litex,clock-duty-den:
    required: true
    type: int
    description: |
      default duty cycle denominator value

  litex,clock-margin:
    required: true
    type: int
    description: |
      clock output margin coefficient

  litex,clock-margin-exp:
    required: true
    type: int
    description: |
      exponent for clkout margin
      effective clkout margin shall be
      margin * 10^(-exponent) * 100%

clock-cells:
  - id
```

## dts/bindings/clock/mediatek,mt818x_cpuclk.yaml
```yaml
# Copyright 2023 The ChromiumOS Authors
# SPDX-License-Identifier: Apache-2.0

description: MediaTek Audio DSP CPU Frequency Control
compatible: "mediatek,mt818x_cpuclk"
properties:
  freqs-mhz:
    type: array
    description: Available frequencies in ascending order
    required: true
  reg:
    type: array
  pll-ctrl-reg:
    type: int
```

## dts/bindings/clock/mediatek,mt8195_cpuclk.yaml
```yaml
# Copyright 2023 The ChromiumOS Authors
# SPDX-License-Identifier: Apache-2.0

description: MediaTek Audio DSP CPU Frequency Control
compatible: "mediatek,mt8195_cpuclk"
properties:
  freqs-mhz:
    type: array
    description: Available frequencies in ascending order
    required: true
  reg:
    type: array
  cg-reg:
    type: int
  pll-ctrl-reg:
    type: int
```

## dts/bindings/clock/microchip,pic32cxsg-gclk.yaml
```yaml
# Copyright (c) 2024 Microchip
# SPDX-License-Identifier: Apache-2.0

description: Microchip PIC32CXSG Generic Clock Controller (GCLK)

compatible: "microchip,pic32cxsg-gclk"

include: [clock-controller.yaml, base.yaml]

properties:
  reg:
    required: true

  "#clock-cells":
    const: 1

clock-cells:
  - periph_ch
```

## dts/bindings/clock/microchip,pic32cxsg-mclk.yaml
```yaml
# Copyright (c) 2024 Microchip
# SPDX-License-Identifier: Apache-2.0

description: Microchip PIC32CXSGD5x Generic Clock Controller (MCLK)

compatible: "microchip,pic32cxsgd5x-mclk"

include: [clock-controller.yaml, base.yaml]

properties:
  reg:
    required: true

  "#clock-cells":
    const: 2

clock-cells:
  - offset
  - bit
```

## dts/bindings/clock/microchip,pic32cxsg-pmc.yaml
```yaml
# Copyright (c) 2024 Microchip
# SPDX-License-Identifier: Apache-2.0

description: |
  Microchip Power Management Controller (PMC)

  The Power Management Controller (PMC) optimizes power consumption by
  controlling all system and user peripheral clocks. The PMC enables/disables
  the clock inputs to many of the peripherals and the processor.

  To specify the clocks in a peripheral, the standard clocks property needs
  to be used, e.g.:

    uart: uart@xxx {
      ...
      clocks = <&pmc PMC_TYPE_PERIPHERAL p-id>;
      ...
    };

  In this example the clock-type was defined as PMC_TYPE_PERIPHERAL and the
  peripheral-id was defined as p-id. The p-id number should be consulted on
  datasheet, usually it is available at Product Mapping figure.

  NOTE: The predefined clock type cell is defined at
  include/zephyr/drivers/clock_clontrol/microchip_pic32cxsg_pmc.h header file.

  The clock-type constants are:
    PMC_TYPE_CORE
    PMC_TYPE_SYSTEM
    PMC_TYPE_PERIPHERAL
    PMC_TYPE_GCK
    PMC_TYPE_PROGRAMMABLE

compatible: "microchip,pic32cxsg-pmc"

include: [clock-controller.yaml, base.yaml]

properties:
  reg:
    required: true

  "#clock-cells":
    const: 2
    description: |
      from common clock binding; shall be set to 2. The first entry is the type
      of the clock (core, system, peripheral or generated) and the second entry
      it's the peripheral identification index as provided by the datasheet.

clock-cells:
  - clock-type
  - peripheral-id
```

## dts/bindings/clock/microchip,sam-d5x-e5x-clock.yaml
```yaml
# Copyright (c) 2025 Microchip Technology Inc.
# SPDX-License-Identifier: Apache-2.0

title: Microchip SAM_D5x_E5x SOC family clock

description: |
  Microchip SAM_D5x_E5x SOC family clock (OSCCTRL, OSC32KCTRL, GCLK, MCLK)

include:
  - name: base.yaml
  - name: pinctrl-device.yaml

compatible: "microchip,sam-d5x-e5x-clock"

properties:
  on-timeout-ms:
    type: int
    default: 5
    description: |
      Timeout in milliseconds for clock to be on.

      Driver waits in clock on API to check if the clock is actually on,
      so that the waiting time is not indefinite.
```
