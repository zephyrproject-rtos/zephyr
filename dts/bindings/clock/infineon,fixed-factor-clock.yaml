## dts/bindings/clock/microchip,sam-d5x-e5x-gclkperiph.yaml
```yaml
# Copyright (c) 2025 Microchip Technology Inc.
# SPDX-License-Identifier: Apache-2.0

title: Microchip GCLK (Generic Clock) peripheral

description: |
  peripheral channel gclk clock configuration.

include: [base.yaml]

compatible: "microchip,sam-d5x-e5x-gclkperiph"

properties:
  "#clock-cells":
    const: 1
    type: int
    description: |
      The subsystem cell is to identify a clock controller sub-system.

      The subsystem can be referred from include\zephyr\dt-bindings\clock\mchp_sam_d5x_e5x_clock.h,
      under the GCLKPERIPH_TYPE section of ids.
      All clock control API use this value to specify the clock on which the API operates.
      Since subsystem is opaque to the user, it can be accessed from the devicetree node and used.

clock-cells:
  - subsystem
```

## dts/bindings/clock/microchip,sam-d5x-e5x-mclkperiph.yaml
```yaml
# Copyright (c) 2025 Microchip Technology Inc.
# SPDX-License-Identifier: Apache-2.0

title: Microchip MCLK (Main Clock) peripheral

description: |
  Main Clock (MCLK) configuration for peripheral AHB and APB clocks.

include: [base.yaml]

compatible: "microchip,sam-d5x-e5x-mclkperiph"

properties:
  "#clock-cells":
    const: 1
    type: int
    description: |
      The subsystem cell is to identify a clock controller sub-system.

      The subsystem can be referred from include\zephyr\dt-bindings\clock\mchp_sam_d5x_e5x_clock.h,
      under the MCLKPERIPH_TYPE section of ids.
      All clock control API use this value to specify the clock on which the API operates.
      Since subsystem is opaque to the user, it can be accessed from the devicetree node and used.

clock-cells:
  - subsystem
```

## dts/bindings/clock/microchip,sam-pmc.yaml
```yaml
# Copyright (C) 2025 Microchip Technology Inc. and its subsidiaries
#
# SPDX-License-Identifier: Apache-2.0
#

description: |
  Microchip Power Management Controller (PMC)

compatible: "microchip,sam-pmc"

include: [clock-controller.yaml, base.yaml]

properties:
  reg:
    required: true

  "#clock-cells":
    const: 2

clock-cells:
  - clock-type
  - peripheral-id
```

## dts/bindings/clock/microchip,sama7g5-sckc.yaml
```yaml
# Copyright (C) 2025-2026 Microchip Technology Inc. and its subsidiaries
#
# SPDX-License-Identifier: Apache-2.0
#

title: Microchip SCKC

description: |
  Microchip SAM Slow Clock Controller (SCKC)

  This driver supports following hardware peripherals:
    - module name="SCKC" id="11073" version="0"
    - module name="SCKC" id="11073" version="G"

compatible: "microchip,sama7g5-sckc"

include: [clock-controller.yaml, base.yaml]

properties:
  reg:
    required: true

  slow-rc-frequency:
    type: int
    default: 64000
    description: |
      This property describes the frequency of the enbedded Slow RC Oscillator.

  osc-sel-pos:
    type: int
    default: 24
    description: |
      This property describes which bit of SCKC_CR register acts as the Slow
      Clock Sector.

  "#clock-cells":
    const: 1
    description: |
      from common clock binding; shall be set to 1.

clock-cells:
  - clock-crystal-osc
```

## dts/bindings/clock/microchip,smartfusion2-clock.yaml
```yaml
# Copyright (c) 2025 Bavariamatic GmbH
# SPDX-License-Identifier: Apache-2.0

description: SmartFusion2 read-only clock controller

compatible: "microchip,smartfusion2-clock"

include: [base.yaml, clock-controller.yaml]

properties:
  clock-frequencies:
    type: array
    required: true
    description: |
      Output clock frequencies in Hz indexed by the SmartFusion2 clock ID.
      The current driver exposes the CPU clock at index 0 and the shared MSS
      peripheral clock at index 1.

  "#clock-cells":
    const: 1

  clock-output-names:
    type: string-array
    description: Optional names for the exported clock outputs.

clock-cells:
  - clkid
```

## dts/bindings/clock/microchip,xec-clock.yaml
```yaml
# Copyright (c) 2021 Microchip Technology Inc.
# SPDX-License-Identifier: Apache-2.0

description: Microchip XEC clock control node

compatible: "microchip,xec-clock"

include: base.yaml

properties:
    label:
      required: true

    reg:
      required: true

    pll-32k-src:
      type: int
      required: true
      description: 32 KHz clock source for PLL

    periph-32k-src:
      type: int
      required: true
      description: 32 KHz clock source for peripherals

    xtal-single-ended:
      type: boolean
      required: false
      description: Use single ended crystal connection to XTAL2 only.

    pin32k-vtr-off-crystal:
      type: boolean
      required: false
      description: |
        When 32 KHz pin input goes off switch to crystal instead of silicon
        oscillator.
```

## dts/bindings/clock/microchip,xec-pcr.yaml
```yaml
# Copyright (c) 2021, Microchip Technology Inc.
# SPDX-License-Identifier: Apache-2.0

description: Microchip XEC Power Clock Reset and VBAT register (PCR)

compatible: "microchip,xec-pcr"

include:
  - "base.yaml"
  - "clock-controller.yaml"
  - "pinctrl-device.yaml"

properties:
  reg:
    required: true

  girqs:
    type: array
    description: |
      PCR clock monitor encoded GIRQ number and bit position.
      Note: MEC15xx PCR does not implement the clock monitor and
      has no interrupt.

  hibtimer-handle:
    type: phandle
    description: |
      Handle to a hibernation timer node used by clock control for timeouts
      during clock configuration.

  core-clock-div:
    type: int
    required: true
    description: Divide 96 MHz PLL clock to produce Cortex-M4 core clock

  slow-clock-div:
    type: int
    description: |
      PWM and TACH clock domain divided down from 48 MHz AHB clock. The
      default value is 480 for 100 kHz.

  pll-32k-src:
    type: int
    required: true
    description: 32 KHz clock source for PLL

  periph-32k-src:
    type: int
    required: true
    description: 32 KHz clock source for peripherals

  xtal-gain:
    type: string
    description: Crystal input amplifier circuit gain
    enum:
      - "4X"
      - "3X"
      - "2X"
      - "1X"

  xtal-single-ended:
    type: boolean
    description: Use single ended crystal connection to XTAL2 pin.

  clk32kmon-period-min:
    type: int
    required: true
    description: |
      32KHz clock monitor minimum valid 32KHz period in 48MHz units

  clk32kmon-period-max:
    type: int
    required: true
    description: |
      32KHz clock monitor maximum valid 32KHz period in 48MHz units

  clk32kmon-duty-cycle-var-max:
    type: int
    required: true
    description: |
      Maximum duty cycle variation. Difference in units of 48HMz between
      the measured 32KHz high and low pulse widths.

  clk32kmon-valid-min:
    type: int
    required: true
    description: |
      Minimum number of consecutive 32KHz pulses that pass all monitor tests

  xtal-enable-delay-ms:
    type: int
    required: true
    default: 10
    description: |
      Delay in milliseconds after crystal is started and before crystal
      is checked.

  xtal-monitor-max-ms:
    type: int
    description: |
      Time interval in milliseconds the driver will check crystal is within
      specified bounds (stable). A value of 0 (default) indicates infinite timeout.

  pll-lock-timeout-ms:
    type: int
    required: true
    default: 30
    description: |
      Timeout in milliseconds waiting for PLL to lock to new clock source.

  internal-osc-disable:
    type: boolean
    description: |
      If the internal silicon 32KHz oscillator is not chosen as the source
      for PLL and Periheral devices then disable the internal 32KHz
      oscillator to save power.

  xtal-hi-startup-current-disable:
    type: boolean
    description: |
      If present disable crystal high startup current afer the crytal is
      stable and PLL has locked.

  pll-src-lock:
    type: boolean
    description: |
      If present the driver will lock the PLL clock source register after
      configuration.

  silosc-en-lock:
    type: boolean
    description: |
      If present after clock configuration the driver will lock the 32KHz
      internal silicon OSC enable bit.

  "#clock-cells":
    const: 3

clock-cells:
  - regidx
  - bitpos
  - domain
```

## dts/bindings/clock/microchip/pic32ck_sg_gc/microchip,pic32ck-sg-gc-clock.yaml
```yaml
# Copyright (c) 2025-2026 Microchip Technology Inc.
# SPDX-License-Identifier: Apache-2.0

title: Microchip PIC32CK_SG_GC SOC family clock

description: |
  Microchip PIC32CK_SG_GC SOC family clock controller.

  Provides the clock subsystem for the PIC32CK_SG_GC SoC family, covering the
  OSCCTRL (1kHz oscillators), OSC32KCTRL (32 kHz oscillators), GCLK and
  MCLK (AHB/APB bus clocks) blocks.
  It acts as the central clock provider that peripherals reference through
  their "clocks" property.

  Example:

    clock: clock@40001000 {
      compatible = "microchip,pic32ck-sg-gc-clock";
      reg = <0x40001000 0x400>;
      #clock-cells = <2>;
      status = "okay";
    };

include:
  - name: base.yaml
  - name: pinctrl-device.yaml

compatible: "microchip,pic32ck-sg-gc-clock"

properties:
  on-timeout-ms:
    type: int
    default: 5
    description: |
      Timeout in milliseconds for clock to be on.

      Driver waits in clock on API to check if the clock is actually on,
      so that the waiting time is not indefinite.

  flash-auto-wait-state-en:
    type: int
    enum:
      - 0
      - 1
    default: 0
    description: |
      Automatic wait state enable
      0: to disable, 1: to enable

  flash-wait-states:
    type: int
    default: 0
    description: |
      Number of wait states for a flash read operation.

      Change this value based on the NVM access time and system frequency
      up to 15 wait states.
```
