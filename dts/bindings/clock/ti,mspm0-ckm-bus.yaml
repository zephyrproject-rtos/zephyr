## dts/bindings/clock/ti,mspm0-ckm-bus.yaml
```yaml
# Copyright (c) 2025 Texas Instruments Inc.
# Copyright (c) 2025 Linumiz
# SPDX-License-Identifier: Apache-2.0

description: TI MSPM0 Clock Module Bus

compatible: "ti,mspm0-ckm-bus"

include: [clock-controller.yaml, base.yaml]

properties:
  "#clock-cells":
    const: 0

  clock-source:
    type: int
    description: |
      Clock input reference source.

  clock-frequency:
    type: int
    required: true
    description: |
      Output clock frequency in Hz.

  ti,xtal:
    type: boolean
    description: |
      Specify it is external crystal Oscillator.

  ti,xtal-startup-delay-us:
    type: int
    description: |
      Crystal Oscillator startup delay in micro seconds.

  clk-div:
    type: int
    description: |
      Clock divider selction value. Valid range [2 ... 16].
```

## dts/bindings/clock/ti,mspm0-clk-out.yaml
```yaml
# Copyright (c) 2025 Linumiz
# SPDX-License-Identifier: Apache-2.0

description: TI MSPM0 CLOCK OUT

compatible: "ti,mspm0-clk-out"

include: [clock-controller.yaml, pinctrl-device.yaml]

properties:
  "#clock-cells":
    const: 1

  pinctrl-0:
    required: true

  pinctrl-names:
    required: true
```

## dts/bindings/clock/ti,mspm0-clk.yaml
```yaml
# Copyright (c) 2025 Texas Instruments Inc.
# Copyright (c) 2025 Linumiz
# SPDX-License-Identifier: Apache-2.0

description: TI MSPM0 Clock

compatible: "ti,mspm0-clk"

include: [clock-controller.yaml, base.yaml]

properties:
  "#clock-cells":
    const: 1

  clocks:
    description: |
      Clock reference source

  clock-frequency:
    type: int
    description: |
      Output clock frequency in Hz.

  clk-div:
    type: int
    description: |
      Clock divider selction value. Valid range [2 ... 16].

clock-cells:
  - clk
```

## dts/bindings/clock/ti,mspm0-clock-mux.yaml
```yaml
# Copyright (c) 2024 Texas Instruments Inc.
# SPDX-License-Identifier: Apache-2.0

description: TI MSPM0 Clock Mux

compatible: "ti,mspm0-clock-mux"

include: [clock-controller.yaml, base.yaml]

properties:
  "#clock-cells":
    const: 1

  uclk-div:
    type: int
    default: 1
    description: |
      Divider from MCLK (system clock) to ULPCLK (low power clock). ULPCLK must
      be less than or equal to 40 MHz. Valid value is 1 when sourced from SYSOSC
      or LFOSC. Valid values are 1 or 2 when sourced from a high speed clock
      (such as PLL or external clock).

  mclk-div:
    type: int
    default: 1
    description: |
      Divider for MCLK (system clock) only when source with SYSOSC with a
      frequency value of 4 MHz. Disabled otherwise. Valid values are 1-16.

  clock-source:
    type: phandle
    required: true
    description: |
      Clock Source for the system clock

  clock-frequency:
    required: true
    type: int
    description: |
      default frequency in Hz for clock output

clock-cells:
  - bus
```

## dts/bindings/clock/ti,mspm0-osc.yaml
```yaml
# Copyright (c) 2025 Texas Instruments Inc.
# Copyright (c) 2025 Linumiz
# SPDX-License-Identifier: Apache-2.0

description: TI MSPM0 oscillator

compatible: "ti,mspm0-osc"

include: [fixed-clock.yaml, base.yaml]

properties:
  "#clock-cells":
    const: 0

  ti,xtal-startup-delay-us:
    type: int
    description: |
      Crystal Oscillator startup delay in micro seconds.

  ti,low-cap:
    type: boolean
    description: |
      Specifies if capacitance is less than 3pF to reduce power consumption.
```

## dts/bindings/clock/ti,mspm0-oscillator.yaml
```yaml
# Copyright (c) 2024 Texas Instruments Inc.
# SPDX-License-Identifier: Apache-2.0

description: TI MSPM0 Oscillator

compatible: "ti,mspm0-oscillator"

include: [fixed-clock.yaml]

properties:
  clock-frequency:
    type: int
    required: true
```

## dts/bindings/clock/ti,mspm0-pll.yaml
```yaml
# Copyright (c) 2024 Texas Instruments Inc.
# SPDX-License-Identifier: Apache-2.0

description: TI MSPM0 Phase Locked Loop

compatible: "ti,mspm0-pll"

include: [clock-controller.yaml, base.yaml]

properties:
  clocks:
    required: true
    description: |
      Clock reference source

  "#clock-cells":
    const: 0

  p-div:
    type: int
    required: true
    enum:
      - 1
      - 2
      - 4
      - 8
    description: |
      pdiv is the pre-divider of the output. ref_in / pdiv * qdiv = VCO

  q-div:
    type: int
    required: true
    description: |
      qdiv functions as a multiplier value for the ref_in / pdiv * qdiv = VCO
      Valid Range: 2 - 128

  clk0-div:
    type: int
    description: |
      CLK0 PLL output is only enabled if the divider is present. Use CLK0 on
      the MSPM0 to output to the MCLK, UCLK, and CPUCLK
      Valid Range: 1 - 16

  clk1-div:
    type: int
    description: |
      CLK1 PLL output is only enabled if the divider is present. Use CLK1 on
      the MSPM0 to output to the CANCLK, FCC, or output via EXCLK
      Valid Range: 1 - 16

  clk2x-div:
    type: int
    description: |
      CLK2X PLL output is only enabled if the divider is present. Use CLK2X on
      the MSPM0 to output to the MCLK, UCLK, and CPUCLK instead of CLK0
      Valid Range: 1 - 16
```

## dts/bindings/clock/ti,stellaris-ccm.yaml
```yaml
#
# Copyright (c) 2018, Zilogic Systems.
#
# SPDX-License-Identifier: Apache-2.0
#
---
title: STELLARIS CCM
version: 0.1

description: >
    This binding gives a base representation of the Stellaris Clock control

properties:
    compatible:
      type: string
      category: required
      description: compatible strings
      constraint: "ti,stellaris-ccm"

    reg:
      type: array
      description: mmio register space
      generation: define
      category: required

    label:
      type: string
      category: required
      description: Human readable string describing the device (used by Zephyr for API name)
      generation: define

"#cells":
  - bus
  - enable
...
```

## dts/bindings/clock/wch,ch32-hse-clock.yaml
```yaml
# Copyright (c) 2025 Fiona Behrens
# SPDX-License-Identifier: Apache-2.0

description: WCH CH32 High Speed External Clock

compatible: "wch,ch32-hse-clock"

include: [fixed-clock.yaml]

properties:
  "#clock-cells":
    const: 0

  hse-bypass:
    type: boolean
    description: |
      HSE crystal oscillator bypass
      Set to the property to by-pass the oscillator with an external clock.
```

## dts/bindings/clock/wch,ch32-hsi-clock.yaml
```yaml
# Copyright (c) 2025 Fiona Behrens
# SPDX-License-Identifier: Apache-2.0

description: WCH CH32 High Speed Internal Clock

compatible: "wch,ch32-hsi-clock"

include: [fixed-clock.yaml]

properties:
  "#clock-cells":
    const: 0
```

## dts/bindings/clock/wch,ch32-lsi-clock.yaml
```yaml
# Copyright (c) 2025 Fiona Behrens
# SPDX-License-Identifier: Apache-2.0

description: WCH CH32 Low Speed Internal Clock

compatible: "wch,ch32-lsi-clock"

include: [fixed-clock.yaml]

properties:
  "#clock-cells":
    const: 0
```

## dts/bindings/clock/wch,ch32-sys-clock.yaml
```yaml
# Copyright (c) 2025 Fiona Behrens
# SPDX-License-Identifier: Apache-2.0

description: WCH CH32 System Clock

compatible: "wch,ch32-sys-clock"

include: [clock-controller.yaml, base.yaml]

properties:
  "#clock-cells":
    const: 0
```

## dts/bindings/clock/wch,ch32_203-rcc.yaml
```yaml
# Copyright (c) 2026 Fiona Behrens
# SPDX-License-Identifier: Apache-2.0

description: WCH CH32F203/V203/V303 Reset and Clock Controller (RCC)

compatible: "wch,ch32_203-rcc"

include: [clock-controller.yaml, base.yaml]

properties:
  "#clock-cells":
    const: 1

clock-cells:
  - id
```

## dts/bindings/clock/wch,ch32fv203_v303-pll-clock.yaml
```yaml
# Copyright (c) 2025 Fiona Behrens
# SPDX-License-Identifier: Apache-2.0

description: WCH CH32V203/303 CH32F203 PLL

compatible: "wch,ch32fv203_v303-pll-clock"

include: ["wch,ch32fv2x_v3x-pll-clock.yaml"]

properties:
  div:
    type: int
    required: true
    description: |
      PLL divider factor applied before the multiplication
    enum:
      - 1 # /1
      - 2 # /2
```

## dts/bindings/clock/wch,ch32fv208-pll-clock.yaml
```yaml
# Copyright (c) 2025 Fiona Behrens
# SPDX-License-Identifier: Apache-2.0

description: WCH CH32V208/F208 PLL

compatible: "wch,ch32fv208-pll-clock"

include: [clock-controller.yaml, base.yaml]

properties:
  "#clock-cells":
    const: 0

  clocks:
    type: phandle-array
    required: true

  mul:
    type: int
    required: true
    description: |
        Main PLL multiplication factor
    enum:
      - 2   # x2
      - 3   # x3
      - 4   # x4
      - 5   # x5
      - 6   # x6
      - 7   # x7
      - 8   # x8
      - 9   # x2
      - 10  # x10
      - 11  # x11
      - 12  # x12
      - 13  # x13
      - 14  # x14
      - 15  # x15
      - 16  # x16
      - 18  # x18

  div:
    type: int
    required: true
    description: |
      PLL divider factor applied before the multiplication
      1 and 2 can only be used for the HSI and 2, 4 and 8 for the HSE.
      HSE 2 sets the USBPRE bit, forcing the USB prescaler to \5
      (only supported if the penultimate digit of the lot number is greated then 0).
    enum:
      - 1 # /1
      - 2 # /2
      - 4 # /4
      - 8 # /8
```

## dts/bindings/clock/wch,ch32fv2x_v3x-rcc.yaml
```yaml
# Copyright (c) 2025 Fiona Behrens
# SPDX-License-Identifier: Apache-2.0

description: WCH CH32FV2x CH32V3x Reset and Clock Control (RCC)

compatible: "wch,ch32fv2x_v3x-rcc"

include: [clock-controller.yaml, base.yaml]

properties:
  "#clock-cells":
    const: 1

  hb-prescaler:
    type: int
    required: true
    description: |
      Prescaler for the HB HCLK
    enum:
      - 1 # Off
      - 2 # /2
      - 4 # /4
      - 8 # /8
      - 16 # /16
      - 64 # /64
      - 128 # /128
      - 256 # /256
      - 512 # /512

clock-cells:
  - id
```

## dts/bindings/clock/wch,ch32h41x-pll-clock.yaml
```yaml
# Copyright (c) 2026 Liu Changjie
# SPDX-License-Identifier: Apache-2.0

description: WCH CH32H41X PLL

compatible: "wch,ch32h41x-pll-clock"

include: [clock-controller.yaml, base.yaml]

properties:
  "#clock-cells":
    const: 0

  clocks:
    type: phandle-array
    required: true
```

## dts/bindings/clock/wch,ch32v003-adc-clock.yaml
```yaml
# Copyright (c) 2025 Fiona Behrens
# SPDX-License-Identifier: Apache-2.0

description: WCH CH32V003 ADC Peripheral Clock

compatible: "wch,ch32v003-adc-clock"

include: [clock-controller.yaml, base.yaml]

properties:
  "#clock-cells":
    const: 0

  clocks:
    type: phandle-array
    required: true

  div:
    type: int
    required: true
    description: |
      ADC Clock source prescaler
    enum:
      - 2
      - 4
      - 6
      - 8
      - 12
      - 16
      - 24
      - 32
      - 48
      - 64
      - 96
      - 128
```

## dts/bindings/clock/wch,ch32v00x-hb-clock.yaml
```yaml
# Copyright (c) 2025 Fiona Behrens
# SPDX-License-Identifier: Apache-2.0

description: WCH CH32V00x HB Bus Peripheral Clock

compatible: "wch,ch32v00x-hb-clock"

include: [clock-controller.yaml, base.yaml]

properties:
  "#clock-cells":
    const: 0

  clocks:
    type: phandle-array
    required: true

  div:
    type: int
    required: true
    description: |
      HB Clock source prescaler
    enum:
      - 1
      - 2
      - 3
      - 4
      - 5
      - 6
      - 7
      - 8
      - 16
      - 32
      - 64
      - 128
      - 256
```

## dts/bindings/clock/wch,ch32v00x-hse-clock.yaml
```yaml
# Copyright (c) 2024 Google LLC.
# SPDX-License-Identifier: Apache-2.0

description: WCH CH32V00x HSE Clock

compatible: "wch,ch32v00x-hse-clock"

include: [fixed-clock.yaml]

properties:
  hse-bypass:
    type: boolean
    description: |
      HSE crystal oscillator bypass
      Set the property to bypass the oscillator with an external clock.
```

## dts/bindings/clock/wch,ch32v00x-hsi-clock.yaml
```yaml
# Copyright (c) 2024 Google LLC.
# SPDX-License-Identifier: Apache-2.0

description: WCH CH32V00x HSI Clock

compatible: "wch,ch32v00x-hsi-clock"

include: [fixed-clock.yaml]
```

## dts/bindings/clock/wch,ch32v00x-pll-clock.yaml
```yaml
# Copyright (c) 2024 Google LLC.
# SPDX-License-Identifier: Apache-2.0

description: WCH CH32V00x PLL

compatible: "wch,ch32v00x-pll-clock"

include: [clock-controller.yaml, base.yaml]

properties:
  "#clock-cells":
    const: 0

  clocks:
    type: phandle-array
    required: true
```

## dts/bindings/clock/wch,ch32v00x-rcc.yaml
```yaml
# Copyright (c) 2025 Fiona Behrens
# SPDX-License-Identifier: Apache-2.0

description: WCH CH32V00x Reset And Clock Control (RCC)

compatible: "wch,ch32v00x-rcc"

include: [clock-controller.yaml, base.yaml]

properties:
  "#clock-cells":
    const: 1

  reg:
    required: true

  clocks:
    type: phandle-array
    required: true

clock-cells:
  - id
```

## dts/bindings/clock/wch,ch32v20x_30x-hclk-clock.yaml
```yaml
# Copyright (c) 2026 Fiona Behrens
# SPDX-License-Identifier: Apache-2.0

description: WCH CH32F/V20x_V30x_V31x HB Clock

compatible: "wch,ch32v20x_30x-hclk-clock"

include: [clock-controller.yaml, base.yaml]

properties:
  "#clock-cells":
    const: 0

  clocks:
    type: phandle-array
    required: true

  prescaler:
    type: int
    description: |
      HCLK divider from HCLK clock source

      Note: HCLK must be less then 144MHz
    enum:
      - 1
      - 2
      - 4
      - 8
      - 16
      - 64
      - 128
      - 256
      - 512

  pclk1-div:
    type: int
    description: |
      Divider for PCLK1 from the HCLK frequency
    enum:
      - 1
      - 2
      - 4
      - 8
      - 16

  pclk2-div:
    type: int
    description: |
      Divider for PCLK2 from the HCLK frequency
    enum:
      - 1
      - 2
      - 4
      - 8
      - 16
```

## dts/bindings/clock/wch,ch32v20x_30x-hsi-clock.yaml
```yaml
# Copyright (c) 2024 Google LLC.
# SPDX-License-Identifier: Apache-2.0

description: WCH CH32F/V20x_V30x_V31x HSI Clock

compatible: "wch,ch32v20x_30x-hsi-clock"

include: [fixed-clock.yaml]

properties:
  trim:
    type: int
    description: |
      HSI clock Trimming

      Range [0, 31]

      The user can input a trimming value that is added to the HSICAL factory bits.
      The default value is 16, which allows you to adjust the HSI to 8MHz+-0.25%;
      the change in HSICAL is adjusted about 20kHz per step.
```
