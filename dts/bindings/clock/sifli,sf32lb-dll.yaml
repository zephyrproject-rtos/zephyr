## dts/bindings/clock/sifli,sf32lb-dll.yaml
```yaml
# Copyright (c) 2025 Core Devices LLC
# SPDX-License-Identifier: Apache-2.0

description: |
  SiFli DLL is a digital phase-locked loop peripheral, controlled by the RCC.
  It can be used as a clock source for the system and peripherals.

compatible: "sifli,sf32lb-dll"

properties:
  clock-frequency:
    type: int
    required: true
    description: |
      Frequency of the clock output (in Hz).
```

## dts/bindings/clock/sifli,sf32lb-hxt48.yaml
```yaml
# Copyright (c) 2025 Core Devices LLC
# SPDX-License-Identifier: Apache-2.0

description: SiFli SF32LB HXT48 clock

compatible: "sifli,sf32lb-hxt48"

include: [base.yaml, clock-controller.yaml, sifli-sf32lb-aon.yaml]

properties:
  clock-frequency:
    type: int
    const: 48000000
    description: Clock frequency in Hz

  "#clock-cells":
    const: 0

  sifli,aon:
    required: true
```

## dts/bindings/clock/sifli,sf32lb-lxt32.yaml
```yaml
# Copyright (c) 2025 SiFli Technologies(Nanjing) Co., Ltd
# SPDX-License-Identifier: Apache-2.0

description: |
  SiFli SF32LB LXT32 clock. The PMUC driver configures the XTAL32K pinmux
  directly when this node is enabled, so no pinctrl bindings are required.

compatible: "sifli,sf32lb-lxt32"

include:
  - base.yaml
  - clock-controller.yaml
  - sifli-sf32lb-pmuc.yaml

properties:
  clock-frequency:
    type: int
    required: true

  "#clock-cells":
    const: 0

  sifli,pmuc:
    required: true
```

## dts/bindings/clock/sifli,sf32lb-pmuc-clk.yaml
```yaml
# Copyright (c) 2025 SiFli Technologies(Nanjing) Co., Ltd
# SPDX-License-Identifier: Apache-2.0

description: |
  SiFli PMUC low-speed clock controller. PMUC controls the on-chip low-power
  RC oscillators and the external 32.768 kHz crystal (LXT32). This binding
  exposes those clocks so other blocks (e.g. RCC) can request and manage them
  through the common clock control API.

compatible: "sifli,sf32lb-pmuc-clk"

include:
  - base.yaml
  - clock-controller.yaml

properties:
  reg:
    required: true

  sifli,clk-wdt-src:
    type: string
    enum: ["lrc10", "lrc32"]
    default: "lrc10"
    description: |
      Selects the watchdog/LPCLK source via the PMUC SEL_LPCLK control.
      Defaults to ``lrc10`` if not provided (reset default).

  "#clock-cells":
    const: 1
    description: Clock index, see dt-bindings/clock/sf32lb-pmuc-clocks.h

clock-cells:
  - clk_id
```

## dts/bindings/clock/sifli,sf32lb-rcc-clk.yaml
```yaml
# Copyright (c) 2025 Core Devices LLC
# Copyright (c) 2025 SiFli Technologies(Nanjing) Co., Ltd
# SPDX-License-Identifier: Apache-2.0

description: |
  SiFli Reset and Clock Controller (RCC) is a multi-function peripheral in
  charge of reset control and clock control for all SoC peripherals. This
  binding represents the clock controller part. It is meant to be used as a
  child node of the RCC node. This is due to the fact Zephyr does not allow
  >1 device referencing to the same devicetree node (e.g. clock and reset
  devices).

  To specify the clocks in a peripheral, the standard clocks property needs
  to be used, e.g.:

    usart1: serial@xxx {
        ...
        /* cell encodes RCC register offset and control bit position */
        clocks = <&rcc_clk SF32LB52X_CLOCK_USART1>;
        ...
    }

  Predefined RCC clock cells are available in
  include/zephyr/dts-bindings/clock/sf32lb{xxx}-clocks.h header files, where
  {xxx} corresponds to the SoC series, e.g. sf32lb52x.

compatible: "sifli,sf32lb-rcc-clk"

include:
  - base.yaml
  - clock-controller.yaml
  - sifli-sf32lb-cfg.yaml
  - sifli-sf32lb-pmuc.yaml

properties:
  clocks:
    required: true

  clock-names:
    required: true

  "#clock-cells":
    const: 1

  sifli,cfg:
    required: true

  sifli,pmuc:
    required: true

  sifli,hdiv:
    type: int
    required: true
    description: |
      Divider for HCLK (0-255). fHCLK = clk_hpsys / HDIV.

  sifli,pdiv1:
    type: int
    required: true
    description: |
      Divider for PCLK1 (0-7). fPCLK1 = fHCLK / 2^PDIV1.

  sifli,pdiv2:
    type: int
    required: true
    description: |
      Divider for PCLK2 (0-7). fPCLK2 = fHCLK / 2^PDIV2.

  sifli,sys-clk-src:
    type: string
    enum: ["hrc48", "hxt48", "dll1"]
    default: "hrc48"
    description: |
      Source used for the HPSYS system clock. When set to ``dll1`` the DLL1 child
      node must be enabled. Defaults to ``hrc48`` if not provided (reset default).

  sifli,peri-clk-src:
    type: string
    enum: ["hrc48", "hxt48"]
    default: "hxt48"
    description: |
      Source used for the HPSYS peripheral clock domain. Defaults to ``hxt48`` if
      not provided (reset default).

  sifli,mpi1-clk-src:
    type: string
    enum: ["peri", "dll1", "dll2"]
    default: "peri"
    description: |
      Source used for the MPI1/QSPI clock tree. Selecting ``dll1`` or ``dll2``
      requires the corresponding DLL child node to be enabled. Defaults to
      ``peri`` if not provided (reset default).

  sifli,mpi2-clk-src:
    type: string
    enum: ["peri", "dll1", "dll2"]
    default: "peri"
    description: |
      Source used for the MPI2/QSPI clock tree. Selecting ``dll1`` or ``dll2``
      requires the corresponding DLL child node to be enabled. Defaults to
      ``peri`` if not provided (reset default).

  sifli,usb-clk-src:
    type: string
    enum: ["sysclk", "dll2"]
    default: "sysclk"
    description: |
      Source used for the USB full-speed controller clock. Selecting ``dll2``
      requires the DLL2 child node to be enabled. Defaults to ``sysclk`` if not
      provided (reset default).

  sifli,usb-div:
    type: int
    default: 4
    description: |
      Divider applied to the selected USB clock source. The divided clock must
      be 60 MHz. For example, when ``clk_dll2`` runs at 240 MHz the divider must
      be ``4`` (reset default).

clock-cells:
  - id
```

## dts/bindings/clock/sifli,sf32lb58-hpsys-aon.yaml
```yaml
# Copyright (c) 2025 Qingdao IotPi Ltd.
# SPDX-License-Identifier: Apache-2.0

description: |
  Sifli SF32LB58 HPSYS AON register

compatible: "sifli,sf32lb58-hpsys-aon"

include: [clock-controller.yaml, base.yaml]

clock-cells:
  - subsys
```

## dts/bindings/clock/sifli,sf32lb58-hpsys-rcc.yaml
```yaml
# Copyright (c) 2025 Qingdao IotPi Ltd.
# SPDX-License-Identifier: Apache-2.0

description: |
  Sifli SF32LB58 HPSYS Reset and Clock Controller

compatible: "sifli,sf32lb58-hpsys-rcc"

include: [clock-controller.yaml, base.yaml]

properties:
  sel-sys:
    type: int
    required: true

  sel-lp-sys:
    type: int
    required: true

  sel-mpi1:
    type: int
    required: true

  sel-mpi2:
    type: int
    required: true

  sel-mpi3:
    type: int
    required: true

  sel-mpi4:
    type: int
    required: true

  sel-peri:
    type: int
    required: true

  sel-pdm1:
    type: int
    required: true

  sel-pdm2:
    type: int
    required: true

  sel-usbc:
    type: int
    required: true

  sel-sdmmc:
    type: int
    required: true

clock-cells:
  - id # subsys, named as `id` to be compatible to sf32lb drivers
```

## dts/bindings/clock/sifli,sf32lb58-peri-hpsys-clk.yaml
```yaml
# Copyright (c) 2025 Qingdao IotPi Ltd.
# SPDX-License-Identifier: Apache-2.0

description: |
  Sifli SF32LB58 HPSYS Peripheral Clock Controller

compatible: "sifli,sf32lb58-peri-hpsys-clk"

include: [fixed-clock.yaml]
```

## dts/bindings/clock/sifli,sf32lb58-rc-clock.yaml
```yaml
# Copyright (c) 2025 Qingdao IotPi Ltd.
# SPDX-License-Identifier: Apache-2.0

description: |
  Sifli SF32LB58 internal RC based clock, namely hrc48 and lrc10

compatible: "sifli,sf32lb58-rc-clk"

include: [base.yaml, clock-controller.yaml, fixed-clock.yaml]
```

## dts/bindings/clock/sifli,sf32lb58-xt-clock.yaml
```yaml
# Copyright (c) 2025 Qingdao IotPi Ltd.
# SPDX-License-Identifier: Apache-2.0

description: |
  Sifli SF32LB58 external crystal based clock, namely hxt48 and lxt32

compatible: "sifli,sf32lb58-xt-clk"

include: [base.yaml, clock-controller.yaml, fixed-clock.yaml]
```

## dts/bindings/clock/silabs,hfxo.yaml
```yaml
compatible: "silabs,hfxo"

title: Silicon Labs Series 2 HFXO (High-Frequency Crystal Oscillator)

description: |
  High-Frequency Crystal Oscillator peripheral on Silicon Labs SoCs.

include: fixed-clock.yaml

properties:
  ctune:
    type: array
    required: true
    description: |
      Load capacitance configuration. If two values are set, they are used for
      XI and XO respectively. If a single value is set, it is used for both.
  precision:
    type: int
    required: true
    description: Precision configuration
  internal-bias:
    type: boolean
    description: Enable XI internal DC bias with an external clock. Ignored in xtal mode.
  mode:
    type: string
    description: |
      Mode of operation. Defaults to "xtal", expecting a crystal oscillator on XI and XO
      pins. May be set to "extclk" or "extclkpkdet" to use an external sinusoidal clock
      on the XI pin with or without use of peak detector.
    default: "xtal"
    enum: ["xtal", "extclk", "extclkpkdet"]
```

## dts/bindings/clock/silabs,series-clock.yaml
```yaml
# Copyright (c) 2024 Silicon Laboratories Inc.
# SPDX-License-Identifier: Apache-2.0

title: Silicon Labs Series 2 CMU (Clock Management Unit)

description: |
  Clock Management Unit for Silicon Labs Series 2+ SoCs.

compatible: "silabs,series-clock"

include: [clock-controller.yaml, base.yaml]

properties:
  reg:
    required: true

  "#clock-cells":
    const: 2

clock-cells:
  - enable
  - branch
```

## dts/bindings/clock/silabs,series0-cmu.yaml
```yaml
description: Silabs Gecko Clock Management Unit

compatible: "silabs,series0-cmu"

include: [base.yaml]

properties:
  reg:
    required: true
```

## dts/bindings/clock/silabs,series0-hfxo.yaml
```yaml
compatible: "silabs,series0-hfxo"

title: Silicon Labs Series 0 HFXO (High-Frequency Crystal Oscillator)

description: |
  High-Frequency Crystal Oscillator peripheral.

include: fixed-clock.yaml
```

## dts/bindings/clock/silabs,series0-lfrco.yaml
```yaml
compatible: "silabs,series0-lfrco"

title: Silicon Labs Series 0 LFRCO (Low-Frequency RC Oscillator)

description: |
  Low-Frequency RC Oscillator peripheral.

include: fixed-clock.yaml
```

## dts/bindings/clock/silabs,series0-lfxo.yaml
```yaml
compatible: "silabs,series0-lfxo"

title: Silicon Labs Series 0 LFXO (Low-Frequency Crystal Oscillator)

description: |
  Low-Frequency Crystal Oscillator peripheral.

include: fixed-clock.yaml
```

## dts/bindings/clock/silabs,series2-hfrcodpll.yaml
```yaml
compatible: "silabs,series2-hfrcodpll"

description: |
  Silicon Labs HFRCODPLL peripheral (high-frequency RC oscillator with digital phase-locked loop).
  Can be used as a free-running RC oscillator or with PLL lock to the crystal oscillators HFXO
  or LFXO. To enable PLL, set the `clocks` property to the source crystal oscillator, and set
  the `dpll-*` options to desired values.

  In PLL mode, `clock-frequency` represents the target PLL frequency.
  In free-running mode, `clock-frequency` represents the HFRCO band to use.

include: fixed-clock.yaml

properties:
  dpll-n:
    type: int
    description: Numerator used in f_out = f_ref * (n+1) / (m+1)
  dpll-m:
    type: int
    description: Denominator used in f_out = f_ref * (n+1) / (m+1)
  dpll-edge:
    type: string
    description: Which edge of the reference is detected
    enum: ["fall", "rise"]
  dpll-lock:
    type: string
    description: |
      PLL lock mode.
      freq: Frequency-lock loop mode
      phase: Phase-lock loop mode
    enum: ["freq", "phase"]
  dpll-autorecover:
    type: boolean
    description: Automatically re-lock if the PLL loses the lock
  dpll-dither:
    type: boolean
    description: Enable dither function
```

## dts/bindings/clock/silabs,series2-hfrcoem23.yaml
```yaml
compatible: "silabs,series2-hfrcoem23"

include: fixed-clock.yaml

title: Silicon Labs Series 2 HFRCOEM23 (High-Frequency RC Oscillator for Energy Mode 2 and 3)

description: |
  High-Frequency RC Oscillator with Energy Mode 2 and 3 capability.
  `clock-frequency` represents the HFRCO band to use.

properties:
  clock-frequency:
    enum:
      - 1000000
      - 2000000
      - 4000000
      - 13000000
      - 16000000
      - 19000000
      - 26000000
      - 32000000
      - 40000000
```

## dts/bindings/clock/silabs,series2-lfrco.yaml
```yaml
compatible: "silabs,series2-lfrco"

title: Silicon Labs Series 2 LFRCO (Low-Frequency RC Oscillator)

description: |
  Low-Frequency RC Oscillator peripheral.

include: fixed-clock.yaml

properties:
  precision-mode:
    type: boolean
    description: |
      Enable precision mode. In precision mode, the LFRCO is
      periodically recalibrated against the HFXO.
```

## dts/bindings/clock/silabs,series2-lfxo.yaml
```yaml
compatible: "silabs,series2-lfxo"

title: Silicon Labs Series 2 LFXO (Low-Frequency Crystal Oscillator)

description: |
  Low-Frequency Crystal Oscillator peripheral.

include: fixed-clock.yaml

properties:
  ctune:
    type: int
    required: true
    description: Load capacitance configuration
  precision:
    type: int
    required: true
    description: Precision configuration
  timeout:
    type: int
    required: true
    description: Startup timeout delay (cycles)
    enum: [2, 256, 1024, 2048, 4096, 8192, 16384, 32768]
  mode:
    type: string
    description: |
      Mode of operation. Defaults to "xtal", expecting a 32768 Hz crystal oscillator on XI and XO
      pins. May be set to "bufextclk" to use an external sinusoidal clock or "digextclk" to use
      an external CMOS clock on the XI pin.
    default: "xtal"
    enum: ["xtal", "bufextclk", "digextclk"]
```

## dts/bindings/clock/silabs,si32-ahb.yaml
```yaml
# Copyright (c) 2024 GARDENA GmbH
#
# SPDX-License-Identifier: Apache-2.0

description: Silabs Si32 AHB clock controller node

compatible: "silabs,si32-ahb"

include: base.yaml

properties:
  clocks:
    required: true
```

## dts/bindings/clock/silabs,si32-apb.yaml
```yaml
# Copyright (c) 2024 GARDENA GmbH
#
# SPDX-License-Identifier: Apache-2.0

description: Silabs Si32 APB clock controller node

compatible: "silabs,si32-apb"

include: base.yaml

properties:
  clocks:
    required: true

  divider:
    type: int
    required: true
```

## dts/bindings/clock/silabs,si32-pll.yaml
```yaml
# Copyright (c) 2024 GARDENA GmbH
#
# SPDX-License-Identifier: Apache-2.0

description: Silabs Si32 PLL clock controller node

compatible: "silabs,si32-pll"

include: base.yaml

properties:
  reg:
    required: true
```

## dts/bindings/clock/silabs,siwx91x-clock.yaml
```yaml
# Copyright (c) 2024 Silicon Laboratories Inc.
# SPDX-License-Identifier: Apache-2.0

description: Clocks embedded on Silabs SiWx91x chips

compatible: "silabs,siwx91x-clock"

include: [clock-controller.yaml, base.yaml]

properties:
  reg:
    required: true

  "#clock-cells":
    const: 1

clock-cells:
  - clkid
```

## dts/bindings/clock/silabs,siwx91x-physical-clock.yaml
```yaml
# Copyright (c) 2026 Silicon Laboratories Inc.
# SPDX-License-Identifier: Apache-2.0

description: |
  On-chip RC or crystal oscillator for SiWx91x SoCs.

  Extends fixed-clock with the measured or datasheet startup time of the
  physical oscillator block.

compatible: "silabs,siwx91x-physical-clock"

include: fixed-clock.yaml

properties:
  silabs,startup-time-us:
    type: int
    required: true
    description: Oscillator startup time in microseconds.
```
