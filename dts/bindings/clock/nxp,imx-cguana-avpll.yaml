## dts/bindings/clock/nxp,imx-cguana-avpll.yaml
```yaml
# SPDX-FileCopyrightText: Copyright 2026 NXP
#
# SPDX-License-Identifier: Apache-2.0

description: |
  Audio/Video PLL in an NXP i.MX CGU analog block.

  A dedicated fractional PLL for the audio and video clock trees. Unlike the
  generic fractional PLL, its output is set by a CCO band selector, an integer
  post-divider, and -- for the video PLL -- a fractional numerator, so it needs
  properties the frac-pll binding does not have.

      avpll_audio: avpll-audio {
              compatible = "nxp,imx-cguana-avpll";
              clocks = <&sxosc>;
              nxp,cco-band-sel = <6>;
              nxp,post-div-ratio = <16>;
              #clock-cells = <0>;
      };

compatible: "nxp,imx-cguana-avpll"

include: [base.yaml]

properties:
  reg:
    required: true
    description: |
      The source's register groups inside the parent nxp,imx-cguana block, as
      offsets: "ctrl", "cal" and "status". Split rather than one span, because
      the block reserves address space between the groups.

  reg-names:
    required: true

  "#clock-cells":
    type: int
    const: 0

  clocks:
    required: true
    description: |
      The reference this PLL locks to, normally the crystal. Which source is
      selected and what frequency it runs at both come from this phandle.

  nxp,cco-band-sel:
    type: int
    required: true
    description: |
      CCO band selector. Selects the current-controlled-oscillator frequency
      band the PLL runs in; the valid bands are hardware-defined.

  nxp,post-div-ratio:
    type: int
    required: true
    description: |
      Integer post-divider applied to the CCO output to produce the PLL output.

  nxp,dnum:
    type: int
    default: 0
    description: |
      Fractional numerator for the output divider. Zero selects a pure integer
      divide (the audio PLL); a non-zero value adds the fractional part used by
      the video PLL. The denominator is fixed in hardware.
```

## dts/bindings/clock/nxp,imx-cguana-core-pll.yaml
```yaml
# SPDX-FileCopyrightText: Copyright 2026 NXP
#
# SPDX-License-Identifier: Apache-2.0

description: |
  Integer PLL in an NXP i.MX CGU analog block.

  Output frequency is the reference multiplied by nxp,loop-div, optionally
  halved by nxp,post-div-by-2. clock-frequency states the resulting output so
  the devicetree is readable without doing the arithmetic; it is checked against
  the multiplier at build time rather than trusted.

      core_pll: core-pll {
              compatible = "nxp,imx-cguana-core-pll";
              clocks = <&sxosc>;
              nxp,loop-div = <33>;
              clock-frequency = <792000000>;
              #clock-cells = <0>;
      };

compatible: "nxp,imx-cguana-core-pll"

include: [base.yaml, fixed-clock.yaml]

properties:
  reg:
    required: true
    description: |
      The source's register groups inside the parent nxp,imx-cguana block, as
      offsets: "ctrl" and "status". Split rather than one span, because
      the block reserves address space between the groups.

  reg-names:
    required: true

  clocks:
    required: true
    description: |
      The reference this PLL locks to, normally the crystal. Which source is
      selected and what frequency it runs at both come from this phandle, so
      the two cannot disagree.

  nxp,loop-div:
    type: int
    required: true
    description: Feedback loop divider; the reference is multiplied by this.

  nxp,post-div-by-2:
    type: boolean
    description: Halve the PLL output after the loop divider.

  nxp,vco-high-band:
    type: boolean
    description: |
      Select the high VCO band. The low band covers roughly 600-858 MHz; a
      target above that needs this set.
```

## dts/bindings/clock/nxp,imx-cguana-frac-pll.yaml
```yaml
# SPDX-FileCopyrightText: Copyright 2026 NXP
#
# SPDX-License-Identifier: Apache-2.0

description: |
  Fractional PLL in an NXP i.MX CGU analog block.

  The VCO runs at a fixed frequency chosen from a small set, and the outputs are
  taken from integer dividers and from three independently configured
  fractional dividers. The fractional outputs are what feed the compute and bus
  clock roots, so this is the node a board edits to change the CPU frequency.

      main_pll: main-pll {
              compatible = "nxp,imx-cguana-frac-pll";
              clocks = <&sxosc>;
              nxp,vco-frequency = <2000000000>;
              nxp,int-divs = <5>, <8>, <10>, <20>;
              nxp,frac-div-sels = <12>, <8>, <10>;
              #clock-cells = <0>;
      };

compatible: "nxp,imx-cguana-frac-pll"

include: [base.yaml]

properties:
  reg:
    required: true
    description: |
      The source's register groups inside the parent nxp,imx-cguana block, as
      offsets: "ctrl" and "status". Split rather than one span, because
      the block reserves address space between the groups.

  reg-names:
    required: true

  "#clock-cells":
    type: int
    const: 0

  clocks:
    required: true
    description: |
      The reference this PLL locks to, normally the crystal. Which source is
      selected and what frequency it runs at both come from this phandle.

  nxp,vco-frequency:
    type: int
    required: true
    description: |
      VCO frequency in Hz. Only the values the hardware offers are accepted;
      anything else is a build error rather than a silently wrong clock tree.

  nxp,int-divs:
    type: array
    description: |
      Which integer-divider outputs to enable, as divide values. Only the
      dividers the hardware implements are accepted. Outputs that are not
      listed stay off.

  nxp,frac-div-sels:
    type: array
    description: |
      Divider selector for each of the three fractional outputs, in order. The
      selector counts quarter steps of the divide value, so the output is
      vco-frequency * 4 / selector: 8 divides by 2.0, 10 by 2.5 and 12 by 3.0.
      A 2 GHz VCO with a selector of 8 therefore yields 1 GHz. A zero leaves
      that output disabled.
```

## dts/bindings/clock/nxp,imx-cguana-fro12m.yaml
```yaml
# SPDX-FileCopyrightText: Copyright 2026 NXP
#
# SPDX-License-Identifier: Apache-2.0

description: |
  Low-frequency free-running oscillator in an NXP i.MX CGU analog block.

  Brought up first during clock configuration so that the rest of the analog
  bring-up always has a known-good clock available. Its selectable output band
  is the whole configuration, so clock-frequency is both the request and the
  description.

compatible: "nxp,imx-cguana-fro12m"

include: [base.yaml, fixed-clock.yaml]

properties:
  reg:
    required: true
    description: |
      The source's register groups inside the parent nxp,imx-cguana block, as
      offsets: "ctrl" and "status". Split rather than one span, because
      the block reserves address space between the groups.

  reg-names:
    required: true
```

## dts/bindings/clock/nxp,imx-cguana-fro192m.yaml
```yaml
# SPDX-FileCopyrightText: Copyright 2026 NXP
#
# SPDX-License-Identifier: Apache-2.0

description: |
  High-frequency free-running oscillator in an NXP i.MX CGU analog block.

  Its selectable output band is the whole configuration, so clock-frequency is
  both the request and the description. This oscillator is untrimmed, so treat
  the value as nominal: it is the right source for parking a clock while a PLL
  is reconfigured, and the wrong one to derive a baud rate or a timer from.

compatible: "nxp,imx-cguana-fro192m"

include: [base.yaml, fixed-clock.yaml]

properties:
  reg:
    required: true
    description: |
      The source's register groups inside the parent nxp,imx-cguana block, as
      offsets: "ctrl" and "status". Split rather than one span, because
      the block reserves address space between the groups.

  reg-names:
    required: true
```

## dts/bindings/clock/nxp,imx-cguana-sxosc.yaml
```yaml
# SPDX-FileCopyrightText: Copyright 2026 NXP
#
# SPDX-License-Identifier: Apache-2.0

description: |
  Crystal oscillator in an NXP i.MX CGU analog block (CGUANA).

  This is the board's crystal, and the reference the PLLs lock to. Declaring it
  here is what lets a board state its own crystal frequency and trim without
  editing SoC or board C code.

      sxosc: sxosc {
              compatible = "nxp,imx-cguana-sxosc";
              clock-frequency = <24000000>;
              nxp,gm-sel = <4>;
              nxp,cap-trim = <16>, <16>;
              #clock-cells = <0>;
      };

compatible: "nxp,imx-cguana-sxosc"

include: [base.yaml, fixed-clock.yaml]

properties:
  reg:
    required: true
    description: |
      The source's register groups inside the parent nxp,imx-cguana block, as
      offsets: "ctrl" and "status". Split rather than one span, because
      the block reserves address space between the groups.

  reg-names:
    required: true

  nxp,mode:
    type: string
    default: "crystal"
    enum:
      - "crystal"
      - "ac-slave"
      - "dc-bypass"
      - "dc-bypass-no-detect"
    description: |
      Oscillator drive mode. "crystal" drives a crystal on XTAL1/XTAL2; the
      bypass modes take an external clock instead.

  nxp,gm-sel:
    type: int
    default: 3
    description: |
      Transconductance select for the oscillator amplifier. The right value
      depends on the crystal's equivalent series resistance; the reference
      manual's crystal table gives a recommended value per frequency, and 3 is
      the recommendation for a 24 MHz crystal.

  nxp,cap-trim:
    type: array
    description: |
      On-chip load-capacitance trim for XTAL1 and XTAL2, in that order, each
      0..63. Must match the board's crystal load capacitance and stray
      capacitance, and both pins normally take the same value unless the
      schematic specifies an asymmetric load.

      Omit it to leave the reset default. A board that supplies a value it has
      not had measured should say so, because an untrimmed load shows up as a
      frequency error in everything derived from this crystal.

  nxp,det-trim:
    type: int
    default: 0
    description: |
      Amplitude-detector trim. Leave at 0 unless the hardware team specifies
      otherwise for start-up margin.

  nxp,div2-enable:
    type: boolean
    description: |
      Halve the oscillator output. Without it the output is the crystal
      frequency named in clock-frequency.
```

## dts/bindings/clock/nxp,imx-cguana.yaml
```yaml
# SPDX-FileCopyrightText: Copyright 2026 NXP
#
# SPDX-License-Identifier: Apache-2.0

description: |
  NXP i.MX CGU analog block (CGUANA) -- the block that generates clocks.

  An i.MX RT clock tree splits into two hardware classes, and this binding covers
  the first of them:

    - Generation: the crystal oscillator, the free-running oscillators and the
      PLLs. They live inside this block, and the SoC layer programs them during
      boot bring-up. Their sequencing is hazard-ordered and strongly SoC-specific,
      which is why they are not modelled as Zephyr clock-control devices: nothing
      calls clock_control_on() or clock_control_get_rate() on them.
    - Distribution: the gates and the mux/divider roots, which are the
      clock_control abstraction. See nxp,imx-ccm-rev3.

  This node is therefore a description of the hardware plus a data table the SoC
  layer reads, not a driver binding surface. It has no driver of its own; the SoC
  clock C code reaches the block by node label to take its base address, and each
  source by node label to take its parameters.

  Each clock source is an addressed child at its offset inside the block, taken
  from the device header's register map. Offsets, not absolute addresses, so one
  shared SoC devicetree serves both the secure and non-secure views of the
  peripheral aperture through this node's "ranges":

      cguana: clock-generation@40500000 {
              compatible = "nxp,imx-cguana";
              reg = <0x40500000 0x10000>;
              #address-cells = <1>;
              #size-cells = <1>;
              ranges = <0x0 0x40500000 0x10000>;

              sxosc: sxosc@20a0 {
                      compatible = "nxp,imx-cguana-sxosc", "nxp,imx-clock-source";
                      reg = <0x20a0 0x4>, <0x20a8 0x4>;
                      reg-names = "ctrl", "status";
                      clock-frequency = <24000000>;
                      #clock-cells = <0>;
              };
      };

  A child exists because it is a clock source referenced by a phandle, not because
  a register group exists. Register groups that belong to the block as a whole --
  the block control and interrupt registers, and the FRO tuner shared by both
  free-running oscillators -- are covered by this node's own "reg" and get no
  child node.

compatible: "nxp,imx-cguana"

include: [base.yaml]

properties:
  reg:
    required: true

  ranges:
    required: true

  "#address-cells":
    const: 1

  "#size-cells":
    const: 1
```

## dts/bindings/clock/nxp,imx-usbphy-pll.yaml
```yaml
# Copyright 2026 NXP
# SPDX-License-Identifier: Apache-2.0

description: |
  NXP i.MX RT USB PHY 480 MHz PLL as a clock provider. Enabling the clock
  locks the PLL and releases the USB controller reset. The output rate is
  fixed, so the specifier cell is unused.

compatible: "nxp,imx-usbphy-pll"

include: ["nxp,usbphy.yaml", clock-controller.yaml]

properties:
  "#clock-cells":
    const: 1

clock-cells:
  - name
```
