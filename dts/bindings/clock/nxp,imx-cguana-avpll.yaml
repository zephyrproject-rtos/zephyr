## dts/bindings/clock/sifive,fu540-c000-prci.yaml
```yaml
# SPDX-FileCopyrightText: Copyright The Zephyr Project Contributors
# SPDX-License-Identifier: Apache-2.0

description: |
  SiFive FU540 Power Reset Clock Interrupt block (PRCI), the clock
  controller of the SoC.

  The node follows the Linux binding, and the clock IDs are those of the
  Linux binding, named in include/zephyr/dt-bindings/clock/sifive-fu540-prci.h.
  The hfclk and rtcclk inputs are the crystals of the board:

    prci: clock-controller@10000000 {
      compatible = "sifive,fu540-c000-prci";
      reg = <0x10000000 0x1000>;
      clocks = <&hfclk>, <&rtcclk>;
      clock-names = "hfclk", "rtcclk";
      #clock-cells = <1>;
    };

    eth0: ethernet@10090000 {
      clocks = <&prci FU540_PRCI_CLK_GEMGXLPLL>, <&prci FU540_PRCI_CLK_GEMGXLPLL>;
      clock-names = "pclk", "hclk";
    };

  The driver derives the rates of the core, DDR and GEMGXL PLLs and of the
  TileLink clock from the registers as the boot firmware left them, and
  gates the outputs of the PLLs. The rates cannot be set.

compatible: "sifive,fu540-c000-prci"

include: [base.yaml, clock-controller.yaml]

properties:
  reg:
    required: true

  clocks:
    required: true

  clock-names:
    required: true
    description: |
      Names of the input clocks: "hfclk", the crystal the PLLs run from,
      required, and "rtcclk", the real-time clock crystal.

  "#clock-cells":
    const: 1

clock-cells:
  - id
```

## dts/bindings/clock/silabs,series-clock-output.yaml
```yaml
# Copyright (c) 2026 Silicon Laboratories Inc.
# SPDX-License-Identifier: Apache-2.0

title: Silicon Labs CMU (Clock Management Unit) CLKOUT (Clock Output)

description: |
  The Silicon Labs Series 2/3 Clock Management Unit has up to three clock outputs that can be routed
  to GPIO pins. Each output can be individually configured to output one of the on-chip oscillators,
  HCLK (the high frequency bus clock) or EXPORTCLK (a divided version of SYSCLK).

  Pin Control is used to configure GPIO routing for the CLKOUT signals.

compatible: "silabs,series-clock-output"

include:
  - name: base.yaml
  - name: clock-controller.yaml
  - name: pinctrl-device.yaml

properties:
  clock-div:
    type: int
    description: Shared clock divider for clock outputs.
    min: 1
    max: 32

  "#clock-cells":
    const: 1

clock-cells:
  - output

child-binding:
  description: |
    Output configuration.

  include:
    - name: base.yaml
      property-allowlist:
        - status
        - reg
        - clocks

  properties:
    reg:
      required: true
    clocks:
      required: true

examples:
  - |
    &pinctrl {
      clkout_default: clkout_default {
        group0 {
          pins = <CMU_CLKOUT0_PC1>, <CMU_CLKOUT1_PC2>;
          drive-push-pull;
          output-low;
        };
      };
    };

    &clkout {
      pinctrl-0 = <&clkout_default>;
      pinctrl-names = "default";
      status = "okay";

      clock-output@0 {
        clocks = <&exportclk>;
        status = "okay";
      };

      clock-output@1 {
        clocks = <&lfxo>;
        status = "okay";
      };
    };
```

## dts/bindings/clock/silabs,siwx91x-clock-route.yaml
```yaml
# Copyright (c) 2026 Silicon Laboratories Inc.
# SPDX-License-Identifier: Apache-2.0

description: |
  SiWx91x clock route under an HP, ULP, or AON CMU node.

  Describes a clock path : which SIWX91X_CLK_* is configured (from the node label
  via SIWX91X_CLOCK_NODE_TO_ID in clock_control_silabs_siwx91x_common.h) and which
  source drives it (clocks property).

  Optional clock-div programs a hardware divider when the clock path
  has a divider register.

  Usage example:

    #include <zephyr/dt-bindings/clock/silabs/siwx91x-clock.h>

    xyz-clock-mux: xyz-clock-mux {
      compatible = "silabs,siwx91x-clock-route";
      #clock-cells = <0>;
      clock-div = <2>;
      clocks = <&abc_clock>;
    };

compatible: "silabs,siwx91x-clock-route"

include: [base.yaml, clock-controller.yaml]

properties:
  clocks:
    required: true
    description: Parent clock source (single phandle).

  "#clock-cells":
    const: 0

  clock-div:
    type: int
    description: Optional hardware divider factor (0 or omitted = no divider programmed).
```
