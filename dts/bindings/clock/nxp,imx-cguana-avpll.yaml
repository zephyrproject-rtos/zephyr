## dts/bindings/clock/nxp,imx9-pll.yaml
```yaml
# Copyright 2026 NXP
# SPDX-License-Identifier: Apache-2.0

description: |
  NXP i.MX9 fractional-N PLL.

  The PLL derives its output from the 24 MHz oscillator using a reference
  predivider, an integer or fractional loop divider and an output divider:

    Fvco = (Fref / RDIV) * (MFI + MFN / MFD)
    Fout = Fvco / ODIV

  In integer mode the fractional part is unused, so:

    Fvco = (Fref / RDIV) * MFI
    Fout = Fvco / ODIV

  (Fref / RDIV) must be within 20 MHz to 40 MHz and Fvco within 2.5 GHz to
  5 GHz, so only validated divider sets may be used.

  Each child node describes one operating point the PLL may be programmed to.
  The dividers must produce the frequency the child advertises in
  clock-frequency.

  A driver that programs a specific instance of this PLL, such as the ARM PLL
  that clocks the Cortex-A cores, identifies its node by the label the SoC
  devicetree gives it (for example arm_pll), because the compatible is shared
  by every instance.

  Example configuration:

  arm_pll: arm-pll@44481000 {
          compatible = "nxp,imx9-pll";
          reg = <0x44481000 0x100>;
          #clock-cells = <0>;
          pll-mode = "integer";

          /* 24 MHz / 1 * 141 / 2 */
          opp-0 {
                  clock-frequency = <DT_FREQ_M(1692)>;
                  rdiv = <1>;
                  mfi = <141>;
                  odiv = <2>;
          };
  };

compatible: "nxp,imx9-pll"

include:
  - clock-controller.yaml
  - base.yaml

properties:
  "#clock-cells":
    const: 0

  pll-mode:
    type: string
    required: true
    enum:
      - "integer"
      - "fractional"
    description: |
      Loop divider mode used by every operating point of this PLL. In integer
      mode the operating points omit mfn and mfd; in fractional mode they must
      provide both.

child-binding:
  description: |
    One PLL operating point.

  properties:
    clock-frequency:
      type: int
      required: true
      description: |
        Output frequency produced by these dividers, in Hz.

    rdiv:
      type: int
      required: true
      enum: [0, 1, 2, 3, 4, 5, 6, 7]
      description: |
        Raw DIV[RDIV] input clock predivider field. Both 0 and 1 select divide
        by 1; values 2 to 7 divide by that value.

    mfi:
      type: int
      required: true
      description: |
        Integer portion of the loop divider, DIV[MFI].

    mfn:
      type: int
      description: |
        Numerator of the fractional loop divider, NUMERATOR[MFN]. Used only in
        fractional mode. MFN / MFD must be within 0 to 1.

    mfd:
      type: int
      description: |
        Denominator of the fractional loop divider, DENOMINATOR[MFD]. Used only
        in fractional mode. Writing 0 to this field is not allowed.

    odiv:
      type: int
      required: true
      description: |
        Raw DIV[ODIV] output divider field. Both 0 and 1 divide by 2; values 2
        to 255 divide by that value.
```

## dts/bindings/clock/nxp,imxrt11xx-enet-timer-root.yaml
```yaml
# Copyright (c) 2026 Powersoft S.p.A.
# SPDX-License-Identifier: Apache-2.0

description: |
  i.MX RT11xx clock root of an ENET 1588 timer (ENET_TIMER1 or ENET_TIMER2).

  clock_init() sets the source and the divider of the root from this node. The
  default of the SoC devicetree is SYS_PLL1_DIV2 / 5, which gives 100 MHz. A board
  or an application selects another root with an overlay, for example:

    &enet_timer2_root {
            clock-mux = <IMXRT11XX_ENET_TIMER_SRC_AUDIO_PLL>;
            clock-div = <2>;
    };

  The IMXRT11XX_ENET_TIMER_SRC_* values are in
  include/zephyr/dt-bindings/clock/nxp_imxrt11xx_enet_timer.h.

  The source must be running before the Ethernet driver starts the timer, which for
  AUDIO_PLL means that the driver that sets up that PLL must initialize first. The
  root frequency must not exceed the maximum of the SoC voltage mode (i.MX RT1170:
  100 MHz in under-drive, 200 MHz in nominal and overdrive).

compatible: "nxp,imxrt11xx-enet-timer-root"

include: clock-controller.yaml

properties:
  "#clock-cells":
    const: 0

  clock-mux:
    type: int
    required: true
    enum: [0, 1, 2, 3, 4, 5, 6, 7]
    description: |
      Source of the clock root:

        0: OSC_RC_48M_DIV2
        1: OSC_24M
        2: OSC_RC_400M
        3: OSC_RC_16M
        4: SYS_PLL1_DIV2
        5: AUDIO_PLL
        6: SYS_PLL1_DIV5 (not enabled by clock_init(), refused at build time)
        7: SYS_PLL2_PFD1

  clock-div:
    type: int
    required: true
    min: 1
    max: 255
    description: |
      Divider of the clock root. The CCM can divide by 256, but clock_init() gives the divider
      to the HAL in an 8-bit field, where 256 would become 0 (divide by 1).
```

## dts/bindings/clock/nxp,mcg-lite.yaml
```yaml
# SPDX-FileCopyrightText: Copyright 2026 NXP
# SPDX-License-Identifier: Apache-2.0

description: |
  NXP Multipurpose Clock Generator Lite (MCG_Lite)

  MCG_Lite is the reduced MCG on MCXC and K32L2 parts. It has no FLL
  or PLL. MCGOUTCLK is taken from one of three sources:

    - HIRC: 48 MHz high-frequency internal reference clock
    - LIRC: 8 MHz or 2 MHz low-frequency internal reference clock,
      divided by 2^fcrdiv (LIRC_DIV1)
    - EXT: the external clock or crystal oscillator (OSC0)

  MCGIRCLK is LIRC_DIV1 further divided by 2^lircdiv2. MCGPCLK is the HIRC
  output for peripherals.

compatible: "nxp,mcg-lite"

include: [clock-controller.yaml, base.yaml]

properties:
  reg:
    required: true

  "#clock-cells":
    const: 1

  clocks:
    description: |
      External clock input (OSC0). Required when clock-source is "ext".

  clock-source:
    type: string
    default: "hirc"
    enum:
      - "hirc"
      - "lirc"
      - "ext"
    description: |
      MCGOUTCLK source, programmed to MCG_C1[CLKS]. Out of reset the part
      runs from LIRC 8 MHz; the default here selects HIRC 48 MHz.

  lirc-frequency:
    type: int
    default: 8000000
    enum:
      - 2000000
      - 8000000
    description: |
      LIRC frequency in Hz, programmed to MCG_C2[IRCS]. The default is the
      reset value of MCG_C2[IRCS].

  fcrdiv:
    type: int
    default: 0
    enum: [0, 1, 2, 3, 4, 5, 6, 7]
    description: |
      First LIRC divider (MCG_SC[FCRDIV]). Division factor is 2^fcrdiv.
      The default is the reset value.

  lircdiv2:
    type: int
    default: 0
    enum: [0, 1, 2, 3, 4, 5, 6, 7]
    description: |
      Second LIRC divider (MCG_MC[LIRC_DIV2]), applied after fcrdiv to
      produce MCGIRCLK. Division factor is 2^lircdiv2. The default is the
      reset value.

  lirc-enable:
    type: boolean
    description: |
      Keep LIRC running when it is not the MCGOUTCLK source, so MCGIRCLK
      and LIRC_CLK stay available to peripherals (MCG_C1[IRCLKEN]).

  lirc-stop-enable:
    type: boolean
    description: |
      Keep LIRC running in Stop mode (MCG_C1[IREFSTEN]). Only takes effect
      together with lirc-enable.

  hirc-enable:
    type: boolean
    description: |
      Keep HIRC running when it is not the MCGOUTCLK source, so MCGPCLK
      stays available to peripherals (MCG_MC[HIRCEN]). Must be left out
      before entering VLPR.

clock-cells:
  - name

examples:
  - |
    # LIRC 8 MHz as MCGOUTCLK, with HIRC kept running for peripherals:
    &mcg {
            clock-source = "lirc";
            lirc-frequency = <DT_FREQ_M(8)>;
            fcrdiv = <1>;
            lirc-enable;
            hirc-enable;
    };
```

## dts/bindings/clock/nxp,mcxl-aon-clock.yaml
```yaml
# Copyright 2026 NXP
# SPDX-License-Identifier: Apache-2.0

description: NXP MCXL always-on (AON) domain clock controller.

compatible: "nxp,mcxl-aon-clock"

include: [clock-controller.yaml, base.yaml]

properties:

  "#clock-cells":
    type: int
    const: 1

clock-cells:
  - name
```

## dts/bindings/clock/nxp,mcxl-main-clock.yaml
```yaml
# Copyright 2026 NXP
# SPDX-License-Identifier: Apache-2.0

description: NXP MCXL main-domain (CM33) clock controller.

compatible: "nxp,mcxl-main-clock"

include: [clock-controller.yaml, base.yaml]

properties:

  firc-mode:
    type: int
    required: true
    description: |
      FIRC oscillator mode: 0 = disabled, 1 = active, 2 = active in low-power mode.
    enum:
      - 0
      - 1
      - 2

  sys-clk-src:
    type: int
    required: true
    description: System clock mux source index.

  frohf-frequency:
    type: int
    required: true
    description: Requested high-frequency FRO output in Hz.

  frohf-div:
    type: int
    required: true
    description: High-frequency FRO post-divider value.

  ahb-div:
    type: int
    required: true
    description: Core bus clock prescaler value.

  slow-clk-div:
    type: int
    required: true
    description: Slow peripheral clock prescaler value.

  core-clock-frequency:
    type: int
    required: true
    description: Expected core clock frequency in Hz after initialization.

  rosc-enable:
    type: boolean
    description: Initialize the 32 kHz ring oscillator during bring-up.

  "#clock-cells":
    type: int
    const: 1

clock-cells:
  - name
```

## dts/bindings/clock/nxp,sirc.yaml
```yaml
# Copyright 2026 NXP
# SPDX-License-Identifier: Apache-2.0

description: Slow internal RC oscillator

compatible: "nxp,sirc"

include: [base.yaml]

properties:
  reg:
    required: true

  standby-enable:
    type: boolean
    description: |
      Keep the SIRC running in Standby mode.
```

## dts/bindings/clock/nxp,sxosc.yaml
```yaml
# Copyright 2026 NXP
# SPDX-License-Identifier: Apache-2.0

description: |
  NXP slow external crystal oscillator (SXOSC).

compatible: "nxp,sxosc"

include: [base.yaml]

properties:
  reg:
    required: true

  delay:
    required: true
    type: int
    min: 1
    max: 255
    description: |
      End-of-count value (EOCV). For a 32.768 kHz crystal, the stabilization
      counting time is approximately delay / 64 seconds.

      The reset value is 125, i.e. about 1.95 s of boot time. Per the
      reference manual, change it only while the oscillator is off.
```

## dts/bindings/clock/puya,py32f0-rcc.yaml
```yaml
# SPDX-FileCopyrightText: Copyright The Zephyr Project Contributors
# SPDX-License-Identifier: Apache-2.0

description: |
  Puya PY32F0 reset and clock controller. Only the 24 MHz HSI source with
  undivided AHB and APB clocks is supported.

compatible: "puya,py32f0-rcc"

include: [base.yaml, clock-controller.yaml]

properties:
  reg:
    required: true
  clocks:
    required: true
  "#clock-cells":
    const: 2
  clock-frequency:
    type: int
    description: System clock frequency in Hz.
    required: true
    const: 24000000
  ahb-prescaler:
    type: int
    required: true
    const: 1
    description: AHB clock divider.
  apb1-prescaler:
    type: int
    required: true
    const: 1
    description: APB clock divider.

clock-cells:
  - bus
  - bits
```

## dts/bindings/clock/renesas,ra6b1-clk.yaml
```yaml
# SPDX-FileCopyrightText: 2026 Renesas Electronics Corporation
# SPDX-License-Identifier: Apache-2.0

description: RA6B1 clock

compatible: "renesas,ra6b1-clk"

include:
  - name: base.yaml
    property-allowlist:
      - status
      - compatible

properties:
  clock-src:
    required: true
    type: phandle
    description: |
      Clock source.
```

## dts/bindings/clock/renesas,ra6b1-osc.yaml
```yaml
# SPDX-FileCopyrightText: 2026 Renesas Electronics Corporation
# SPDX-License-Identifier: Apache-2.0

description: RA6B1 oscillator

compatible: "renesas,ra6b1-osc"

include:
  - name: base.yaml
    property-allowlist:
      - interrupts
      - interrupt-names
  - name: fixed-clock.yaml
    property-allowlist:
      - status
      - compatible
      - clock-frequency

properties:
  settle-time:
    type: int
    default: 8000
    description: |
      Time in ms needed to oscillator to settle.

  calibration-interval:
    type: int
    default: 10000
    description: |
      Time in ms between oscillator calibrations.

  calibration-cycles:
    type: int
    default: 10
    description: |
      Number of clocks cycle used for calibration.
```

## dts/bindings/clock/renesas,rx-cgc-pll-out.yaml
```yaml
# Copyright (c) 2026 Renesas Electronics Corporation
# SPDX-License-Identifier: Apache-2.0

description: Renesas RX Clock Generation Circuit PLL Clock out line

compatible: "renesas,rx-cgc-pll-out"

include: [clock-controller.yaml, base.yaml]

properties:
  freq:
    type: int

  div:
    required: true
    type: int

  mul:
    type: array
    description: |
      Multiple to calculate the PLL frequency from the input clock frequency
      This array type is used for FSP configuration to set values into register.
      It contains both the integer and the fractional part.
      Note: for PLL child node (P, Q, R), the multiple should be set to <1 0>.

  "#clock-cells":
    const: 0
```

## dts/bindings/clock/renesas,rx-cgc-pllccr-type.yaml
```yaml
# Copyright (c) 2026 Renesas Electronics Corporation
# SPDX-License-Identifier: Apache-2.0

description: Renesas RX Clock Generation Circuit PLLCCR

compatible: "renesas,rx-cgc-pllccr-type"

include: [clock-controller.yaml, base.yaml]

properties:
  freq:
    type: int

  div:
    required: true
    type: int

  mul:
    type: array
    description: |
      Multiple to calculate the PLL frequency from the input clock frequency
      This array type is used for FSP configuration to set values into register.
      It contains both the integer and the fractional part.
      Note: for PLL child node (P, Q, R), the multiple should be set to <1 0>.

  "#clock-cells":
    const: 0
```

## dts/bindings/clock/rockchip,rk3588-cru-clk.yaml
```yaml
# SPDX-FileCopyrightText: Copyright (c) 2026 KylinSoft Corporation
# SPDX-License-Identifier: Apache-2.0

title: Rockchip RK3588 CRU Clock Controller

description: |
  Clock controller for the Rockchip RK3588 CRU. It gates the peripheral clocks
  and selects the divider and parent of the ComboPHY0 reference clock. Clock IDs
  are defined in include/zephyr/dt-bindings/clock/rk3588-cru.h.

compatible: "rockchip,rk3588-cru-clk"

include: [clock-controller.yaml, base.yaml]

properties:
  "#clock-cells":
    const: 1

clock-cells:
  - clkid
```

## dts/bindings/clock/rockchip,rk3588-cru.yaml
```yaml
# Copyright (c) 2026 KylinSoft Corporation
# SPDX-License-Identifier: Apache-2.0

title: Rockchip RK3588 CRU

description: |
  Rockchip RK3588 Clock and Reset Unit (CRU) register block. Child nodes
  provide the clock and reset controller interfaces.

compatible: "rockchip,rk3588-cru"

include: base.yaml

properties:
  reg:
    required: true

child-binding:
  description: |
    Child clock or reset controller nodes sharing the CRU register block.
```
