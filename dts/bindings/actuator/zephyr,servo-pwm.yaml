## dts/bindings/actuator/zephyr,servo-pwm.yaml
```yaml
# Copyright (c) 2025 Nordic Semiconductor ASA
# SPDX-License-Identifier: Apache-2.0

description: PWM driven servo device

include: actuator-device.yaml

compatible: zephyr,servo-pwm

properties:
  pwms:
    type: phandle-array
    required: true

  pulse-min-ns:
    type: int
    required: true

  pulse-max-ns:
    type: int
    required: true
```

## dts/bindings/adc/adc-comparator.yaml
```yaml
# Copyright (c) 2022 Intel Corporation
# SPDX-License-Identifier: Apache-2.0

description: |
    Comparator will continuously monitor signal through ADC channel and compare
    its result with defined threshold value. When comparison criterion is met,
    event will be triggered.

include: base.yaml

properties:
    io-channels:
      type: phandle-array
      required: true
      description: |
        ADC channel that will perform measurement.
```

## dts/bindings/adc/adc-controller.yaml
```yaml
# Copyright (c) 2017, NXP
# Copyright (c) 2022, Nordic Semiconductor ASA
# SPDX-License-Identifier: Apache-2.0

# Common fields for ADC controllers

include: base.yaml

properties:
  "#io-channel-cells":
    type: int
    required: true

  "#address-cells":
    const: 1

  "#size-cells":
    const: 0

child-binding:
  description: |
    Channel configuration.

    All nodes using this binding must be named "channel", otherwise their
    data will not be accessible for the ADC API macros.

    This is based on Linux, documentation:
      https://www.kernel.org/doc/Documentation/devicetree/bindings/iio/adc/adc.yaml

  properties:
    reg:
      type: array
      required: true
      description: Channel identifier.

    zephyr,gain:
      type: string
      required: true
      description: |
        Gain selection:
        - ADC_GAIN_1_6: x 1/6
        - ADC_GAIN_1_5: x 1/5
        - ADC_GAIN_1_4: x 1/4
        - ADC_GAIN_1_3: x 1/3
        - ADC_GAIN_2_5: x 2/5
        - ADC_GAIN_1_2: x 1/2
        - ADC_GAIN_2_3: x 2/3
        - ADC_GAIN_4_5: x 4/5
        - ADC_GAIN_1:   x 1
        - ADC_GAIN_2:   x 2
        - ADC_GAIN_3:   x 3
        - ADC_GAIN_4:   x 4
        - ADC_GAIN_6:   x 6
        - ADC_GAIN_8:   x 8
        - ADC_GAIN_12:  x 12
        - ADC_GAIN_16:  x 16
        - ADC_GAIN_24:  x 24
        - ADC_GAIN_32:  x 32
        - ADC_GAIN_64:  x 64
        - ADC_GAIN_128: x 128
      enum:
        - "ADC_GAIN_1_6"
        - "ADC_GAIN_1_5"
        - "ADC_GAIN_1_4"
        - "ADC_GAIN_1_3"
        - "ADC_GAIN_2_5"
        - "ADC_GAIN_1_2"
        - "ADC_GAIN_2_3"
        - "ADC_GAIN_4_5"
        - "ADC_GAIN_1"
        - "ADC_GAIN_2"
        - "ADC_GAIN_3"
        - "ADC_GAIN_4"
        - "ADC_GAIN_6"
        - "ADC_GAIN_8"
        - "ADC_GAIN_12"
        - "ADC_GAIN_16"
        - "ADC_GAIN_24"
        - "ADC_GAIN_32"
        - "ADC_GAIN_64"
        - "ADC_GAIN_128"

    zephyr,reference:
      type: string
      required: true
      description: |
        Reference selection:
        - ADC_REF_VDD_1:     VDD
        - ADC_REF_VDD_1_2:   VDD/2
        - ADC_REF_VDD_1_3:   VDD/3
        - ADC_REF_VDD_1_4:   VDD/4
        - ADC_REF_INTERNAL:  Internal
        - ADC_REF_EXTERNAL0: External, input 0
        - ADC_REF_EXTERNAL1: External, input 1
      enum:
        - "ADC_REF_VDD_1"
        - "ADC_REF_VDD_1_2"
        - "ADC_REF_VDD_1_3"
        - "ADC_REF_VDD_1_4"
        - "ADC_REF_INTERNAL"
        - "ADC_REF_EXTERNAL0"
        - "ADC_REF_EXTERNAL1"

    zephyr,vref-mv:
      type: int
      description: |
        This property can be used to specify the voltage (in millivolts)
        of the reference selected for this channel, so that applications
        can get that value if needed for some calculations.
        For the internal reference, the voltage can be usually obtained with
        a dedicated ADC API call, so there is no need to use this property
        in that case, but for other references this property can be useful.

    zephyr,acquisition-time:
      type: int
      required: true
      description: |
        Acquisition time.
        Use the ADC_ACQ_TIME macro to compose the value for this property
        or pass ADC_ACQ_TIME_DEFAULT to use the default setting for a given
        hardware (e.g. when the hardware does not allow to configure the
        acquisition time).

    zephyr,differential:
      type: boolean
      description: |
        When set, selects differential input mode for the channel. Otherwise,
        single-ended mode is used unless the zephyr,input-negative property is
        specified, in which case the differential mode is selected implicitly.

    zephyr,input-positive:
      type: int
      description: |
        Positive ADC input. Used only for drivers that select
        the ADC_CONFIGURABLE_INPUTS Kconfig option.

    zephyr,input-negative:
      type: int
      description: |
        Negative ADC input. Used only for drivers that select
        the ADC_CONFIGURABLE_INPUTS Kconfig option.
        When specified, implies the differential input mode for the channel.

    zephyr,resolution:
      type: int
      description: |
        ADC resolution to be used for the channel.

    zephyr,oversampling:
      type: int
      description: |
        Oversampling setting to be used for the channel.
        When specified, each sample is averaged from 2^N conversion results
        (where N is the provided value).

    zephyr,current-source-pin:
      type: uint8-array
      description: |
        Output pin selection for the current sources. The actual
        interpretation depends on the driver. This is used only for drivers
        which select the ADC_CONFIGURABLE_EXCITATION_CURRENT_SOURCE_PIN
        Kconfig option.
```

## dts/bindings/adc/adi,ad4050-adc.yaml
```yaml
# Copyright (c) 2025 Analog Devices, Inc.
# SPDX-License-Identifier: Apache-2.0

description: ADI AD4050 ADC Controller

compatible: "adi,ad4050-adc"

include: adi,ad405x-adc-base.yaml
```

## dts/bindings/adc/adi,ad4052-adc.yaml
```yaml
# Copyright (c) 2025 Analog Devices, Inc.
# SPDX-License-Identifier: Apache-2.0

description: ADL4052 ADC Controller

compatible: "adi,ad4052-adc"

include: adi,ad405x-adc-base.yaml
```

## dts/bindings/adc/adi,ad405x-adc-base.yaml
```yaml
# Copyright (c) 2025 Analog Devices, Inc.
# SPDX-License-Identifier: Apache-2.0

description: ADL4050 ADC Controller

compatible: "adi,ad4050-adc"

include: [adc-controller.yaml, spi-device.yaml]

properties:
  gp1-gpios:
    type: phandle-array
    description: |
      The GP1 signal defaults to DEV_RDY as produced by the
      adc. The property value should ensure the flags properly
      describe the signal that is presented to the driver.
  gp0-gpios:
    type: phandle-array
    description: |
      The GP0 signal defaults to Disabled as produced by the
      adc. The property value should ensure the flags properly
      describe the signal that is presented to the driver.
  conversion-gpios:
    type: phandle-array
    description: |
      The CONV signal.
    required: true
  "#io-channel-cells":
    const: 1

  double-input-range:
    type: boolean
    description: |
      Default ADC input range is 0V to Vref.
      This option increases the range from 0V to 2 x Vref. Note that this
      requires VDD >= 2 x Vref.

io-channel-cells:
  - input
```

## dts/bindings/adc/adi,ad4114-adc.yaml
```yaml
include: [adc-controller.yaml, spi-device.yaml]

compatible: "adi,ad4114-adc"

description: Binding for the ADI AD4114 ADC.

properties:
  map-inputs:
    type: array
    required: true
    description: |
      Array of 16 values corresponding to CHANNEL REGISTER 0 TO CHANNEL REGISTER 15.
```

## dts/bindings/adc/adi,ad4130-adc.yaml
```yaml
# Copyright (c) 2025 Analog Devices, Inc.
# SPDX-License-Identifier: Apache-2.0

description: |
  Bindings for the ADI AD4130 Analog-to-Digital Converter.

  This device is controlled over SPI and exposes one or more ADC input channels.
  Each child node corresponds to a channel and supports standard ADC properties
  such as gain, reference, resolution, and input configuration.

  Sample binding

  &spi0 {
      status = "okay";

      spi_ad4130: ad4130@0 {
          compatible = "adi,ad4130-adc";
          reg = <0x0>;
          spi-max-frequency = <2700000>;
          status = "okay";

          #address-cells = <1>;
          #size-cells = <0>;
          #io-channel-cells = <1>;

          channel@1 {
              reg = <1>;
              zephyr,gain = "ADC_GAIN_1";
              zephyr,reference = "ADC_REF_INTERNAL";
              zephyr,acquisition-time = <ADC_ACQ_TIME_DEFAULT>;
              zephyr,resolution = <24>;
              zephyr,input-positive = <AD4130_ADC_AIN8>;
              zephyr,input-negative = <AD4130_ADC_AIN9>;
          };

          channel@2 {
              reg = <2>;
              zephyr,gain = "ADC_GAIN_1";
              zephyr,reference = "ADC_REF_INTERNAL";
              zephyr,acquisition-time = <ADC_ACQ_TIME_DEFAULT>;
              zephyr,resolution = <24>;
              zephyr,input-positive = <AD4130_ADC_AIN10>;
              zephyr,input-negative = <AD4130_ADC_AIN11>;
          };
      };
  };

  For input constants such as `AD4130_ADC_AIN8`, refer to the binding header:
  `include/zephyr/dt-bindings/adc/ad4130-adc.h`

compatible: adi,ad4130-adc

include: [adc-controller.yaml, spi-device.yaml]

properties:
  bipolar:
    type: boolean
    description: |
      Bipolar configuration for AD4130
  internal-reference-value:
    type: int
    enum: [0, 1]
    default: 0
    description: |
      Internal reference value selection:
      - AD4130_INTREF_2_5V
      - AD4130_INTREF_1_25V
      The default value is set to 0 to provide a higher full-scale range
      for ADC measurements, which is suitable for a wider variety of
      general-purpose applications.
  adc-mode:
    type: int
    enum: [0, 1, 2, 3, 4]
    default: 0
    description: |
      ADC operating mode for AD4130
      - 0 AD4130_CONTINUOUS
      - 1 AD4130_SINGLE
      - 2 AD4130_STANDBY
      - 3 AD4130_POWER_DOWN
      - 4 AD4130_IDLE
      The default is set to 0 because the continuous conversion mode
      is enabled for control setup upon power-up or after reset.
  clock-type:
    type: int
    enum: [0, 1, 2, 3]
    default: 0
    description: |
      Clock selection:
      - AD4130_INT_76_8_KHZ_OUT_OFF
      - AD4130_INT_76_8_KHZ_OUT_ON
      - AD4130_EXT_76_8KHZ
      - AD4130_EXT_153_6_KHZ_DIV_2
      The default value is 0, which selects the internal clock without
      enabling the clock output.
  "#io-channel-cells":
    const: 1

io-channel-cells:
  - input
```

## dts/bindings/adc/adi,ad4130.yaml
```yaml
# Copyright (c) 2025 Analog Devices, Inc.
# SPDX-License-Identifier: Apache-2.0

description: |
  Bindings for the ADI AD4130 Analog-to-Digital Converter.
compatible: adi,ad4130-adc

include: [adc-controller.yaml, spi-device.yaml]

properties:
  bipolar:
    type: boolean
    description: |
      Bipolar configuration for AD4130
  internal-reference-value:
    type: int
    enum: [0, 1]
    default: 0
    description: |
      Internal reference value selection:
      - AD4130_INTREF_2_5V
      - AD4130_INTREF_1_25V
  adc-mode:
    type: int
    enum: [0, 1, 2, 3, 4]
    default: 0
    description: |
      ADC operating mode for AD4130
      - 0 AD4130_CONTINUOUS
      - 1 AD4130_SINGLE
      - 2 AD4130_STANDBY
      - 3 AD4130_POWER_DOWN
      - 4 AD4130_IDLE
      The default is set to 0 because the continuous conversion mode
      is enabled for control setup upon power-up or after reset.
  clock-type:
    type: int
    enum: [0, 1, 2, 3]
    default: 0
    description: |
      Clock selection:
      - AD4130_INT_76_8_KHZ_OUT_OFF
      - AD4130_INT_76_8_KHZ_OUT_ON
      - AD4130_EXT_76_8KHZ
      - AD4130_EXT_153_6_KHZ_DIV_2
  "#io-channel-cells":
    const: 1

io-channel-cells:
  - input
```

## dts/bindings/adc/adi,ad4170-adc.yaml
```yaml
# Copyright (c) 2025 Analog Devices, Inc.
# SPDX-License-Identifier: Apache-2.0

description: |
  Bindings for the ADI AD4170 Analog-to-Digital Converter.

  This device is controlled over SPI and exposes one or more ADC input channels.
  Each child node corresponds to a channel and supports standard ADC properties
  such as gain, reference, resolution, and input configuration.

  Example binding:

  &spi0 {
      status = "okay";
      #address-cells = <1>;
      #size-cells = <0>;

      ad4170: ad4170@0 {
          compatible = "adi,ad4170-adc";
          reg = <0x0>;
          spi-max-frequency = <100000000>;
          spi-cpol;
          spi-cpha;
          status = "okay";

          #address-cells = <1>;
          #size-cells = <0>;
          #io-channel-cells = <1>;

          channel@1 {
              reg = <1>;
              zephyr,gain = "ADC_GAIN_1";
              zephyr,reference = "ADC_REF_INTERNAL";
              zephyr,acquisition-time = <ADC_ACQ_TIME_DEFAULT>;
              zephyr,resolution = <24>;
              zephyr,input-positive = <AD4170_ADC_AIN0>;
              zephyr,input-negative = <AD4170_ADC_AIN1>;
          };

          channel@2 {
              reg = <2>;
              zephyr,gain = "ADC_GAIN_1";
              zephyr,reference = "ADC_REF_INTERNAL";
              zephyr,acquisition-time = <ADC_ACQ_TIME_DEFAULT>;
              zephyr,resolution = <24>;
              zephyr,input-positive = <AD4170_ADC_AIN12>;
              zephyr,input-negative = <AD4170_ADC_AIN13>;
          };
      };
  };

  For input constants such as `AD4170_ADC_AIN0`, refer to the binding header:
  `include/zephyr/dt-bindings/adc/ad4170-adc.h`

compatible: adi,ad4170-adc

include: [adc-controller.yaml, spi-device.yaml]

properties:
  bipolar:
    type: boolean
    description: |
      If true, the ADC operates in bipolar mode, otherwise it operates in
      unipolar mode.

  adc-mode:
    type: int
    enum: [0, 1, 2, 3, 4]
    default: 0
    description: |
      ADC Operating Mode. The default corresponds to the reset value of the
      register field.
      - 0 AD4170_CONTINUOUS_MODE (Default)
      - 1 AD4170_SINGLE_MODE
      - 2 AD4170_STANDBY_MODE
      - 3 AD4170_POWER_DOWN_MODE
      - 4 AD4170_IDLE_MODE

  clock-select:
    type: int
    enum: [0, 1, 2, 3]
    default: 0
    description: |
      ADC Clock Select. The default corresponds to the reset value of the
      register field.
      - 0 AD4170_CLKSEL_INT (Default)
      - 1 AD4170_CLKSEL_INT_OUT
      - 2 AD4170_CLKSEL_EXT
      - 3 AD4170_CLKSEL_EXT_XTAL

  clock-frequency:
    type: int
    description: |
      Master clock frequency in Hertz (minimum 1000000, maximum 17000000). The
      default is 16MHz, which corresponds to the internal clock frequency.
    default: 16000000

  filter-type:
    type: int
    enum: [0, 1, 2]
    default: 0
    description: |
      ADC Filter Type. The default corresponds to the reset value of the
      register field.
      - 0 AD4170_SINC5_AVG (Default)
      - 1 AD4170_SINC5
      - 2 AD4170_SINC3

  "#io-channel-cells":
    const: 1

io-channel-cells:
  - input
```

## dts/bindings/adc/adi,ad4190-8-adc.yaml
```yaml
# Copyright (c) 2026 Analog Devices, Inc.
# SPDX-License-Identifier: Apache-2.0

description: |
  ADI AD4190-8 ADC Controller.

compatible: "adi,ad4190-8-adc"

include: adi,ad4170-adc.yaml
```

## dts/bindings/adc/adi,ad4190-adc.yaml
```yaml
# Copyright (c) 2025 Analog Devices, Inc.
# SPDX-License-Identifier: Apache-2.0

description: |
  ADI AD4190 ADC Controller.

compatible: "adi,ad4190-adc"

include: adi,ad4170-adc.yaml
```

## dts/bindings/adc/adi,ad4195-8-adc.yaml
```yaml
# Copyright (c) 2026 Analog Devices, Inc.
# SPDX-License-Identifier: Apache-2.0

description: |
  ADI AD4195-8 ADC Controller.

compatible: "adi,ad4195-8-adc"

include: adi,ad4170-adc.yaml
```
