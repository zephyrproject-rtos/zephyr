## dts/bindings/adc/adi,ad4195-adc.yaml
```yaml
# Copyright (c) 2025 Analog Devices, Inc.
# SPDX-License-Identifier: Apache-2.0

description: |
  ADI AD4195 ADC Controller.

compatible: "adi,ad4195-adc"

include: adi,ad4170-adc.yaml
```

## dts/bindings/adc/adi,ad5592-adc.yaml
```yaml
# Copyright (c) 2023 Grinn
# SPDX-License-Identifier: Apache-2.0

description: AD5592 ADC Controller

compatible: "adi,ad5592-adc"

include: adc-controller.yaml

properties:
  "#io-channel-cells":
    const: 1

io-channel-cells:
  - input
```

## dts/bindings/adc/adi,ad559x-adc.yaml
```yaml
# Copyright (c) 2023 Grinn
# SPDX-License-Identifier: Apache-2.0

description: AD559x ADC Controller

compatible: "adi,ad559x-adc"

include: adc-controller.yaml

properties:
  "#io-channel-cells":
    const: 1

  double-input-range:
    type: boolean
    description: |
      Default ADC input range is 0V to Vref.
      This option increases the range from 0V to 2 x Vref. Note that this
      requires VDD >= 2 x Vref.

io-channel-cells:
  - input
```

## dts/bindings/adc/adi,ad7124-adc.yaml
```yaml
# Copyright (c) 2025 Analog Devices, Inc.
# SPDX-License-Identifier: Apache-2.0

description: |
  Bindings for the ADI AD7124 Analog-to-Digital Converter.

compatible: adi,ad7124-adc

include: [adc-controller.yaml, spi-device.yaml]

properties:

  reference-enable:
    type: boolean
    description: |
      Enable internal reference for AD7124
      - true: Enable internal reference
      - false: Disable internal reference

  filter-type-mask:
    type: int
    default: 0
    description: |
      Filter type for AD7124:
      Each bit set in this mask enables the filter type,
      with the 0th bit corresponding to the 0th channel,
      the 1st bit to the 1st channel, and so on.
      - 0 means AD7124_FILTER_SINC4
      - 1 means AD7124_FILTER_SINC3
      The default is set to 0 because the filter type is set to SINC4
      for all filter setups upon power-up or after reset.
      Therefore, this setting is considered the default for all channels.

  bipolar-mask:
    type: int
    default: 0xFFFF
    description: |
      Bipolar configuration for AD7124
      Each bit set in this mask enables the polarity,
      with the 0th bit corresponding to the 0th channel,
      the 1st bit to the 1st channel, and so on.
      - 0 Unipolar operation selection
      - 1 Bipolar operation selection
      The default is set to 0xFFFF because the bipolar configuration
      is activated for all configuration setups upon power-up or after reset.
      Therefore, this setting is considered the default for all channels.

  inbuf-enable-mask:
    type: int
    default: 0xFFFF
    description: |
      Input buffer configuration for AD7124
      Each bit set in this mask enables the input buffer,
      with the 0th bit corresponding to the 0th channel,
      the 1st bit to the 1st channel, and so on.
      - 0 Analog input pin is unbuffered
      - 1 Analog input pin is buffered
      The default is set to 0xFFFF because the analog input buffer
      is enabled for all configuration setups upon power-up or after reset.
      Therefore, this setting is considered the default for all channels.

  refbuf-enable-mask:
    type: int
    default: 0
    description: |
      Reference buffer configuration for AD7124
      Each bit set in this mask enables the reference buffer,
      with the 0th bit corresponding to the 0th channel,
      the 1st bit to the 1st channel, and so on.
      - 0 Reference input pin is unbuffered
      - 1 Reference input pin is buffered
      The default is set to 0 because the reference input buffer
      is enabled for all configuration setups upon power-up or after reset.
      Therefore, this setting is considered the default for all channels.

  adc-mode:
    type: int
    enum: [0, 1, 2, 3, 4, 5, 6, 7, 8]
    default: 0
    description: |
      ADC operating mode for AD7124
      - 0 AD7124_CONTINUOUS
      - 1 AD7124_SINGLE
      - 2 AD7124_STANDBY
      - 3 AD7124_POWER_DOWN
      - 4 AD7124_IDLE
      - 5 AD7124_IN_ZERO_SCALE_OFF
      - 6 AD7124_IN_FULL_SCALE_GAIN
      - 7 AD7124_SYS_ZERO_SCALE_OFF
      - 8 AD7124_SYS_ZERO_SCALE_GAIN
      The default is set to 0 because the continuous conversion mode
      is enabled for control setup upon power-up or after reset.

  power-mode:
    type: int
    enum: [0, 1, 2]
    default: 0
    description: |
      Power mode of the ADC for AD7124
      - 0 AD7124_LOW_POWER_MODE
      - 1 AD7124_MID_POWER_MODE
      - 2 AD7124_HIGH_POWER_MODE
      The default is set to 0 because the low power mode
      is enabled for control setup upon power-up or after reset.

  active-device:
    type: int
    enum: [0, 1]
    required: true
    description: |
      Active device for AD7124
      - 0 ID_AD7124_4
      - 1 ID_AD7124_8

  "#io-channel-cells":
    const: 1

io-channel-cells:
  - input
```

## dts/bindings/adc/adi,max32-adc-10b.yaml
```yaml
# Copyright (c) 2023-2024 Analog Devices, Inc.
# SPDX-License-Identifier: Apache-2.0

description: ADI MAX32 ADC 10-Bits

compatible: "adi,max32-adc-10b"

include:
  - name: adi,max32-adc.yaml
    property-blocklist:
      - clock-source
      - clock-divider
      - track-count
      - idle-count
```

## dts/bindings/adc/adi,max32-adc-b-me18.yaml
```yaml
# Copyright (c) 2023-2024 Analog Devices, Inc.
# SPDX-License-Identifier: Apache-2.0

description: ADI MAX32 ADC that supports revB and me18

compatible: "adi,max32-adc-b-me18"

include: adi,max32-adc.yaml
```

## dts/bindings/adc/adi,max32-adc-sar.yaml
```yaml
# Copyright (c) 2023-2024 Analog Devices, Inc.
# SPDX-License-Identifier: Apache-2.0

description: ADI MAX32 ADC SAR

compatible: "adi,max32-adc-sar"

include: adi,max32-adc.yaml
```

## dts/bindings/adc/adi,max32-adc.yaml
```yaml
# Copyright (c) 2023-2024 Analog Devices, Inc.
# SPDX-License-Identifier: Apache-2.0

description: ADI MAX32 ADC

compatible: "adi,max32-adc"

include: [adc-controller.yaml, pinctrl-device.yaml]

properties:
  reg:
    required: true

  interrupts:
    required: true

  clocks:
    required: true

  pinctrl-0:
    required: true

  pinctrl-names:
    required: true

  channel-count:
    type: int
    required: true
    description: The maximum channels supported on each unit.

  vref-mv:
    type: int
    required: true
    description: Indicates the reference voltage of the ADC in mV (on the target board).

  resolution:
    type: int
    required: true
    description: Indicates the resolution supported by the ADC instance.

  clock-source:
    required: true
    type: int
    enum: [0, 1, 2, 3]
    description: |
      Clock source to be used by the ADC peripheral. The following options
      are available:
      - 0: "ADI_MAX32_PRPH_CLK_SRC_PCLK" Peripheral clock
      - 1: "ADI_MAX32_PRPH_CLK_SRC_EXTCLK" External Clock
      - 2: "ADI_MAX32_PRPH_CLK_SRC_IBRO" Internal Baud Rate Oscillator
      - 3: "ADI_MAX32_PRPH_CLK_SRC_ERFO" External Radio Frequency Oscillator
      The target device might not support every option please take a look on
      target device user guide

  clock-divider:
    required: true
    type: int
    enum: [1, 2, 4, 8, 16]
    description: |
      The clock divider divides the ADC source clock to set the ADC clock frequency as follows:
        F_sar_clk = F_clock_source / clock divider

  track-count:
    required: true
    type: int
    description: |
      The number of cycles to add to the minimum track time.

  idle-count:
    required: true
    type: int
    description: |
      The number of cycles to add to the minimum hold time.

  "#io-channel-cells":
    const: 1

io-channel-cells:
  - input
```

## dts/bindings/adc/ambiq,adc.yaml
```yaml
# Copyright (c) 2024 Ambiq Micro Inc.
# SPDX-License-Identifier: Apache-2.0

description: Ambiq ADC node

compatible: "ambiq,adc"

include: [adc-controller.yaml, pinctrl-device.yaml]
properties:
  reg:
    required: true

  interrupts:
    required: true

  channel-count:
    type: int
    required: true
    description: The maximum channels supported on each unit.

  internal-vref-mv:
    type: int
    required: true
    description: Indicates the reference voltage of the ADC in mV.

  dma-mode:
    description: Enables DMA over ADC.
    type: boolean

  dma-buffer-location:
    type: string
    description: |
      Define the DMA buffer location section

  dma-buffer-size:
    type: int
    description: |
      Define the DMA buffer size in (4-byte) words

io-channel-cells:
  - input
```

## dts/bindings/adc/atmel,sam-adc.yaml
```yaml
# Copyright (c) 2022, Basalte bv
# SPDX-License-Identifier: Apache-2.0

description: Atmel SAM family ADC

compatible: "atmel,sam-adc"

include: [adc-controller.yaml, pinctrl-device.yaml]

properties:
  reg:
    required: true

  interrupts:
    required: true

  clocks:
    required: true

  prescaler:
    type: int
    required: true
    description: CPU clock prescaler applied to get the ADC clock.

  startup-time:
    type: int
    required: true
    description: |
      ADC startup time in ADC clock cycles.
    enum: [0, 8, 16, 24, 64, 80, 96, 112, 512, 576, 640, 704, 768, 832, 896, 960]

  settling-time:
    type: int
    required: true
    description: |
      ADC settling time in ADC clock cycles. When the gain, offset
      or differential input parameters of the analog cell change
      between two channels, the analog cell may need a specific
      settling time before starting the tracking phase.
    enum: [3, 5, 9, 17]

  tracking-time:
    type: int
    required: true
    description: |
      ADC tracking time in ADC clock cycles. A minimal tracking time
      is necessary for the ADC to guarantee the best converted final
      value between two channel selections.
    enum: [1, 2, 3, 4, 5, 6, 7, 8, 9, 10, 11, 12, 13, 14, 15, 16]

  "#io-channel-cells":
    const: 1

  pinctrl-0:
    required: true

  pinctrl-names:
    required: true

io-channel-cells:
  - input
```

## dts/bindings/adc/atmel,sam-afec.yaml
```yaml
description: Atmel SAM family AFEC

compatible: "atmel,sam-afec"

include:
  - name: adc-controller.yaml
  - name: pinctrl-device.yaml

properties:
  reg:
    required: true

  interrupts:
    required: true

  clocks:
    required: true

  "#io-channel-cells":
    const: 1

io-channel-cells:
  - input
```

## dts/bindings/adc/atmel,sam0-adc.yaml
```yaml
# Copyright (c) 2019 Derek Hageman <hageman@inthat.cloud>
# Copyright (c) 2024 Gerson Fernando Budke <nandojve@gmail.com>
# SPDX-License-Identifier: Apache-2.0

description: Atmel SAM0 family ADC

compatible: "atmel,sam0-adc"

include:
  - name: adc-controller.yaml
  - name: pinctrl-device.yaml
  - name: atmel,assigned-clocks.yaml

properties:
  reg:
    required: true

  interrupts:
    required: true

  clocks:
    required: true

  clock-names:
    required: true

  atmel,assigned-clocks:
    required: true

  atmel,assigned-clock-names:
    required: true

  prescaler:
    type: int
    required: true
    description: clock prescaler divisor applied to the generic clock

  "#io-channel-cells":
    const: 1

  calib-offset:
    type: int
    description: |
      bit position offset in NVM SW Calib for start of ADC0 BIASCOMP field.
      This property is expected to be set on SAM{D,E}5x family of SoCs.
      For ADC0 this should be 0, and for ADC1 this should be 14.
    enum:
      - 0
      - 14

io-channel-cells:
  - input
```
