## dts/bindings/gpio/nxp,pca6416.yaml
```yaml
# Copyright 2024-2025 NXP
# SPDX-License-Identifier: Apache-2.0
description: NXP PCA6416 I2C GPIO expander
compatible: nxp,pca6416
include: nxp,pca_series.yaml

properties:
  ngpios:
    required: true
    const: 16
```

## dts/bindings/gpio/nxp,pca6416a.yaml
```yaml
# Copyright 2024-2025 NXP
# SPDX-License-Identifier: Apache-2.0
description: NXP PCA6416A I2C GPIO expander node
compatible: nxp,pca6416a
include: nxp,pca_series.yaml

properties:
  ngpios:
    required: true
    const: 16
```

## dts/bindings/gpio/nxp,pca9536.yaml
```yaml
# Copyright (c) 2019 Intel Corporation
# Copyright (C) 2020, Riedo Networks Ltd
# SPDX-License-Identifier: Apache-2.0

description: PCA9536 4bits I2C-based GPIO expander

compatible: "nxp,pca9536"

include: [gpio-controller.yaml, i2c-device.yaml]

properties:
    label:
      required: true

    "#gpio-cells":
      const: 1

gpio-cells:
  - pin
  - flags
```

## dts/bindings/gpio/nxp,pca9538.yaml
```yaml
# Copyright 2024 NXP
# SPDX-License-Identifier: Apache-2.0
description: NXP PCA9538 I2C GPIO expander node
compatible: nxp,pca9538
include: nxp,pca_series.yaml

properties:
  ngpios:
    required: true
    const: 8
```

## dts/bindings/gpio/nxp,pca9539.yaml
```yaml
# Copyright 2024 NXP
# SPDX-License-Identifier: Apache-2.0
description: NXP PCA9539 I2C GPIO expander node
compatible: nxp,pca9539
include: nxp,pca_series.yaml

properties:
  ngpios:
    required: true
    const: 16
```

## dts/bindings/gpio/nxp,pca9555.yaml
```yaml
# Copyright 2024 NXP
# SPDX-License-Identifier: Apache-2.0
description: NXP PCA9555 I2C GPIO expander

compatible: "nxp,pca9555"

include: nxp,pca_series.yaml

properties:
  ngpios:
    required: true
    const: 16
```

## dts/bindings/gpio/nxp,pca9574.yaml
```yaml
# Copyright 2024 NXP
# SPDX-License-Identifier: Apache-2.0
description: NXP PCA9574 I2C GPIO expander node
compatible: nxp,pca9574
include: nxp,pca_series.yaml

properties:
  ngpios:
    required: true
    const: 8
```

## dts/bindings/gpio/nxp,pca95xx.yaml
```yaml
# Copyright (c) 2019 Intel Corporation
# SPDX-License-Identifier: Apache-2.0

description: PCA95xx series I2C-based GPIO expander

compatible: "nxp,pca95xx"

include: [gpio-controller.yaml, i2c-device.yaml]

properties:
    has-pud:
      type: boolean
      required: false
      description: Supports pull-up/pull-down

    has-interrupt-mask-reg:
      type: boolean
      required: false
      description: Has Interrupt mask register (PCAL95xx)

    interrupt-gpios:
      type: phandle-array
      required: false
      description: Interrupt GPIO pin (active-low open-drain)

    "#gpio-cells":
      const: 2

gpio-cells:
  - pin
  - flags
```

## dts/bindings/gpio/nxp,pca_series.yaml
```yaml
# Copyright 2024 NXP
# SPDX-License-Identifier: Apache-2.0

description: PCA series I2C-based GPIO expander

include: [gpio-controller.yaml, i2c-device.yaml]

# Currently supported device:
#   pca9538    pca9539
#   pca9554    pca9555
#   pca6408    pca6416
#   pca9574    pca9575
#   pcal9538   pcal9539
#   pcal6408   pcal6416
#   pcal6524   pcal6534
#
#   PCA9538   compatible with  PCA9534   PCA9554   PCA6408(*a)
#   PCA9539   compatible with  PCA9535   PCA9555   PCA6416(*a)
#   PCAL9538  compatible with  PCAL9554  PCAL6408(*a)
#   PCAL9539  compatible with  PCAL9555  PCAL6416(*a)
#   (a) PCA(L)64xxA series support voltage level translation,
#       but has no difference from driver's view.
#   (b) PCAL6534 has 34 GPIO pins in 4x 8-bit port and 1x
#       2-bit port. This driver only support 4x 8-bit port.

properties:
  reset-gpios:
    type: phandle-array
    description:
      Reset GPIO pin (active-low)
      Left blank if the device does not have reset pin
      or the pin is not connected in your application.

  int-gpios:
    type: phandle-array
    description:
      Interrupt GPIO pin (active-low open-drain)
      Left blank if the pin is not connected in your
      application.

  "#gpio-cells":
    const: 2

gpio-cells:
  - pin
  - flags
```

## dts/bindings/gpio/nxp,pcal6408a.yaml
```yaml
# Copyright (c) 2021 Nordic Semiconductor ASA
# Copyright (c) 2023 SILA Embedded Solutions GmbH
# SPDX-License-Identifier: Apache-2.0

description: PCAL6408A 8-bit I2C-based I/O expander

compatible: "nxp,pcal6408a"

include: nxp,pcal64xxa-base.yaml

properties:
  ngpios:
    required: true
    const: 8
```

## dts/bindings/gpio/nxp,pcal6416.yaml
```yaml
# Copyright 2025 NXP
# SPDX-License-Identifier: Apache-2.0
description: NXP PCAL6416 I2C GPIO expander
compatible: nxp,pcal6416
include: nxp,pca_series.yaml

properties:
  ngpios:
    required: true
    const: 16
```

## dts/bindings/gpio/nxp,pcal6416a.yaml
```yaml
# Copyright (c) 2023 SILA Embedded Solutions GmbH
# Copyright 2025 NXP
# SPDX-License-Identifier: Apache-2.0
description: NXP PCAL6416A I2C GPIO expander node
compatible: nxp,pcal6416a
include: nxp,pca_series.yaml

properties:
  ngpios:
    required: true
    const: 16
```

## dts/bindings/gpio/nxp,pcal64xxa-base.yaml
```yaml
# Copyright (c) 2021 Nordic Semiconductor ASA
# Copyright (c) 2023 SILA Embedded Solutions GmbH
# SPDX-License-Identifier: Apache-2.0

include: [i2c-device.yaml, gpio-controller.yaml]

properties:
  int-gpios:
    type: phandle-array
    description: |
      GPIO connected to the controller INT pin. This pin is active-low.

  reset-gpios:
    type: phandle-array
    description: |
      GPIO connected to the controller RESET pin. This pin is active-low.

  no-auto-reset:
    type: boolean
    description: |
      This flag disables the automatic reset, which allows the implementation
      of for instance an external state retention of the port expander. If
      this flag is set it must be ensured that for an actually uninitialized
      port expander the manual reset is triggered via the exposed reset
      function, specific to the PCAL64XXA.

  "#gpio-cells":
    const: 2

gpio-cells:
  - pin
  - flags
```

## dts/bindings/gpio/nxp,pcal6524.yaml
```yaml
# Copyright 2024 NXP
# SPDX-License-Identifier: Apache-2.0
description: NXP PCAL6524 I2C GPIO expander node
compatible: nxp,pcal6524
include: nxp,pca_series.yaml

properties:
  ngpios:
    required: true
    const: 24
```

## dts/bindings/gpio/nxp,pcal9722.yaml
```yaml
# Copyright (c) 2025 Michael Estes
# SPDX-License-Identifier: Apache-2.0

description: PCA9722 series SPI-based GPIO expander

compatible: "nxp,pcal9722"

include: [gpio-controller.yaml, spi-device.yaml]

properties:
  irq-gpios:
    type: phandle-array
    description: Interrupt GPIO pin (active-low open-drain)

  addr:
    required: true
    type: int
    enum: [0x40, 0x42]
    default: 0x40
    description:
      Address used to address device on the SPI bus. Two PCAL9722 devices can be connected to the
      same SPI chip select by pulling the ADDR pin high or low. If pulled low, the address should
      be 0x40. If pulled high, the address should be 0x42.

  "#gpio-cells":
    const: 2

  ngpios:
    required: true
    const: 22

gpio-cells:
  - pin
  - flags
```

## dts/bindings/gpio/nxp,pcf8574.yaml
```yaml
# Copyright (c) 2022 ithinx GmbH
# SPDX-License-Identifier: Apache-2.0

description: PCF8574 8-bit I2C-based I/O expander

compatible: "nxp,pcf8574"

include: [i2c-device.yaml, gpio-controller.yaml]

properties:
    ngpios:
      required: true
      const: 8

    int-gpios:
      type: phandle-array
      required: false
      description: |
        GPIO connected to the controller INT pin. This pin is active-low.

    "#gpio-cells":
      const: 2

gpio-cells:
  - pin
  - flags
```

## dts/bindings/gpio/nxp,pcf8575.yaml
```yaml
# Copyright (c)
# 2023 Amrith Venkat Kesavamoorthi <amrith@mr-beam.org>
# 2023 Mr Beam Lasers GmbH.
# SPDX-License-Identifier: Apache-2.0

description: PCF8575 16-bit I2C-based I/O expander

compatible: "nxp,pcf8575"

include: [i2c-device.yaml, gpio-controller.yaml]

properties:
  ngpios:
    required: true
    const: 16

  int-gpios:
    type: phandle-array
    description: |
      GPIO connected to the controller INT pin. This pin is active-low.

  "#gpio-cells":
    const: 2

gpio-cells:
  - pin
  - flags
```

## dts/bindings/gpio/nxp,pcf857x.yaml
```yaml
# Copyright (c) 2022 ithinx GmbH
# 2023 Amrith Venkat Kesavamoorthi <amrith@mr-beam.org>
# 2023 Mr Beam Lasers GmbH.
# SPDX-License-Identifier: Apache-2.0

description: PCF857x 8/16-bit I2C-based I/O expander

compatible: "nxp,pcf857x"

include: [i2c-device.yaml, gpio-controller.yaml]

properties:
  ngpios:
    required: true
    enum:
      - 8
      - 16

  int-gpios:
    type: phandle-array
    description: |
      GPIO connected to the controller INT pin. This pin is active-low.

  "#gpio-cells":
    const: 2

gpio-cells:
  - pin
  - flags
```

## dts/bindings/gpio/nxp,s32-gpio.yaml
```yaml
# Copyright 2022 NXP
# SPDX-License-Identifier: Apache-2.0

description: NXP S32 GPIO node

compatible: "nxp,s32-gpio"

include: [gpio-controller.yaml, base.yaml]

properties:
  reg:
    required: true

  reg-names:
    required: true

  interrupts:
    description: |
      For GPIO ports that have pins can be used for processing
      external interrupt signal, this is a list of GPIO pins and
      respective external interrupt lines (<gpio-pin eirq-line>).

  "#gpio-cells":
    const: 2

gpio-cells:
  - pin
  - flags
```

## dts/bindings/gpio/nxp,sc18im704-gpio.yaml
```yaml
# Copyright (c), 2023 Basalte bv
# SPDX-License-Identifier: Apache-2.0

description: GPIO controller part for the SC18IM704 bridge

compatible: "nxp,sc18im704-gpio"

include: gpio-controller.yaml

properties:
  "#gpio-cells":
    required: true
    const: 2

  ngpios:
    required: true
    const: 8

gpio-cells:
  - pin
  - flags

on-bus: nxp,sc18im704
```

## dts/bindings/gpio/nxp,siul2-gpio.yaml
```yaml
# Copyright 2022-2023, 2025 NXP
# SPDX-License-Identifier: Apache-2.0

description: |
  NXP SIUL2 GPIO controller.

  The GPIO controller provides the option to route external input pad interrupts
  to either the SIUL2 EIRQ interrupt controller or, when available on the SoC,
  the WKPU interrupt controller. By default, GPIO interrupts are routed to the
  SIUL2 EIRQ interrupt controller.

  To route external interrupts to the WKPU interrupt controller, the GPIO
  specifier must be supplied with the flag `NXP_SIUL2_GPIO_INT_WKPU`. For example,
  the following snippet of devicetree source code instructs the GPIO controller
  to route the interrupt from pin 9 of `gpioa` to the WKPU interrupt controller:

    #include <zephyr/dt-bindings/gpio/nxp-siul2-gpio.h>

    &device {
        gpios = <&gpioa 9 (NXP_SIUL2_GPIO_INT_WKPU | GPIO_ACTIVE_HIGH)>;
    };

  Explicitly specifying the routing of a GPIO interrupt to a particular
  interrupt controller allows for the allocation of distinct interrupt
  priorities according to application-specific requirements. This is owing to
  the fact that each interrupt controller features its own interrupt vector.
  To illustrate, it is plausible to allocate the board's button interrupts to
  the interrupt controller configured with a lower priority compared to the one
  designated for the data-ready interrupt originating from a sensor. This
  decision is justified by the potentially higher importance of the latter
  interrupt to the overall system operation.

  The `NXP_SIUL2_GPIO_INT_WKPU` flag is intended exclusively for specifying WKPU
  as the interrupt controller for the corresponding GPIO. It's worth noting that
  despite being named WKPU, the flag is not meant to configure GPIOs as wake-up
  sources.

compatible: "nxp,siul2-gpio"

include: [gpio-controller.yaml, base.yaml]

properties:
  reg:
    required: true

  reg-names:
    required: true

  interrupts:
    description: |
      For GPIO ports that have pins can be used for processing
      external interrupt signal, this is a list of GPIO pins and
      respective external interrupt lines (<gpio-pin eirq-line>).

  nxp,wkpu:
    type: phandle
    description: |
      NXP WKPU controller associated to this GPIO port.

  nxp,wkpu-interrupts:
    type: array
    description: |
      Map between WKPU external interrupt sources and pins of this GPIO port,
      as in a tuple `<gpio-pin wkpu-interrupt-source>`.

  "#gpio-cells":
    const: 2

gpio-cells:
  - pin
  - flags
```

## dts/bindings/gpio/openisa,rv32m1-gpio.yaml
```yaml
description: OpenISA GPIO

compatible: "openisa,rv32m1-gpio"

include: [gpio-controller.yaml, base.yaml]

properties:
  reg:
    required: true

  interrupts:
    required: true

  "#gpio-cells":
    const: 2

  openisa,rv32m1-port:
    required: true
    type: phandle
    description: |
      A phandle reference to the device tree node that contains the pinmux
      port associated with this GPIO controller.

gpio-cells:
  - pin
  - flags
```

## dts/bindings/gpio/panasonic,reduced-arduino-header.yaml
```yaml
# Copyright (c) 2022 Panasonic Industrial Devices Europe GmbH
# SPDX-License-Identifier: Apache-2.0

description: |
    Panasonic's reduced Arduino header.

                                  D15    21
                                  D14    20
                                  AREF   -
                                  GND    -
        -   N/C                   D13    19
        -   IOREF                 D12    18
        -   RESET                 D11    17
        -   3V3                   D10    16
        -   5V                    D9     NC
        -   GND                   D8     NC
        -   GND
        -   VIN                   D7     NC
                                  D6     NC
        0   A0                    D5     11
        1   A1                    D4     10
        2   A2                    D3     9
        3   A3                    D2     8
        NC  A4                    D1     7
        NC  A5                    D0     6

    Panasonic's reduced Arduino header is based on the Arduino UNO layout
    and provides four different headers. The main difference is that some
    pins are not available due to the lack of pins on the Panasonic module.
    These unconnected pins are labeled "NC" in the mapping above.

    So:

    1. Power Supply header exactly, like on Arduino UNO layout.

    2. Analog Input header, like on Arduino UNO layout, but A4 and A5 are
    not connected.

    3. 8-pin header (opposite Analog Input).  Digital input signals, like on
    Arduino UNO layout, labeled from D0 at the bottom to D7 at the top, but D6
    and D7 are not connected.

    4. 10-pin header (opposite Power Supply). Digital input signals, like on
    Arduino UNO layout, labeled from D8 at the bottom through D15 at the top,
    but D8 and D9 are not connected.

compatible: "panasonic,reduced-arduino-header"

include: [gpio-nexus.yaml, base.yaml]
```
