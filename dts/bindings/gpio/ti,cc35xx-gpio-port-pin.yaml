## dts/bindings/gpio/ti,cc35xx-gpio-port-pin.yaml
```yaml
# SPDX-License-Identifier: Apache-2.0

description: |
    TI GPIO

compatible: "ti,cc35xx-gpio-port-pin"

include: [gpio-controller.yaml, base.yaml]

properties:
  npins:
    type: int
    const: 1
    description: |
      Number of GPIOs available on port.

  gpio-index:
    type: int
    required: true

gpio-cells:
  - pin
  - flags
```

## dts/bindings/gpio/ti,cc35xx-gpio-port.yaml
```yaml
# SPDX-License-Identifier: Apache-2.0

description: |
    TI GPIO port node

compatible: "ti,cc35xx-gpio-port"

include: [gpio-controller.yaml, base.yaml]

properties:
  "#gpio-cells":
    const: 2

  gpio-index-offset:
    type: int
    required: true
    description: |
      The cc35xx hardware has a single GPIO controller
      which aggregates all the available GPIO pins.
      The indexes range from 0 to <n>

      In Zephyr the GPIOs are split into ports,
      each aggregating up to 32 pins.
      First port indexes match the global indexes (0-31),
      second port is offset by 32
      (0-31 port pins map to 32-63 pins in the global pool).
      and so on.

gpio-cells:
  - pin
  - flags
```

## dts/bindings/gpio/ti,cc35xx-gpio.yaml
```yaml
# SPDX-License-Identifier: Apache-2.0

description: |
    TI GPIO nexus node.

compatible: "ti,cc35xx-gpio"

include: [gpio-nexus.yaml, base.yaml]
```

## dts/bindings/gpio/ti,mspm0-gpio.yaml
```yaml
# SPDX-License-Identifier: Apache-2.0

description: TI MSPM0 GPIO

compatible: "ti,mspm0-gpio"

include: [gpio-controller.yaml, base.yaml]

properties:
  reg:
    required: true

  interrupts:
    required: true

  "#gpio-cells":
    const: 2

  pinmux:
    type: phandles
    required: true
    description: |
      GPIO-function pinctrl nodes in pin order (index = pin number); each
      carries the pin's pinmux, applied via pinctrl_configure_pins(). A node
      with pinmux 0 marks a non-bonded pin.

gpio-cells:
  - pin
  - flags
```

## dts/bindings/gpio/ti,tca9538.yaml
```yaml
# Copyright (c) 2018, Aapo Vienamo
# Copyright (c) 2021, Laird Connectivity
# SPDX-License-Identifier: Apache-2.0

description: |
  TCA9538 GPIO

  The TCA9536 has the same registers with four pins and is described with
  this compatible and ngpios = <4>.

compatible: "ti,tca9538"

include: [i2c-device.yaml, gpio-controller.yaml]

properties:
  "#gpio-cells":
    const: 2

  ngpios:
    enum:
      - 4
      - 8
    description: |
      Number of GPIOs available on port expander: 8 for the TCA9538, 4 for
      the TCA9536.

  nint-gpios:
    type: phandle-array
    description: |
      Connection for the NINT signal. This signal is active-low when
      produced by tca9538 GPIO node.

  input-latch:
    type: int
    description: |
      Input latch register bit is 0 by default and the input pin state
      is not latched. When input latch register bit is 1 and the input
      pin state is latched.

  interrupt-mask:
    type: int
    description: |
      Interrupt mask register is set to logic 1 by default without
      enabling interrupts. Setting corresponding mask bits to logic
      0 to enable the interrupts.

  has-pud:
    type: boolean
    description: Supports pull-up/pull-down resistors

gpio-cells:
  - pin
  - flags
```

## dts/bindings/gpio/ti,tca9555.yaml
```yaml
# SPDX-FileCopyrightText: Copyright The Zephyr Project Contributors
# SPDX-License-Identifier: Apache-2.0

description: |
  TI TCA9555 16-bit I2C GPIO expander. The device is register-compatible
  with the PCA9555; use "nxp,pca9555" as a fallback compatible.

compatible: "ti,tca9555"

include: nxp,pca9555.yaml
```

## dts/bindings/gpio/ti,tlc6c59xx-gpio.yaml
```yaml
#
# Copyright (c) 2026 iomico
#
# SPDX-License-Identifier: Apache-2.0
#

description: |
  Texas Instruments 8/12-Channel Shift-Register LED Driver GPIO instance.

  The driver supports output-only control of the fixed output stage. Input,
  pull-up, pull-down and selectable open-drain/open-source modes are not
  supported. GPIO values control shift-register bits; a set bit enables the
  corresponding current-sink output.

compatible: "ti,tlc6c59xx-gpio"

include:
  - name: gpio-controller.yaml
    property-blocklist:
      - ngpios
  - base.yaml

on-bus: tlc6c59xx

properties:
  "#gpio-cells":
    const: 2

  reg:
    required: true
    description: |
      Zero-based physical position in the chain. Position 0 is the chip whose
      serial input is connected to the SPI controller. Positions increase
      toward the far end of the chain and must be unique and contiguous.

  ngpios:
    type: int
    enum:
      - 8
      - 12
    required: true
    description: |
      Number of outputs in each physical chip. This determines the serial
      word width and must be the same for every chip in the chain.

gpio-cells:
  - pin
  - flags
```

## dts/bindings/gpio/virtio,gpio.yaml
```yaml
# SPDX-FileCopyrightText: Copyright The Zephyr Project Contributors
# SPDX-License-Identifier: Apache-2.0

description: |
  VIRTIO GPIO device (ID:41)

compatible: "virtio,gpio"

include: [gpio-controller.yaml, base.yaml]

properties:
  ngpios:
    max: 32

  "#gpio-cells":
    const: 2

gpio-cells:
  - pin
  - flags

examples:
  - |
    virtio_mmio0: virtio_mmio@a000000 {
            compatible = "virtio,mmio";
            reg = <0xa000000 0x200>;
            interrupts = <0 16 4>;
            status = "okay";

            virtio_gpio0: virtio-gpio {
                    compatible = "virtio,gpio";
                    gpio-controller;
                    #gpio-cells = <2>;
                    status = "okay";
            };
    };
```

## dts/bindings/gpio/waveshare,ch32v003.yaml
```yaml
# Copyright 2026, Kim Bøndergaard <kim@fam-boendergaard.dk>
# SPDX-License-Identifier: Apache-2.0
description: Waveshare CH32V003 I2C GPIO expander

compatible: "waveshare,ch32v003"

include: [gpio-controller.yaml, i2c-device.yaml]

properties:
  "#gpio-cells":
    const: 2

gpio-cells:
  - pin
  - flags
```

## dts/bindings/graphics_accelerator/vsi,gpu-gc555.yaml
```yaml
# Copyright (c) 2026 Felipe Neves ryukokki.felipe@gmail.com
# Copyright 2026 NXP
# SPDX-License-Identifier: Apache-2.0


description: VSI GPU2D graphics accelerator

compatible: "vsi,gpu-gc555"

include: [reset-device.yaml, base.yaml]

properties:
  reg:
    required: true

  interrupts:
    required: true

  clocks:
    required: true
```

## dts/bindings/haptics/cirrus,cs40l5x.yaml
```yaml
# Copyright (c) 2026 Cirrus Logic, Inc.
# SPDX-License-Identifier: Apache-2.0

description: CS40L5x haptic driver

properties:
  cirrus,external-boost:
    type: phandle
    description: External boost regulator.
```

## dts/bindings/haptics/cirrus,cs40lxx.yaml
```yaml
# Copyright (c) 2026 Cirrus Logic, Inc.
# SPDX-License-Identifier: Apache-2.0

description: Cirrus Logic haptic drivers

properties:
  reset-gpios:
    type: phandle-array
    max-len: 1
    description: Host GPIO pin mapped to CS40Lxx reset pin.

  int-gpios:
    type: phandle-array
    max-len: 1
    description: Host GPIO pin mapped to CS40Lxx interrupt pin.

  trigger-gpios:
    type: phandle-array
    description: Host GPIO pins mapped to CS40Lxx trigger pins.

  cirrus,trigger-mapping:
    type: array
    description: For each GPIO provided to 'trigger-gpios',
      provide the corresponding CS40Lxx pin number.

  cirrus,flash-storage:
    type: phandle
    description: Flash storage for CS40Lxx calibration data. Must
      be a phandle to a flash device or fixed partition.

  cirrus,flash-offset:
    type: int
    description: Register offset to store and load CS40Lxx calibration data.
```

## dts/bindings/hwinfo/infineon,tle927x-hwinfo.yaml
```yaml
# SPDX-FileCopyrightText: Copyright (c) 2026 Deere & Company
# SPDX-FileCopyrightText: Copyright (c) 2026 Linumiz
# SPDX-License-Identifier: Apache-2.0

description: |
  Infineon TLE927x SBC reset cause.

  Reports the reset cause through the hwinfo API, decoded from the SUP_STAT,
  THERM_STAT and DEV_STAT registers. The driver reads and clears these three
  registers at init; the TLE927x MFD driver only clears the other status
  registers. Without this node the three registers keep the bits latched
  before the last reset, so it should be present on every TLE927x board.

  Only one instance is supported.

compatible: "infineon,tle927x-hwinfo"

include: base.yaml

on-bus: tle927x
```

## dts/bindings/hwinfo/nxp,lpc-pmc-hwinfo.yaml
```yaml
# Copyright 2026 NXP
# SPDX-License-Identifier: Apache-2.0

description: NXP LPC55xx PMC reset-cause hwinfo.

compatible: "nxp,lpc-pmc-hwinfo"

include: base.yaml

properties:
  reg:
    required: true
```

## dts/bindings/hwinfo/nxp,resetcon-hwinfo.yaml
```yaml
# SPDX-FileCopyrightText: Copyright 2026 NXP
# SPDX-License-Identifier: Apache-2.0

description: |
  NXP RESETCON (Reset Controller) reset cause flags.

  The sticky reset status register (RSTSTAT_STICKY) accumulates every reset
  source since it was last cleared, including the resets a low-power wakeup
  ends in.

compatible: "nxp,resetcon-hwinfo"

include: base.yaml

properties:
  reg:
    required: true
```

## dts/bindings/hwinfo/ti,k3-jtagid.yaml
```yaml
# SPDX-FileCopyrightText: 2026 Texas Instruments Incorporated
# SPDX-License-Identifier: Apache-2.0

description: |
  Texas Instruments K3 JTAGID register.

  Must be a child of a syscon node. The hwinfo device ID backend reads the
  register through the parent syscon.

compatible: "ti,k3-jtagid"

include: base.yaml

properties:
  reg:
    required: true
```

## dts/bindings/hwinfo/ti,k3-rst-src.yaml
```yaml
# SPDX-FileCopyrightText: 2026 Texas Instruments Incorporated
# SPDX-License-Identifier: Apache-2.0

description: |
  Texas Instruments K3 reset source register.

  Must be a child of a syscon node. The hwinfo reset-cause backend reads and
  clears the register through the parent syscon.

compatible: "ti,k3-rst-src"

include: base.yaml

properties:
  reg:
    required: true
```

## dts/bindings/hwinfo/wch,esig.yaml
```yaml
# SPDX-FileCopyrightText: Copyright Michael Hope <michaelh@juju.nz>
# SPDX-License-Identifier: Apache-2.0

description: WCH CH32V Electronic Signature (ESIG)

compatible: "wch,esig"

include: base.yaml

properties:
  reg:
    required: true
```

## dts/bindings/hwinfo/zephyr,hwinfo-nvmem.yaml
```yaml
# SPDX-FileCopyrightText: Copyright (c) 2026 Basalte bv
# SPDX-License-Identifier: Apache-2.0

description: |
  Generic hwinfo backend reading identifiers from NVMEM cells.

  Pseudo-node, placed at the root of the devicetree, pointing the hwinfo
  backend at an NVMEM cell holding the device unique identifier
  ("device-id", required) and optionally a cell holding the device EUI-64
  ("eui64", exactly 8 bytes, stored in canonical byte order).

  Only one hwinfo device-id backend can be linked into an image; disable the
  SoC-specific backend (for example CONFIG_HWINFO_STM32) when enabling this
  node on an SoC that provides one.

compatible: "zephyr,hwinfo-nvmem"

include: [base.yaml, nvmem-consumer.yaml]

properties:
  nvmem-cells:
    required: true

  nvmem-cell-names:
    required: true

examples:
  - |
    / {
        hwinfo {
            compatible = "zephyr,hwinfo-nvmem";
            nvmem-cells = <&uid_cell>, <&eui64_cell>;
            nvmem-cell-names = "device-id", "eui64";
        };
    };
```

## dts/bindings/hwspinlock/ti,k3-hwspinlock.yaml
```yaml
# Copyright (c) 2026 Dhruv Menon <dhruvmenon1104@gmail.com>
# SPDX-License-Identifier: Apache-2.0

description: |
  TI K3 SPINLOCK hardware spinlock controller (e.g. J722S SPINLOCK0).

  Each LOCK_REG_j is acquired by reading it (0 means this read took the lock,
  1 means it was already taken). Write 0 to release. Soft reset of the module
  clears all locks and must not be performed while other initiators may hold one.

compatible: "ti,k3-hwspinlock"

include:
  - name: base.yaml
  - name: hwspinlock-controller.yaml

properties:
  reg:
    required: true

  num-locks:
    description: |
      Number of LOCK_REG entries implemented by this instance (J722S: 256).

hwlock-cells:
  - id

examples:
  - |
    spinlock0: hwspinlock@2a000000 {
        compatible = "ti,k3-hwspinlock";
        reg = <0x2a000000 0x1000>;
        #hwlock-cells = <1>;
        num-locks = <256>;
    };
```

## dts/bindings/i2c/adi,max96717-i2c-gate.yaml
```yaml
#
# Copyright (c) 2026 Charles Dias
# SPDX-License-Identifier: Apache-2.0
#

description: |
  I2C gate of an ADI MAX96717 GMSL2 serializer: the camera-side I2C bus driven
  by the serializer's I2C master.

  The node is a child of the serializer, which itself sits on the deserializer's
  I2C gate. The image sensor and any other device on the serializer's local I2C
  bus are children of this node. Transfers are forwarded unchanged to the
  serializer's own bus, the deserializer gate.

compatible: "adi,max96717-i2c-gate"

include: i2c-controller.yaml
```

## dts/bindings/i2c/adi,max96724-i2c-gate.yaml
```yaml
#
# Copyright (c) 2026 Charles Dias
# SPDX-License-Identifier: Apache-2.0
#

description: |
  I2C gate of an ADI MAX96724 GMSL2 deserializer: the I2C bus behind one of its
  GMSL links.

  The node is a child of the deserializer. Every device the host reaches through
  the deserializer's I2C forwarding on that link is a child of this node: the
  serializer, and through the serializer's own gate the devices on its camera
  bus. Transfers are forwarded unchanged to the bus the deserializer sits on.

  Example:

    max96724: max96724@27 {
        compatible = "adi,max96724";
        reg = <0x27>;
        #address-cells = <1>;
        #size-cells = <0>;

        des_i2c: i2c-gate@0 {
            compatible = "adi,max96724-i2c-gate";
            reg = <0>;
            #address-cells = <1>;
            #size-cells = <0>;

            max96717: max96717@40 {
                compatible = "adi,max96717";
                reg = <0x40>;
            };
        };
    };

compatible: "adi,max96724-i2c-gate"

include: i2c-controller.yaml

properties:
  reg:
    required: true
    description: |
      Index of the GMSL link this gate forwards to, 0 to 3 for links A to D,
      the number of the deserializer's input port for that link.
```

## dts/bindings/i2c/infineon,scb-i2c.yaml
```yaml
# SPDX-FileCopyrightText: Copyright (c) 2026 Linumiz
#
# SPDX-License-Identifier: Apache-2.0

title: Infineon SCB I2C controller

description: |
  Serial Communication Block (SCB) of Infineon TRAVEO T2G devices operated
  in I2C mode. The block is an I2C controller and can additionally act as a
  target with one 7-bit address.

  The SCB clock comes from an integer peripheral clock divider (8-bit or
  16-bit) without a fixed clock-div value, since the driver programs it for
  the selected bus speed. Standard, Fast and Fast-mode Plus are supported.

  SCL and SDA pins must be configured as open-drain with the input buffer
  enabled.

compatible: "infineon,scb-i2c"

include: [i2c-controller.yaml, pinctrl-device.yaml]

properties:
  reg:
    required: true

  interrupts:
    required: true

  clocks:
    required: true
    description: Integer peripheral clock divider feeding the SCB.

  clk-dst:
    type: int
    required: true
    description: Peripheral clock destination ID of this SCB instance.

  pinctrl-0:
    required: true

  pinctrl-names:
    required: true

  scl-gpios:
    type: phandle-array
    description: |
      GPIO routed to the SCL pin, used to recover a stuck bus. Must be given
      together with sda-gpios.

  sda-gpios:
    type: phandle-array
    description: |
      GPIO routed to the SDA pin, used to recover a stuck bus. Must be given
      together with scl-gpios.
```
