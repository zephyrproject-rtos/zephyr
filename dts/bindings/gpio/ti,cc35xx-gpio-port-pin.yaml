## dts/bindings/i2c/ite,enhance-i2c.yaml
```yaml
# Copyright (c) 2022 ITE Corporation. All Rights Reserved.
# SPDX-License-Identifier: Apache-2.0

description: ITE enhance I2C

compatible: "ite,enhance-i2c"

include: ite,common-i2c.yaml

properties:
  prescale-scl-low:
    type: int
    description: |
      This option is used to configure the I2C speed prescaler for
      the SCL low period. When set to >= 1, it will increase the
      low period of the SCL clock and so reduce the signal frequency.
      The resulting SCL cycle time is given by the following formula:
      SCL cycle = 2 * (psr + prescale_tweak + 2) *
                  SMBus clock cycle

  data-hold-time:
    type: int
    default: 3
    enum:
      - 3
      - 4
      - 5
      - 6
      - 7
      - 8
      - 9
      - 10
    description: |
      This option is used to configure the data hold time of the I2C.
      The unit is number of SMB clock cycles.  The time calculation
      is (data-hold-time / smb_clk) seconds.

  target-enable:
    type: boolean
    description: |
      This option is used when the I2C target is enabled. It is
      necessary to prevent the target port from being configured
      with I2C host related initialization.

  target-pio-mode:
    type: boolean
    description: |
      This option is used when the I2C target is enabled and it can
      support PIO mode for I2C target transfer.

  scl-sda-low-timeout:
    type: int
    min: 0
    max: 255
    description: |
      This option is used to configure the SCL/SDA low hardware timeout.
      The timeout value specifies the number of 1024 kHz clock periods
      to wait, which roughly translates to milliseconds of delay.
      If this property is not specified, the driver defaults to the longest
      possible SCL/SDA low timeout of 255 (which is 249 ms).

      The ITE enhance driver also supports a software timeout using the
      zephyr,transfer-timeout-ms property (or CONFIG_I2C_TRANSFER_TIMEOUT_MS).

      The shorter timeout value (hardware or software) configures the maximum
      clock stretch time supported on this I2C bus.

      To support I2C targets that clock stretch longer than 249ms, set
      scl-sda-low-timeout-ms to 0 to disable the hardware timer. The maximum
      clock stretch time is then configured using the software timeout property
      zephyr,transfer-timeout-ms.
```

## dts/bindings/i2c/lowrisc,opentitan-i2c-2.0.0.yaml
```yaml
# Copyright (c) 2025 Rivos Inc.
# SPDX-License-Identifier: Apache-2.0

description: |
  OpenTitan I2C controller, IP version 2.0.0.

  The IP version is separate from the chip release version. The OpenTitan
  earlgrey_1.0.0 release has I2C IP version 2.0.0. Version 1.0 has a
  different register map and does not use this binding.

compatible: "lowrisc,opentitan-i2c-2.0.0"

include: i2c-controller.yaml

properties:
  reg:
    description: Base address and size of the I2C registers.
    required: true
  clocks:
    description: Input clock for the I2C controller.
    required: true
```
