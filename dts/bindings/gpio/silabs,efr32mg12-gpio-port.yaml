## dts/bindings/gpio/st,m2-memory-connector.yaml
```yaml
# Copyright (c) 2026 Filip Stojanovic <filipembedded@gmail.com>
# SPDX-License-Identifier: Apache-2.0

title: ST M.2 Key A Serial Memory Connector

description: |
  Non-power pins exposed on the ST M.2 Key A serial memory connector.

  This connector reuses the M.2 Key A form factor for XSPI memories and
  auxiliary interfaces such as I2C and SPI, as described in ST TN1618.

  The binding provides a gpio-nexus style mapping for connector signals that
  may be referenced from board DTS files and shield overlays.

  Use M2MEM_CONNECTOR_* constants from
  <zephyr/dt-bindings/gpio/m2-memory-connector.h> to refer to connector pins.

  Power, ground, reserved, and key pins are intentionally omitted.

compatible: "st,m2-memory-connector"

include: [gpio-nexus.yaml, base.yaml]

properties:
  "#gpio-cells":
    const: 2

gpio-cells:
  - pin
  - flags
```

## dts/bindings/gpio/st,mfxstm32l152.yaml
```yaml
# Copyright (c) 2024 STMicroelectronics
# SPDX-License-Identifier: Apache-2.0

description: MFXSTM32L152 I2C-based GPIO expander

compatible: "st,mfxstm32l152"

include: [gpio-controller.yaml, i2c-device.yaml]

properties:
  int-gpios:
    type: phandle-array
    description: |
        GPIO connected to the controller INT pin. This pin is active-low
        and open-drain.

  "#gpio-cells":
    const: 2

gpio-cells:
  - pin
  - flags
```

## dts/bindings/gpio/st,stm32-gpio-pinctrl.yaml
```yaml
---
title: STM32 GPIO with PINCTRL backend
id: st,stm32-gpio-pinctrl
version: 0.1

description: >
    This is a representation of the STM32 GPIO node using a PINCTRL backend

inherits:
    !include gpio-pinctrl.yaml

properties:
    compatible:
      type: string
      category: required
      description: compatible strings
      constraint: "st,stm32-gpio-pinctrl"
      generation: define

    reg:
      type: int
      description: mmio register space
      generation: define
      category: required

    interrupts:
      type: compound
      category: required
      description: required interrupts
      generation: define

    st,bank-name:
      type: string
      category: required
      description: bank name (one of "GPIOA", "GPIOB", ...)
      generation: define
...
```

## dts/bindings/gpio/st,stm32-gpio.yaml
```yaml
# Copyright (c) 2018, Linaro Limited
# SPDX-License-Identifier: Apache-2.0

description: STM32 GPIO node

compatible: "st,stm32-gpio"

include:
  - name: gpio-controller.yaml
    property-blocklist:
      - ngpios
  - name: base.yaml

properties:
  reg:
    required: true

  clocks:
    required: true

  "#gpio-cells":
    const: 2

  ngpios:
    type: int
    default: 16
    description: |
        This property indicates the number of in-use slots of available slots
        for GPIOs. The STM32 GPIO controller typically has all 16 possible port
        IO with few exceptions. It should only be necessary to explicitly set
        this property if the controller itself does not implement all 16 port
        IO register bits; for example PORTE in the STM32WB55xx series which only
        implements the first 5. Package restrictions on the number of exposed
        GPIO should not influence this property. For cases in which there might
        be holes in the slot range, this value should be the max slot number+1.

gpio-cells:
  - pin
  - flags
```
