## dts/bindings/gpio/silabs,efr32mg12-gpio-port.yaml
```yaml
description: EFR32MG GPIO port node

compatible: "silabs,efr32mg-gpio-port"

include: [gpio-controller.yaml, base.yaml]

properties:
    reg:
      required: true

    label:
      required: true

    "#gpio-cells":
      const: 2

gpio-cells:
  - pin
  - flags
```

## dts/bindings/gpio/silabs,efr32mg12-gpio.yaml
```yaml
title: EFR32MG GPIO

description: |
    This is a representation of the EFR32MG GPIO nodes

compatible: "silabs,efr32mg-gpio"

include: base.yaml

properties:
    reg:
      required: true

    interrupts:
      required: true

    label:
      required: true

    location-swo:
      type: int
      required: false
      description: Serial Wire Output (SWO) PIN location
```

## dts/bindings/gpio/silabs,efr32xg1-gpio-port.yaml
```yaml
description: EFR32XG1 GPIO port node

compatible: "silabs,efr32xg1-gpio-port"

include: [gpio-controller.yaml, base.yaml]

properties:
    reg:
      required: true

    label:
      required: true

    "#gpio-cells":
      const: 2

gpio-cells:
  - pin
  - flags
```

## dts/bindings/gpio/silabs,efr32xg1-gpio.yaml
```yaml
description: EFR32XG1 GPIO node

compatible: "silabs,efr32xg1-gpio"

include: base.yaml

properties:
    reg:
      required: true

    interrupts:
      required: true

    label:
      required: true

    location-swo:
      type: int
      required: false
      description: Serial Wire Output (SWO) PIN location
```

## dts/bindings/gpio/silabs,exp-header.yaml
```yaml
# Copyright (c) 2025 Silicon Laboratories Inc.
# SPDX-License-Identifier: Apache-2.0

title: Silicon Labs Kit Expansion Header

description: |
  GPIO pins exposed on the Expansion Header of Silicon Labs Pro Kits, Wireless Pro Kits,
  Starter Kits and Wireless Starter Kits. Dev Kits also use the Expansion Header pinout
  for their breakout pads.

  The Expansion Header contains several I/O pins as well as VMCU, 3.3V and 5V power rails.

    20 -o 3V3            BOARD_ID_SDA o- 19
    18 -o 5V             BOARD_ID_SCL o- 17
    16 -o I2C SDA             I2C SCL o- 15
    14 -o UART RX                GPIO o- 13
    12 -o UART TX                GPIO o- 11
    10 -o SPI CS                 GPIO o- 9
     8 -o SPI CLK                GPIO o- 7
     6 -o SPI CIPO               GPIO o- 5
     4 -o SPI COPI               GPIO o- 3
     2 -o VMCU                    GND o- 1

  Note: The BOARD_ID I2C lines are connected to the debugger, not to the SoC, so the usable
  GPIOs range from pin 3 to pin 16. Not all pins are routed on all boards, depending on the
  SoC used and board design.

compatible: "silabs,exp-header"

include: [gpio-nexus.yaml, base.yaml]
```

## dts/bindings/gpio/silabs,gecko-gpio-port.yaml
```yaml
title: Silicon Labs Series 0-2 GPIO (General Purpose Input/Output) Port

description: |
  Single GPIO port on Silicon Labs EFM32 and EFR32 Series 0, 1 and 2.

compatible: "silabs,gecko-gpio-port"

include: [gpio-controller.yaml, base.yaml]

properties:
  reg:
    required: true

  peripheral-id:
    type: int
    description: peripheral ID

  "#gpio-cells":
    const: 2

gpio-cells:
  - pin
  - flags
```

## dts/bindings/gpio/silabs,gecko-gpio.yaml
```yaml
title: Silicon Labs Series 0-2 GPIO (General Purpose Input/Output) Peripheral

description: |
  GPIO peripheral for Silicon Labs EFM32 and EFR32 Series 0, 1 and 2.

compatible: "silabs,gecko-gpio"

include: base.yaml

properties:
  reg:
    required: true

  interrupts:
    required: true

  location-swo:
    type: int
    description: Serial Wire Output (SWO) PIN location
```

## dts/bindings/gpio/silabs,gpio-port.yaml
```yaml
title: Silicon Labs Series 2 GPIO (General Purpose Input/Output) Port

description: |
  Single GPIO port on Silicon Labs EFR32 Series 2.

compatible: "silabs,gpio-port"

include: [gpio-controller.yaml, base.yaml]

properties:
  reg:
    required: true

  "#gpio-cells":
    const: 2

  silabs,wakeup-ints:
    type: array
    description: |
      List of EM4 wakeup interrupt numbers for this port. The corresponding entry
      in `silabs,wakeup-pins` indicates the pin associated with the interrupt number.

  silabs,wakeup-pins:
    type: array
    description: |
      List of EM4 wakeup capable pins for this port. The corresponding entry in
      `silabs,wakeup-ints` indicates the interrupt number associated with the pin.

gpio-cells:
  - pin
  - flags
```

## dts/bindings/gpio/silabs,gpio.yaml
```yaml
title: Silicon Labs Series 2 GPIO (General Purpose Input/Output) Peripheral

description: |
  GPIO peripheral for Silicon Labs EFR32 Series 2.

compatible: "silabs,gpio"

include: base.yaml

properties:
  reg:
    required: true

  interrupts:
    required: true
```

## dts/bindings/gpio/silabs,si32-gpio.yaml
```yaml
# Copyright (c) 2024 GARDENA GmbH
#
# SPDX-License-Identifier: Apache-2.0

description: Si32 GPIO node

compatible: "silabs,si32-gpio"

include: [gpio-controller.yaml, base.yaml]

properties:
  reg:
    required: true

  "#gpio-cells":
    const: 2

  disable-pullups:
    type: boolean

gpio-cells:
  - pin
  - flags
```

## dts/bindings/gpio/silabs,si32-hd-gpio.yaml
```yaml
# Copyright (c) 2024 GARDENA GmbH
#
# SPDX-License-Identifier: Apache-2.0

description: Si32 high drive GPIO

compatible: "silabs,si32-hd-gpio"

include: [gpio-controller.yaml, base.yaml]

properties:
  reg:
    required: true

  "#gpio-cells":
    const: 2

  nchannel-current-limit:
    type: int

  pchannel-current-limit:
    type: int

  enable-bias:
    type: boolean

  low-power-port-mode:
    type: boolean

  enable-drivers:
    type: boolean

gpio-cells:
  - pin
  - flags
```

## dts/bindings/gpio/silabs,siwx91x-gpio-port.yaml
```yaml
description: Silabs SiWx91x GPIO port node

compatible: "silabs,siwx91x-gpio-port"

include: [gpio-controller.yaml, base.yaml]

properties:

  reg:
    required: true

  "#gpio-cells":
    const: 2

  silabs,pads:
    type: uint8-array
    required: true
    description: |
      Contains the map of what pad number is used for each GPIO.
      0xFF if a GPIO has no pad.
      0 if the pad is directly configured using port and pin number.

gpio-cells:
  - pin
  - flags
```

## dts/bindings/gpio/silabs,siwx91x-gpio-uulp.yaml
```yaml
description: |
  Silabs SiWx91x UULP (ultra ultra low power) GPIO Port

  Lookup table: Pin (dts) -> SoC Pin (ULP Pin from reference manual):

  Pin : 0  1  2  3  4

  ULP : 0  1  2  3  4

compatible: "silabs,siwx91x-gpio-uulp"

include: [gpio-controller.yaml, base.yaml]

properties:

  reg:
    required: true

  "#gpio-cells":
    const: 2

gpio-cells:
  - pin
  - flags
```

## dts/bindings/gpio/silabs,siwx91x-gpio.yaml
```yaml
description: |
  Silabs SiWx91x GPIO

  Lookup table:  Port-Pin (dts) -> SoC Pin (HP Pin from reference manual)

  Port: A  A  A  A  B  B  B  B  B  B  B  C  C  C  C  C  D  D  D  D  D  D  D  D  D  D
  Pin : 10 11 12 15 09 10 11 12 13 14 15 00 01 02 14 15 00 01 02 03 04 05 06 07 08 09

  HP  : 10 11 12 15 25 26 27 28 29 30 31 32 33 34 46 47 48 49 50 51 52 53 54 55 56 57

compatible: "silabs,siwx91x-gpio"

include: base.yaml

properties:
  reg:
    required: true

  interrupts:
    required: true

  silabs,ulp:
    type: boolean
    description: |
      If this property is set, the GPIO controller uses ULP (ultra low power) pads.
```

## dts/bindings/gpio/snps,creg-gpio.yaml
```yaml
# Copyright (c) 2021 Synopsys, Inc. All rights reserved.
# SPDX-License-Identifier: Apache-2.0

description: Synopsys CREG GPIO

compatible: "snps,creg-gpio"

include: [gpio-controller.yaml, base.yaml]

properties:
  reg:
    required: true

  bit-per-gpio:
    type: int
    required: true

  off-val:
    type: int
    required: true

  on-val:
    type: int
    required: true

  "#gpio-cells":
    const: 2

gpio-cells:
  - pin
  - flags
```

## dts/bindings/gpio/solderedelectronics,easyc-connector.yaml
```yaml
# Copyright (c) 2026 Fabian Blatz <fabianblatz@gmail.com>
# SPDX-License-Identifier: Apache-2.0

description: |
    EasyC is a 4-pin JST connector for I2C devices.
    It's compatible with STEMMA QT, Grove, and Qwiic connectors.
    The pin assignments are as follows:

        0  SCL
        1  SDA
        -  VCC (3.3V)
        -  GND

compatible: "solderedelectronics,easyc-connector"

include: [gpio-nexus.yaml, base.yaml]
```

## dts/bindings/gpio/sparkfun,micromod-gpio.yaml
```yaml
# Copyright (c) 2024 Jerónimo Agulló
# SPDX-License-Identifier: Apache-2.0

description: |
    GPIO pins exposed on micromod headers.

    The micromod standard leverages the M.2 connector with 76 pins for
    swap between a myriad of supported boards and carriers.

    The micromod standard consists of two lanes with the following
    supported buses:
    * An 6-pin Power Supply header.  No pins on this header are exposed
      by this binding.
    * Reset, Boot pins and SWD pins not exposed by this binding.
    * 2 UART buses. First with RTS and CTS pins, while the 2nd with only
    RX and TX pins. Neither of them are exposed by this binding.
    * 2 i2c buses. Only the corresponding interrupt pin is exposed by
    this binding.
    * 2 SPI buses not exposed by this binding. Only SPI CS control pin
      is exposed by this binding.
    * Audio line not exposed by this binding.
    * 2 analog pins (A0 and A1).
    * 2 digital pins (D0 and D1).
    * 12 General purpose pins (G0 - G11).

    This binding provides a nexus mapping for the analog, digital and
    general purpose gpios in the order depicted below:

      - 00 -> A0                      PIN 34
      - 01 -> A1                      PIN 38
      - 02 -> D0                      PIN 10
      - 03 -> D1/CAM_TRIG             PIN 18
      - 04 -> I2C_INT#                PIN 16
      - 05 -> G0/BUS0                 PIN 40
      - 06 -> G1/BUS1                 PIN 42
      - 07 -> G2/BUS2                 PIN 44
      - 08 -> G3/BUS3                 PIN 46
      - 09 -> G4/BUS4                 PIN 48
      - 10 -> G5/BUS5                 PIN 73
      - 11 -> G6/BUS6                 PIN 71
      - 12 -> G7/BUS7                 PIN 69
      - 13 -> G8                      PIN 67
      - 14 -> G9/ADC_D-/CAM_HSYNC     PIN 65
      - 15 -> G10/ADC_D+/CAM_VSYNC    PIN 63
      - 16 -> G11/SWO                 PIN  8
      - 17 -> SPI_CS                  PIN 55


compatible: "sparkfun,micromod-gpio"

include: [gpio-nexus.yaml, base.yaml]
```

## dts/bindings/gpio/sparkfun,pro-micro-gpio.yaml
```yaml
# Copyright (C) 2021 Peter Johanson
# SPDX-License-Identifier: Apache-2.0

description: |
    GPIO pins exposed on Sparkfun Pro Micro (and compatible devices) headers.

    The Sparkfun Pro Micro layout provides two headers, along opposite
    edges of the board.

    Proceeding counter-clockwise:
    * A 12-pin Power and Digital Input header.  This has input signals
      labeled from 0 at the top through 9 at the bottom.
    * An 12-pin Power and Digital/Analog Input header.  This
      has four power pins, followed by eight inputs, with a
      non-monotonically decreasing numbering.

    This binding provides a nexus mapping for 18 pins, as depicted below:

        1 D1/TXO                 RAW     -
        0 D0/RXI                 GND     -
        - GND                    RST     -
        - GND                    VCC     -
        2 D2                     D21/A3  21
        3 D3                     D20/A2  20
        4 D4/A6                  D19/A1  19
        5 D5                     D18/A0  18
        6 D6/A7                  D15     15
        7 D7                     D14     14
        8 D8/A8                  D16     16
        9 D9/A9                  D10/A10 10

    A graphical datasheet of the headers can be seen here:
    https://cdn.sparkfun.com/assets/f/d/8/0/d/ProMicro16MHzv2.pdf

compatible: "sparkfun,pro-micro-gpio"

include: [gpio-nexus.yaml, base.yaml]
```

## dts/bindings/gpio/sparkfun-pro-micro-header.yaml
```yaml
# Copyright (C) 2021 Peter Johanson
# SPDX-License-Identifier: Apache-2.0

description: |
    GPIO pins exposed on Sparkfun Pro Micro (and compatible devices) headers.

    The Sparkfun Pro Micro layout provides two headers, along opposite
    edges of the board.

    Proceeding counter-clockwise:
    * A 12-pin Power and Digital Input header.  This has input signals
      labeled from 0 at the top through 9 at the bottom.
    * An 12-pin Power and Digital/Analog Input header.  This
      has four power pins, followed by eight inputs, with a
      non-monotonically decreasing numbering.

    This binding provides a nexus mapping for 18 pins, as depicted below:

        0 TX0                    RAW    -
        1 RX1                    GND    -
        - GND                    RST    -
        - GND                    VCC    -
        2 D2                     D21/A3 21
        3 D3                     D20/A2 20
        4 A4                     D19/A1 19
        5 D5                     D18/A0 18
        6 D6                     D15    15
        7 D7                     D14    14
        8 D8                     D16    16
        9 D9                     D10    10


compatible: "sparkfun,pro-micro-gpio"

include: [gpio-nexus.yaml, base.yaml]
```

## dts/bindings/gpio/st,dcmi-camera-fpu-330zh.yaml
```yaml
# Copyright (c) 2025 Charles Dias
# SPDX-License-Identifier: Apache-2.0

description: |
  GPIO pins exposed on the 30-pin ZIF connector (CN5) of the B-CAMS-OMV.
  Connector layout:
    (1)   3V3
    (2)   GND
    (3)   I2C_SCL
    (4)   I2C_SDA
    (5)   RESET#
    (6)   PWR_EN / LED1
    (7)   SHUTTER
    (8)   GND
    (9)   PULLDOWN / LED2
    (10)  Camera_CLK
    (11)  3V3
    (12)  DCMI_VSYNC
    (13)  5V (RSU)
    (14)  DCMI_HSYNC
    (15)  GND
    (16)  DCMI_PIXCK
    (17)  GND
    (18)  SPI_MISO
    (19)  SPI_CS
    (20)  DCMI_D7
    (21)  DCMI_D6
    (22)  DCMI_D5
    (23)  DCMI_D4
    (24)  DCMI_D3
    (25)  DCMI_D2
    (26)  DCMI_D1
    (27)  DCMI_D0
    (28)  SPI_MOSI
    (29)  SPI_CLK
    (30)  GND

compatible: "st,dcmi-camera-fpu-330zh"

include: [gpio-nexus.yaml, base.yaml]
```

## dts/bindings/gpio/st,dsi-lcd-qsh-030.yaml
```yaml
# Copyright (c) 2023 bytes at work AG
# SPDX-License-Identifier: Apache-2.0

description: |
  GPIO pins exposed on QSH-030-01-F-D-A connector used as DSI LCD connector.

  Connector layout (not mapped GPIOs in parentheses):

    (1)   GND                             -  (2)
    (3)   DSI_CK_P                TOUCH_INT   4
    (5)   DSI_CK_N                        -  (6)
    (7)   GND                             -  (8)
    (9)   DSI_D0_P                        -  (10)
    (11)  DSI_D0_N                        -  (12)
    (13)  GND                             -  (14)
    (15)  DSI_D1_P                        -  (16)
    (17)  DSI_D1_N                        -  (18)
    (19)  GND                             -  (20)
    (21)  BLVDD(+5V)                      -  (22)
    (23)  BLVDD(+5V)                      -  (24)
    (25)  -                               -  (26)
    (27)  BLGND                           -  (28)
    (29)  BLGND                           -  (30)
    (31)  -                               -  (32)
    (33)  -                               -  (34)
     35   SCLK/MCLK          VDD(2.8V-3.3V)  (36)
     37   LRCLK                           -  (38)
     39   I2S                       I2C_SDA   40
    (41)  -                               -  (42)
    (43)  -                         I2C_SCL   44
     45   CEC_CLK                         -  (46)
     47   CEC                             -  (48)
     49   DSI_TE                          -  (50)
    (51)  -                               -  (52)
     53   BL_CTRL                         -  (54)
    (55)  -                               -  (56)
     57   RESET                           -  (58)
    (59)  -                               -  (60)

compatible: "st,dsi-lcd-qsh-030"

include: [gpio-nexus.yaml, base.yaml]
```
