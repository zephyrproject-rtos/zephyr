## dts/bindings/gpio/ti,tca6424a.yaml
```yaml
# Copyright (c) 2022 Chromium OS Authors
# SPDX-License-Identifier: Apache-2.0

description: TI TCA6424A I2C-based GPIO expander

compatible: "ti,tca6424a"

include: [gpio-controller.yaml, i2c-device.yaml]

properties:
  int-gpios:
    type: phandle-array
    description: |
        GPIO connected to the controller INT pin. This pin is active-low
        and open-drain.

  reset-gpios:
    type: phandle-array
    description: |
        GPIO connected to the controller RESET pin. This pin is active-low.

  "#gpio-cells":
    const: 2

gpio-cells:
  - pin
  - flags
```

## dts/bindings/gpio/ti,tca9538-gpio.yaml
```yaml
# Copyright (c) 2018, Aapo Vienamo
# Copyright (c) 2021, Laird Connectivity
# SPDX-License-Identifier: Apache-2.0

description: TCA9538 GPIO node

compatible: "ti,tca9538"

include: [i2c-device.yaml, gpio-controller.yaml]

properties:
    label:
      required: true

    "#gpio-cells":
      const: 2

    ngpios:
      required: true
      const: 8
      description: |
        Number of GPIOs available on port expander.

    nint-gpios:
      type: phandle-array
      required: false
      description: |
        Connection for the NINT signal. This signal is active-low when
        produced by tca9538 GPIO node.

    init-out-low:
      type: int
      required: false
      default: 0
      description: |
        Bit mask identifying pins that should be initialized as outputs
        driven low.

    init-out-high:
      type: int
      required: false
      default: 0
      description: |
        Bit mask identifying pins that should be initialized as outputs
        driven high.

    init-input-inversion:
      type: int
      required: false
      default: 0
      description: |
        Bit mask identifying input pins that should be inverted.

gpio-cells:
  - pin
  - flags
```

## dts/bindings/gpio/ti,tca9554.yaml
```yaml
# Copyright (c) 2026, Leica Geosystems AG
# SPDX-License-Identifier: Apache-2.0

description: Texas Instruments 8-bit I2C IO-Expander

compatible: "ti,tca9554"

include: [gpio-controller.yaml, i2c-device.yaml]

properties:
  "#gpio-cells":
    const: 2

  ngpios:
    required: true
    const: 8

gpio-cells:
  - pin
  - flags
```

## dts/bindings/gpio/ti,tla2528-gpio.yaml
```yaml
# Copyright (c) 2026 Leica Geosystems AG
# SPDX-License-Identifier: Apache-2.0

description: GPIO binding for the Texas Instruments 8 channel 12 bit I2C ADC with GPIOs

compatible: "ti,tla2528-gpio"

include: [gpio-controller.yaml, base.yaml]

on-bus: tla2528

properties:
  "#gpio-cells":
    const: 2

  ngpios:
    const: 8

gpio-cells:
  - pin
  - flags
```

## dts/bindings/gpio/ti,tms570-gpio.yaml
```yaml
# Copyright (c) 2025 ispace, inc.
# SPDX-License-Identifier: Apache-2.0

description: TMS570 GPIO

compatible: "ti,tms570-gpio"

include: [gpio-controller.yaml, base.yaml]

properties:
  # NOTE: Register ranges:
  #        - 0 : GIO port registers
  #        - 1 : GIO base registers
  reg:
    required: true

  interrupt-parent:
    required: true

  ngpios:
    required: true

gpio-cells:
  - pin
  - flags
```

## dts/bindings/gpio/wch,ch56x-gpio.yaml
```yaml
# Copyright (c) 2023-2024 Chen Xingyu <hi@xingrz.me>
# SPDX-License-Identifier: Apache-2.0

description: WCH CH56x GPIO

compatible: "wch,ch56x-gpio"

include: [gpio-controller.yaml, base.yaml]

properties:
  reg:
    required: true

  interrupts:
    required: true

  interruptible-pins:
    type: array
    description: |
      List of <pin offset> pairs for pins that can be used as interrupt. Refer
      to the datasheet for offset values.

  "#gpio-cells":
    const: 2

gpio-cells:
  - pin
  - flags
```

## dts/bindings/gpio/wch,ch5xx-gpio.yaml
```yaml
# SPDX-FileCopyrightText: 2026 SMILE (smile.eu)
# SPDX-License-Identifier: Apache-2.0

description: WCH CH5xx General-Purpose Input/Output (GPIO)

compatible: "wch,ch5xx-gpio"

include: [gpio-controller.yaml, base.yaml]

properties:
  reg:
    required: true

  "#gpio-cells":
    const: 2

  port:
    required: true
    type: string
    description: GPIO port
    enum:
      - "port-a"
      - "port-b"

gpio-cells:
  - pin
  - flags
```

## dts/bindings/gpio/wch,gpio.yaml
```yaml
# Copyright (c) 2024 Michael Hope
# SPDX-License-Identifier: Apache-2.0

description: WCH CH32V00x General-Purpose Input/Output (GPIO)

compatible: "wch,gpio"

include: [gpio-controller.yaml, base.yaml]

properties:
  reg:
    required: true

  "#gpio-cells":
    const: 2

gpio-cells:
  - pin
  - flags
```

## dts/bindings/gpio/weact,dcmi-camera-connector.yaml
```yaml
# SPDX-License-Identifier: Apache-2.0

description: |
  GPIO pins exposed on the DCMI camera connector used for interfacing
  with the OV2640, OV7670, and OV5640 camera sensors.

  Connector layout (not mapped GPIOs in parentheses):

    (1)   OV_STROBE (Unused)                 (2)   AGND
     3    DVP_SDA                            (4)   AVDD-2V8
     5    DVP_SCL                            (6)   DVP_RST
     7    DVP_VSYNC                           8    DVP_PWDN
     9    DVP_HSYNC                          (10)  DVDD-1V5
    (11)  2V8                                 12   DVP_D7
     13   DVP_XCLK                            14   DVP_D6
    (15)  GND                                 16   DVP_D5
     17   DVP_PCLK                            18   DVP_D4
     19   DVP_D0                              20   DVP_D3
     21   DVP_D1                              22   DVP_D2
    (23)  AF-2V8                             (24)  GND

compatible: "weact,dcmi-camera-connector"

include: [gpio-nexus.yaml, base.yaml]
```

## dts/bindings/gpio/wisblock-io-slot.yaml
```yaml
# Copyright (c) 2026 RAKwireless Technology Limited
# SPDX-License-Identifier: Apache-2.0

description: |
  GPIO pins exposed on a WisBlock I/O Slot interface.

  An I/O Slot uses a WC40 40-pin connector (WC40F on the Base Board side)
  and accepts an I/O Module. All I/O Slots share a single pin assignment.

  This binding provides a gpio-nexus mapping for the 25 logical signal pins,
  where parent pin indices correspond to the WISBLOCK_IO_* constants defined in
  <zephyr/dt-bindings/gpio/wisblock-io-slot.h>:

    0   SW1       User button
    1   TXD0      UART0 TX
    2   RXD0      UART0 RX
    3   LED1      User LED 1
    4   LED2      User LED 2
    5   LED3      User LED 3
    6   I2C1_SDA  I2C bus 1 SDA
    7   I2C1_SCL  I2C bus 1 SCL
    8   AIN0      Analog input 0
    9   AIN1      Analog input 1
    10  IO7       General-purpose IO7
    11  SPI_CS    SPI chip select
    12  SPI_CLK   SPI clock
    13  SPI_MISO  SPI MISO
    14  SPI_MOSI  SPI MOSI
    15  IO1       General-purpose IO1
    16  IO2       General-purpose IO2
    17  IO3       General-purpose IO3
    18  IO4       General-purpose IO4
    19  TXD1      UART1 TX
    20  RXD1      UART1 RX
    21  I2C2_SDA  I2C bus 2 SDA
    22  I2C2_SCL  I2C bus 2 SCL
    23  IO5       General-purpose IO5
    24  IO6       General-purpose IO6

compatible: "wisblock-io-slot"

include: [gpio-nexus.yaml, base.yaml]
```

## dts/bindings/gpio/wisblock-sensor-slot.yaml
```yaml
# Copyright (c) 2026 RAKwireless Technology Limited
# SPDX-License-Identifier: Apache-2.0

description: |
  GPIO pins exposed on a WisBlock Sensor Slot interface.

  A Sensor Slot uses a WC24 24-pin connector (WC24F on the Base Board side).
  Base boards provide between two and six Sensor Slots labeled A through F,
  each implementing one of the six electrical interface variants (SSA–SSF).
  All variants expose the same 10 signal-carrying pin names; GPIO1 and GPIO2
  route to different platform IO signals depending on the variant.

  This binding provides a gpio-nexus mapping for those 10 logical pins, where
  parent pin indices correspond to the WISBLOCK_SENSOR_* constants defined in
  <zephyr/dt-bindings/gpio/wisblock-sensor-slot.h>:

    0   TXD       UART TX
    1   SPI_CS    SPI chip select
    2   SPI_CLK   SPI clock
    3   SPI_MISO  SPI MISO
    4   SPI_MOSI  SPI MOSI
    5   I2C_SCL   I2C SCL
    6   I2C_SDA   I2C SDA
    7   GPIO1     General-purpose GPIO1
    8   GPIO2     General-purpose GPIO2
    9   RXD       UART RX

  Each Base Board instantiates one node per slot using this binding
  (e.g. wisblock_sensor_a, wisblock_sensor_b, ...) and maps the logical
  slot pins to the underlying SoC GPIO lines via wisblock_io.

compatible: "wisblock-sensor-slot"

include: [gpio-nexus.yaml, base.yaml]
```

## dts/bindings/gpio/x-powers,axp192-gpio.yaml
```yaml
# Copyright (c) 2023 Martin Kiepfer
# SPDX-License-Identifier: Apache-2.0

description: AXP192 GPIO Controller

  AX192 features 5 native GPIOs. In addition the EXTEN pin can be configured
  to be used as an IO as well.

  Pin-Mapping is as follows
    [0] GPIO0
    [1] GPIO1
    [2] GPIO2
    [3] GPIO3
    [4] GPIO4
    [5] GPIO5/NRSTO
    [6] EXTEN

compatible: "x-powers,axp192-gpio"

include: gpio-controller.yaml

properties:
  "#gpio-cells":
    const: 2

  ngpios:
    required: true
    const: 7
    description: |
      Number of GPIOs available on axp192.

gpio-cells:
  - pin
  - flags
```

## dts/bindings/gpio/xhsc,hc32-gpio.yaml
```yaml
# Copyright (C) 2024-2025, Xiaohua Semiconductor Co., Ltd.
# SPDX-License-Identifier: Apache-2.0

description: xhsc hc32 GPIO node

compatible: "xhsc,hc32-gpio"

include: [gpio-controller.yaml, base.yaml]

properties:
  reg:
    required: true

  "#gpio-cells":
    const: 2

gpio-cells:
  - pin
  - flags
```

## dts/bindings/gpio/xlnx,ps-gpio-bank.yaml
```yaml
#
# Copyright (c) 2022, Weidmueller Interface GmbH & Co. KG
# SPDX-License-Identifier: Apache-2.0
#

description: |
  Xilinx Zynq-7000/ZynqMP MIO/EMIO GPIO controller bank node.

  Each node of this type specified in the devicetree represents
  a bank of the MIO/EMIO GPIO controller integrated in the Processor
  System.

compatible: "xlnx,ps-gpio-bank"

include: [gpio-controller.yaml, base.yaml]

properties:
    reg:
      required: true

    "#gpio-cells":
      const: 2

    ngpios:
      required: true

gpio-cells:
  - pin
  - flags
```

## dts/bindings/gpio/xlnx,ps-gpio.yaml
```yaml
#
# Copyright (c) 2022, Weidmueller Interface GmbH & Co. KG
# SPDX-License-Identifier: Apache-2.0
#

description: |
  Xilinx Zynq-7000/ZynqMP MIO/EMIO GPIO Controller.

  This GPIO controller is contained in both the Xilinx Zynq-7000 and
  ZynqMP (UltraScale) SoCs. It interfaces both I/O pins of the SoC,
  which can be mapped in the system design tools (MIO pins), or SoC-
  internal signals between the processor system and the programmable
  logic part of the SoC (EMIO pins).

  It is organized in banks, where the number of banks and total number
  of available GPIO pins differs between the two SoC families:

  Zynq-7000 (comp. Zynq-7000 TRM, chap. 14.1.2, p. 381):
    * Bank 0: MIO  pins [31:00]
    * Bank 1: MIO  pins [53:32] (total: 54 MIO pins)
    * Bank 2: EMIO pins [31:00]
    * Bank 3: EMIO pins [63:32] (total: 64 EMIO pins)

  ZynqMP (UltraScale) (comp. Ultrascale TRM, chap. 27, p. 769):
    * Bank 0: MIO  pins [25:00]
    * Bank 1: MIO  pins [51:26]
    * Bank 2: MIO  pins [77:52] (total: 78 MIO pins, 26 per bank)
    * Bank 3: EMIO pins [31:00]
    * Bank 4: EMIO pins [63:32]
    * Bank 5: EMIO pins [95:64] (total: 96 EMIO pins)

  The controller is interrupt-capable. Certain pins both in the Zynq-
  7000 and the ZynqMP are reserved or at least limited regarding their
  direction.

compatible: "xlnx,ps-gpio"

include: base.yaml

properties:
  reg:
    required: true

  interrupts:
    required: true
```

## dts/bindings/gpio/xlnx,xlnx,xps-gpio-1.00.a-gpio2.yaml
```yaml
description: Xilinx AXI GPIO IP GPIO2 node

compatible: "xlnx,xps-gpio-1.00.a-gpio2"

include: [gpio-controller.yaml, base.yaml]

on-bus: xlnx,xps-gpio-1.00.a

properties:
    label:
      required: true

    "#gpio-cells":
      const: 2

gpio-cells:
  - pin
  - flags
```

## dts/bindings/gpio/xlnx,xps-gpio-1.00.a-gpio2.yaml
```yaml
description: Xilinx AXI GPIO IP GPIO2 node

compatible: "xlnx,xps-gpio-1.00.a-gpio2"

include: [gpio-controller.yaml, base.yaml]

on-bus: xlnx,xps-gpio-1.00.a

properties:
    "#gpio-cells":
      const: 2

gpio-cells:
  - pin
  - flags
```

## dts/bindings/gpio/xlnx,xps-gpio-1.00.a.yaml
```yaml
description: Xilinx AXI GPIO IP node

compatible: "xlnx,xps-gpio-1.00.a"

include: [gpio-controller.yaml, base.yaml]

bus: xlnx,xps-gpio-1.00.a

# Property names correspond to a subset of those generated by
# https://github.com/Xilinx/device-tree-xlnx

properties:
    reg:
      required: true

    label:
      required: true

    xlnx,all-inputs:
      type: int
      description: |
        1 if all GPIOs are inputs, 0 otherwise

    xlnx,all-outputs:
      type: int
      description: |
        1 if all GPIOs are outputs, 0 otherwise

    xlnx,dout-default:
      type: int
      description: |
        Default output value. If n-th bit is 1, GPIO-n default value is 1.

    xlnx,gpio-width:
      type: int
      description: |
        Number of GPIOs supported

    xlnx,tri-default:
      type: int
      description: |
        Default tristate register value. If n-th bit is 1, GPIO-n is an input.

    xlnx,is-dual:
      type: int
      description: |
        1 if controller has GPIO2 enabled, 0 otherwise

    xlnx,all-inputs-2:
      type: int
      description: |
        1 if all GPIO2s are inputs, 0 otherwise

    xlnx,all-outputs-2:
      type: int
      description: |
        1 if all GPIO2s are outputs, 0 otherwise

    xlnx,dout-default-2:
      type: int
      description: |
        Default output value. If n-th bit is 1, GPIO2-n default value is 1.

    xlnx,gpio2-width:
      type: int
      description: |
        Number of GPIO2s supported

    xlnx,tri-default-2:
      type: int
      description: |
        Default tristate register value. If n-th bit is 1, GPIO2-n is an input.

    "#gpio-cells":
      const: 2

gpio-cells:
  - pin
  - flags
```

## dts/bindings/gpio/zephyr,gpio-emul-sdl.yaml
```yaml
# Copyright 2022, Basalte bv
# SPDX-License-Identifier: Apache-2.0

description: |
  SDL keyboard GPIO input Emulator

  Simulate GPIO state/interrupts using SDL keyboard events. This node has
  to be a child of a `zephyr,gpio-emul` compatible.
  Add a list of scancodes for the desired keys to be mapped.

  This driver uses USB HID scancodes, they are different from linux key codes,
  and thus do not match Zephyr code values as described in input-event-codes.h.
  Refer to https://www.usb.org/sites/default/files/documents/hut1_12v2.pdf
  section Keyboard/Keypad (p53) for a list of scancode values.

  The following example maps the first 3 numeric keys to GPIO pins:
  - Scancode 30: "Keyboard 1 and !", mapped to gpio0 0
  - Scancode 31: "Keyboard 2 and @", mapped to gpio0 1
  - Scancode 32: "Keyboard 3 and \#", mapped to gpio0 2

  The "typical position" column from HID table suggests to match them
  with standard keycode values 2, 3 and 4, corresponding to
  INPUT_KEY_1, INPUT_KEY_2 and INPUT_KEY_3 in input-event-codes.h.

  /* gpio0 has to be a zephyr,gpio-emul device */
  &gpio0 {
    ngpios = <3>;

    sdl_gpio {
      compatible = "zephyr,gpio-emul-sdl";
      scancodes = <30 31 32>;
    };
  };

  keypad: keypad {
    compatible = "gpio-keys";
    key1: key1 {
      gpios = <&gpio0 0 GPIO_ACTIVE_HIGH>;
    };
    key2: key2 {
      gpios = <&gpio0 1 GPIO_ACTIVE_HIGH>;
    };
    key3: key3 {
      gpios = <&gpio0 2 GPIO_ACTIVE_HIGH>;
    };
  };

  The limitations of usage are:
  - Only active high as we don't get events for keys that aren't pressed
  - Pressing multiple keys is best effort, state will be kept but no events
    are generated once the last key is released

compatible: "zephyr,gpio-emul-sdl"

include: base.yaml

properties:
  scancodes:
    type: array
    required: true
    description: |
      An array of SDL scancodes mapped to its GPIO index
```
