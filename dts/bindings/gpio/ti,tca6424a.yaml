## dts/bindings/gpio/zephyr,gpio-emul.yaml
```yaml
# Copyright 2020, Friedt Professional Engineering Services, Inc
# SPDX-License-Identifier: Apache-2.0

description: GPIO Emulator

compatible: "zephyr,gpio-emul"

include: [gpio-controller.yaml, base.yaml]

properties:
    reg:
      required: true

    rising-edge:
      description: Enables support for rising edge interrupt detection
      type: boolean

    falling-edge:
      description: Enables support for falling edge interrupt detection
      type: boolean

    high-level:
      description: Enables support for high level interrupt detection
      type: boolean

    low-level:
      description: Enables support for low level interrupt detection
      type: boolean

    "#gpio-cells":
      const: 2

gpio-cells:
  - pin
  - flags
```

## dts/bindings/gpio/zephyr,gpio-fake.yaml
```yaml
# Copyright (c) 2026 Nordic Semiconductor ASA
# SPDX-License-Identifier: Apache-2.0

description: Fake GPIO device used as stub or mock for testing

compatible: "zephyr,gpio-fake"

include:
  - base.yaml
  - gpio-controller.yaml

properties:
  "#gpio-cells":
    const: 2

gpio-cells:
  - pin
  - flags
```

## dts/bindings/gpio/zephyr,gpio-keys.yaml
```yaml
# Copyright (c) 2022 Google LLC
# SPDX-License-Identifier: Apache-2.0

description: Zephyr GPIO KEYS parent node

compatible: "zephyr,gpio-keys"

include: [gpio-keys.yaml]
```

## dts/bindings/gpio/zephyr,gpio-pin.yaml
```yaml
# Copyright (c) 2025, Yishai Jaffe
# SPDX-License-Identifier: Apache-2.0

description: GPIO pin information

compatible: "zephyr,gpio-pin"

include: base.yaml

properties:
  gpios:
    type: phandle-array
    required: true
    description: |
      GPIO used for general purpose
```

## dts/bindings/gpu/ambiq,nema-gpu.yaml
```yaml
# Copyright (c) 2025, Ambiq Micro Inc. <www.ambiq.com>
# SPDX-License-Identifier: Apache-2.0

description: |
  Bindings for the Ambiq Nema|GFX and Nema|VG Graphics Processor (GPU).
  This GPU is used for 2D and vector graphics acceleration.

compatible: "ambiq,nema-gpu"

include: [base.yaml]

properties:
  reg:
    required: true
    description: Base address and size of the GPU's memory-mapped register space.

  interrupts:
    required: true
    description: Interrupt specifier for the GPU, typically for command completion.

  high-performance-mode:
    type: boolean
    description: |
      If present, sets the GPU to default to High Performance (HP@250MHz) mode.
      HP mode offers maximum rendering speed at higher power consumption.
      If this property is absent, the GPU will default to Low Power (LP@96MHz) mode.
```

## dts/bindings/gpu/nxp,imx-pxp.yaml
```yaml
#
# Copyright (c) 2022, Basalte bv
#
# SPDX-License-Identifier: Apache-2.0
#

description: NXP MCUX PXP module

compatible: "nxp,imx-pxp"

include: base.yaml

properties:
    interrupts:
      required: true

    label:
      required: true
```
