## dts/bindings/gpio/nordic,nrf-port-configs.yaml
```yaml
# Copyright (c) 2024 Nordic Semiconductor ASA
# SPDX-License-Identifier: LicenseRef-Nordic-4-Clause

description: |
  Nordic Port Configs

  Hardware configurations that apply to IO ports.

properties:
  ioport-power-rails:
    type: phandle-array
    description: |
      Power supply configurations for GPIO ports. The configuration is board-
      specific and stored in BICR.
      The property is encoded as <&phandle rail>, where:

      - phandle is the phandle of the associated GPIO port
      - rail is the 8-bit power rail configuration to apply to the port

  ioport-drivectrls:
    type: phandle-array
    description: |
      Drive control settings for GPIO ports. The configuration is board-specific
      and stored in BICR.
      The property is encoded as <&phandle resistance>, where:

      - phandle is the phandle of the associated GPIO port
      - resistance is the resistance in ohms to adjust in the port's drive
      control, and can be one of the following: [33, 40, 50, 66, 100].

ioport-power-rail-cells:
  - rail

ioport-drivectrl-cells:
  - resistance
```

## dts/bindings/gpio/nordic-thingy53-edge-connector.yaml
```yaml
# Copyright (c) 2023 Nordic Semiconductor ASA
# SPDX-License-Identifier: Apache-2.0

description: |
  This binding provides a nexus mapping for 20 pins (HW rev 1.1.0) as depicted below
        P1   VLi-Ion
        P2   VBat
        P3   VOUTB
        P4   VDD_nRF53
        P5   P1.01/GRANT
        P6   P1.00/REQ
        P7   RESET
        P8   P0.05/AIN1
        P9   P0.04/AIN0
        P10  LOAD_SW_DISABLE
        P11  VOUTB_2
        P12  VDD_nRF21540
        P13  VDD_EXP_BRD
        P14  3V3
        P15  P0.08/TRACEDATA3
        P16  P0.09/TRACEDATA2
        P17  P0.10/TRACEDATA1
        P18  P0.11/TRACEDATA0
        P19  P0.12/TRACECLK
        P20  GND

compatible: "nordic-thingy53-edge-connector"

include: [gpio-nexus.yaml, base.yaml]
```

## dts/bindings/gpio/nuvoton,nct38xx-gpio-alert.yaml
```yaml
# Copyright (c) 2021 Nuvoton Technology Corporation.
# SPDX-License-Identifier: Apache-2.0

description: |
    Nuvoton NCT38XX series I2C-based GPIO expander alert handler

    Example:
      nct3807_alert_1 {
        compatible = "nuvoton,nct38xx-gpio-alert";
        irq-gpios = <&gpiod 4 (GPIO_PULL_UP | GPIO_ACTIVE_LOW)>;
        nct38xx-dev = <&nct3808_0_P1 &nct3808_0_P2>;
      };

compatible: "nuvoton,nct38xx-gpio-alert"

include: [base.yaml]

properties:
    irq-gpios:
      type: phandle-array
      required: true
      description: Interrupt GPIO pin

    nct38xx-dev:
      type: phandles
      required: true
      description: |
        NCT38XX devices which alert are handled by this alert handler.
```

## dts/bindings/gpio/nuvoton,nct38xx-gpio-port.yaml
```yaml
# Copyright (c) 2021 Nuvoton Technology Corporation.
# SPDX-License-Identifier: Apache-2.0

description: Nuvoton NCT38XX series I2C-based GPIO expander port

compatible: "nuvoton,nct38xx-gpio-port"

include: [gpio-controller.yaml, base.yaml]

properties:
  reg:
    required: true

  pin_mask:
    type: int
    required: true
    description: |
      Not every GPIOs are usable for different NCT38XX series. This property
      indicates the usable GPIO mask.

      NCT3808: <0xdc>
      others: <0xff>

  pinmux_mask:
    type: int
    description: |
      NCT38XX series port 0 has Pin Multiplexing functionality. However, not
      every GPIOs have pinmux controller functionality. This property
      indicates the usable GPIO pinmux mask. For port 1, this property is
      ignored.

      NCT3807 port 0: <0xf7>
      others: <0xff>

  "#gpio-cells":
    const: 2

gpio-cells:
  - pin
  - flags
```

## dts/bindings/gpio/nuvoton,nct38xx-gpio.yaml
```yaml
# Copyright (c) 2021 Nuvoton Technology Corporation.
# SPDX-License-Identifier: Apache-2.0

description: |
    Nuvoton NCT38XX series I2C-based GPIO expander

    This must be a child of the NCT38xx multi-function device.

    Example:
      &i2c0_0 {
        nct3807@70 {
          compatible = "nuvoton,nct38xx";
          reg = <0x70>;

          nct3807-gpio {
            #address-cells = <1>;
            #size-cells = <0>;
            compatible = "nuvoton,nct38xx-gpio";

            gpio@0 {
              compatible = "nuvoton,nct38xx-gpio-port";
              reg = <0x0>;
              gpio-controller;
              #gpio-cells = <2>;
              ngpios = <8>;
              pin-mask = <0xff>;
              pinmux-mask = <0xf7>;
            };

            gpio@1 {
              compatible = "nuvoton,nct38xx-gpio-port";
              reg = <0x1>;
              gpio-controller;
              #gpio-cells = <2>;
              ngpios = <8>;
              pin-mask = <0xff>;
            };
          };
        };

        nct3808_0_P1@71 {
          compatible = "nuvoton,nct38xx";
          reg = <0x71>;

          nct3808-0-p1-gpio {
            #address-cells = <1>;
            #size-cells = <0>;
            compatible = "nuvoton,nct38xx-gpio";

            gpio@0 {
              compatible = "nuvoton,nct38xx-gpio-port";
              reg = <0x0>;
              gpio-controller;
              #gpio-cells = <2>;
              ngpios = <8>;
              pin-mask = <0xdc>;
              pinmux-mask = <0xff>;
            };
          };
        };

        nct3808_0_P2@75 {
          compatible = "nuvoton,nct38xx";
          reg = <0x75>;

          nct3808-0-P2-gpio {
            #address-cells = <1>;
            #size-cells = <0>;
            compatible = "nuvoton,nct38xx-gpio";

            gpio@0 {
              compatible = "nuvoton,nct38xx-gpio-port";
              reg = <0x0>;
              gpio-controller;
              #gpio-cells = <2>;
              ngpios = <8>;
              pin-mask = <0xdc>;
              pinmux-mask = <0xff>;
            };
          };
        };
      };

compatible: "nuvoton,nct38xx-gpio"

include: [base.yaml]
```

## dts/bindings/gpio/nuvoton,npcx-gpio.yaml
```yaml
# Copyright (c) 2020 Nuvoton Technology Corporation.
# SPDX-License-Identifier: Apache-2.0

description: Nuvoton, NPCX-GPIO node

compatible: "nuvoton,npcx-gpio"

include: [gpio-controller.yaml, base.yaml]

properties:
    reg:
        required: true

    index:
        type: int
        required: true
        description: index of gpio device

    wui-maps:
        type: phandles
        required: true
        description: |
            Mapping table between Wake-Up Input (WUI) and 8 IOs belong to this device.
            Please notice not all IOs connect to WUIs.
            In this case, it will be presented by wui_none.

            For example the WUI mapping on NPCX7 GPIO8 would be
               wui-maps = <&wui_io80 &wui_io81 &wui_io82 &wui_io83
                           &wui_none &wui_none &wui_io86 &wui_io87>;

    lvol-maps:
        type: phandles
        required: false
        description: |
            Mapping table between Low-Voltage controllers and 8 IOs belong to
            this device. Please notice not all IOs support Low-Voltage detection.
            In this case, it will be presented by lvol_none.

            For example the LVOL mapping on NPCX7 GPIOC would be
               lvol-maps = <&lvol_none &lvol_ioc1 &lvol_ioc2 &lvol_none
                            &lvol_none &lvol_ioc5 &lvol_ioc6 &lvol_ioc7>;

    "#gpio-cells":
      const: 2

gpio-cells:
  - pin
  - flags
```

## dts/bindings/gpio/nuvoton,npcx-psl-out.yaml
```yaml
# Copyright (c) 2021 Nuvoton Technology Corporation.
# SPDX-License-Identifier: Apache-2.0

description: Nuvoton, NPCX-PSL (Power Switch Logic) Output node

compatible: "nuvoton,npcx-psl-out"

include: [base.yaml]

properties:
    controller:
        type: phandle
        required: true
        description: gpio controller to handle PSL output pad.

    pin:
        type: int
        required: true
        description: pin in gpio controller for PSL output.
```

## dts/bindings/gpio/nuvoton,numaker-gpio.yaml
```yaml
# Copyright (c) 2023 Nuvoton Technology Corporation.
# SPDX-License-Identifier: Apache-2.0

description: Nuvoton Numaker GPIO

compatible: "nuvoton,numaker-gpio"

include: [gpio-controller.yaml, base.yaml]

properties:
  reg:
    required: true

  "#gpio-cells":
    const: 2

gpio-cells:
  - pin
  - flags
```

## dts/bindings/gpio/nuvoton,numicro-gpio.yaml
```yaml
# Copyright (c) 2022 SEAL AG
# SPDX-License-Identifier: Apache-2.0

description: Nuvoton NuMicro GPIO

compatible: "nuvoton,numicro-gpio"

include: [gpio-controller.yaml, base.yaml]

properties:
  reg:
    required: true

  interrupts:
    required: true

  "#gpio-cells":
    const: 2

gpio-cells:
  - pin
  - flags
```

## dts/bindings/gpio/nxp,cam-44pins-connector.yaml
```yaml
# Copyright 2024 NXP
# SPDX-License-Identifier: Apache-2.0

description: |
    GPIO pins exposed on NXP 44-pin board-to-board camera connector.
    The connector layout is depicted below:

        42 GND                 GND              41
        2  AF_GND              AGND             1
        4  AF_VCC              STROBE           3
        6  VCMSINK             SDA              5
        8  AVDD                SCL              7
        10 GPIO1               RESETB           9
        12 GPIO0               PCLK             11
        14 FREX                VSYNC            13
        16 MIPI_CSI_DP1/D9     HREF             15
        18 MIPI_CSI_DN1/D8     PWDN             17
        20 DGND                MIPI_CSI_DP1/D9  19
        22 MIPI_CSI_CLKP/D7    MIPI_CSI_DN1/D8  21
        24 MIPI_CSI_CLKN/D6    MIPI_CSI_CLKP/D7 23
        26 DGND                MIPI_CSI_CLKN/D6 25
        28 MIPI_CSI_DP0/D5     MIPI_CSI_DP0/D5  27
        30 MIPI_CSI_DN0/D4     MIPI_CSI_DN0/D4  29
        32 DGND                D3               31
        34 XCLK                D2               33
        36 DVDD                D1               35
        38 DOVDD               D0               37
        40 DGND                DGND             39
        44 AF_GND              GND              43

compatible: "nxp,cam-44pins-connector"

include: [gpio-nexus.yaml, base.yaml]
```

## dts/bindings/gpio/nxp,flexio-lcd.yaml
```yaml
# Copyright 2024 NXP
# SPDX-License-Identifier: Apache-2.0


compatible: "nxp,flexio-lcd"

description: |
    GPIO pins exposed on NXP FlexIO LCD interface. These pins are
    exposed on a 32 pin. The pins have the
    following assignments:

      Pin Number    Usage
      1             VDD (3v3)
      2             GND
      3             FC2_I2C_SCL-FXIO_HDR
      4             FC2_I2C_SDA-FXIO_HDR
      5             LCD_INT
      6             LCD_GPIO
      7             LCD_RST
      8             LCD_DC
      9             LCD_CS
      10            LCD_WR
      11            LCD_RD
      12            LCD_TE
      13-15         FXIO_HDR
      16            D19
      17            D20
      18            D21
      19            D22
      20            D23
      21            D24
      22            D25
      23            D26
      24            D27
      25            D28
      26            D29
      27            D30
      28            D31
      29-32         NC

include: [gpio-nexus.yaml, base.yaml]
```

## dts/bindings/gpio/nxp,gpio-cluster.yaml
```yaml
description: A group of GPIOs that share an interrupt.

compatible: "nxp,gpio-cluster"

include: [base.yaml]

properties:
  interrupts:
    required: true
```

## dts/bindings/gpio/nxp,i2c-tsc-fpc.yaml
```yaml
# Copyright 2024 NXP
# SPDX-License-Identifier: Apache-2.0


compatible: "nxp,i2c-tsc-fpc"

description: |
    GPIO pins exposed on NXP LCD touch controller interface. These pins are
    exposed on a 6 pin flexible printed cable connector. The pins have the
    following assignments:

      Pin Number    Usage
      1             VDD
      2             LCD touch reset
      3             LCD touch interrupt
      4             LCD touch controller I2C SCL
      5             LCD touch controller I2C SDA
      6             GND

include: [gpio-nexus.yaml, base.yaml]
```

## dts/bindings/gpio/nxp,ias-camera-to-rpi-camera-adapter.yaml
```yaml
# Copyright 2026 NXP
# SPDX-License-Identifier: Apache-2.0

title: NXP IAS Camera to RPi Camera Adapter GPIO nexus

description: |
  This binding is used to abstract board-specific GPIO wiring for the
  "IAS Camera to RPi Camera Adapter".

  The adapter (and connected camera module) typically needs a few control GPIOs
  such as RESET and ISP enable. Boards should provide a gpio-nexus node (usually
  labelled `nxp_cam_connector`) that maps these logical pins to the real GPIO
  controllers/pins available on that board (including GPIO expanders).

  Use constants from:

    <zephyr/dt-bindings/gpio/nxp-ias-camera-to-rpi-camera-adapter.h>

  Nexus mapping:
    0  NXP_IAS_CAM_RESET   Camera module reset
    1  NXP_IAS_CAM_ISP_EN  Camera module ISP enable

compatible: "nxp,ias-camera-to-rpi-camera-adapter"

include: [gpio-nexus.yaml, base.yaml]
```

## dts/bindings/gpio/nxp,imx-gpio.yaml
```yaml
# Copyright 2017, 2024 NXP
# SPDX-License-Identifier: Apache-2.0

description: i.MX GPIO node

compatible: "nxp,imx-gpio"

include: [gpio-controller.yaml, base.yaml, "nxp,rdc-policy.yaml"]

properties:
  reg:
    required: true

  pinmux:
    type: phandles
    description: |
      IMX pin selection peripheral does not follow specific
      pattern for which GPIO port uses which pinmux. Use this property to specify
      pinctrl nodes to use for the gpio port when CONFIG_PINCTRL=y. Note that
      the order of the nodes matters. The first node for gpio1 will be used
      as the pinmux for gpio0, port 0.

  "#gpio-cells":
    const: 2

gpio-cells:
  - pin
  - flags
```

## dts/bindings/gpio/nxp,kinetis-gpio.yaml
```yaml
description: Kinetis GPIO

compatible: "nxp,kinetis-gpio"

include: [gpio-controller.yaml, base.yaml]

properties:
  reg:
    required: true

  "#gpio-cells":
    const: 2

  nxp,kinetis-port:
    required: true
    type: phandle
    description: |
      A phandle reference to the device tree node that contains the pinmux
      port associated with this GPIO controller.

  gpio-port-offest:
    type: int
    default: 0
    description: |
      Describes an offset between inst index and actual GPIO port number.

  wakeup-line:
    type: int
    description: |
      On some NXP platforms, GPIO can wake up the MCU from low power mode,
      but the wakeup capability is configured through a specific peripheral.
      Such as the wakeup unit. We need to use the wakeup unit peripheral to
      configure which GPIO and which signal can wake up the MCU from low power
      mode.
      Note: Users need to configure this property according to the options
      provided in 'zephyr/dt-bindings/gpio/nxp-kinetis-gpio', The driver will
      parses this property and configures the wakeup uint.

gpio-cells:
  - pin
  - flags
```

## dts/bindings/gpio/nxp,lcd-8080.yaml
```yaml
# Copyright 2024 NXP
# SPDX-License-Identifier: Apache-2.0


compatible: "nxp,lcd-8080"

description: |
    GPIO pins exposed on NXP LCD 8080 interface (e.g., used on LCD-PAR-035 panel).
    These pins are exposed on a 32 pin connector. The pins have the
    following assignments:

      Pin Number    Usage
      1             Not connected
      2             VBUS
      3             Not connected
      4             GND
      5             VCC
      6             GND
      7             LCD touch controller I2C SCL
      8             LCD touch controller I2C SDA
      9             LCD touch interrupt
      10            GPIO to control LCD backlight
      11            LCD and touch reset
      12            LCD 8080 interface D/C pin
      13            LCD 8080 interface CS pin
      14            LCD 8080 interface WR pin
      15            LCD 8080 interface RD pin
      16            LCD TE(tearing effect) pin
      17-32         LCD 8080 interface D0 - D15

include: [gpio-nexus.yaml, base.yaml]
```
