## dts/bindings/gpio/nxp,lcd-pmod.yaml
```yaml
# Copyright 2025 NXP
# SPDX-License-Identifier: Apache-2.0


compatible: "nxp,lcd-pmod"

description: |
    GPIO pins exposed on NXP LCD pmod interface (e.g., used on LCD-PAR-035 panel).
    These pins are exposed on a 12 pin connector. The pins have the
    following assignments:

      Pin Number    Usage
      1             VCC
      2             VCC
      3             GND
      4             GND
      5             LCD PMOD interface WR pin
      6             LCD touch controller I2C SCL
      7             LCD PMOD interface D/C pin
      8             LCD touch controller I2C SDA
      9             LCD PMOD interface MOSI pin
      10            LCD and touch reset
      11            LCD PMOD interface CS pin
      12            LCD touch interrupt

include: [gpio-nexus.yaml, base.yaml]
```

## dts/bindings/gpio/nxp,lpc-gpio-port.yaml
```yaml
# Copyright 2019-2022, 2024 NXP
# SPDX-License-Identifier: Apache-2.0

description: LPC GPIO port device.

compatible: "nxp,lpc-gpio-port"

include: [gpio-controller.yaml, base.yaml]

properties:
  reg:
    required: true

  "#gpio-cells":
    const: 2

  int-source:
    type: string
    default: "none"
    enum:
      - "pint"
      - "int-a"
      - "int-b"
      - "none"
    description: |
      Interrupt source for the gpio port. For ports that can use the PINT
      as an interrupt source for their pins (typically ports 0 and 1),
      this can be set to PINT. Otherwise, the property should be set to "int-a"
      or "int-b" if interrupt support is desired, and the appropriate IRQ number
      should set for the device.

gpio-cells:
  - pin
  - flags
```

## dts/bindings/gpio/nxp,lpc-gpio.yaml
```yaml
# Copyright 2024 NXP
# SPDX-License-Identifier: Apache-2.0

# This binding is for the gpio device,
# which has multiple ports that share the same
# base address. It is the ports that are
# functionally gpio devices.

description: LPC GPIO node

compatible: "nxp,lpc-gpio"

include: base.yaml

properties:
  reg:
    required: true

  "#address-cells":
    const: 1

  "#size-cells":
    const: 0
```

## dts/bindings/gpio/nxp,lpc11u6x-gpio.yaml
```yaml
# Copyright (c) 2020 Seagate Technology LLC
# SPDX-License-Identifier: Apache-2.0

description: NXP LPC11U6X GPIO node

compatible: "nxp,lpc11u6x-gpio"

include: [gpio-controller.yaml, base.yaml]

properties:
    reg:
      required: true

    label:
      required: true

    interrupts:
      required: true

    "#gpio-cells":
      const: 2

    base:
      type: int
      required: false
      default: 0
      description: index of the first GPIO for this port.

    clocks:
      required: true

    iocon:
      required: true
      type: phandle
      description: |
        a phandle reference to the devicetree node that contains the pinmux
        controller associated with the GPIO controller.

gpio-cells:
  - pin
  - flags
```

## dts/bindings/gpio/nxp,lpc84x-gpio.yaml
```yaml
# Copyright (c) 2026 Aerlync Labs Inc.
# SPDX-License-Identifier: Apache-2.0

description: NXP LPC84X GPIO

compatible: "nxp,lpc84x-gpio"

include: [gpio-controller.yaml, base.yaml]

properties:
  reg:
    required: true

  clocks:
    required: true

  interrupt-parent:
    type: phandle
    description:
      The GPIO peripheral does not generate interrupts directly.
      Instead, the PINT peripheral handles interrupt generation for the GPIO.

  port-no:
    type: int
    required: true
    description: GPIO port number.

  ngpios:
    type: int
    required: true
    description: Number of GPIOs supported by this port.

  "#gpio-cells":
    const: 2

gpio-cells:
  - pin
  - flags
```

## dts/bindings/gpio/nxp,parallel-lcd-connector.yaml
```yaml
# Copyright 2024 NXP
# SPDX-License-Identifier: Apache-2.0


compatible: "nxp,parallel-lcd-connector"

description: |
    GPIO pins exposed on NXP LCD interface. These pins are
    exposed on a 40 pin flexible printed cable connector. The pins have the
    following assignments:

      FPC Pin      Function
      1            LED backlight cathode
      2            LED backlight anode
      3            GND
      4            VDD (3v3)
      5-7          GND
      8-12         LCD D11-D15
      13-14        GND
      15-20        LCD D5-D10
      21-23        GND
      24-28        LCD D0-D4
      29           GND
      30           LCD CLK
      31           LCD DISP
      32           LCD HSYNC
      33           LCD VSYNC
      34           LCD DE
      35           NC
      36           GND
      37-40        NC

include: [gpio-nexus.yaml, base.yaml]
```

## dts/bindings/gpio/nxp,pca6408.yaml
```yaml
# Copyright 2025 NXP
# SPDX-License-Identifier: Apache-2.0
description: NXP PCA6408 I2C GPIO expander
compatible: nxp,pca6408
include: nxp,pca_series.yaml

properties:
  ngpios:
    required: true
    const: 8
```

## dts/bindings/gpio/nxp,pca6408a.yaml
```yaml
# Copyright 2025 NXP
# SPDX-License-Identifier: Apache-2.0
description: NXP PCA6408A I2C GPIO expander node
compatible: nxp,pca6408a
include: nxp,pca_series.yaml

properties:
  ngpios:
    required: true
    const: 8
```
