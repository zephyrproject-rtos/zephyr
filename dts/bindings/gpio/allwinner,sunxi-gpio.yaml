## dts/bindings/gpio/arduino-mega-header.yaml
```yaml
# Copyright (c) 2026 Analog Devices, Inc.
# SPDX-License-Identifier: Apache-2.0

title: GPIO pins exposed on Arduino Mega (rev3) headers

description: |
    The Arduino Mega layout provides six headers, three each along
    opposite edges of the board.

    Proceeding counter-clockwise:
    * An 8-pin Power Supply header. No pins on this header are exposed
      by this binding.
    * An 8-pin Analog Input header. This has analog input signals
      labeled from A0 at the top through A7 at the bottom.
    * Another 8-pin Analog Input header. This has eight additional analog
      input signals labeled from A8 at the top through A15 at the bottom.

    * An 8-pin header (opposite the second Analog Input header). This has
      digital input signals labeled in decreasing order from D21 at the bottom
      to D14 at the top.
    * Another 8-pin header (opposite the first Analog Input header). This has
      digital input signals labeled from D0 at the bottom to D7 at the top.
    * A 10-pin header (opposite Power Supply). This has six additional
      digital input signals labelled from D8 at the bottom through D13
      towards the top, skipping two pins (GND and AREF), then finishing with
      SDA1 and SCL1 at the top.

    This binding provides a nexus mapping for 40 pins, extending the mapping of
    the Arduino Uno (R3) header.

    The pins overlapping between Arduino Mega and Arduino Uno have the following
    parent pin mapping:
    * Parent pins 0 through 5 correspond to A0 through A5.
    * Parent pins 6 through 19 correspond to D0 through D13.
    * Parent pins 20 and 21 correspond to SDA1 and SCL1.

    The additional pins of Arduino Mega have the following parent pin mapping:
    * Parent pins 22 through 27 correspond to D14 through D19.
    * Parent pins 28 and 29 correspond to D20 and D21.
    * Parent pins 30 and 31 correspond to A6 and A7.
    * Parent pins 32 through 39 correspond to A8 through A15.

    The parent pin mapping and their physical layout are depicted below:

                                 SCL1 21
                                 SDA1 20
                                 AREF -
                                 GND  -
        - N/C                    D13  19
        - IOREF                  D12  18
        - RESET                  D11  17
        - 3V3                    D10  16
        - 5V                     D9   15
        - GND                    D8   14
        - GND
        - VIN                    D7   13
                                 D6   12
        0  A0                    D5   11
        1  A1                    D4   10
        2  A2                    D3    9
        3  A3                    D2    8
        4  A4                    D1    7
        5  A5                    D0    6
        30 A6
        31 A7                    D14  22
                                 D15  23
        32 A8                    D16  24
        33 A9                    D17  25
        34 A10                   D18  26
        35 A11                   D19  27
        36 A12                   D20  28
        37 A13                   D21  29
        38 A14
        39 A15

    Use ARDUINO_MEGA_HEADER_* constants in <zephyr/dt-bindings/gpio/arduino-mega-header.h>
    to refer to specific pins using convenient constant names.

compatible: "arduino-mega-header"

include: [gpio-nexus.yaml, base.yaml]
```

## dts/bindings/gpio/arduino-mkr-header.yaml
```yaml
# Copyright (c) 2022 TOKITA Hiroshi <tokita.hiroshi@fujitsu.com>
# SPDX-License-Identifier: Apache-2.0

description: |
    GPIO pins exposing on Arduino MKR headers.

    The Arduino MKR layout provides two headers on both edges of the board.

    * One side of the 14-pin header is analog inputs and digital signals.
      A1 to A6 is Analog input. The outside pin is AREF.
      A0 that is next to AREF used as a DAC output pin too.
      D0-D5 is a digital output.
    * The other side 14-pin header is power supplies and peripheral interface.
      There are 5V and VCC power supply, GND, and RESET pin. UART, I2C,
      and SPI peripheral pins are also there. The end 2 pins are simple GPIO pins.

    This binding provides a nexus mapping for 22 pins where parent pins 0
    through 14 correspond to D0 through D21, and parent pins 15 through 21
    correspond to A0 through A6, as depicted below.

        -  AREF                 5V       -
        15 A0/D15/DAC0          VIN      -
        16 A1/D16               VCC      -
        17 A2/D17               GND      -
        18 A3/D18               RESET    -
        19 A4/D19               D14/TX   14
        20 A5/D20               D13/RX   13
        21 A6/D21               D12/SCL  12
        0  D0                   D11/SDA  11
        1  D1                   D10/CPIO 10
        2  D2                   D9/SCK   9
        3  D3                   D8/COPI  8
        4  D4                   D7       7
        5  D5                   D6       6


compatible: "arduino-mkr-header"

include: [gpio-nexus.yaml, base.yaml]
```

## dts/bindings/gpio/arduino-nano-header-r3.yaml
```yaml
# Copyright (c) 2022 Joylab AG
# SPDX-License-Identifier: Apache-2.0

description: |
    GPIO pins exposed on Arduino Nano (R3) headers.

    The Arduino Nano layout provides two headers on opposite edges of the board.

    * A 15-pin header with mostly digital signals. The additional NRST (pin3)
      and GND (pin 4) pins are not exposed by this binding.
    * A 15-pin Analog Input and power supply header. This has analog input
      signals labeled from A0 through A7, as well a digital signal D13. The
      power supply and reset pins are not exposed by this binding.

    This binding provides a nexus mapping for 22 pins where parent pins 0
    through 13 correspond to D0 through D13, and parent pins 14 through 21
    correspond to A0 through A7, as depicted below.

        1  D1                   VIN    -
        0  D0                   GND    -
        -  RESET                RESET  -
        -  GND                  5V     -
        2  D2                   A7/D21 21
        3  D3                   A6/D20 20
        4  D4                   A5/D19 19
        5  D5                   A4/D18 18
        6  D6                   A3/D17 17
        7  D7                   A2/D16 16
        8  D8                   A1/D15 15
        9  D9                   A0/D14 14
        10 D10                  AREF   -
        11 D11                  3V3    -
        12 D12                  D13    13


compatible: "arduino-nano-header-r3"

include: [gpio-nexus.yaml, base.yaml]
```

## dts/bindings/gpio/arm,cmsdk-gpio.yaml
```yaml
description: ARM CMSDK GPIO

compatible: "arm,cmsdk-gpio"

include: [gpio-controller.yaml, base.yaml]

properties:
  reg:
    required: true

  interrupts:
    required: true

  "#gpio-cells":
    const: 2

gpio-cells:
  - pin
  - flags
```

## dts/bindings/gpio/arm,mmio32-gpio.yaml
```yaml
description: ARM MMIO32 GPIO

compatible: "arm,mmio32-gpio"

include: [gpio-controller.yaml, base.yaml]

properties:
  reg:
    required: true

  ngpios:
    required: true

  "#gpio-cells":
    const: 1

  direction-input:
    type: boolean
    description: Marks this pin set as all input pins.

gpio-cells:
  - pin
```

## dts/bindings/gpio/arm,mps2-fpgaio-gpio.yaml
```yaml
title: ARM MPS2 FPGA GPIO

description: GPIO controller on ARM MPS2 FPGA

compatible: "arm,mps2-fpgaio-gpio"

include: [gpio-controller.yaml, base.yaml]

properties:
    reg:
      required: true

    ngpios:
      required: true

    "#gpio-cells":
      const: 1

gpio-cells:
  - pin
```

## dts/bindings/gpio/arm,mps3-fpgaio-gpio.yaml
```yaml
description: GPIO controller on ARM MPS3 FPGA

compatible: "arm,mps3-fpgaio-gpio"

include: [gpio-controller.yaml, base.yaml]

properties:
  reg:
    required: true

  ngpios:
    required: true

  "#gpio-cells":
    const: 1

gpio-cells:
  - pin
```

## dts/bindings/gpio/at,at32-gpio.yaml
```yaml
# Copyright (c) 2021 Teslabs Engineering S.L.
# SPDX-License-Identifier: Apache-2.0

description: AT32 GPIO node

compatible: "at,at32-gpio"

include: [gpio-controller.yaml, reset-device.yaml, base.yaml]

properties:
  reg:
    required: true

  clocks:
    required: true

  resets:
    required: true

  "#gpio-cells":
    const: 2

gpio-cells:
  - pin
  - flags
```

## dts/bindings/gpio/atmel,sam-gpio.yaml
```yaml
# Copyright (c) 2021-2023, Gerson Fernando Budke <nandojve@gmail.com>
# SPDX-License-Identifier: Apache-2.0

description: SAM GPIO Port

compatible: "atmel,sam-gpio"

include: [gpio-controller.yaml, base.yaml]

properties:
  reg:
    required: true

  interrupts:
    required: true

  clocks:
    required: true

  "#gpio-cells":
    const: 2

  "#atmel,pin-cells":
    type: int
    required: true
    const: 2
    description: Number of items to expect in a atmel,pins specifier


gpio-cells:
  - pin
  - flags

atmel,pin-cells:
  - pin
  - peripheral
```

## dts/bindings/gpio/atmel,sam0-gpio.yaml
```yaml
description: SAM0 GPIO PORT node

compatible: "atmel,sam0-gpio"

include: [gpio-controller.yaml, base.yaml]

properties:
  reg:
    required: true

  "#gpio-cells":
    const: 2

  "#atmel,pin-cells":
    type: int
    required: true
    const: 2
    description: Number of items to expect in a atmel,pins specifier

gpio-cells:
  - pin
  - flags

atmel,pin-cells:
  - pin
  - peripheral
```

## dts/bindings/gpio/atmel,sam4l-gpio.yaml
```yaml
# Copyright (c) 2021-2023, Gerson Fernando Budke <nandojve@gmail.com>
# SPDX-License-Identifier: Apache-2.0

description: SAM4L GPIO Port

compatible: "atmel,sam4l-gpio"

include: ["atmel,sam-gpio.yaml"]
```

## dts/bindings/gpio/atmel-xplained-header.yaml
```yaml
# Copyright (C) 2020 Gerson Fernando Budke <nandojve@gmail.com>
# SPDX-License-Identifier: Apache-2.0

description: |
    GPIO pins exposed on Atmel Xplained headers.

    The Xplained layout provide a standard 10 pin header.  A board can have
    one or more headers and can share pins.  This connector was developed to
    match with Atmel AVR XMEGA devices GPIO port plus power signals.  The Atmel
    Xplained Pro standard connector keep compatibility with this header and it
    can be defined on every board with an Xplained Pro Connector extension and
    every pin can be defined as general purpose GPIO.

    The AVR XMEGA port was designed as:

    Signal  Main Function
       Px0  SDA
       Px1  SCL
       Px2  RX
       Px3  TX
       Px4  SS
       Px5  MOSI
       Px6  MISO
       Px7  SCK
       GND
       VDD

    Documentation:
    https://www.microchip.com/development-tools/xplained-boards
    http://ww1.microchip.com/downloads/en/DeviceDoc/Atmel-42091-Atmel-Xplained-Pro-Hardware-Development-Kit_User%20Guide.pdf

    This binding provides a nexus mapping for 10 pins where pins are disposed
    to have a even and odd column:

                           Connector
    Bind      Pin Name     Pin   Pin  Pin Name        Bind
      0          I2C(SDA)  1       2  I2C(SCL)         1
      2          UART(RX)  3       4  UART(TX)         3
      4          SPI(CS0)  5       6  SPI(MOSI)        5
      6         SPI(MISO)  7       8  SPI(SCK)         7
                      GND  9      10  VDD(+3.3V)

compatible: "atmel-xplained-header"

include: [gpio-nexus.yaml, base.yaml]
```

## dts/bindings/gpio/atmel-xplained-pro-header.yaml
```yaml
# Copyright (C) 2020 Gerson Fernando Budke <nandojve@gmail.com>
# SPDX-License-Identifier: Apache-2.0

description: |
    GPIO pins exposed on Atmel Xplained Pro headers.

    The Xplained Pro layout provide a standard 20 pin header.  A board can have
    one or more headers and can share pins.  The extension headers are given
    names EXTn where n ϵ [1…7], n is determined by which ID pin is connected
    to the embedded debugger.  A header with ID7 signal from the embedded
    debugger connected should be called EXT7. PWR, EXT1, EXT2 and EXT3 are
    standard extension headers that have a predefined position according to the
    list below:
      * PWR is right angled at the top right hand side of the board. This
      header must always be implemented.
      * EXT1 is right angled at the top right hand side of the board, located
      below the PWR header. This header must always be present.
      * EXT2 is right angled and at the bottom right hand side of the board.
      This header is mandatory for medium and large boards and should not be
      implemented on small boards.
      * EXT3 is right angled pointing downwards
    All MCU boards have to implement at least PWR, EXT1, EXT2 (on medium and
    large boards), and EXT3. EXT4 to EXT7 can be placed differently depending
    on the board design. EXT4 to EXT7 can either be standard extension headers
    or application specific headers.

    Documentation:
    * https://www.microchip.com/development-tools/xplained-boards
    * http://ww1.microchip.com/downloads/en/DeviceDoc/Atmel-42091-Atmel-Xplained-Pro-Hardware-Development-Kit_User%20Guide.pdf

    This binding provides a nexus mapping for 20 pins where pins are disposed
    to have a even and odd column:

                           Connector
    Bind      Pin Name     Pin   Pin  Pin Name        Bind
                       ID  1       2  GND
      0            ADC(+)  3       4  ADC(-)           1
      2   UART(RTS)/GPIO1  5       6  UART(CTS)/GPIO2  3
      4            PWM(+)  7       8  PWM(-)           5
      6         IRQ/GPIO3  9      10  SPI(CS1)/GPIO4   7
      8          I2C(SDA)  11     12  I2C(SCL)         9
     10          UART(RX)  13     14  UART(TX)         11
     12          SPI(CS0)  15     16  SPI(MOSI)        13
     14         SPI(MISO)  17     18  SPI(SCK)         15
                      GND  19     20  VDD(+3.3V)

compatible: "atmel-xplained-pro-header"

include: [gpio-nexus.yaml, base.yaml]
```

## dts/bindings/gpio/atmel.sam-gpio.yaml
```yaml
---
title: Atmel SAM GPIO PORT driver
id: atmel,sam-gpio
version: 0.1

description: >
    This is a representation of the SAM GPIO PORT nodes

properties:
    compatible:
      type: string
      category: required
      description: compatible strings
      constraint: "atmel,sam-gpio"
      generation: define

    reg:
      type: int
      description: mmio register space
      generation: define
      category: required

    interrupts:
      type: compound
      category: required
      description: required interrupts
      generation: define

    label:
      type: string
      category: required
      description: Human readable string describing the device (used by Zephyr for API name)
      generation: define

    peripheral-id:
      type: int
      description: peripheral ID
      generation: define
      category: required
```

## dts/bindings/gpio/awinic,aw9523b-gpio.yaml
```yaml
# Copyright (c) 2024 TOKITA Hiroshi
# SPDX-License-Identifier: Apache-2.0

description: AW9523B GPIO Controller

compatible: "awinic,aw9523b-gpio"

include: gpio-controller.yaml

on-bus: aw9523b

properties:
  int-gpios:
    type: phandle-array
    description: |
      Set GPIO connected to the controller INTN pin.
      This is used for notifying interruption.

  reset-gpios:
    type: phandle-array
    description: |
      Set GPIO connected to the controller RSTN pin.
      This is used for controlling resets via GPIO.

  port0-push-pull:
    type: boolean
    description: |
      Configure Port0 to Push-Pull mode.
      Port0 is worked in Open-Drain mode by default.

  "#gpio-cells":
    const: 2

gpio-cells:
  - pin
  - flags
```
