## dts/bindings/gpio/allwinner,sunxi-gpio.yaml
```yaml
# Copyright (c) 2026 Khai Do
# SPDX-License-Identifier: Apache-2.0

description: Allwinner sunxi GPIO controller

compatible: "allwinner,sunxi-gpio"

include: [gpio-controller.yaml, base.yaml]

properties:
  reg:
    required: true

  reg-names:
    required: true

  "#gpio-cells":
    const: 2

  allwinner,hw-bank:
    type: int
    required: true
    description: Hardware bank ID for the interrupts

gpio-cells:
  - pin
  - flags
```

## dts/bindings/gpio/altr,pio-1.0.yaml
```yaml
# Copyright (c) 2023 Intel Corporation
# SPDX-License-Identifier: Apache-2.0

description: Altera PIO

compatible: "altr,pio-1.0"

include: [gpio-controller.yaml, base.yaml]

properties:
  reg:
    required: true

  direction:
    type: string
    description: |
      Direction can be set to bidir, input, inout or output.
      It cannot be configure when during the runtime and should be
      set according to the synthesized FPGA design.
    default: output
    enum:
      - "bidir"
      - "input"
      - "inout"
      - "output"

  outset:
    type: boolean
    description: |
      Enable outset register to specify which bit of the output port to set.

  outclear:
    type: boolean
    description: |
      Enable outclear register to specify which output bit to clear.

  "#gpio-cells":
    const: 2

gpio-cells:
  - pin
  - flags
```

## dts/bindings/gpio/altr,pio.yaml
```yaml
# Copyright (c) 2022 Intel Corporation
# SPDX-License-Identifier: Apache-2.0

description: Altera PIO node

compatible: "altr,pio"

include: [gpio-controller.yaml, base.yaml]

properties:
  reg:
    required: true

  ngpios:
    required: true
    type: int
    description: |
        Width of the I/O ports.

  direction:
    required: false
    type: string
    description: |
        Direction can be set to Bidir, Input, InOut or Output.
    default: Output
    enum:
      - "Bidir"
      - "Input"
      - "InOut"
      - "Output"

  "#gpio-cells":
    const: 2

gpio-cells:
  - pin
  - flags
```

## dts/bindings/gpio/ambiq,gpio-bank.yaml
```yaml
# Copyright (c) 2023 Antmicro <www.antmicro.com>
# Copyright (c) 2023 Ambiq Micro Inc. <www.ambiq.com>
# SPDX-License-Identifier: Apache-2.0

description: Ambiq GPIO bank node

compatible: "ambiq,gpio-bank"

include: [gpio-controller.yaml, base.yaml]

properties:
  reg:
    required: true
    description: |
      This property indicates the register address offset of each GPIO child node
      under the "ambiq,gpio" parent node. The register address of pin described in
      gpio-cells can be obtained by: base address + child address offset + (pin << 2).

  "#gpio-cells":
    const: 2

gpio-cells:
  - pin
  - flags
```

## dts/bindings/gpio/ambiq,gpio.yaml
```yaml
# Copyright (c) 2023 Ambiq Micro Inc. <www.ambiq.com>
# SPDX-License-Identifier: Apache-2.0

description: |
    Ambiq GPIO provides the GPIO pin mapping for GPIO child nodes.

    The Ambiq Apollo4x soc designs a single GPIO port with 128 pins.
    It uses 128 continuous 32-bit registers to configure the GPIO pins.
    This binding provides a pin mapping to solve the limitation of the maximum
    32 pins handling in GPIO driver API.

    The Ambiq Apollo4x soc should define one "ambiq,gpio" parent node in soc
    devicetree and some child nodes which are compatible with "ambiq,gpio-bank"
    under this parent node.

    Here is an example of how a "ambiq,gpio" node can be used with the combined
    gpio child nodes:

    gpio: gpio@40010000 {
      compatible = "ambiq,gpio";
      gpio-map-mask = <0xffffffe0 0xffffffc0>;
      gpio-map-pass-thru = <0x1f 0x3f>;
      gpio-map = <
        0x00 0x0 &gpio0_31 0x0 0x0
        0x20 0x0 &gpio32_63 0x0 0x0
        0x40 0x0 &gpio64_95 0x0 0x0
        0x60 0x0 &gpio96_127 0x0 0x0
      >;
      reg = <0x40010000>;
      #gpio-cells = <2>;
      #address-cells = <1>;
      #size-cells = <0>;
      ranges;

      gpio0_31: gpio0_31@0 {
        compatible = "ambiq,gpio-bank";
        gpio-controller;
        #gpio-cells = <2>;
        reg = <0>;
        interrupts = <56 0>;
        status = "disabled";
      };

      gpio32_63: gpio32_63@80 {
        compatible = "ambiq,gpio-bank";
        gpio-controller;
        #gpio-cells = <2>;
        reg = <0x80>;
        interrupts = <57 0>;
        status = "disabled";
      };

      gpio64_95: gpio64_95@100 {
        compatible = "ambiq,gpio-bank";
        gpio-controller;
        #gpio-cells = <2>;
        reg = <0x100>;
        interrupts = <58 0>;
        status = "disabled";
      };

      gpio96_127: gpio96_127@180 {
        compatible = "ambiq,gpio-bank";
        gpio-controller;
        #gpio-cells = <2>;
        reg = <0x180>;
        interrupts = <59 0>;
        status = "disabled";
      };
    };

    In the above example, the gpio@40010000 is a "ambiq,gpio" parent node which
    provides the base register address 0x40010000. It has four "ambiq,gpio-bank"
    child nodes. Each of them covers 32 pins (the default value of "ngpios"
    property is 32). The "reg" property of child nodes defines the register
    address offset. The register address of pin described in gpio-cells can be
    obtained by: base address + child address offset + (pin << 2). For example:
    the address of pin 20 of gpio32_63@80 node is (0x40010000 + 0x80 + (20 << 2))
    = 0x400100D0 and the real GPIO pin number of this pin in soc is (20 + 32)
    = 52.

compatible: "ambiq,gpio"

include: [gpio-nexus.yaml, base.yaml]
```

## dts/bindings/gpio/ambiq-header.yaml
```yaml
# Copyright (c) 2023 Antmicro <www.antmicro.com>
# SPDX-License-Identifier: Apache-2.0

description: |
    GPIO pins exposed on Ambiq Apollo4p EVB headers

    The Ambiq Apollo4p EVB layout provides 5x16 and 1x20 pin headers.

    The binding provides a nexus mapping for these pins as depicted below.

            J7                              J12

    VDD_MCU - VDD_MCU -             GPIO22 22 GND     -
    VDD_EXT - VDD_EXT -             GPIO23 23 GPIO24 24
    nRST    - GND     -             VDD_MCU - GND     -
    VDD_EXT - VDD_EXT -             GND     - GPIO64 64
    VDD_5V  - VDD_5V  -             GPIO61 61 GPIO65 65
    GND     - GND     -             GPIO63 63 GPIO66 66
    GND     - GPIO100 100           GPIO62 62 GPIO67 67
    VDDH2   - GPIO97  97            GPIO47 47 GPIO68 68
                                    GPIO49 49 GPIO69 69
            J9                      GPIO48 48 GPIO70 70

    GPIO19 19 GPIO96  96                    J11
    GPIO18 18 GPIO95  95
    GPIO17 17 GPIO98  98            GPIO53 53 GPIO71 71
    GPIO16 16 GPIO99  99            GPIO52 52 GPIO72 72
    GPIO15 15 GPIO102 102           GPIO91 91 GPIO73 73
    GPIO14 14 GPIO34  34            GPIO90 90 GPIO93 93
    GPIO13 13 GPIO35  35            GPIO11 11 GPIO92 92
    GPIO12 12 GPIO36  36            GPIO10 10 GPIO33 33
                                    GPIO8  8  GPIO32 32
                                    GPIO9  9  GPIO31 31

                                            J10

                                    GPIO28 28 GPIO60 60
                                    GPIO30 30 GPIO59 59
                                    GPIO94 94 GPIO58 58
                                    GPIO55 55 GPIO7  7
                                    GPIO0  0  GPIO54 54
                                    GPIO51 51 GPIO1  1
                                    GPIO2  2  GPIO50 50
                                    GPIO3  3  GPIO4  4

                                      Voltage Header

                                    VDD_EXT - VDD_5V -
                                    GND     - GND    -
                                    BIAS    - BIAS   -
                                    GND     - AUDA   -
                                    GND     - GND    -
                                    D1P     - DON    -
                                    D1N     - DOP    -
                                    GND     - GND    -

compatible: "ambiq-header"

include: [gpio-nexus.yaml, base.yaml]
```

## dts/bindings/gpio/andestech,atcgpio100.yaml
```yaml
# Copyright (c) 2021, Andes Technology Corporation.
# SPDX-License-Identifier: Apache-2.0

description: Andes Technology ATCGPIO100 GPIO Controller.

compatible: "andestech,atcgpio100"

include: [gpio-controller.yaml, base.yaml]

properties:

  reg:
    required: true

  interrupts:
    required: true

  "#gpio-cells":
    const: 2

gpio-cells:
  - pin
  - flags
```

## dts/bindings/gpio/arducam,dvp-20pin-connector.yaml
```yaml
# Copyright 2025 tinyVision.ai Inc.
# SPDX-License-Identifier: Apache-2.0

title: ArduCam 20-pin header camera connector.

description: |
  GPIO pins exposed on an ArduCam 20-pin header for camera modules.
  Originally designed to connect Arducam modules to Arduino Giga R1,
  but further used by other vendors of camera modules and devkits.

  The connector layout is depicted below:

     1   3V3          2   GND
     3   SCL          4   SDA
     5   VS           6   HS
     7   PCLK         8   XCLK
     9   D7           10  D6
     11  D5           12  D4
     13  D3           14  D2
     15  D1           16  D0
     17  PEN          18  PDN
     19  GPIO0        20  GPIO1

  In some variants, the last row containing the pins 19 and 20 is
  not present, and the module is only providing 18 pins out of 20.

  The following node labels can be used in devicetree:

  - dvp_20pin_interface: the video interface that receives the video
    feed and use with the zephyr,camera chosen node.

  - dvp_20pin_i2c: the I2C device of the devkit on which the camera
    module is instantiated.

  - dvp_20pin_connector: the GPIO nexus using the arducam,dvp-20pin-connector
    that defines the camera pins ('reset' (PEN), 'power-down' (PDN)...)

  See <zephyr/dt-bindings/gpio/dvp-20pin-connector.h> for pin description.

compatible: "arducam,dvp-20pin-connector"

include: [gpio-nexus.yaml, base.yaml]
```

## dts/bindings/gpio/arducam,ffc-40pin-connector.yaml
```yaml
# Copyright (c) 2025 Renesas Electronics Corporation
# SPDX-License-Identifier: Apache-2.0

title: ArduCam FFC 40-pin camera connector.

description: |
  GPIO pins and high-speed differential pairs exposed on an ArduCam FFC 40-pin
  camera connector supporting either DVP or MIPI CSI-2 interfaces.

  The connector layout is depicted below:

    1   GND
    2   D11
    3   D10
    4   GND
    5   D9 / MIPI_CSI_DL1_P
    6   D8 / MIPI_CSI_DL1_P
    7   GND
    8   D7 / MIPI_CSI_CL_P
    9   D6 / MIPI_CSI_CL_P
    10  GND
    11  D5 / MIPI_CSI_DL0_P
    12  D4 / MIPI_CSI_DL0_P
    13  GND
    14  D3
    15  D2
    16  GND
    17  D1
    18  D0
    19  GND
    20  SCL
    21  SDA
    22  GND
    23  VSYNC
    24  HSYNC
    25  RESET
    26  XCLK
    27  PCLK
    28  INT
    29  GND
    30  GND
    31  3V3
    32  GND
    33  GND
    34  3V3
    35  3V3
    36  3V3
    37  GND
    38  GND
    39  3V3
    40  GND

  The following node labels can be used in devicetree:

  - arducam_ffc_40pin_interface: the video interface that receives the video
    feed and use with the zephyr,camera chosen node.

  - arducam_ffc_40pin_i2c: the I2C device for camera control.

  - arducam_ffc_40pin_connector: the GPIO nexus using the arducam,ffc-40pin-connector
    that defines the camera pins.

  See <zephyr/dt-bindings/gpio/arducam-ffc-40pin-connector.h> for pin description.

compatible: "arducam,ffc-40pin-connector"

include: [gpio-nexus.yaml, base.yaml]
```

## dts/bindings/gpio/arduino-header-r3.yaml
```yaml
# Copyright (c) 2019 Foundries.io
# Copyright (C) 2019 Peter Bigot Consulting, LLC
# SPDX-License-Identifier: Apache-2.0

description: |
    GPIO pins exposed on Arduino Uno (R3) headers.

    The Arduino Uno layout provides four headers, two each along
    opposite edges of the board.

    Proceeding counter-clockwise:
    * An 8-pin Power Supply header.  No pins on this header are exposed
      by this binding.
    * A 6-pin Analog Input header.  This has analog input signals
      labeled from A0 at the top through A5 at the bottom.
    * An 8-pin header (opposite Analog Input).  This has digital input
      signals labeled from D0 at the bottom D7 at the top;
    * A 10-pin header (opposite Power Supply).  This has six additional
      digital input signals labelled from D8 at the bottom through D13
      towards the top, skipping two pins, then finishing with SDA and
      SCL at the top.

    This binding provides a nexus mapping for 20 pins where parent pins 0
    through 5 map to A0 through A5, parent pins 6 through 19 map to D0
    through D13, and finally 20 and 21 map to SDA and SCL, as depicted
    below:

                                 SCL  21
                                 SDA  20
                                 AREF -
                                 GND  -
        - N/C                    D13  19
        - IOREF                  D12  18
        - RESET                  D11  17
        - 3V3                    D10  16
        - 5V                     D9   15
        - GND                    D8   14
        - GND
        - VIN                    D7   13
                                 D6   12
        0 A0                     D5   11
        1 A1                     D4   10
        2 A2                     D3    9
        3 A3                     D2    8
        4 A4                     D1    7
        5 A5                     D0    6

    Use ARDUINO_HEADER_R3_* constants in <zephyr/dt-bindings/gpio/arduino-header-r3.h> to refer to
    specific pins using convenient constant names. Note that SCL and SDA were also referred to as
    D14 and D15 in previous versions of this Zephyr binding, but this is now deprecated.


compatible: "arduino-header-r3"

include: [gpio-nexus.yaml, base.yaml]
```
