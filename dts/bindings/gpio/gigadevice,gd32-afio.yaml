## dts/bindings/gpio/gigadevice,gd32-afio.yaml
```yaml
description: GigaDevice GD32 family Alternate Functiona I/O

compatible: "gigadevice,gd32-afio"

include: base.yaml

properties:
  reg:
    required: true
```

## dts/bindings/gpio/gigadevice,gd32-gpio.yaml
```yaml
# Copyright (c) 2021 Tokita, Hiroshi <tokita.hiroshi@gmail.com>
# SPDX-License-Identifier: Apache-2.0

description: GD32 GPIO node

compatible: "gigadevice,gd32-gpio"

include: [gpio-controller.yaml, base.yaml]

properties:
    reg:
      required: true

    label:
      required: true

    clocks:
      required: true

    "#gpio-cells":
      const: 2

gpio-cells:
  - pin
  - flags
```

## dts/bindings/gpio/gpio-controller.yaml
```yaml
# Copyright (c) 2019, Linaro Limited
# SPDX-License-Identifier: Apache-2.0

# Common fields for GPIO controllers

properties:
  "gpio-controller":
    type: boolean
    required: true
    description: Convey's this node is a GPIO controller
  "#gpio-cells":
    type: int
    required: true
    description: Number of items to expect in a GPIO specifier
  ngpios:
    type: int
    default: 32
    description: |
        This property indicates the number of in-use slots of available slots
        for GPIOs. The typical example is something like this: the hardware
        register is 32 bits wide, but only 18 of the bits have a physical
        counterpart. The driver is generally written so that all 32 bits can
        be used, but the IP block is reused in a lot of designs, some using
        all 32 bits, some using 18 and some using 12. In this case, setting
        "ngpios = <18>;" informs the driver that only the first 18 GPIOs, at
        local offset 0 .. 17, are in use.  For cases in which there might be
        holes in the slot range, this value should be the max slot number-1.
  gpio-reserved-ranges:
    type: array
    description: |
        If not all the GPIOs at offsets 0...N-1 are usable for ngpios = <N>, then
        this property contains an additional set of tuples which specify which GPIOs
        are unusable. This property indicates the start and size of the GPIOs
        that can't be used.

        For example, setting "gpio-reserved-ranges = <3 2>, <10 1>;" means that
        GPIO offsets 3, 4, and 10 are not usable, even if ngpios = <18>.
  gpio-line-names:
    type: string-array
    description: |
        This is an array of strings defining the names of the GPIO lines
        going out of the GPIO controller

child-binding:
  description: |
    Optional GPIO hog configuration.

    Each GPIO controller may contain GPIO hog definitions. GPIO hogging is a mechanism for
    providing automatic GPIO configuration during driver initialization when Kconfig
    CONFIG_GPIO_HOGS is enabled.

    Each GPIO hog is represented as a child node of the GPIO controller.

    Example:
      &gpio1 {
        mux-hog {
          gpio-hog;
          gpios = <10 GPIO_ACTIVE_HIGH>, <11 GPIO_ACTIVE_HIGH>;
          output-high;
        };
      };

      &gpio2 {
        test-hog {
          gpio-hog;
          gpios = <26 GPIO_ACTIVE_HIGH>;
          output-low;
          line-name = "test";
      };
    };

  properties:
    gpio-hog:
      type: boolean
      required: true
      description: |
        Conveys this node is a GPIO hog.
    gpios:
      type: array
      required: true
      description: |
        This is an array of GPIO specifiers (e.g. pin, flags) to be hogged. The number of array
        entries must be an integer multiple of the number of GPIO specifier cells for the parent
        GPIO controller.
    input:
      type: boolean
      description: |
        If this property is set, the GPIO is configured as an input. This property takes
        precedence over the output-low and output-high properties.
    output-low:
      type: boolean
      description: |
        If this property is set, the GPIO is configured as an output set to logical low. This
        property takes precedence over the output-high property.
    output-high:
      type: boolean
      description: |
        If this property is set, the GPIO is configured as an output set to logical high.
    line-name:
      type: string
      description: |
        Optional GPIO line name.
```

## dts/bindings/gpio/gpio-generic.yaml
```yaml
title: GPIO GENERIC

description: >
    This is a representation of the GPIO GENERIC nodes

inherits:
    !include [base.yaml]

properties:
    compatible:
        constraint: "gpio-generic"

sub-node:
    properties:
        gpios:
            type: compound
            category: required
        label:
            type: string
            category: required
```

## dts/bindings/gpio/gpio-keys.yaml
```yaml
# Copyright (c) 2018, Linaro Limited
# SPDX-License-Identifier: Apache-2.0

description: GPIO KEYS parent node

compatible: "gpio-keys"

child-binding:
    description: GPIO KEYS child node
    properties:
       gpios:
          type: phandle-array
          required: true
       label:
          required: true
          type: string
          description: Human readable string describing the device (used as device_get_binding() argument)
```

## dts/bindings/gpio/gpio-lcd.yaml
```yaml
# Copyright (c) 2018, Linaro Limited
# SPDX-License-Identifier: Apache-2.0

description: GPIO LCD parent node

compatible: "gpio-lcd"

child-binding:
    description: GPIO LCD child node
    properties:
       gpios:
          type: phandle-array
          required: true
       label:
          required: true
          type: string
          description: Human readable string describing the device (used as device_get_binding() argument)
```

## dts/bindings/gpio/gpio-leds.yaml
```yaml
# Copyright (c) 2018, Linaro Limited
# SPDX-License-Identifier: Apache-2.0

description: |
  This allows you to define a group of LEDs. Each LED in the group is
  controlled by a GPIO. Each LED is defined in a child node of the
  gpio-leds node.

  Here is an example which defines three LEDs in the node /leds:

  / {
  	leds {
  		compatible = "gpio-leds";
  		led_0 {
  			gpios = <&gpio0 1 GPIO_ACTIVE_LOW>;
  		};
  		led_1 {
  			gpios = <&gpio0 2 GPIO_ACTIVE_HIGH>;
  		};
  		led_2 {
  			gpios = <&gpio1 15 (GPIO_PULL_UP | GPIO_ACTIVE_LOW)>;
  		};
  	};
  };

  Above:

  - led_0 is pin 1 on gpio0. The LED is on when the pin is low,
    and off when the pin is high.
  - led_1 is pin 2 on gpio0. The LED is on when the pin is high,
    and off when it is low.
  - led_2 is pin 15 on gpio1. The LED is on when the pin is low,
    and the pin's internal pull-up resistor should be enabled.

compatible: "gpio-leds"

child-binding:
    description: GPIO LED child node
    properties:
       gpios:
          type: phandle-array
          required: true
       label:
          required: false
          type: string
          description: |
            Human readable string describing the LED. It can be used by an
            application to identify this LED or to retrieve its number/index
            (i.e. child node number) on the parent device.
```

## dts/bindings/gpio/gpio-mmio-latch.yaml
```yaml
# Copyright (c) 2026 Zhaoming Li
# SPDX-License-Identifier: Apache-2.0

title: Memory-mapped latch GPIO controller

description: |
  GPIO controller backed by a memory-mapped output latch register.

  Each GPIO line corresponds to one bit in the latch register. Writing a bit
  drives the associated output and the value remains latched until another
  write updates it. The hardware is output-only and may not provide a readable
  register, so the driver keeps a software shadow of the last output value to
  implement GPIO masked writes, set, clear, toggle, and readback operations.

compatible: "gpio-mmio-latch"

include: [gpio-controller.yaml, base.yaml]

properties:
  reg:
    required: true

  ngpios:
    required: true
    description: |
      Number of usable GPIO lines exposed by this latch port.
      Must not exceed the register width in bits.

  initial-output:
    type: int
    default: 0
    description: |
      Initial shadow/output value written to the latch during driver init.
      The default writes 0 to the latch so all output bits start cleared.
      Override this property if the board requires a different latch output
      pattern during initialization.

  "#gpio-cells":
    const: 2

gpio-cells:
  - pin
  - flags

examples:
  - |
    gpio_latch0: gpio@40000000 {
        compatible = "gpio-mmio-latch";
        reg = <0x40000000 0x4>;
        gpio-controller;
        #gpio-cells = <2>;
        ngpios = <8>;
        initial-output = <0x5a>;
    };
```

## dts/bindings/gpio/gpio-nexus.yaml
```yaml
# Copyright (c) 2019, Linaro Limited
# SPDX-License-Identifier: Apache-2.0

# Common fields for GPIO nexus nodes
#
# see 2.5 Nexus Nodes and Specifier Mapping
# https://devicetree-specification.readthedocs.io/en/latest/chapter2-devicetree-basics.html#nexus-nodes-and-specifier-mapping
# in the Devicetree Specification

properties:
  gpio-map:
    type: compound
    required: true

  gpio-map-mask:
    type: array

  gpio-map-pass-thru:
    type: array

  "#gpio-cells":
    type: int
    required: true
    description: Number of items to expect in a GPIO specifier
```

## dts/bindings/gpio/gpio-out.yaml
```yaml
#
# Copyright (c) 2019, Prevas A/S
# All rights reserved.
#
# SPDX-License-Identifier: Apache-2.0
#
---
title: GPIO OUT
version: 0.1

description: >
    This is a representation of generic GPIO output nodes

properties:
    compatible:
      type: string
      category: required
      description: compatible strings
      constraint: "gpio-out"
      generation: define

    gpios:
      type: compound
      category: required
      generation: define

    label:
      type: string
      category: required
      description: Human readable string describing the device (used by Zephyr for API name)
      generation: define

...
```

## dts/bindings/gpio/grove-header.yaml
```yaml
# Copyright (c) 2023 Joel Guittet
# SPDX-License-Identifier: Apache-2.0

description: |
    GPIO pins exposing on Grove 4 pins headers.

    This binding provides a nexus mapping for 2 pins as depicted below.

        0  SCL/RXD/A/IN
        1  SDA/TXD/B/OUT
        -  VCC
        -  GND


compatible: "grove-header"

include: [gpio-nexus.yaml, base.yaml]
```

## dts/bindings/gpio/holtek,ht16k33-keyscan.yaml
```yaml
description: Holtek HT16K33 LED driver with keyscan

compatible: "holtek,ht16k33-keyscan"

include: base.yaml

on-bus: ht16k33

properties:
    reg:
      required: true
    label:
      required: true

gpio-cells:
  - pin
  - flags
```

## dts/bindings/gpio/infineon,airoc-gpio.yaml
```yaml
# Copyright (c) 2025, Atym, Inc.
# SPDX-License-Identifier: Apache-2.0

description: AIROC Wifi GPIO Port

compatible: "infineon,airoc-gpio"

include: [gpio-controller.yaml, base.yaml]

properties:
  "#gpio-cells":
    const: 1

gpio-cells:
  - pin
```

## dts/bindings/gpio/infineon,cat1-gpio.yaml
```yaml
# Copyright (c) 2020-2021 ATL Electronics
# Copyright (c) 2022 Cypress Semiconductor Corporation (an Infineon company) or
# an affiliate of Cypress Semiconductor Corporation
#
# SPDX-License-Identifier: Apache-2.0

description: Infineon CAT1 GPIO Port

compatible: "infineon,cat1-gpio"

include: [gpio-controller.yaml, base.yaml, "infineon,system-interrupts.yaml"]

properties:
  reg:
    required: true

  interrupts:
    description: Required for non-cat1c devices

  system-interrupts:
    description: Required for cat1c devices

  "#gpio-cells":
    const: 2

gpio-cells:
  - pin
  - flags
```

## dts/bindings/gpio/infineon,cyw43-gpio.yaml
```yaml
# Copyright (c) 2025 John Lin
# SPDX-License-Identifier: Apache-2.0

description: |
  Infineon CYW43 GPIO controller.

  Exposes the CYW43 WL_GPIO pins as a standard GPIO controller.
  This is a child node of the CYW43 WiFi device node.

compatible: "infineon,cyw43-gpio"

include: gpio-controller.yaml

properties:
  ngpios:
    required: true
    description: Number of WL_GPIO pins exposed.

gpio-cells:
  - pin
  - flags
```

## dts/bindings/gpio/infineon,gpio.yaml
```yaml
# Copyright (c) 2020-2021 ATL Electronics
# Copyright (c) 2022 Cypress Semiconductor Corporation (an Infineon company) or
# an affiliate of Cypress Semiconductor Corporation
#
# SPDX-License-Identifier: Apache-2.0

description: Infineon GPIO Port

compatible: "infineon,gpio"

include: [gpio-controller.yaml, base.yaml, "infineon,system-interrupts.yaml"]

properties:
  reg:
    required: true

  system-interrupts:
    description: Required for cat1c devices

  "#gpio-cells":
    const: 2

gpio-cells:
  - pin
  - flags
```

## dts/bindings/gpio/infineon,shared-gpio.yaml
```yaml
# Copyright (c) 2020-2021 ATL Electronics
# Copyright (c) 2022 Cypress Semiconductor Corporation (an Infineon company) or
# an affiliate of Cypress Semiconductor Corporation
#
# SPDX-License-Identifier: Apache-2.0

description: Infineon Shared GPIO Set

compatible: "infineon,shared-gpio"

include: base.yaml

properties:
  reg:
    required: true

  interrupts:
    required: true
```

## dts/bindings/gpio/infineon,tc4x-gpio.yaml
```yaml
# Copyright (c) 2024 Infineon Technologies AG
# SPDX-License-Identifier: Apache-2.0

description: Infineon TC4x Port Module

compatible: "infineon,tc4x-gpio"

include: [gpio-controller.yaml, base.yaml]

properties:
  reg:
    required: true

  irq-sources:
    type: array

  "#gpio-cells":
    const: 2

gpio-cells:
  - pin
  - flags
```

## dts/bindings/gpio/infineon,tle9104-gpio.yaml
```yaml
#
# Copyright (c) 2024 SILA Embedded Solutions GmbH
#
# SPDX-License-Identifier: Apache-2.0
#

description: Infineon TLE9104 4-channel powertrain switch GPIO instance

compatible: "infineon,tle9104-gpio"

include: gpio-controller.yaml

on-bus: tle9104

properties:
  "#gpio-cells":
    const: 2

  ngpios:
    type: int
    required: true
    const: 4
    description: Number of GPIOs supported

gpio-cells:
  - pin
  - flags
```

## dts/bindings/gpio/infineon,tle9104.yaml
```yaml
#
# Copyright (c) 2023 SILA Embedded Solutions GmbH
#
# SPDX-License-Identifier: Apache-2.0
#

description: Infineon TLE9104 4-channel powertrain switch

compatible: "infineon,tle9104"

include: [gpio-controller.yaml, spi-device.yaml]

properties:
  "#gpio-cells":
    const: 2

  ngpios:
    type: int
    required: true
    const: 4
    description: Number of GPIOs supported

  en-gpios:
    type: phandle-array
    description: "GPIO for enable"

  resn-gpios:
    type: phandle-array
    description: "GPIO for reset"

  in1-gpios:
    type: phandle-array
    description: "GPIO for controlling OUT1"

  in2-gpios:
    type: phandle-array
    description: "GPIO for controlling OUT2"

  in3-gpios:
    type: phandle-array
    description: "GPIO for controlling OUT3"

  in4-gpios:
    type: phandle-array
    description: "GPIO for controlling OUT4"

gpio-cells:
  - pin
  - flags
```

## dts/bindings/gpio/infineon,xmc4xxx-gpio.yaml
```yaml
description: INFINEON XMC4XXX GPIO Port

compatible: "infineon,xmc4xxx-gpio"

include: [gpio-controller.yaml, base.yaml]

properties:
  reg:
    required: true

  "#gpio-cells":
    const: 2

gpio-cells:
  - pin
  - flags
```

## dts/bindings/gpio/intel,apl-gpio.yaml
```yaml
# Copyright (c) 2018-2019 Intel Corporation
# SPDX-License-Identifier: Apache-2.0

description: Intel Apollo Lake GPIO node

compatible: "intel,apl-gpio"

include: [gpio-controller.yaml, base.yaml]

properties:
    reg:
      required: true

    label:
      required: true

    interrupts:
      required: true

    ngpios:
      required: true

    pin-offset:
      type: int
      required: true
      description: Pin offset of this GPIO entry

    "#gpio-cells":
      const: 2

gpio-cells:
  - pin
  - flags
```
