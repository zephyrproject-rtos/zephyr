## dts/bindings/gpio/intel,apollo-lake-gpio.yaml
```yaml
# Copyright (c) 2019 Peter Bigot Consulting, LLC
# SPDX-License-Identifier: Apache-2.0

description: |
    Apollo Lake GPIO Map

    Map from Apollo Lake GPIO to component GPIO driver instances.

    The Apollo Lake GPIO architecture provides four controllers each of
    which has more than 32 pins.  To be supported on Zephyr these pins
    must be mapped to sub-devices that have no more than 32 pins each.
    This compatible is used to map the full controller to its
    subdevices.

    The NORTH controller supports 78 pins.
    The NORTHWEST controller supports 77 pins.
    The WEST controller supports 47 pins.
    The SOUTHWEST controller supports 43 pins.

compatible: "intel,apollo-lake-gpio"

include: [gpio-nexus.yaml, base.yaml]
```

## dts/bindings/gpio/intel,gpio.yaml
```yaml
# Copyright (c) 2018-2019 Intel Corporation
# SPDX-License-Identifier: Apache-2.0

description: Intel GPIO

compatible: "intel,gpio"

include: [acpi.yaml, gpio-controller.yaml, base.yaml]

properties:
  reg:
    description: reg properties not required if acpi enumerated

  group-index:
    type: int
    description: Group number for this GPIO entry

  interrupts:
    description: interrupts properties not required if acpi enumerated

  ngpios:
    description: Number of pins for this GPIO entry

  pin-offset:
    type: int
    description: Pin offset of this GPIO entry

  int-en-offset:
    type: int
    description: |
      This parameter enables to add proper offset to access
      GPIO_INT_EN register from General Purpose Events status
      Register, as it is observed that the offset varies from
      platform to platform. GP_EVENT_STAT register is fetched
      from ACPI GPIO table.

  int-stat-offset:
    type: int
    description: |
      This parameter enables to add proper offset to access
      GPIO_INT_STAT register from General Purpose Events status
      Register, as it is observed that the offset varies from
      platform to platform. GP_EVENT_STAT register is fetched
      from ACPI GPIO table.

  acpi-ginf-3-param:
    type: boolean
    description: |
      This boolean will indicate the version of GINF method ACPI
      enabled for a given platform. If the value is true, GINF
      method which takes 3 parameters (u-id, bank-id and field-id)
      will be used else GINF method with 2 parameters (field-id
      and bank-id) will be used.

  "#gpio-cells":
    const: 2

gpio-cells:
  - pin
  - flags
```

## dts/bindings/gpio/intel,qmsi-gpio.yaml
```yaml
# Copyright (c) 2018 Intel Corporation
# SPDX-License-Identifier: Apache-2.0

title: Intel QMSI GPIO

description: >
    This is a representation of the Intel QMSI GPIO nodes

compatible: "intel,qmsi-gpio"

include: [gpio-controller.yaml, base.yaml]

properties:
    reg:
      required: true

    interrupts:
      required: true

    label:
      required: true

    "#gpio-cells":
      const: 2

"#cells":
  - pin
  - flags
```
