## dts/bindings/gpio/microchip,mcp23s08.yaml
```yaml
#
# Copyright (c) 2024 SILA Embedded Solutions GmbH
#
# SPDX-License-Identifier: Apache-2.0
#

description: Microchip MCP23S08 SPI GPIO Expander.

compatible: "microchip,mcp23s08"

include: ["microchip,mcp23xxx.yaml", spi-device.yaml]
```

## dts/bindings/gpio/microchip,mcp23s09.yaml
```yaml
#
# Copyright (c) 2024 SILA Embedded Solutions GmbH
#
# SPDX-License-Identifier: Apache-2.0
#

description: This is a representation of the Microchip MCP23S09 SPI GPIO Expander.

compatible: "microchip,mcp23s09"

include: ["microchip,mcp23xxx.yaml", spi-device.yaml]
```

## dts/bindings/gpio/microchip,mcp23s17.yaml
```yaml
#
# Copyright (c) 2024 SILA Embedded Solutions GmbH
#
# SPDX-License-Identifier: Apache-2.0
#

description: This is a representation of the Microchip MCP23S17 SPI GPIO Expander.

compatible: "microchip,mcp23s17"

include: ["microchip,mcp23xxx.yaml", spi-device.yaml]
```

## dts/bindings/gpio/microchip,mcp23x17-common.yaml
```yaml
#
# Copyright (c) 2018-2020 Prevas A/S
#
# SPDX-License-Identifier: Apache-2.0
#

properties:
    label:
      required: true

    "#gpio-cells":
      const: 2

    ngpios:
      type: int
      required: true
      const: 16
      description: Number of gpios supported

gpio-cells:
  - pin
  - flags
```

## dts/bindings/gpio/microchip,mcp23x17-i2c.yaml
```yaml
#
# Copyright (c) 2018-2020 Prevas A/S
#
# SPDX-License-Identifier: Apache-2.0
#

description: Microchip MCP23017 I2C Gpio Expander.

compatible: "microchip,mcp23x17"

include: [gpio-controller.yaml, i2c-device.yaml, "microchip,mcp23x17-common.yaml"]
```

## dts/bindings/gpio/microchip,mcp23x17-spi.yaml
```yaml
#
# Copyright (c) 2020 Geanix ApS
# Copyright (c) 2020 Prevas A/S
#
# SPDX-License-Identifier: Apache-2.0
#

description: Microchip MCP23017 SPI Gpio Expander.

compatible: "microchip,mcp23x17"

include: [gpio-controller.yaml, spi-device.yaml, "microchip,mcp23x17-common.yaml"]
```

## dts/bindings/gpio/microchip,mcp23x17.yaml
```yaml
#
# Copyright (c) 2020 Geanix ApS
# Copyright (c) 2020 Prevas A/S
#
# SPDX-License-Identifier: Apache-2.0
#

description: >
    This is a representation of the Microchip MCP23X17 Gpio Expander family.

compatible: "microchip,mcp23x17"

include: [gpio-controller.yaml, spi-device.yaml]

properties:
    label:
      required: true

    "#gpio-cells":
      const: 2

    ngpios:
      type: int
      required: true
      const: 16
      description: Number of gpios supported

gpio-cells:
  - pin
  - flags
```

## dts/bindings/gpio/microchip,mec5-gpio.yaml
```yaml
# Copyright (c) 2024, Microchip Technology Inc.
# SPDX-License-Identifier: Apache-2.0

description: Microchip MEC5 GPIO node

compatible: "microchip,mec5-gpio"

include: [gpio-controller.yaml, base.yaml]

properties:
  reg:
    required: true

  "#gpio-cells":
    const: 2

gpio-cells:
  - pin
  - flags
```

## dts/bindings/gpio/microchip,mpfs-gpio.yaml
```yaml
# Copyright (c) 2022 Microchip Technology Inc.
# SPDX-License-Identifier: Apache-2.0

description: Microchip PolarFire SoC GPIO node

compatible: "microchip,mpfs-gpio"

include: [gpio-controller.yaml, base.yaml]

properties:
  reg:
    required: true

  "#gpio-cells":
    const: 2

gpio-cells:
  - pin
  - flags
```

## dts/bindings/gpio/microchip,pic32cxsg-gpio.yaml
```yaml
description: Microchip PIC32CXSG GPIO PORT node

compatible: "microchip,pic32cxsg-gpio"

include: [gpio-controller.yaml, base.yaml]

properties:
  reg:
    required: true

  "#gpio-cells":
    const: 2

  "#atmel,pin-cells":
    type: int
    required: true
    const: 2
    description: Number of items to expect in a microchip(atmel),pins specifier

gpio-cells:
  - pin
  - flags

atmel,pin-cells:
  - pin
  - peripheral
```

## dts/bindings/gpio/microchip,port-g1-gpio.yaml
```yaml
# Copyright (c) 2025 Microchip Technology Inc.
# SPDX-License-Identifier: Apache-2.0

title: Microchip Port G1 GPIO

description: |
  GPIO controller for the Microchip Port Group 1 (G1)

  Group g1 PORT GPIO driver supports following hardware peripherals:
    - module name="PORT" id="U2210" version="2.2.0"
    - module name="PORT" id="U2210" version="3.1.0"

compatible: "microchip,port-g1-gpio"

include:
  - name: base.yaml
  - name: gpio-controller.yaml

properties:
  reg:
    required: true

  "#gpio-cells":
    const: 2

  "#microchip,pin-cells":
    type: int
    required: true
    const: 2
    description: |
      Number of items to expect in a microchip,pins specifier

gpio-cells:
  - pin
  - flags

microchip,pin-cells:
  - pin
  - peripheral
```

## dts/bindings/gpio/microchip,xec-gpio-v2.yaml
```yaml
# Copyright (c) 2019, Intel Corporation
# SPDX-License-Identifier: Apache-2.0

description: Microchip CEC/MEC GPIO V2 node

compatible: "microchip,xec-gpio-v2"

include: [gpio-controller.yaml, base.yaml]

properties:
    reg:
      required: true

    interrupts:
      required: false

    label:
      required: true

    port-id:
      type: int
      required: true
      description: Zero based GPIO port number

    girq-id:
      type: int
      required: true
      description: Aggregated GIRQ number for this bank of 32 GPIO pins.

    "#gpio-cells":
      const: 2

gpio-cells:
  - pin
  - flags
```

## dts/bindings/gpio/microchip,xec-gpio.yaml
```yaml
# Copyright (c) 2019, Intel Corporation
# Copyright (c) 2025, Microchip Technology Inc.
# SPDX-License-Identifier: Apache-2.0

description: Microchip CEC/MEC GPIO

compatible: "microchip,xec-gpio"

include: ["gpio-controller.yaml", "base.yaml", "microchip,dmec-ecia-girq.yaml"]

properties:
  reg:
    required: true

  interrupts:
    required: true

  "#gpio-cells":
    const: 2

gpio-cells:
  - pin
  - flags
```

## dts/bindings/gpio/mikro-bus.yaml
```yaml
# Copyright (C) 2020 Linaro
# SPDX-License-Identifier: Apache-2.0

description: |
    GPIO pins exposed on Mikro BUS headers.

    The Mikro BUS layout provides two headers, aligned on the opposite
    edges of the board.

    Documentation:
    * https://www.mikroe.com/mikrobus
    * https://download.mikroe.com/documents/standards/mikrobus/mikrobus-standard-specification-v200.pdf

    This binding provides a nexus mapping for 10 pins, left side pins are
    numbered 0 - 5 (AN - MOSI), the right side pins are numbered 6 - 10
    (PWM - SDA). The bottom 2 pins on each side are used for input voltage
    and ground, they are not mapped in the nexus.

                           Analog - AN     PWM - PWM output
                            Reset - RST    INT - Hardware Interrupt
                  SPI Chip Select - CS      RX - UART Receive
                        SPI Clock - SCK     TX - UART Transmit
    SPI Master Input Slave Output - MISO   SCL - I2C Clock
    SPI Master Output Slave Input - MOSI   SDA - I2C Data
                   VCC-3.3V power - +3.3V  +5V - VCC-5V power
                 Reference Ground - GND    GND - Reference Ground

    Board's silkscreen may vary depending you board, but coherent with
    the description above as it's according to the standard's specification.

compatible: "mikro-bus"

include: [gpio-nexus.yaml, base.yaml]
```

## dts/bindings/gpio/neorv32-gpio.yaml
```yaml
description: NEORV32 GPIO

compatible: "neorv32-gpio"

include: [gpio-controller.yaml, base.yaml]

properties:
    reg:
      required: true

    reg-names:
      required: true

    syscon:
      type: phandle
      required: true
      description: |
        phandle to syscon (NEORV32 SYSINFO) node.

    "#gpio-cells":
      const: 2

gpio-cells:
  - pin
  - flags
```

## dts/bindings/gpio/nordic,expansion-board-header.yaml
```yaml
# Copyright (c) 2025 Nordic Semiconductor ASA
# SPDX-License-Identifier: Apache-2.0

description: |
  Nordic Expansion Board header

  The header is 2x13 in odd/even order.

                   1  2
            VDDIO |x||x| GND
               00 |x||x| 01 - PWM
               02 |x||x| 03
               04 |x||x| 05
    SPI MOSI - 06 |x||x| 07 - SPI MISO
               08 |x||x| 09
      SPI CS - 10 |x||x| 11 - SPI SCK
               12 |x||x| 13
               14 |x||x| 15
              GND |x||x| VDDIO
     QSPI D3 - 16 |x||x| 17 - QSPI CLK
     QSPI D0 - 18 |x||x| 19 - QSPI D2
     QSPI D1 - 20 |x||x| 21 - QSPI CS

compatible: "nordic,expansion-board-header"

include:
  - base.yaml
  - gpio-nexus.yaml
```

## dts/bindings/gpio/nordic,npm10xx-gpio.yaml
```yaml
# Copyright (c) 2026 Nordic Semiconductor ASA
# SPDX-License-Identifier: Apache-2.0

description: nPM10 Series PMIC GPIO Controller

compatible: "nordic,npm10xx-gpio"

include: gpio-controller.yaml

gpio-cells:
  - pin
  - flags
```

## dts/bindings/gpio/nordic,npm1300-gpio.yaml
```yaml
# Copyright (c) 2023 Nordic Semiconductor ASA
# SPDX-License-Identifier: Apache-2.0

description: nPM1300 GPIO Controller

compatible: "nordic,npm1300-gpio"

include: gpio-controller.yaml

gpio-cells:
  - pin
  - flags
```

## dts/bindings/gpio/nordic,npm1304-gpio.yaml
```yaml
# Copyright (c) 2025 Nordic Semiconductor ASA
# SPDX-License-Identifier: Apache-2.0

description: nPM1304 GPIO Controller

compatible: "nordic,npm1304-gpio"

include: gpio-controller.yaml

gpio-cells:
  - pin
  - flags
```

## dts/bindings/gpio/nordic,npm2100-gpio.yaml
```yaml
# Copyright (c) 2024 Nordic Semiconductor ASA
# SPDX-License-Identifier: Apache-2.0

description: nPM2100 GPIO Controller

compatible: "nordic,npm2100-gpio"

include: gpio-controller.yaml

gpio-cells:
  - pin
  - flags
```

## dts/bindings/gpio/nordic,npm6001-gpio.yaml
```yaml
# Copyright (c) 2022 Nordic Semiconductor ASA
# SPDX-License-Identifier: Apache-2.0

description: nPM6001 GPIO Controller

compatible: "nordic,npm6001-gpio"

include: gpio-controller.yaml

gpio-cells:
  - pin
  - flags
```

## dts/bindings/gpio/nordic,nrf-gpio-forwarder.yaml
```yaml
# Copyright (c) 2020 Nordic Semiconductor ASA
# SPDX-License-Identifier: Apache-2.0

description: |
    This is an abstract device responsible for forwarding pins between cores.

    In nRF53 family of SoCs, GPIO pins must be explicitly forwarded by
    the application core to the network core if the latter should drive them.
    The purpose of this abstract device is to represent all GPIO pins that the
    nRF53 application core should forward to the nRF53 network core.

    Once the control over selected GPIO pins is forwarded to it, the network
    core is responsible for configuring the pins and driving them as needed.

    Here is an example of how a nrf-gpio-forwarder can be used with a nRF5340
    combined with a nRF21540 Front-End module. Consider the following node
    present in DTS file targeted for the nRF5340 network core, which defines
    the details of the nRF21540 Front-End module's interface:

    nrf_radio_fem: nrf21540 {
      compatible = "nordic,nrf21540-fem";
      tx-en-gpios = <&gpio0 30 GPIO_ACTIVE_HIGH>;
      rx-en-gpios = <&gpio1 11 GPIO_ACTIVE_HIGH>;
      pdn-gpios   = <&gpio1 10 GPIO_ACTIVE_HIGH>;
      mode-gpios  = <&gpio1 12 GPIO_ACTIVE_HIGH>;
    };

    Since the nRF21540 Front-End module should be controlled by the nRF5340
    network core, all the GPIO pins used to control it must be forwarded by
    the nRF5340 application core to the network core. Consider the following
    nrf-gpio-forwarder node defined in DTS file targeted for the nRF5340
    application core:

    gpio_fwd: nrf-gpio-forwarder {
      compatible = "nordic,nrf-gpio-forwarder";
      nrf21540-gpio-if {
        gpios = <&gpio0 30 0>, <&gpio1 11 0>, <&gpio1 10 0>, <&gpio1 12 0>;
      };
    };

    In the above example, the nrf-gpio-forwarder node is configured to forward
    control over the following GPIO pins to the network core:

      - P0.30 (matching `tx-en-gpios`)
      - P1.11 (matching `rx-en-gpios`)
      - P1.10 (matching `pdn-gpios`)
      - P1.12 (matching `mode-gpios`)

    Please note that the GPIO flags provided for child nodes of the forwarder
    are ignored. In order to configure the GPIOs passed to the forwarder, their
    GPIO flags must be set in the matching node that these GPIOs are forwarded
    to. In the above example, the GPIO flags must be set in the nrf21540 node.
    They are set to 0 in the nrf-gpio-forwarder node as they are ignored anyway.

    Child nodes for the forwarder can be defined independently by multiple DTS
    files. They are merged into a single node with multiple child nodes when
    processing devicetree for an application build. However, in order for that
    to happen, names of the child nodes must be unique in the scope of a single
    nrf-gpio-forwarder instance.

compatible: "nordic,nrf-gpio-forwarder"

include: "base.yaml"

child-binding:
  description: Arrays of GPIOs to be forwarded.

  properties:
    gpios:
      type: phandle-array
      required: true
      description: |
          Array of GPIOs to be forwarded. Note that GPIO flags provided for
          elements of this array are ignored. In order to configure the GPIOs
          from this array, their GPIO flags must be set in the matching
          node that these GPIOs are forwarded to.
```

## dts/bindings/gpio/nordic,nrf-gpio-pad-group.yaml
```yaml
# Copyright 2025 Nordic Semiconductor ASA
# SPDX-License-Identifier: Apache-2.0

description: |
  Nordic nRF GPIO pad group.

  The GPIO pad group describes the pads (package
  pins of the SoC) the GPIO controller manages.

  The pads may be in a different power domain than
  the GPIO controller, and may require enabling
  retention to preserve the GPIO configuration if
  the power domain is suspended.

  The GPIO pad group is a child node of the GPIO
  controller which manages the pad group, named
  pad-group. The pad group's nodelabel is named
  gpio_pad_group<GPIO number>.

  Example layout:

    gpio0: gpio@938000 {
            compatible = "nordic,nrf-gpio";

            ...

            gpio_pad_group0: pad-group {
                    compatible = "nordic,nrf-gpio-pad-group";
                    power-domains = <&gdpwr_slow_main>;
                    retain-mask = <0xFFF>;
            };
    };

compatible: "nordic,nrf-gpio-pad-group"

include: base.yaml

properties:
  retain-mask:
    type: int
    description: |
      Mask of pins which shall be retained if pad
      group's power domain is powered off.
```

## dts/bindings/gpio/nordic,nrf-gpio.yaml
```yaml
# Copyright (c) 2018, marc-cpdesign
# SPDX-License-Identifier: Apache-2.0

description: NRF5 GPIO node

compatible: "nordic,nrf-gpio"

include: [gpio-controller.yaml, base.yaml]

properties:
  reg:
    required: true

  "#gpio-cells":
    const: 2

  sense-edge-mask:
    type: int
    description: |
      Mask of pins that use the GPIO sense mechanism for edge detection.
      Pins not included in the mask use GPIOTE channels in the event mode.

  port:
    type: int
    required: true
    description: |
      The GPIO port number. GPIO port P0 has:

        port = <0>;

      And P1 has:

        port = <1>;

gpio-cells:
  - pin
  - flags
```

## dts/bindings/gpio/nordic,nrf-gpiote.yaml
```yaml
# Copyright (c) 2018, marc-cpdesign
# SPDX-License-Identifier: Apache-2.0

description: NRF5 GPIOTE

compatible: "nordic,nrf-gpiote"

include:
  - base.yaml
  - nordic,split-channels.yaml
  - pinctrl-device.yaml

properties:
  reg:
    required: true

  interrupts:
    required: true

  no-port-event:
    type: boolean
    description: |
      Indicates that the GPIOTE instance does not support PORT event.

  fixed-channels-supported:
    type: boolean
    description: |
      Indicates that the GPIOTE instance has fixed connection between pins and TE channels.
      It means that a specific TE channel must be used for a given pin.

  instance:
    type: int
    required: true
    description: |
      The GPIOTE instance number. GPIOTE instance GPIOTE0 has:

        instance = <0>;

      And GPIOTE1 has:

        instance = <1>;
```
