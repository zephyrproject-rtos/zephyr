## dts/bindings/gpio/renesas,rz-gpio-int.yaml
```yaml
# Copyright (c) 2024 Renesas Electronics Corporation
# SPDX-License-Identifier: Apache-2.0

description: Renesas RZ GPIO Interrupt

compatible: "renesas,rz-gpio-int"

include: base.yaml

properties:
  interrupts:
    required: true

  "#address-cells":
    const: 1

  "#size-cells":
    const: 0
```

## dts/bindings/gpio/renesas,rz-gpio.yaml
```yaml
# Copyright (c) 2024-2025 Renesas Electronics Corporation
# SPDX-License-Identifier: Apache-2.0

description: |
  Renesas RZ GPIO controller.

  The following example configures pull-up for pin 2 port 8 and maps it to GPIO interrupt TINT10
    gpio-consumer {
      out-gpio = <&gpio8 2 (GPIO_PULL_UP)>;
    };

    &gpio8 {
      irqs = <&tint10 2>;
      status = "okay";
    };

  Note that for RZ/T, RZ/N series ("gpio-common-v2" compatible), please replace "&tint10" with
  a "renesas,rz-ext-irq" node to map the pin to an external interrupt.
  For example, setting "irqs = <&irq10 2>" maps the pin to IRQ10.

compatible: "renesas,rz-gpio"

include:
- name: base.yaml
  property-allowlist:
  - status
  - reg
  - label
- name: gpio-controller.yaml

properties:
  reg:
    required: true
    description: GPIO port number

  irqs:
    type: phandle-array
    description: Interrupts corresponding to pins

  "#gpio-cells":
    const: 2

gpio-cells:
- pin
- flags
```

## dts/bindings/gpio/renesas,rz-mipi-header.yaml
```yaml
# Copyright (c) 2025 Renesas Electronics Corporation
# SPDX-License-Identifier: Apache-2.0

description: |
  GPIO pins exposed on Renesas MIPI lcd display headers.

  The Renesas MIPI lcd display layout provides 2 columns of 20 pins headers

  This binding provides a mapping for the default 40 pins as depicted below:

      1  GND                 DIMMER    21
      2  GND                 I2C SCL   22
      3  DATA0_P             TP_INT    23
      4  DATA1_P             TP_RESET  24
      5  DATA0_N             GND       25
      6  DATA1_N             GND       26
      7  GND                 NC        27
      8  GND                 NC        28
      9  DATA2_P             NC        29
      10 DATA3_P             NC        30
      11 DATA2_N             NC        31
      12 DATA3_N             NC        32
      13 GND                 GND       33
      14 GND                 GND       34
      15 CLK_P               1.8V      35
      16 NC                  1.8V      36
      17 CLK_N               3.3V      37
      18 GND                 3.3V      38
      19 GND                 5V        39
      20 I2C SDA             5V        40

compatible: "renesas,rz-gpio-mipi-header"

include: [gpio-nexus.yaml, base.yaml]
```

## dts/bindings/gpio/renesas,rza2m-gpio-int.yaml
```yaml
description: Renesas RZ/A2M GPIO Interrupt

compatible: "renesas,rza2m-gpio-int"

include: base.yaml

properties:

  "#address-cells":
    const: 1

  "#size-cells":
    const: 0
```

## dts/bindings/gpio/renesas,rza2m-gpio.yaml
```yaml
description: Renesas RZ/A2M GPIO Controller

compatible: "renesas,rza2m-gpio"

include: [gpio-controller.yaml, base.yaml]

properties:
  reg:
    required: true
    description: |
      GPIO port number. RZ/A2M board has a number of ports that
      are used to calculate correct pin number.

  "#gpio-cells":
    const: 2

gpio-cells:
  - pin
  - flags
```

## dts/bindings/gpio/renesas,rzt2m-gpio-common.yaml
```yaml
# Copyright (c) 2024 Antmicro <www.antmicro.com>
# SPDX-License-Identifier: Apache-2.0
description: Renesas RZT2M GPIO common

compatible: "renesas,rzt2m-gpio-common"

include: base.yaml

properties:
  interrupts:
    required: true
```

## dts/bindings/gpio/renesas,rzt2m-gpio.yaml
```yaml
# Copyright (c) 2023 Antmicro <www.antmicro.com>
# SPDX-License-Identifier: Apache-2.0
description: Renesas RZT2M GPIO

compatible: "renesas,rzt2m-gpio"

include: [gpio-controller.yaml, base.yaml]

properties:
  reg:
    required: true

  "#gpio-cells":
    const: 2

gpio-cells:
  - pin
  - flags
```

## dts/bindings/gpio/renesas,smartbond-gpio.yaml
```yaml
# Copyright (c) 2022 Renesas Electronics Corporation
# SPDX-License-Identifier: Apache-2.0

description: Renesas SmartBond(tm) GPIO node

compatible: "renesas,smartbond-gpio"

include: [gpio-controller.yaml, base.yaml]

properties:
  reg:
    required: true

  "#gpio-cells":
    const: 2

gpio-cells:
  - pin
  - flags
```

## dts/bindings/gpio/richtek,rt1718s-gpio-port.yaml
```yaml
# Copyright 2022 Google LLC
# SPDX-License-Identifier: Apache-2.0

description: |
    Richtek RT1718S TCPC chip GPIO port

    "richtek,rt1718s-gpio-port" node handles GPIO feature of the RT1718S TCPC
    chip.

    Example:
      &i2c2_0 {
          rt1718s_port0: rt1718s@40 {
              compatible = "richtek,rt1718s";
              reg = <0x40>;

              rt1718s_gpio_port0: rt1718s_gpio {
                  compatible = "richtek,rt1718s-gpio-port";

                  gpio-controller;
                  #gpio-cells = <2>;
                  ngpios = <3>;
              };
          };
      };

include: [gpio-controller.yaml, base.yaml]

compatible: "richtek,rt1718s-gpio-port"
```

## dts/bindings/gpio/richtek,rt1718s.yaml
```yaml
# Copyright 2022 Google LLC
# SPDX-License-Identifier: Apache-2.0

description: |
    Richtek RT1718S TCPC chip

    The Richtek RT1718S chip is TCPC, but also has 3 pins, which can be used as
    a usual GPIO. This node collects common properties for RT1718S chip e.g. I2C
    address. Feature-specific(GPIO, TCPC) properties should be placed in a child
    node e.g. a number of GPIOs.

    Example:
      &i2c2_0 {
          rt1718s_port0: rt1718s@40 {
              compatible = "richtek,rt1718s";
              reg = <0x40>;
              irq-gpios = <&gpioe 1 (GPIO_PULL_UP | GPIO_ACTIVE_LOW)>;

              rt1718s_gpio_port0: rt1718s_gpio {
                  compatible = "richtek,rt1718s-gpio-port";

                  gpio-controller;
                  #gpio-cells = <2>;
                  ngpios = <3>;
              };
          };
      };

compatible: "richtek,rt1718s"

include: [i2c-device.yaml]

properties:
  irq-gpios:
    type: phandle-array
    description: Interrupt GPIO pin connected from the chip(IRQB)
```

## dts/bindings/gpio/rohm,bd8lb600fs-gpio.yaml
```yaml
#
# Copyright (c) 2022 SILA Embedded Solutions GmbH
# Copyright (c) 2024 SILA Embedded Solutions GmbH
#
# SPDX-License-Identifier: Apache-2.0
#

description: |
    Rohm BD8LB600FS SPI GPIO Expander.
    Multiple instances may be daisy chained, which can be configured
    via the number of supported GPIOs.

compatible: "rohm,bd8lb600fs-gpio"

include: gpio-controller.yaml

on-bus: bd8lb600fs

properties:
  "#gpio-cells":
    const: 2

  ngpios:
    type: int
    required: true
    enum:
      - 8
      - 16
      - 24
      - 32
    description: |
      Number of pins for the expander. This must be a multiple of 8.
      The number of pins also defines how many devices are daisy chained.
      Set to 8 for one instance without daisy chaining.

gpio-cells:
  - pin
  - flags
```

## dts/bindings/gpio/rohm,bd8lb600fs.yaml
```yaml
#
# Copyright (c) 2022 SILA Embedded Solutions GmbH
#
# SPDX-License-Identifier: Apache-2.0
#

description: |
    This is a representation of the Rohm BD8LB600FS SPI Gpio Expander.
    Multiple instances may be daisy chained, which can be configured
    via the number of supported GPIOs.

compatible: "rohm,bd8lb600fs"

include: [gpio-controller.yaml, spi-device.yaml]

properties:
  "#gpio-cells":
    const: 2

  ngpios:
    type: int
    required: true
    description: |
      Number of pins for the expander. This must be a multiple of 8.
      The number of pins also defines how many devices are daisy chained.
      Set to 8 for one instance without daisy chaining.

  reset-gpios:
    type: phandle-array
    required: true
    description: GPIO for reset

gpio-cells:
  - pin
  - flags
```

## dts/bindings/gpio/seeed,xiao-expand.yaml
```yaml
# SPDX-FileCopyrightText: Copyright (c) 2026 Navimatix GmbH
# SPDX-FileCopyrightText: Copyright (c) 2026 TiaC Systems
# SPDX-License-Identifier: Apache-2.0

description: |
    GPIO pins exposed on Seeeduino Xiao (and compatible devices) pads.

    Some Seeeeduino Xiao layout providing pads for connecting with pogo
    spring contact pins, along opposite rows on the bottom of the board.

    Proceeding counter-clockwise:
    * A 4-pin pad row of Digital/Analog Input signals.  This has signals
      labeled from 11 at the top through 14 at the bottom.
    * A 4-pin pad row of Digital/Analog Input signals.  This has signals
      labeled 18 at the top through 15 at the bottom.

    This binding provides a nexus mapping for 8 pins where parent pins 0
    through 7 correspond to D11 through D18, as depicted below:

        0 D11 (A11/RX1)    (CS1n/A18) D18 7
        1 D12 (A12/TX1)    (SCK1/A17) D17 6
        2 D13 (A13/SCL1)  (MISO1/A16) D16 5
        3 D14 (A14/SDA1)  (MOSI1/A15) D15 4

    https://github.com/Seeed-Studio/OSHW-XIAO-Series


compatible: "seeed,xiao-expand"

include: [gpio-nexus.yaml, base.yaml]
```

## dts/bindings/gpio/seeed,xiao-gpio.yaml
```yaml
# Copyright (c) 2019 Foundries.io
# Copyright (C) 2019 Peter Bigot Consulting, LLC
# Copyright (C) 2021 Peter Johanson
# SPDX-License-Identifier: Apache-2.0

description: |
    GPIO pins exposed on Seeeduino Xiao (and compatible devices) headers.

    The Seeeeduino Xiao layout provides two headers, along opposite
    edges of the board.

    Proceeding counter-clockwise:
    * A 7-pin Digital/Analog Input header.  This has input signals
      labeled from 0 at the top through 6 at the bottom.
    * A 7-pin header Power and Digital/Analog Input header.  This
      has three power pins, followed by four inputs labeled 10 at the
      top through 7 at the bottom.

    This binding provides a nexus mapping for 11 pins where parent pins 0
    through 10 correspond to D0 through D10, as depicted below:

        0 D0 (A0/DAC)                5V   -
        1 D1 (A1)                    GND  -
        2 D2 (A2)                    3V3  -
        3 D3 (A3/CS0n)   (MOSI0/A10) D10 10
        4 D4 (A4/SDA0)    (MISO0/A9) D9   9
        5 D5 (A5/SCL0)     (SCK0/A8) D8   8
        6 D6 (A6/TX0)  (RX0/CS0n/A7) D7   7

    https://github.com/Seeed-Studio/OSHW-XIAO-Series


compatible: "seeed,xiao-gpio"

include: [gpio-nexus.yaml, base.yaml]
```

## dts/bindings/gpio/seeed-xiao-header.yaml
```yaml
# Copyright (c) 2019 Foundries.io
# Copyright (C) 2019 Peter Bigot Consulting, LLC
# Copyright (C) 2021 Peter Johanson
# SPDX-License-Identifier: Apache-2.0

description: |
    GPIO pins exposed on Seeeduino Xiao (and compatible devices) headers.

    The Seeeeduino Xiao layout provides two headers, along opposite
    edges of the board.

    Proceeding counter-clockwise:
    * A 7-pin Digital/Analog Input header.  This has input signals
      labeled from 0 at the top through 6 at the bottom.
    * An 7-pin header Power and Digital/Analog Input header.  This
      has three power pins, followed by four inputs labeled 10 at the
      top through 7 at the bottom.

    This binding provides a nexus mapping for 10 pins where parent pins 0
    through 10 correspond to D0 through D10, as depicted below:

        0 D0                     5V   -
        1 D1                     GND  -
        2 D2                     3V3  -
        3 D3                     D10 10
        4 A4                     D9   9
        5 D5                     D8   8
        6 D6                     D7   7


compatible: "seeed,xiao-gpio"

include: [gpio-nexus.yaml, base.yaml]
```

## dts/bindings/gpio/semtech,sx1509b-gpio.yaml
```yaml
# Copyright (c) 2018, Aapo Vienamo
# SPDX-License-Identifier: Apache-2.0

description: SX1509B GPIO node

compatible: "semtech,sx1509b"

include: [i2c-device.yaml, gpio-controller.yaml]

properties:
    label:
      required: true

    "#gpio-cells":
      const: 2

    ngpios:
      required: true
      const: 16

    nint-gpios:
      type: phandle-array
      required: false
      description: |
        Connection for the NINT signal. This signal is active-low when
        produced by sx1509b GPIO node.

    init-out-low:
      type: int
      required: false
      default: 0
      description: |
        Bit mask identifying pins that should be initialized as outputs
        driven low.

    init-out-high:
      type: int
      required: false
      default: 0
      description: |
        Bit mask identifying pins that should be initialized as outputs
        driven high.

gpio-cells:
  - pin
  - flags
```

## dts/bindings/gpio/semtech,sx1509b.yaml
```yaml
# Copyright (c) 2018, Aapo Vienamo
# SPDX-License-Identifier: Apache-2.0

description: SX1509B GPIO

compatible: "semtech,sx1509b"

include: [i2c-device.yaml, gpio-controller.yaml]

properties:
  "#gpio-cells":
    const: 2

  ngpios:
    required: true
    const: 16

  nint-gpios:
    type: phandle-array
    description: |
      Connection for the NINT signal. This signal is active-low when
      produced by sx1509b GPIO node.

  init-out-low:
    type: int
    default: 0
    description: |
      Bit mask identifying pins that should be initialized as outputs
      driven low.

  init-out-high:
    type: int
    default: 0
    description: |
      Bit mask identifying pins that should be initialized as outputs
      driven high.

gpio-cells:
  - pin
  - flags
```

## dts/bindings/gpio/sensry,sy1xx-gpio.yaml
```yaml
# Copyright (c) 2024 sensry.io
# SPDX-License-Identifier: Apache-2.0

description: Sensry SY1XX GPIO Port

compatible: "sensry,sy1xx-gpio"

include: [gpio-controller.yaml, base.yaml]

properties:
  reg:
    required: true
    description: Base address for the gpio configuration.

  "#gpio-cells":
    const: 2

  pad-cfg:
    type: int
    required: true
    description: Offset for gpio pad ctrl registers.

gpio-cells:
  - pin
  - flags
```

## dts/bindings/gpio/shakthi,gpio0.yaml
```yaml
# Copyright (c) 2018, SiFive Inc.
# SPDX-License-Identifier: Apache-2.0

description: SHAKTI GPIO node

compatible: "shakti,GPIO"

include: [gpio-controller.yaml, base.yaml]

properties:
  reg:
    required: true

  interrupts:
    required: false

  "#gpio-cells":
    const: 2

gpio-cells:
  - pin
  - flags
```

## dts/bindings/gpio/shakti,gpio.yaml
```yaml
# Copyright (c) 2026 RISE Lab, IIT Madras
# SPDX-License-Identifier: Apache-2.0

description: Shakti GPIO

compatible: "shakti,gpio"

include: [gpio-controller.yaml, base.yaml]

properties:
  reg:
    required: true

gpio-cells:
  - pin
  - flags
```

## dts/bindings/gpio/sifive,gpio0.yaml
```yaml
# Copyright (c) 2018, SiFive Inc.
# SPDX-License-Identifier: Apache-2.0

description: SiFive GPIO node

compatible: "sifive,gpio0"

include: [gpio-controller.yaml, base.yaml]

properties:
  reg:
    required: true

  interrupts:
    required: true

  "#gpio-cells":
    const: 2

gpio-cells:
  - pin
  - flags
```

## dts/bindings/gpio/sifli,sf32lb-gpio-parent.yaml
```yaml
# Copyright (c) 2025 Core Devices LLC
# SPDX-License-Identifier: Apache-2.0

description: SF32LB GPIO (parent)

compatible: "sifli,sf32lb-gpio-parent"

include: base.yaml

properties:
  reg:
    required: true

  ranges:
    type: array
    required: true

  "#address-cells":
    const: 1

  "#size-cells":
    const: 1

  clocks:
    required: true

  interrupts:
    required: true
```

## dts/bindings/gpio/sifli,sf32lb-gpio.yaml
```yaml
# Copyright (c) 2025 Core Devices LLC
# SPDX-License-Identifier: Apache-2.0

description: SF32LB GPIO

compatible: "sifli,sf32lb-gpio"

include: [gpio-controller.yaml, base.yaml]

properties:
  reg:
    required: true

  ngpios:
    required: true

  "#gpio-cells":
    const: 2

  sifli,pinmuxs:
    type: phandle-array
    required: true

gpio-cells:
  - pin
  - flags
```
