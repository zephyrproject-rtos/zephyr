## dts/bindings/gpio/silabs,efm32-gpio-port.yaml
```yaml
title: EFM32 GPIO

description: |
    This is a representation of the EFM32 GPIO Port nodes

compatible: "silabs,efm32-gpio-port"

include: [gpio-controller.yaml, base.yaml]

properties:
    reg:
      required: true

    label:
      required: true

    "#gpio-cells":
      const: 2

gpio-cells:
  - pin
  - flags
```

## dts/bindings/gpio/silabs,efm32-gpio.yaml
```yaml
description: EFM32 GPIO node

compatible: "silabs,efm32-gpio"

include: base.yaml

properties:
    reg:
      required: true

    interrupts:
      required: true

    label:
      required: true

    location-swo:
      type: int
      required: false
      description: Serial Wire Output (SWO) PIN location
```
