## dts/bindings/gpio/renesas,ra-gpio.yaml
```yaml
# Copyright (c) 2023 TOKITA Hiroshi <tokita.hiroshi@fujitsu.com>
# SPDX-License-Identifier: Apache-2.0

description: Renesas RA series GPIO

compatible: "renesas,ra-gpio"

include: [gpio-controller.yaml, base.yaml]

properties:
  reg:
    required: true

  port-irq0-pins:
    type: array
    description: Pins allow to assign port-irq0

  port-irq1-pins:
    type: array
    description: Pins allow to assign port-irq1

  port-irq2-pins:
    type: array
    description: Pins allow to assign port-irq2

  port-irq3-pins:
    type: array
    description: Pins allow to assign port-irq3

  port-irq4-pins:
    type: array
    description: Pins allow to assign port-irq4

  port-irq5-pins:
    type: array
    description: Pins allow to assign port-irq5

  port-irq6-pins:
    type: array
    description: Pins allow to assign port-irq6

  port-irq7-pins:
    type: array
    description: Pins allow to assign port-irq7

  port-irq8-pins:
    type: array
    description: Pins allow to assign port-irq8

  port-irq9-pins:
    type: array
    description: Pins allow to assign port-irq9

  port-irq10-pins:
    type: array
    description: Pins allow to assign port-irq10

  port-irq11-pins:
    type: array
    description: Pins allow to assign port-irq11

  port-irq12-pins:
    type: array
    description: Pins allow to assign port-irq12

  port-irq13-pins:
    type: array
    description: Pins allow to assign port-irq13

  port-irq14-pins:
    type: array
    description: Pins allow to assign port-irq14

  port-irq15-pins:
    type: array
    description: Pins allow to assign port-irq15

  "#gpio-cells":
    const: 2

gpio-cells:
  - pin
  - flags
```

## dts/bindings/gpio/renesas,ra-parallel-graphics-header.yaml
```yaml
# Copyright (c) 2025 Renesas Electronics Corporation
# SPDX-License-Identifier: Apache-2.0

description: |
  GPIO pins exposed on Renesas Parallel Graphics Expansion Header.

  This binding provides a nexus mapping for 40 pins Paralel Graphics LCD header, using
  <board>_PARALLEL_GRAPHICS_HEADER_<pin> macros, defined at:
  - include/zephyr/dt-bindings/gpio/renesas-ek-ra6m3g-header.h
  - include/zephyr/dt-bindings/gpio/renesas-ek-ra8d1-header.h

compatible: "renesas,ra-parallel-graphics-header"

include: [gpio-nexus.yaml, base.yaml]
```

## dts/bindings/gpio/renesas,ra2-gpio.yaml
```yaml
# Copyright (c) 2023-2024 MUNIC SA
# SPDX-License-Identifier: Apache-2.0

description: RA2 GPIO PORT node

compatible: "renesas,ra2-gpio"

include: [gpio-controller.yaml, base.yaml]

properties:
  reg:
    required: true

  renesas,ra2-pfs:
    type: phandle
    required: true
    description: Reference to RA2 pinmux node

gpio-cells:
  - pin
  - flags
```

## dts/bindings/gpio/renesas,ra8-gpio.yaml
```yaml
# Copyright (c) 2024 Renesas Electronics Corporation
# SPDX-License-Identifier: Apache-2.0

description: Renesas RA8 GPIO

compatible: "renesas,ra8-gpio"

include: [gpio-controller.yaml, base.yaml]

properties:
  reg:
    required: true

  port:
    type: int
    required: true

  vbatts_pins:
    type: array
    description: Array of vbatt pin on port

  "#gpio-cells":
    const: 2

gpio-cells:
  - pin
  - flags
```

## dts/bindings/gpio/renesas,rcar-gpio.yaml
```yaml
#
# Copyright (c) 2020 IoT.bzh
#
# SPDX-License-Identifier: Apache-2.0
#

description: Renesas RCAR GPIO

compatible: "renesas,rcar-gpio"

include: [gpio-controller.yaml, base.yaml]

properties:
    reg:
      required: true

    label:
      required: true

    interrupts:
      required: true

    "#gpio-cells":
      const: 2

gpio-cells:
  - pin
  - flags
```

## dts/bindings/gpio/renesas,rx-gpio.yaml
```yaml
# Copyright (c) 2024 Renesas Electronics Corporation
# SPDX-License-Identifier: Apache-2.0

description: Renesas RX series GPIO

compatible: "renesas,rx-gpio"

include: [gpio-controller.yaml, base.yaml]

properties:
  reg:
    required: true

  port:
    type: int
    required: true

  "#gpio-cells":
    const: 2

  pinmux:
    required: true
    type: phandle
    description: |
      A phandle reference to the device tree node that contains the pinmux
      port associated with this GPIO controller.

  port-irqs:
    type: phandle-array
    description: Port irq which this port can be use

  port-irq-names:
    type: string-array
    description: The name of port irq

  port-irq0-pins:
    type: array
    description: Pins allow to assign port-irq0

  port-irq1-pins:
    type: array
    description: Pins allow to assign port-irq1

  port-irq2-pins:
    type: array
    description: Pins allow to assign port-irq2

  port-irq3-pins:
    type: array
    description: Pins allow to assign port-irq3

  port-irq4-pins:
    type: array
    description: Pins allow to assign port-irq4

  port-irq5-pins:
    type: array
    description: Pins allow to assign port-irq5

  port-irq6-pins:
    type: array
    description: Pins allow to assign port-irq6

  port-irq7-pins:
    type: array
    description: Pins allow to assign port-irq7

gpio-cells:
  - pin
  - flags
```

## dts/bindings/gpio/renesas,rz-gpio-common-v2.yaml
```yaml
# Copyright (c) 2025 Renesas Electronics Corporation
# SPDX-License-Identifier: Apache-2.0

description: Renesas RZ GPIO common V2

compatible: "renesas,rz-gpio-common-v2"

include: base.yaml
```

## dts/bindings/gpio/renesas,rz-gpio-common-v3.yaml
```yaml
# Copyright (c) 2026 Renesas Electronics Corporation
# SPDX-License-Identifier: Apache-2.0

description: Renesas RZ GPIO common v3

compatible: "renesas,rz-gpio-common-v3"

include: base.yaml
```

## dts/bindings/gpio/renesas,rz-gpio-common.yaml
```yaml
# Copyright (c) 2025 Renesas Electronics Corporation
# SPDX-License-Identifier: Apache-2.0

description: Renesas RZ GPIO common

compatible: "renesas,rz-gpio-common"

include: base.yaml
```
