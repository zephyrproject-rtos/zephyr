## dts/bindings/gpio/raspberrypi,bcm283x-gpio.yaml
```yaml
# Copyright (c) 2026 Muhammad Waleed Badar
# SPDX-License-Identifier: Apache-2.0

description: Raspberry Pi BCM283x GPIO Expander

compatible: "raspberrypi,bcm283x-gpio"

include: [gpio-controller.yaml, base.yaml]

properties:
  ngpios:
    required: true
    const: 8

  "#gpio-cells":
    const: 2

gpio-cells:
  - pin
  - flags
```

## dts/bindings/gpio/raspberrypi,csi-15pins-connector.yaml
```yaml
# Copyright 2025 tinyVision.ai Inc.
# SPDX-License-Identifier: Apache-2.0

description: |
  GPIO pins exposed on the Raspberry Pi CSI 15pins Camera connector
  Connector layout:

    1   GND
    2   CSI_D0_N
    3   CSI_D0_P
    4   GND
    5   CSI_D1_N
    6   CSI_D1_P
    7   GND
    8   CSI_CK_N
    9   CSI_CK_P
    10  GND
    11  IO0
    12  IO1
    13  I2C_SCL
    14  I2C_SDA
    15  VCC (3v3)

compatible: "raspberrypi,csi-15pins-connector"

include: [gpio-nexus.yaml, base.yaml]
```

## dts/bindings/gpio/raspberrypi,csi-22pins-connector.yaml
```yaml
# Copyright 2025 STMicroelectronics
# SPDX-License-Identifier: Apache-2.0

description: |
  GPIO pins exposed on the Raspberry Pi CSI 22pins Camera connector
  Connector layout:

    1	GND
    2	CSI_D0_N
    3	CSI_D0_P
    4	GND
    5	CSI_D1_N
    6	CSI_D1_P
    7	GND
    8	CSI_CK_N
    9	CSI_CK_P
    10	GND
    11	CSI_D2_N
    12	CSI_D2_P
    13	GND
    14	CSI_D3_N
    15	CSI_D3_P
    16	GND
    17	IO0
    18	IO1
    19	GND
    20	I2C_SCL
    21	I2C_SDA
    22	VCC (3v3)

compatible: "raspberrypi,csi-22pins-connector"

include: [gpio-nexus.yaml, base.yaml]
```

## dts/bindings/gpio/raspberrypi,csi-connector.yaml
```yaml
# Copyright 2025 STMicroelectronics
# SPDX-License-Identifier: Apache-2.0

title: GPIO pins exposed on the Raspberry Pi CSI Camera connector

description: |
  There are 2 variants of the Raspberry Pi CSI camera connector. Either 15-pin
  or 22-pin. Here only GPIO provided by those connectors are abstracted since
  others pins are directly connected to CSI PHY.
  For reference, pinout of 15-pin and 22-pin connectors are references below.
  In this gpio nexus, only GPIOs are represented and should be described in
  the following way, allowing to have a single compatible for both 15-pin
  and 22-pin connectors and also allowing to deal with 15-pin to 22-pin
  conversion cables.

  Nexus mapping:
    1   IO0      pin 11 (15-pin based) / pin 17 (22-pin based)
    2   IO1      pin 12 (15-pin based) / pin 18 (22-pin based)
    3   I2C_SCL  pin 13 (15-pin based) / pin 20 (22-pin based)
    4   I2C_SDA  pin 14 (15-pin based) / pin 21 (22-pin based)

  Use CSI_* constants in <zephyr/dt-bindings/gpio/raspberrypi-csi-connector.h>
  to refer to specific pins using convenient constant names.

  For reference only, Raspberry 15-pin Connector layout:
    1   GND
    2   CSI_D0_N
    3   CSI_D0_P
    4   GND
    5   CSI_D1_N
    6   CSI_D1_P
    7   GND
    8   CSI_CK_N
    9   CSI_CK_P
    10  GND
    11  IO0
    12  IO1
    13  I2C_SCL
    14  I2C_SDA
    15  VCC (3v3)

  For reference only, Raspberry 22-pin Connector layout:

    1	GND
    2	CSI_D0_N
    3	CSI_D0_P
    4	GND
    5	CSI_D1_N
    6	CSI_D1_P
    7	GND
    8	CSI_CK_N
    9	CSI_CK_P
    10	GND
    11	CSI_D2_N
    12	CSI_D2_P
    13	GND
    14	CSI_D3_N
    15	CSI_D3_P
    16	GND
    17	IO0
    18	IO1
    19	GND
    20	I2C_SCL
    21	I2C_SDA
    22	VCC (3v3)

compatible: "raspberrypi,csi-connector"

include: [gpio-nexus.yaml, base.yaml]
```

## dts/bindings/gpio/raspberrypi,pico-gpio-port.yaml
```yaml
# Copyright (c) 2021, Yonatan Schachter
# SPDX-License-Identifier: Apache-2.0

description: Raspberry Pi Pico GPIO Port

compatible: "raspberrypi,pico-gpio-port"

include: [gpio-controller.yaml, base.yaml]

properties:
  reg:
    required: true

  "#gpio-cells":
    const: 2

gpio-cells:
  - pin
  - flags
```

## dts/bindings/gpio/raspberrypi,pico-gpio.yaml
```yaml
# Copyright (c) 2024 TOKITA Hiroshi
# SPDX-License-Identifier: Apache-2.0

description: Raspberry Pi Pico GPIO

compatible: "raspberrypi,pico-gpio"

include: [gpio-nexus.yaml, base.yaml]
```

## dts/bindings/gpio/raspberrypi,pico-header.yaml
```yaml
# Copyright (c) 2023, Joseph Yates
# SPDX-License-Identifier: Apache-2.0

description: |
    GPIO pins exposed on Raspberry Pi Pico headers.

    The Raspberry Pi Pico layout provides 2 columns of 20 pins headers

    This binding provides a nexus mapping for the default 26 pins as depicted below:

        0  GPIO0/UART0_TX      VBUS            -
        1  GPIO1/UART0_RX      VSYS            -
        -  GND                 GND             -
        2  GPIO2               3V3_EN          -
        3  GPIO3               3V3_OUT         -
        4  GPIO4/I2C0_SDA      ADC_VREF        -
        5  GPIO5/I2C0_SCL      GPIO28/ADC2     28
        -  GND                 GND             -
        6  GPIO6               GPIO27/ADC1     27
        7  GPIO7               GPIO26/ADC0     26
        8  GPIO8               RUN             -
        9  GPIO9               GPIO22          22
        -  GND                 GND             -
        10 GPIO10              GPIO21          21
        11 GPIO11              GPIO20          20
        12 GPIO12              GPIO19/SPI0_TX  19
        13 GPIO13              GPIO18/SPI0_SCK 18
        -  GND                 GND             -
        14 GPIO14              GPIO17/SPI0_CSn 17
        15 GPIO15              GPIO16/SPI0_RX  16

compatible: "raspberrypi,pico-header"

include: [gpio-nexus.yaml, base.yaml]
```

## dts/bindings/gpio/raspberrypi,rp1-gpio.yaml
```yaml
# Copyright (c) 2024 Junho Lee <junho@tsnlab.com>
# SPDX-License-Identifier: Apache-2.0

description: GPIO Banks on RP1 peripheral controller

compatible: "raspberrypi,rp1-gpio"

include: [gpio-controller.yaml, base.yaml]

properties:
  reg:
    required: true

  "#gpio-cells":
    const: 2

gpio-cells:
  - pin
  - flags
```

## dts/bindings/gpio/raspberrypi,rp2-gpio.yaml
```yaml
# Copyright (c) 2021, Yonatan Schachter
# SPDX-License-Identifier: Apache-2.0

description: Raspberry Pi GPIO

compatible: "raspberrypi,rp2-gpio"

include: [gpio-controller.yaml, base.yaml]

properties:
  reg:
    required: true

  label:
    required: true

  "#gpio-cells":
    const: 2

gpio-cells:
  - pin
  - flags
```

## dts/bindings/gpio/raspberrypi-40pins-header.yaml
```yaml
# Copyright (c) 2023 Joel Guittet
# SPDX-License-Identifier: Apache-2.0

description: |
    GPIO pins exposed on Raspberry Pi 40-pin header.

    The Raspberry Pi layout provides a 2x20 pins header.

    This binding provides a nexus mapping for 28 pins as depicted below.

        -  3V3                  5V               -
        0  GPIO2/I2C1_SDA       5V               -
        1  GPIO3/I2C1_SCL       GND              -
        2  GPIO4                GPIO14/UART0_TXD 3
        -  GND                  GPIO15/UART0_RXD 4
        5  GPIO17               GPIO18           6
        7  GPIO27               GND              -
        8  GPIO22               GPIO23           9
        -  3V3                  GPIO24           10
        11 GPIO10/SPI0_MOSI     GND              -
        12 GPIO9/SPI0_MISO      GPIO25           13
        14 GPIO11/SPI0_SCLK     GPIO8/SPI0_CE0   15
        -  GND                  GPIO7/SPI0_CE1   16
        17 ID_SD/I2C0_SDA       ID_SC/I2C0_SCL   18
        19 GPIO5                GND              -
        20 GPIO6                GPIO12           21
        22 GPIO13               GND              -
        23 GPIO19               GPIO16           24
        25 GPIO26               GPIO20           26
        -  GND                  GPIO21           27


compatible: "raspberrypi-40pins-header"

include: [gpio-nexus.yaml, base.yaml]
```

## dts/bindings/gpio/realtek,ameba-gpio.yaml
```yaml
# Copyright (c) 2024 Realtek Semiconductor Corp.
# SPDX-License-Identifier: Apache-2.0

description: Realtek Ameba GPIO controller

compatible: "realtek,ameba-gpio"

include: [gpio-controller.yaml, base.yaml]

properties:
  reg:
    required: true

  interrupts:
    required: true

  "#gpio-cells":
    const: 2

gpio-cells:
  - pin
  - flags
```

## dts/bindings/gpio/realtek,bee-gpio.yaml
```yaml
# Copyright (c) 2026, Realtek Semiconductor Corporation
# SPDX-License-Identifier: Apache-2.0

description: |
  Bee GPIO controller.
  First of all, a Pad of bee series soc refers to the physical pin exposed on the chip package
  (e.g., P0_0, P0_1). Most Pads can be configured via pinmuxing to function as GPIOs.

  In contrast, the GPIO in the driver refers to the peripheral control logic, which is distinct
  from the physical Pads. A single GPIO port consists of 32 logical pins (e.g., GPIOA_0...GPIOA_31).

  Typically, a logical GPIO pin (e.g., GPIOA_0) is statically mapped to a fixed Pad (e.g., P0_0).
  However, certain GPIO pins support flexible mapping, allowing a single logical pin to be routed
  to different physical Pads.

  Note that only one mapping configuration can be active at any given time. Users must pre-configure
  the specific GPIO mux in the pinctrl node of the device tree using the correct macro (e.g.,
  BEE_PSEL_GPIOA_0_P0_0) to prevent the GPIO pin from being routed to the wrong Pad.

  Example Usage
    &gpioa {
      pinctrl-0 = <&gpioa_default>;
      pinctrl-names = "default";
      status = "okay";
    };

    &leds {
        compatible = "gpio-leds";
        led0: led_0 {
            /* Logical GPIO pin 0 */
            gpios = <&gpioa 0 GPIO_ACTIVE_LOW>;
        };
    };

    &pinctrl {
        gpioa_default: gpioa_default {
            group1 {
                /* Pinmux: Mapping GPIOA_0 to Pad P0_0 */
                psels = <BEE_PSEL_GPIOA_0_P0_0>;
            };
        };
    };

compatible: "realtek,bee-gpio"

include: [gpio-controller.yaml, base.yaml, pinctrl-device.yaml]

properties:
  reg:
    required: true

  clocks:
    required: true

  pinctrl-0:
    required: true

  pinctrl-names:
    required: true

  "#gpio-cells":
    const: 2

gpio-cells:
  - pin
  - flags
```

## dts/bindings/gpio/realtek,rts5817-gpio.yaml
```yaml
# Copyright (c) 2026 Realtek Semiconductor, Inc.
# SPDX-License-Identifier: Apache-2.0

description: RTS5817 GPIO controller

compatible: "realtek,rts5817-gpio"

include: [gpio-controller.yaml, base.yaml]

properties:
  reg:
    required: true

  interrupts:
    required: true

  "#gpio-cells":
    const: 2

gpio-cells:
  - pin
  - flags
```

## dts/bindings/gpio/realtek,rts5912-gpio.yaml
```yaml
# SPDX-License-Identifier: Apache-2.0
#
# Copyright (c) 2024 Realtek Semiconductor Corporation, SIBG-SD7
#

description: Realtek RTS5912 GPIO

compatible: "realtek,rts5912-gpio"

include: [gpio-controller.yaml, base.yaml]

properties:
  reg:
    required: true

gpio-cells:
  - pin
  - flags
```

## dts/bindings/gpio/renesas,ra-gpio-ioport.yaml
```yaml
# Copyright (c) 2024 Renesas Electronics Corporation
# SPDX-License-Identifier: Apache-2.0

description: Renesas RA GPIO I/O Port

compatible: "renesas,ra-gpio-ioport"

include: [gpio-controller.yaml, base.yaml]

properties:
  reg:
    required: true

  port:
    type: int
    required: true

  vbatts-pins:
    type: array
    description: Array of vbatt pin on port

  port-irqs:
    type: phandle-array
    description: Port irq which this port can be use

  port-irq-names:
    type: string-array
    description: The name of port irq

  port-irq0-pins:
    type: array
    description: Pins allow to assign port-irq0

  port-irq1-pins:
    type: array
    description: Pins allow to assign port-irq1

  port-irq2-pins:
    type: array
    description: Pins allow to assign port-irq2

  port-irq3-pins:
    type: array
    description: Pins allow to assign port-irq3

  port-irq4-pins:
    type: array
    description: Pins allow to assign port-irq4

  port-irq5-pins:
    type: array
    description: Pins allow to assign port-irq5

  port-irq6-pins:
    type: array
    description: Pins allow to assign port-irq6

  port-irq7-pins:
    type: array
    description: Pins allow to assign port-irq7

  port-irq8-pins:
    type: array
    description: Pins allow to assign port-irq8

  port-irq9-pins:
    type: array
    description: Pins allow to assign port-irq9

  port-irq10-pins:
    type: array
    description: Pins allow to assign port-irq10

  port-irq11-pins:
    type: array
    description: Pins allow to assign port-irq11

  port-irq12-pins:
    type: array
    description: Pins allow to assign port-irq12

  port-irq13-pins:
    type: array
    description: Pins allow to assign port-irq13

  port-irq14-pins:
    type: array
    description: Pins allow to assign port-irq14

  port-irq15-pins:
    type: array
    description: Pins allow to assign port-irq15

  port-irq16-pins:
    type: array
    description: Pins allow to assign port-irq16

  port-irq17-pins:
    type: array
    description: Pins allow to assign port-irq17

  port-irq18-pins:
    type: array
    description: Pins allow to assign port-irq18

  port-irq19-pins:
    type: array
    description: Pins allow to assign port-irq19

  port-irq20-pins:
    type: array
    description: Pins allow to assign port-irq20

  port-irq21-pins:
    type: array
    description: Pins allow to assign port-irq21

  port-irq22-pins:
    type: array
    description: Pins allow to assign port-irq22

  port-irq23-pins:
    type: array
    description: Pins allow to assign port-irq23

  port-irq24-pins:
    type: array
    description: Pins allow to assign port-irq24

  port-irq25-pins:
    type: array
    description: Pins allow to assign port-irq25

  port-irq26-pins:
    type: array
    description: Pins allow to assign port-irq26

  port-irq27-pins:
    type: array
    description: Pins allow to assign port-irq27

  port-irq28-pins:
    type: array
    description: Pins allow to assign port-irq28

  port-irq29-pins:
    type: array
    description: Pins allow to assign port-irq29

  port-irq30-pins:
    type: array
    description: Pins allow to assign port-irq30

  port-irq31-pins:
    type: array
    description: Pins allow to assign port-irq31

  "#gpio-cells":
    const: 2

gpio-cells:
  - pin
  - flags
```

## dts/bindings/gpio/renesas,ra-gpio-mipi-header.yaml
```yaml
# Copyright (c) 2024 Renesas Electronics Corporation
# SPDX-License-Identifier: Apache-2.0

description: |
  GPIO pins exposed on Renesas MIPI lcd display headers.

  The Renesas MIPI lcd display layout provides 2 columns of 13 pins headers

  This binding provides a mapping for the default 26 pins as depicted below:

      1  GND                 IIC_SDA         14
      2  GND                 DISP_BLEN       15
      3  MIPI_DL0_P          IIC_SCL         16
      4  MIPI_DL1_P          DISP_INT        17
      5  MIPI_DL0_N          DISP_RST        18
      6  MIPI_DL1_N          GND             19
      7  GND                 GND             20
      8  GND                 1V8             21
      9  MIPI_CL_P           1V8             22
      10 GND                 3V3             23
      11 MIPI_CL_N           3V3             24
      12 GND                 5V0             25
      13 GND                 5V0             26

compatible: "renesas,ra-gpio-mipi-header"

include: [gpio-nexus.yaml, base.yaml]
```
