## dts/bindings/gpio/bflb,bl-gpio.yaml
```yaml
# Copyright (c) 2021, Gerson Fernando Budke <nandojve@gmail.com>
# SPDX-License-Identifier: Apache-2.0

description: Bouffalo Lab GPIO node

compatible: "bflb,bl-gpio"

include: [gpio-controller.yaml, base.yaml]

properties:
    reg:
      required: true

    interrupts:
      required: false

    label:
      required: true

    "#gpio-cells":
      const: 0

    "#bflb,pin-cells":
      type: int
      required: true
      const: 2
      description: Number of items to expect in a bflb,pins specifier

    "#bflb,signal-cells":
      type: int
      required: false
      const: 1
      description: Number of items to expect in a bflb,signals specifier

bflb,pin-cells:
  - fun
  - pin

bflb,signal-cells:
  - flags
```

## dts/bindings/gpio/bflb,bl60x_70x-gpio.yaml
```yaml
# Copyright (c) 2021-2025 Gerson Fernando Budke <nandojve@gmail.com>
#
# SPDX-License-Identifier: Apache-2.0

description: Bouffalo Lab BL60x and BL70x GPIO node

compatible: "bflb,bl60x_70x-gpio"

include:
  - name: base.yaml
  - name: gpio-controller.yaml

properties:
  reg:
    required: true

  interrupts:
    required: true

  "#gpio-cells":
    const: 2

gpio-cells:
  - pin
  - flags
```

## dts/bindings/gpio/bflb,bl61x-gpio.yaml
```yaml
# Copyright (c) 2025 MASSDRIVER EI (massdriver.space)
# SPDX-License-Identifier: Apache-2.0

description: BouffaloLab GPIO node for BL61X series

compatible: "bflb,bl61x-gpio"

include: base.yaml

properties:
  reg:
    required: true

  interrupts:
    required: true

  interrupt-names:
    required: true

child-binding:

  description: Group of 32 pins for BL61x GPIOs

  include: gpio-controller.yaml

  properties:
    reg:
      type: int
      required: true
      enum:
        - 0
        - 1
      description: |
        Indicates which set of pins this manages:
        0: Pins 0-31
        1: Pins 32 - 63
        BL61x has 35 brought out pins, BL61xL has 37, BL61xD has 53.

    drive-strength:
      type: int
      default: 0
      enum:
        - 0     # Default value, lower strength, ~3mA
        - 1     # ~10mA
        - 2     # ~17mA
        - 3     # highest strength, ~24mA
      description: |
        Pin drive strength for the port. It tunes maximum pin current where 0 means lower
        value, which is the default, and 3 represents max drive strength.

    "#gpio-cells":
      const: 2

  gpio-cells:
    - pin
    - flags
```

## dts/bindings/gpio/bflb,bl61x-wo-device.yaml
```yaml
# Copyright (c) 2026, MASSDRIVER EI (massdriver.space)
# SPDX-License-Identifier: Apache-2.0

# Common fields for Bouffalolab GPIO FIFO / WO

properties:
  time-t0h:
    type: int
    description: |
      0 pulse duration in ns. Can be 0.

  time-t1h:
    type: int
    description: |
      1 pulse duration in ns. Can be 0.

  time-total:
    type: int
    description: |
      Specify the total length of a pulse representing a bit. This or time-total must be defined.

  frequency:
    type: int
    description: |
      Frequency at which the bits are sent. This or time-total must be defined.
```

## dts/bindings/gpio/bflb,gpio.yaml
```yaml
# Copyright (c) 2021-2025 Gerson Fernando Budke <nandojve@gmail.com>
#
# SPDX-License-Identifier: Apache-2.0

description: Bouffalo Lab GPIO node

compatible: "bflb,gpio"

include:
  - name: base.yaml
  - name: gpio-controller.yaml

properties:
  reg:
    required: true

  interrupts:
    required: true

  "#gpio-cells":
    const: 2

  "#bflb,pin-cells":
    type: int
    required: true
    const: 2
    description: Number of items to expect in a bflb,pins specifier

gpio-cells:
  - pin
  - flags

bflb,pin-cells:
  - pin
  - peripheral
```

## dts/bindings/gpio/brcm,bcm2835-gpio.yaml
```yaml
# Copyright (c) 2026
# SPDX-License-Identifier: Apache-2.0

description: BCM2835 GPIO

compatible: "brcm,bcm2835-gpio"

include: [gpio-controller.yaml, base.yaml]

properties:
  reg:
    required: true

  interrupts:
    required: true

  "#gpio-cells":
    const: 2

gpio-cells:
  - pin
  - flags
```

## dts/bindings/gpio/brcm,brcmstb-gpio.yaml
```yaml
# Copyright (c) 2024 Junho Lee <junho@tsnlab.com>
# SPDX-License-Identifier: Apache-2.0

description: BRCMSTB GPIO

compatible: "brcm,brcmstb-gpio"

include: [gpio-controller.yaml, base.yaml]

properties:
  reg:
    required: true

  "#gpio-cells":
    const: 2

gpio-cells:
  - pin
  - flags
```

## dts/bindings/gpio/brcm,iproc-gpio.yaml
```yaml
# Copyright 2020 Broadcom
# SPDX-License-Identifier: Apache-2.0

description: Broadcom iProc GPIO Controller

compatible: "brcm,iproc-gpio"

include: [gpio-controller.yaml, base.yaml]

properties:
  reg:
    required: true
    description: |
      Define the base and range of the I/O address space that contains SoC
      GPIO/PINCONF controller registers

  ngpios:
    required: true
    description: Total number of in-use slots in GPIO controller

  interrupts:
    required: true

  "#gpio-cells":
    const: 2

gpio-cells:
  - pin
  - flags
```

## dts/bindings/gpio/cdac,thejas32-gpio.yaml
```yaml
# Copyright (c) 2026 Anuj Deshpande
# SPDX-License-Identifier: Apache-2.0

description: |
  C-DAC THEJAS32 GPIO controller.

  Each controller handles 16 pins. Pin data is accessed through address
  masking: bits [17:2] of the address select which pins a data access
  operates on, so individual pins can be set and cleared without
  read-modify-write. The direction register sits above the data window.

compatible: "cdac,thejas32-gpio"

include: [gpio-controller.yaml, base.yaml]

properties:
  reg:
    required: true

  ngpios:
    const: 16

  "#gpio-cells":
    const: 2

gpio-cells:
  - pin
  - flags
```

## dts/bindings/gpio/cypress,cy8c95xx-gpio-port.yaml
```yaml
# Copyright (c) 2021 Synopsys
# SPDX-License-Identifier: Apache-2.0

description: Cypress cy8c95xx GPIO port node

compatible: "cypress,cy8c95xx-gpio-port"

include: [gpio-controller.yaml, base.yaml]

properties:
  reg:
    required: true

  "#gpio-cells":
    const: 2

  ngpios:
    required: true
    const: 8

gpio-cells:
  - pin
  - flags
```

## dts/bindings/gpio/cypress,cy8c95xx-gpio.yaml
```yaml
# Copyright (c) 2021 Synopsys
# SPDX-License-Identifier: Apache-2.0

description: Cypress cy8c95xx GPIO

compatible: "cypress,cy8c95xx-gpio"

include: base.yaml

properties:
  reg:
    required: true
```

## dts/bindings/gpio/cypress,psoc6-gpio.yaml
```yaml
# Copyright (c) 2020-2021 ATL Electronics
# SPDX-License-Identifier: Apache-2.0

description: Cypress GPIO Port

compatible: "cypress,psoc6-gpio"

include: ["gpio-controller.yaml", "base.yaml"]

properties:
  reg:
    required: true

  interrupts:
    required: true

  "#gpio-cells":
    const: 2

  "#cypress,pin-cells":
    type: int
    required: true
    const: 2
    description: Number of items to expect in a cypress,pins specifier

gpio-cells:
  - pin
  - flags

cypress,pin-cells:
  - pin
  - hsiom
```

## dts/bindings/gpio/cypress,psoc6-hsiom.yaml
```yaml
# Copyright (c) 2020 ATL Electronics
# SPDX-License-Identifier: Apache-2.0

description: Cypress High Speed I/O Matrix

compatible: "cypress,psoc6-hsiom"

include: base.yaml

properties:
  reg:
    required: true

  interrupts:
    required: true
```

## dts/bindings/gpio/digilent,pmod.yaml
```yaml
# Copyright (c) 2023 Elektronikutvecklingsbyrån EUB AB
# SPDX-License-Identifier: Apache-2.0

description: |
    GPIO pins exposed on a Digilent Pmod interface.

    This binding provides a nexus mapping for 8 pins where parent pins 0
    through 3 correspond to IO1 through IO4, and parent pins 4 through 7
    correspond to IO5 through IO8, as depicted below for a 12-pin connector.

    12-pin Pmod interface:

        0 IO1                    IO5   4
        1 IO2                    IO6   5
        2 IO3                    IO7   6
        3 IO4                    IO8   7
        - GND                    GND   -
        - VDD                    VDD   -

    This binding can also be used with the 6-pin Pmod connector variant which
    is a proper subset of the 12-pin connector. In that case parent pins 4
    through 7 are omitted from the GPIO nexus node, resulting in a mapping
    as depicted below.

    6-pin Pmod interface:

        0 IO1
        1 IO2
        2 IO3
        3 IO4
        - GND
        - VDD

compatible: "digilent,pmod"

include: [gpio-nexus.yaml, base.yaml]
```

## dts/bindings/gpio/diodes,pi4ioe5v6408.yaml
```yaml
# Copyright (c) 2026 Carlo Caione <ccaione@baylibre.com>
# SPDX-License-Identifier: Apache-2.0

title: Diodes/Pericom PI4IOE5V6408 8-bit I2C-bus I/O expander

description: |
  The device exposes eight GPIO lines that can be individually configured as inputs or outputs, with
  optional pull-up / pull-down resistors. An interrupt output (INT, open-drain, active-low) signals
  input transitions away from a per-pin programmable default state.

  The chip has two fixed I2C addresses depending on the ADDR pin: 0x43 (ADDR tied low) and 0x44
  (ADDR tied high).

compatible: "diodes,pi4ioe5v6408"

include: [i2c-device.yaml, gpio-controller.yaml]

properties:
  "#gpio-cells":
    const: 2

  ngpios:
    required: true
    const: 8

  int-gpios:
    type: phandle-array
    description: |
      Connection for the open-drain INT output. When set, the driver enables interrupt support and
      dispatches GPIO callbacks on input transitions matching the configured edges.

gpio-cells:
  - pin
  - flags
```

## dts/bindings/gpio/elan,em32-gpio.yaml
```yaml
# Copyright (c) 2025, Elan Microelectronics Corp.
# SPDX-License-Identifier: Apache-2.0

description: EM32 GPIO Controller

compatible: "elan,em32-gpio"

include:
  - name: gpio-controller.yaml
    property-blocklist:
      - ngpios
  - name: base.yaml

properties:
  reg:
    required: true

  clocks:
    type: phandle-array
    required: true

  "#gpio-cells":
    const: 2

  ngpios:
    type: int
    default: 16
    description: |
        This property indicates the number of in-use slots of available slots
        for GPIOs. The EM32 GPIO controller typically has all 16 possible port
        IO with few exceptions.

  port-id:
    type: int
    required: true
    description: |
        Port identifier (0 for PORTA, 1 for PORTB).
        Used for IOMUX register selection and UART1 PA1/PA2 coordination.

  port-name:
    type: string
    required: false
    description: |
        Human-readable port name for debugging and logging.
        Should be "PORTA" or "PORTB".

gpio-cells:
  - pin
  - flags
```

## dts/bindings/gpio/ene,kb1200-gpio.yaml
```yaml
# Copyright (c) 2023 ENE Technology Inc.
# SPDX-License-Identifier: Apache-2.0

description: |
    ENE KB1200 GPIO Port

    The GPIO controller provides group control of GPIO functions. Each port
    group contains 32 pins. GPIO_00~GPIO_1F belong to the Port0 group,
    GPIO_20~GPIO_3F belong to the Port1 group, and so on.

    In particular, the 32 pins of the port group do not share the same IRQ
    interrupt, but are assigned to two different IRQ interrupts in groups of 16
    pins. This means that single port group provide two interrupt source.
    ex.Port0 group GPIO_00~GPIO_0F shares IRQ18, and Port0 group
    GPIO_10~GPIO_1F shares IRQ19.

compatible: "ene,kb1200-gpio"

include: [gpio-controller.yaml, base.yaml]

properties:
  reg:
    required: true

  interrupts:
    required: true

  "#gpio-cells":
    const: 2

gpio-cells:
  - pin
  - flags
```

## dts/bindings/gpio/esp-01-header.yaml
```yaml
# SPDX-FileCopyrightText: Copyright The Zephyr Project Contributors
# SPDX-License-Identifier: Apache-2.0

description: |
    GPIO pins exposed on ESP-01 headers.

    This binding provides a nexus mapping for the GPIO-capable pins on an
    ESP-01 2x4 header. Power and ground pins are not mapped.

        1  GND      2  RXD
        3  GPIO2    4  CH_PD
        5  GPIO0    6  RST
        7  TXD      8  3V3

compatible: "esp-01-header"

include: [gpio-nexus.yaml, base.yaml]
```

## dts/bindings/gpio/espressif,esp-threadbr-header.yaml
```yaml
# Copyright (c) 2026 Espressif Systems (Shanghai) Co., Ltd.
# SPDX-License-Identifier: Apache-2.0

description: |
    GPIO pins exposed on the ESP Thread Border Router sub-board header.

    The ESP Thread BR board provides a sub-board connector for expansion
    modules such as the Ethernet (W5500) sub-board.

    This binding provides a nexus mapping for the following pins:

         Conn J4 (2x13)
         ==========================
         Signal    Pin    Signal
         --------------------------
          (GND)   1   2   (GND)
           (5V)   3   4   (3V3)
         GPIO15   5   6   GPIO16
         GPIO03   7   8   GPIO46
         GPIO09   9   10  GPIO14
         GPIO21  11   12  GPIO47
         GPIO48  13   14  GPIO45
         GPIO35  15   16  GPIO36
         GPIO37  17   18  GPIO38
         GPIO39  19   20  GPIO40
         GPIO41  21   22  GPIO42
          U0_RX  23   24  U0_TX
         GPIO02  25   26  GPIO01

compatible: "espressif,esp-threadbr-header"

include: [gpio-nexus.yaml, base.yaml]
```

## dts/bindings/gpio/espressif,esp32-gpio.yaml
```yaml
# Copyright (c) 2019, Yannis Damigos
# SPDX-License-Identifier: Apache-2.0

description: ESP32 GPIO controller

compatible: "espressif,esp32-gpio"

include: [gpio-controller.yaml, base.yaml]

properties:
    reg:
        required: true

    label:
        required: true

    "#gpio-cells":
        const: 2

gpio-cells:
  - pin
  - flags
```

## dts/bindings/gpio/espressif,esp32-lpgpio.yaml
```yaml
# Copyright (c) 2025 Espressif Systems (Shanghai) Co., Ltd.
# SPDX-License-Identifier: Apache-2.0

description: ESP32 Low Power GPIO controller for LP Core

compatible: "espressif,esp32-lpgpio"

include: [gpio-controller.yaml, base.yaml]

properties:
  reg:
    required: true

  "#gpio-cells":
    const: 2

gpio-cells:
  - pin
  - flags
```

## dts/bindings/gpio/fcs,fxl6408.yaml
```yaml
# Copyright (c) 2021 Abel Sensors
# SPDX-License-Identifier: Apache-2.0

description: FXL6408 I2C-based GPIO expander

compatible: "fcs,fxl6408"

include: [gpio-controller.yaml, i2c-device.yaml]

properties:
    label:
      required: true

    "#gpio-cells":
      const: 2

gpio-cells:
  - pin
  - flags
```

## dts/bindings/gpio/fobe,quill-header.yaml
```yaml
# Copyright (c) 2025 FoBE Studio
# SPDX-License-Identifier: Apache-2.0

title: GPIO pins exposed on the FoBE Quill connector

description: |
    The Quill layout provides two headers, one each along
    opposite edges of the board.
    Pin mapping overview:
     * Left 14-pin header: 11 pins are mapped in this binding.
     * Right 14-pin header: 12 pins are mapped in this binding.

    This binding provides a nexus mapping for 20 pins where parent pins 14
    through 19 correspond to A0 through A5, and parent pins 0 through 13
    correspond as depicted below:

                                  VBUS   -
                                  3V3    -
                                  GND    -
                                  3V3_EN -
        -  BAT                    REF    -
        -  RESET                  D2     2
        -  GND                    D1     1
        13 D13                    D0     0
        12 D12                    A5     19
        11 D11                    A4     18
        10 D10                    A3     17
        9  D9                     A2     16
        8  D8                     A1     15
        7  D7                     A0     14
        6  D6
        5  D5
        4  D4
        3  D3

compatible: "fobe,quill-header"

include: [gpio-nexus.yaml, base.yaml]
```

## dts/bindings/gpio/gaisler,grgpio.yaml
```yaml
description: Gaisler GRLIB GRGPIO - General Purpose I/O Port

compatible: "gaisler,grgpio"

include: [gpio-controller.yaml, base.yaml]

properties:
  reg:
    required: true

  "#gpio-cells":
    const: 2

gpio-cells:
  - pin
  - flags
```
