## dts/bindings/gpio/st,stm32mp2-gpio.yaml
```yaml
# Copyright (C) 2025 Savoir-faire Linux, Inc.
# SPDX-License-Identifier: Apache-2.0

description: STM32MP2 GPIO Controller

compatible: "st,stm32mp2-gpio"

include:
  - name: st,stm32-gpio.yaml
    property-blocklist:
      - clocks

properties:
  clocks:
    type: phandle-array
    description: |
      The clocks property is optional for STM32MP2 GPIO controllers.
      This property is not required when the Cortex-A core is responsible for
      GPIO initialization and acts as the resource manager, as defined by the
      RIF (Resource Isolation Framework) peripheral. Adding the GPIO clocks
      in that case would only trigger an IAC event.
      If the Cortex-M core is designated as the resource manager, then the
      clocks property must be defined and added to the device tree.
```

## dts/bindings/gpio/st,stmod-plus-connector.yaml
```yaml
# SPDX-FileCopyrightText: Copyright The Zephyr Project Contributors
# SPDX-License-Identifier: Apache-2.0

description: |
    GPIO pins exposed on STMod+ connectors.

    STMod+ is a 20-pin expansion connector used on STMicroelectronics
    Discovery and Evaluation boards. This binding provides a nexus mapping
    for the GPIO-capable STMod+ pins. Power and ground pins are not mapped.

    Use STMOD_PLUS_* constants in
    <zephyr/dt-bindings/gpio/stmod-plus-connector.h> to refer to specific
    pins using convenient constant names.

compatible: "st,stmod-plus-connector"

include: [gpio-nexus.yaml, base.yaml]
```

## dts/bindings/gpio/st,stmpe1600.yaml
```yaml
# Copyright (c) 2021 Titouan Christophe
# SPDX-License-Identifier: Apache-2.0

description: STMPE1600 I2C-based GPIO expander

compatible: "st,stmpe1600"

include: [gpio-controller.yaml, i2c-device.yaml]

properties:
    "#gpio-cells":
      const: 2

gpio-cells:
  - pin
  - flags
```

## dts/bindings/gpio/st-morpho-header.yaml
```yaml
# Copyright (c) 2023 Teslabs Engineering S.L.
# SPDX-License-Identifier: Apache-2.0

description: |
  GPIO pins exposed on ST Morpho connector.

  The ST morpho connector consists in male pin headers (CN7 and CN10 in case of
  Nucleo-64, CN11 and CN12 in case of Nucleo-144) accessible on both sides of
  any Nucleo board. They can be used to connect shields. All signals and power
  pins of the STM32 are available on the ST morpho connector.

  Use ST_MORPHO_* constants in <zephyr/dt-bindings/gpio/st-morpho-header.h>
  to refer to specific pins using convenient constant names.

compatible: "st-morpho-header"

include: [gpio-nexus.yaml, base.yaml]
```

## dts/bindings/gpio/stemma-qt-connector.yaml
```yaml
# Copyright (c) 2024 TOKITA Hiroshi
# SPDX-License-Identifier: Apache-2.0

description: |
    STEMMA QT is a 4-pin JST-SH connector for I2C devices.
    The pin assignments are as follows.

        0  SCL
        1  SDA
        -  VCC (3-5V)
        -  GND

    STEMMA, Grove, Qwiic, and Gravity connectors are similar to this,
    but the connector form and VCC voltage are different.
    Please see
    https://learn.adafruit.com/introducing-adafruit-stemma-qt/stemma-qt-comparison#quick-comparison-3035247

compatible: "stemma-qt-connector"

include: [gpio-nexus.yaml, base.yaml]
```

## dts/bindings/gpio/swj-connector.yaml
```yaml
description: Serial Wire - JTAG Connector

compatible: "swj-connector"

include: pinctrl-device.yaml
```

## dts/bindings/gpio/syna,aon-gpio.yaml
```yaml
#
# SPDX-FileCopyrightText: Copyright (c) 2025 Synaptics Incorporated
#
# SPDX-License-Identifier: Apache-2.0
#

description: Synaptics AON GPIO

compatible: "syna,aon-gpio"

include: [gpio-controller.yaml, base.yaml, pinctrl-device.yaml]

properties:
  reg:
    required: true

  reg-width:
    type: int
    description:
      Width in bits for configuration of each GPIO in register.

  polarity-shift:
    type: int
    description:
      Bit position inside configuration bits to set polarity.

gpio-cells:
  - pin
  - flags
```

## dts/bindings/gpio/tcc,tccvcp-gpio.yaml
```yaml
# Copyright (c) 2024 Hounjoung Rim <hounjoung@tsnlab.com>
# SPDX-License-Identifier: Apache-2.0

description: TCCVCP GPIO

compatible: "tcc,tccvcp-gpio"

include: [gpio-controller.yaml, base.yaml]

properties:
  reg:
    required: true

  "#gpio-cells":
    const: 2

gpio-cells:
  - pin
  - flags
```

## dts/bindings/gpio/telink,b91-gpio.yaml
```yaml
# Copyright (c) 2021, Telink Semiconductor
# SPDX-License-Identifier: Apache-2.0

description: Telink B91 GPIO node

compatible: "telink,b91-gpio"

include: [gpio-controller.yaml, base.yaml]

properties:
    reg:
      required: true

    label:
      required: true

    "#gpio-cells":
      const: 2

gpio-cells:
  - pin
  - flags
```

## dts/bindings/gpio/telink,b9x-gpio.yaml
```yaml
# Copyright (c) 2021-2023, Telink Semiconductor
# SPDX-License-Identifier: Apache-2.0

description: Telink B9x GPIO node

compatible: "telink,b9x-gpio"

include: [gpio-controller.yaml, base.yaml]

properties:
  reg:
    required: true

  "#gpio-cells":
    const: 2

gpio-cells:
  - pin
  - flags
```

## dts/bindings/gpio/telink,w91-gpio.yaml
```yaml
# Copyright (c) 2024, Telink Semiconductor
# SPDX-License-Identifier: Apache-2.0

description: Telink W91 GPIO node

compatible: "telink,w91-gpio"

include: [gpio-controller.yaml, base.yaml]

properties:
  "#gpio-cells":
    const: 2

  ngpios:
    required: true

gpio-cells:
  - pin
  - flags
```

## dts/bindings/gpio/ti,ads114s0x-gpio.yaml
```yaml
#
# Copyright (c) 2022 SILA Embedded Solutions GmbH
#
# SPDX-License-Identifier: Apache-2.0
#

description: TI ADS114S0x GPIO controller binding

compatible: "ti,ads114s0x-gpio"

include: [gpio-controller.yaml, base.yaml]

on-bus: ads114s0x

properties:
  "#gpio-cells":
    const: 2

  ngpios:
    type: int
    required: true
    const: 4
    description: Number of gpios supported

gpio-cells:
  - pin
  - flags
```

## dts/bindings/gpio/ti,ads1x4s0x-gpio.yaml
```yaml
#
# Copyright (c) 2022 SILA Embedded Solutions GmbH
#
# SPDX-License-Identifier: Apache-2.0
#

description: TI ADS114S0x GPIO Controller

compatible: "ti,ads1x4s0x-gpio"

include: [gpio-controller.yaml, base.yaml]

on-bus: ads1x4s0x

properties:
  "#gpio-cells":
    const: 2

  ngpios:
    type: int
    required: true
    const: 4
    description: Number of gpios supported

gpio-cells:
  - pin
  - flags
```

## dts/bindings/gpio/ti,boosterpack-header.yaml
```yaml
# Copyright (c) 2019 Brett Witherspoon
# SPDX-License-Identifier: Apache-2.0

description: |
    TI BoosterPack GPIO header

    GPIO pins exposed as BoosterPack headers on TI LaunchPads.

    BoosterPack plug-in modules are available in 20 and 40 pin variants. The
    20 pin variant has two 10 x 1 pin headers and the 40 pin variant has two
    10 x 2 pin headers. Both variants are compatible and stackable.

    The pins of the 20 pin variant and the outer row of the 40 pin variant are
    numbered 1 through 20. The inner rows of the 40 pin variant are numbered 21
    through 40. The BoosterPack pinout is depicted below:

    1  3.3V     21 5V                    40 GPIO 20 GND
    2  Analog   22 GND                   39 GPIO 19 GPIO / SPI CS
    3  UART RXD 23 Analog                38 GPIO 18 GPIO
    4  UART TXD 24 Analog                37 GPIO 17 GPIO
    5  GPIO     25 Analog                36 GPIO 16 RESET
    6  Analog   26 Analog                35 GPIO 15 SPI MOSI
    7  SPI CLK  27 Analog                34 GPIO 14 SPI MISO
    8  GPIO     28 Analog                33 GPIO 13 GPIO / SPI CS
    9  I2C SCL  29                       32 GPIO 12 GPIO / SPI CS
    10 I2C SDA  30                       31 GPIO 11 GPIO

    Additional information about the BoosterPack pinout can be found at
    http://processors.wiki.ti.com/index.php/BYOB or in the documentation for
    a TI LaunchPad development kit,

compatible: "ti,boosterpack-header"

include: [gpio-nexus.yaml, base.yaml]
```

## dts/bindings/gpio/ti,cc13xx-cc26xx-gpio.yaml
```yaml
# Copyright (c) 2019 Brett Witherspoon
# SPDX-License-Identifier: Apache-2.0

description: TI SimpleLink CC13xx / CC26xx GPIO node

compatible: "ti,cc13xx-cc26xx-gpio"

include: [gpio-controller.yaml, base.yaml]

properties:
    reg:
      required: true

    interrupts:
      required: true

    label:
      required: true

    "#gpio-cells":
      const: 2

gpio-cells:
  - pin
  - flags
```

## dts/bindings/gpio/ti,cc23x0-gpio.yaml
```yaml
# Copyright (c) 2024 Texas Instruments Incorporated
# Copyright (c) 2024 BayLibre, SAS
#
# SPDX-License-Identifier: Apache-2.0

description: TI SimpleLink CC23X0 GPIO node

compatible: "ti,cc23x0-gpio"

include: [gpio-controller.yaml, base.yaml]

properties:
  reg:
    required: true

  interrupts:
    required: true

  "#gpio-cells":
    const: 2

gpio-cells:
  - pin
  - flags
```

## dts/bindings/gpio/ti,cc2650-gpio.yaml
```yaml
# SPDX-License-Identifier: Apache-2.0
description: TI CC2650 GPIO node

compatible: "ti,cc2650-gpio"

include: [gpio-controller.yaml, base.yaml]

properties:
    reg:
      required: true

    interrupts:
      required: true
```

## dts/bindings/gpio/ti,cc32xx-gpio.yaml
```yaml
# SPDX-License-Identifier: Apache-2.0
description: TI CC32XX GPIO

compatible: "ti,cc32xx-gpio"

include: [gpio-controller.yaml, base.yaml]

properties:
  reg:
    required: true

  interrupts:
    required: true

  "#gpio-cells":
    const: 2

gpio-cells:
  - pin
  - flags
```

## dts/bindings/gpio/ti,davinci-gpio-nexus.yaml
```yaml
# Copyright (C) 2023 BeagleBoard.org Foundation
# Copyright (C) 2023 S Prashanth
#
# SPDX-License-Identifier: Apache-2.0

description: GPIO controller for Davinci and Keystone devices

compatible: "ti,davinci-gpio-nexus"

include: [base.yaml, gpio-nexus.yaml, pinctrl-device.yaml]

properties:
  "#gpio-cells":
    const: 2

gpio-cells:
  - pin
  - flags
```

## dts/bindings/gpio/ti,davinci-gpio.yaml
```yaml
# Copyright (C) 2023 BeagleBoard.org Foundation
# Copyright (C) 2023 S Prashanth
#
# SPDX-License-Identifier: Apache-2.0

description: GPIO Controller for Davinci and Keystone devices.

compatible: "ti,davinci-gpio"

include: [base.yaml, gpio-controller.yaml, pinctrl-device.yaml]

properties:
  reg:
    required: true

  "#gpio-cells":
    const: 2

gpio-cells:
  - pin
  - flags
```

## dts/bindings/gpio/ti,lmp90xxx-gpio.yaml
```yaml
description: TI LMP90xxx GPIO Controller

compatible: "ti,lmp90xxx-gpio"

include: [gpio-controller.yaml, base.yaml]

on-bus: lmp90xxx

properties:
  "#gpio-cells":
    const: 2

gpio-cells:
  - pin
  - flags
```

## dts/bindings/gpio/ti,msp432p4xx-gpio.yaml
```yaml
# SPDX-License-Identifier: Apache-2.0
description: TI msp432p4xx GPIO node

compatible: "ti,msp432p4xx-gpio"

include: [gpio-controller.yaml, base.yaml]

properties:
    reg:
      required: true

    interrupts:
      required: true

    "#gpio-cells":
      const: 2

gpio-cells:
  - pin
  - flags
```

## dts/bindings/gpio/ti,sn74hc595.yaml
```yaml
# Copyright (c) 2022, Matthias Freese
# SPDX-License-Identifier: Apache-2.0

description: |
  SN74HC595 SPI based GPIO expander.
  The SNx4HC595 is an 8-bit shift register.
  Note: There are two clock inputs, one for shifting (SRCLK) and one for storing
  (RCLK). On a rising edge, the shift clock puts a bit into the shift register,
  but does not make it appear on the output. On a rising edge of the store clock,
  all shifted in bits appear on the outputs of the shift register. One can use
  `cs-gpios` property of the shift register's parent SPI controller to work the
  load clock. If one assigns a GPIO in the GPIO_ACTIVE_LOW configuration, then as
  the CS pin goes high at the end of the SPI transaction, the shift register will
  load in all shifted bits.

compatible: "ti,sn74hc595"

include: [gpio-controller.yaml, spi-device.yaml]

properties:
  reset-gpios:
    type: phandle-array
    description: |
      An optional GPIO connected to the reset input of the shift register(s).
      It will be set to a logical 1 and then held at a logical 0 on init.

  enable-gpios:
    type: phandle-array
    description: |
      An optional GPIO connected to the enable input of the shift register(s).
      It will be set to a logical 1 on init.

  reset-value:
    type: int
    default: 0x0
    description: |
      The value to be shifted into the register (or registers) and loaded on
      init. This is useful when you want to start with the register(s) in a
      specific state and or you don't have control over the hard reset input of
      the register(s).

  ngpios:
    type: int
    required: true
    enum:
      - 8
      - 16
      - 24
      - 32
    description: |
      The number of supported gpios. Although each shift register has only eight
      outputs, they can be chained together. Due to Zephyr's idea of a GPIO port
      only controlling up to 32 pins, the maximum number you can indicate here
      is 32, equating to four chained shift registers.

  "#gpio-cells":
    const: 2

gpio-cells:
  - pin
  - flags
```

## dts/bindings/gpio/ti,stellaris-gpio.yaml
```yaml
# SPDX-License-Identifier: Apache-2.0

description: TI Stellaris GPIO node

compatible: "ti,stellaris-gpio"

include: [gpio-controller.yaml, base.yaml]

properties:
    reg:
      required: true

    label:
      required: true

    interrupts:
      required: true

    "#gpio-cells":
      const: 2

gpio-cells:
  - pin
  - flags
```

## dts/bindings/gpio/ti,tca6408a.yaml
```yaml
# Copyright (c) 2020, Innoseis BV
# SPDX-License-Identifier: Apache-2.0

description: TCA6408a I2C GPIO expander

compatible: "ti,tca6408a"

include: [i2c-device.yaml, gpio-controller.yaml]

properties:
  "#gpio-cells":
    const: 2
  ngpios:
    const: 8

gpio-cells:
  - pin
  - flags
```
