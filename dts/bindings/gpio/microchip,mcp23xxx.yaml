## dts/bindings/gpio/renesas,rh850-gpio.yaml
```yaml
# Copyright (c) 2026 Renesas Electronics Corporation
# SPDX-License-Identifier: Apache-2.0

description: Renesas RH850 GPIO

compatible: "renesas,rh850-gpio"

include: [gpio-controller.yaml, base.yaml]

properties:
  reg:
    required: true

  port:
    type: int
    required: true

  port-type:
    type: string
    description: Type of port is port/jport/aport
    required: true
    enum:
      - "port"
      - "jport"
      - "aport"

  protected-write-mask:
    type: int
    description: Bitmask to select which protected registers can be written
    required: true

  interrupts:
    description: interrupt node

  irqs:
    type: phandle-array
    description: external irq node - pin pairs

  "#gpio-cells":
    const: 2

gpio-cells:
  - pin
  - flags
```

## dts/bindings/gpio/renesas,rx-gpio-ioport.yaml
```yaml
# Copyright (c) 2026 Renesas Electronics Corporation
# SPDX-License-Identifier: Apache-2.0

description: Renesas RX GPIO IO port

compatible: "renesas,rx-gpio-ioport"

include: [gpio-controller.yaml, base.yaml]

properties:
  reg:
    required: true

  port:
    type: int
    required: true

  vbatts-pins:
    type: array
    description: Array of vbatt pin on port

  "#gpio-cells":
    const: 2

gpio-cells:
  - pin
  - flags
```

## dts/bindings/gpio/seeed,xiao-plus-gpio.yaml
```yaml
# SPDX-FileCopyrightText: Copyright The Zephyr Project Contributors
# SPDX-License-Identifier: Apache-2.0

title: GPIO pins exposed on the additional pads of Seeed Studio XIAO Plus boards

description: |
    XIAO Plus boards keep the 14 castellated pins of the XIAO form factor
    (see seeed,xiao-gpio) and add 9 pads on the bottom side, placed between
    the castellated pins along both long edges. Carrier boards solder the
    module on matching SMD pads.

    This binding provides a nexus mapping for 9 pins where parent pins 11
    through 19 correspond to D11 through D19. The castellated pins, shown in
    brackets, are not part of this mapping. Top view:

           [D0]                        [5V]
        11  D11 (I2S_SD)
           [D1]                        [GND]
        12  D12 (I2S_SCK)
           [D2]                        [3V3]
        13  D13 (I2S_WS)
           [D3]                        [D10]
        14  D14 (RX1)          (MOSI1)  D19 19 *
           [D4]                        [D9]
        15  D15 (TX1)          (MISO1)  D18 18
           [D5]                        [D8]
        16  D16 (ADC_BAT)       (SCK1)  D17 17 *
           [D6]                        [D7]

    * The XIAO nRF52840 Plus places D17 between D7 and D8 and D19 between D9
      and D10, as shown above. The XIAO ESP32S3 Plus swaps these two positions.
      Parent pins 17 and 19 always refer to the pads labeled D17 (SCK1) and
      D19 (MOSI1) on the pinout of the module, which is also how Seeed Studio
      routes these signals on the carrier boards designed for each module.

    D14, D15 and D16 may share pins with other functions of the module, such
    as NFC or battery voltage measurement, see the board documentation.

    https://wiki.seeedstudio.com/XIAO_BLE/
    https://wiki.seeedstudio.com/xiao_esp32s3_getting_started/

compatible: "seeed,xiao-plus-gpio"

include: [gpio-nexus.yaml, base.yaml]
```

## dts/bindings/gpio/smarc-gpio.yaml
```yaml
# SPDX-FileCopyrightText: Copyright 2026 Ezurio
# SPDX-License-Identifier: Apache-2.0

description: |
    GPIO signals exposed on the SMARC 2.x module connector.

    SMARC (Smart Mobility ARChitecture) is an SGET-standardized computer-on-module
    form factor built around a 314-pin edge connector. This binding provides a
    nexus mapping so carrier-board (shield) overlays can reference SMARC connector
    GPIO-style signals by standardized index values, independent of the SoC or
    expanders on any particular module (e.g. GPIO_IO0..GPIO_IO13, GBE LED pins).

    Cell 0 is the SMARC GPIO_IO signal index. Each module board maps these to its
    own SoC GPIO controller through the nexus gpio-map property. Reference pins
    using the SMARC_GPIO_IO* constants in <dt-bindings/gpio/smarc-gpio.h>, e.g.

        reset-gpios = <&smarc_gpio SMARC_GPIO_IO6 GPIO_ACTIVE_LOW>;

compatible: "smarc-gpio"

include: [gpio-nexus.yaml, base.yaml]
```

## dts/bindings/gpio/snps,designware-gpio.yaml
```yaml
# Copyright (c) 2018 Synopsys, Inc. All rights reserved.
# SPDX-License-Identifier: Apache-2.0

description: Synopsys DesignWare GPIO

compatible: "snps,designware-gpio"

include: [gpio-controller.yaml, base.yaml, pinctrl-device.yaml, reset-device.yaml]

properties:
  reg:
    required: true

  clocks:
    description: |
      Debounce clock (dbclk), with which the debounce logic samples the
      interrupt inputs of port A. Only needed where the SoC gates it; the
      driver enables it at initialization.

  clock-names:
    description: |
      Must be "db" for the debounce clock.
    enum:
      - "db"

  "#gpio-cells":
    const: 2

gpio-cells:
  - pin
  - flags
```

## dts/bindings/gpio/st-zio-header.yaml
```yaml
# Copyright (c) 2026 Michele Vaccari
# SPDX-License-Identifier: Apache-2.0

description: |
  GPIO pins exposed on ST Zio connector.

  The ST Zio connector extends the ARDUINO Uno V3 connectivity. It consists in
  four female headers (CN7, CN8, CN9 and CN10) available on STM32 Nucleo-144
  boards. They can be used to connect ARDUINO Uno V3 compatible shields, while
  exposing additional STM32 signals compared to the ARDUINO Uno V3 connector.

  Use ST_ZIO_* constants in <zephyr/dt-bindings/gpio/st-zio-header.h>
  to refer to specific pins using convenient constant names.

compatible: "st-zio-header"

include: [gpio-nexus.yaml, base.yaml]
```

## dts/bindings/gpio/ti,cc27xx-gpio.yaml
```yaml
# Copyright (c) 2025 Texas Instruments Incorporated
# Copyright (c) 2024 BayLibre, SAS
#
# SPDX-License-Identifier: Apache-2.0

description: TI SimpleLink CC27XX GPIO node

compatible: "ti,cc27xx-gpio"

include: [gpio-controller.yaml, base.yaml]

properties:
  reg:
    required: true

  interrupts:
    required: true

  "#gpio-cells":
    const: 2

gpio-cells:
  - pin
  - flags
```
