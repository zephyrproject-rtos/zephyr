## dts/bindings/gpio/microchip,mcp23xxx.yaml
```yaml
#
# Copyright (c) 2020 Geanix ApS
# Copyright (c) 2021 Peter Johanson
# Copyright (c) 2021 metraTec GmbH
#
# SPDX-License-Identifier: Apache-2.0
#

include: [gpio-controller.yaml]

properties:
  "#gpio-cells":
    const: 2

  int-gpios:
    type: phandle-array
    description: |
        GPIOs connected to the controller INT pin(s).

        With a single entry, the 16 pin parts mirror the interrupts of both
        ports onto that line (IOCON.MIRROR) and only one of INTA/INTB needs
        to be wired. With two entries, the first is INTA (port A, pins 0-7)
        and the second INTB (port B, pins 8-15), and the ports interrupt
        independently. Two entries are only valid on the 16 pin parts.

        The INT pins are push-pull by default and their polarity follows the
        GPIO_ACTIVE_LOW / GPIO_ACTIVE_HIGH flag given here (IOCON.INTPOL);
        both entries must use the same polarity. Set int-open-drain to make
        them open-drain active-low instead.

  int-open-drain:
    type: boolean
    description: |
        Configure the INT pin as an open-drain output (IOCON.ODR). The pin is
        then active-low regardless of the flags in int-gpios, and needs an
        external pull-up (or GPIO_PULL_UP in int-gpios if the host provides
        one). Use this to share one interrupt line between several expanders.

  reset-gpios:
    type: phandle-array
    description: |
        GPIO connected to the controller RESET pin. This pin is active-low.

gpio-cells:
  - pin
  - flags
```

## dts/bindings/gpio/microchip,sam-pio4.yaml
```yaml
# Copyright (C) 2025-2026 Microchip Technology Inc. and its subsidiaries
# SPDX-License-Identifier: Apache-2.0

title: Microchip Parallel Input/Output Controller (PIO)

description: |
  SAM PIO4 GPIO PORT

  This driver supports following hardware peripherals:
    <module name="PIO" id="11264" version="K">
    <module name="PIO" id="11264" version="204">

compatible: "microchip,sam-pio4"

include: [gpio-controller.yaml, base.yaml]

properties:
  reg:
    required: true

  interrupts:
    required: true

  clocks:
    required: true

  "#gpio-cells":
    const: 2

gpio-cells:
  - pin
  - flags
```

## dts/bindings/gpio/microchip,sodimm-connector.yaml
```yaml
# Copyright (c) 2026  Microchip Technology Inc.
# SPDX-License-Identifier: Apache-2.0

description: |
    Microchip's SODIMM connector.

    Microchip’s SODIMM connector is repurposed as a high-density, low-cost
    board-to-board interface rather than a traditional memory expansion slot.
    Microchip frequently uses one-piece, standard 260-pin SODIMM form factors
    on its evaluation boards and host processors to route high-speed
    networking signals to modular expansion cards.

compatible: "microchip,sodimm-connector"

include: [gpio-nexus.yaml, base.yaml]
```

## dts/bindings/gpio/mr-mcxn-t1-header.yaml
```yaml
# SPDX-FileCopyrightText: 2026 CogniPilot Foundation
# SPDX-License-Identifier: Apache-2.0

description: |
    GPIO control lines exposed on the MR-MCXN-T1 stacking header.

    The MR-MCXN-T1 carries a stacking header that mates a series of expansion
    boards (optical flow, GNSS, flex IO). This binding maps the header's raw
    GPIO control lines (sensor interrupts, resets, indicator and user inputs)
    so that expansion-board overlays reference stable nexus names instead of
    SoC GPIO controllers. The multiplexed peripheral buses (SPI, I2C, UART,
    PWM, ADC) are exposed separately as labeled bus nodes on the board
    devicetree.

    The mapped lines are:

        0  Optical flow AFBR-S50 rangefinder interrupt
        1  Optical flow ICM-42688 IMU interrupt
        2  Optical flow ICM-45686 IMU interrupt
        3  Optical flow PAA3905 flow-sensor interrupt
        4  GNSS u-blox F9P reset
        5  GNSS RM3100 magnetometer data-ready
        6  GNSS fix-status indicator
        7  GNSS F9P external-interrupt time-mark
        8  User input 0
        9  User input 1

compatible: "mr-mcxn-t1-header"

include: [gpio-nexus.yaml, base.yaml]
```

## dts/bindings/gpio/nordic,nrf71-p4-gpio.yaml
```yaml
# Copyright (c) 2026 Nordic Semiconductor ASA
# SPDX-License-Identifier: Apache-2.0

description: |
  Nordic nRF71 GPIO port.

  Extends the generic nordic,nrf-gpio binding with pad voltage selection for
  PORTCNF.PWRCTRL, available on GPIO ports with a switchable floating-ground
  supply rail (currently only P4 on nRF7120).

compatible: "nordic,nrf71-p4-gpio"

include: nordic,nrf-gpio.yaml

properties:
  nordic,pad-voltage:
    type: string
    enum:
      - "1v8"
      - "3v3"
    default: "3v3"
    description: |
      Pad voltage for this port's floating-ground supply rail (PORTCNF.PWRCTRL).

      WARNING!
      If selecting 1v8, you must drive the VIOP4 with roughly 1.8V. Driving it
      with 3.3V will damage this port.
```

## dts/bindings/gpio/nxp,imx-gpio-v2.yaml
```yaml
# Copyright 2026 NXP
# SPDX-License-Identifier: Apache-2.0

description: |
  NXP i.MX GPIO controller.

  Pin mux is handled by an external IOMUXC controller; the driver requires a
  per-port "pinmux" phandle list (when CONFIG_PINCTRL=y) because the IOMUXC
  does not follow a fixed GPIO-port-to-pad mapping.

compatible: "nxp,imx-gpio-v2"

include: [gpio-controller.yaml, base.yaml]

properties:
  reg:
    required: true

  clocks:
    description: |
      Clock gate for this GPIO port. Optional: VBAT-domain instances are
      permanently powered and carry no gate; omit this property for those
      nodes. All other instances (HSP and WAKE domain) gate through the CCM
      LPCG and must provide this property so the driver opens the gate at
      init.

  pinmux:
    type: phandles
    description: |
      Ordered list of IOMUXC pinmux nodes, one per pad that can be assigned
      to this GPIO port, in pin-number order. Required when CONFIG_PINCTRL=y.
      The IOMUXC on this SoC has no fixed GPIO-to-pad mapping, so the list
      must be provided explicitly.

  irq-output-select:
    type: int
    default: 0
    description: |
      Which of the two NVIC interrupt lines this port routes its requests to.
        0 = first IRQ line, channel A (default)
        1 = second IRQ line, channel B
    enum:
      - 0
      - 1

  "#gpio-cells":
    const: 2

gpio-cells:
  - pin
  - flags
```

## dts/bindings/gpio/nxp,imx-rgpio.yaml
```yaml
# Copyright 2024 NXP
# SPDX-License-Identifier: Apache-2.0

description: i.MX RGPIO

compatible: "nxp,imx-rgpio"

include: [gpio-controller.yaml, base.yaml, "nxp,rdc-policy.yaml"]

properties:
  reg:
    required: true

  clocks:
    description: |
      Clock gate for this port, when the SoC has one that software must open.

      Optional: on SoCs where the RGPIO block is permanently clocked from its
      subsystem bus clock, leave it out and the driver makes no clock call. On
      SoCs that gate it -- the i.MX RT266x parts, for example, come out of reset
      with the RGPIO gate closed -- the driver opens the gate during init, so it
      must be given here rather than opened from board code.

  pinmux:
    type: phandles
    description: |
      IMX pin selection peripheral does not follow specific
      pattern for which GPIO port uses which pinmux. Use this property to specify
      pinctrl nodes to use for the gpio port when CONFIG_PINCTRL=y. Note that
      the order of the nodes matters. The first node for gpio1 will be used
      as the pinmux for gpio0, port 0.

  "#gpio-cells":
    const: 2

  irq-output-select:
    type: int
    default: 0
    description: |
      Select which IRQ line the GPIO controller outputs to.
      0 = First IRQ line (default)
      1 = Second IRQ line
    enum:
      - 0
      - 1

gpio-cells:
  - pin
  - flags
```

## dts/bindings/gpio/nxp,pca-series-gpio-port.yaml
```yaml
# Copyright 2026 Ezurio
# SPDX-License-Identifier: Apache-2.0

title: NXP PCA series I2C GPIO expander segment

description: |
  A Zephyr GPIO controller is limited to 32 pins, so a PCA series expander
  node only covers its first 32 pins. On parts with more pins, the remaining
  pins are exposed by optional child nodes of this type. Each one is a
  separate GPIO controller covering up to 32 pins, sharing the expander I2C
  bus, lock and interrupt.

  Currently supported parts with more than 32 pins:
    - PCAL6534: pins 32-33 (P4_0, P4_1), with "reg = <4>" and "ngpios = <2>".

  Example:

    pcal6534: pcal6534@22 {
      compatible = "nxp,pcal6534";
      reg = <0x22>;
      gpio-controller;
      #gpio-cells = <2>;
      ngpios = <32>;
      #address-cells = <1>;
      #size-cells = <0>;

      pcal6534_p4: gpio-port@4 {
        compatible = "nxp,pca-series-gpio-port";
        reg = <4>;
        gpio-controller;
        #gpio-cells = <2>;
        ngpios = <2>;
      };
    };

compatible: "nxp,pca-series-gpio-port"

include: [gpio-controller.yaml, base.yaml]

properties:
  reg:
    required: true
    description: |
      First 8-pin hardware port of the segment. Must be a multiple of 4, so
      each segment starts on a 32-pin boundary.

  "#gpio-cells":
    const: 2

  ngpios:
    required: true
    min: 1
    max: 32
    description: |
      Number of pins of the segment, from 1 to 32. The segment must not
      extend past the last pin of the part.

gpio-cells:
  - pin
  - flags
```

## dts/bindings/gpio/nxp,pca9554.yaml
```yaml
# Copyright 2024 NXP
# SPDX-License-Identifier: Apache-2.0
description: NXP PCA9554 I2C GPIO expander

compatible: "nxp,pca9554"

include: nxp,pca_series.yaml

properties:
  ngpios:
    const: 8
```

## dts/bindings/gpio/nxp,pcal6534.yaml
```yaml
# Copyright 2024 NXP
# SPDX-License-Identifier: Apache-2.0
description: |
  NXP PCAL6534 I2C GPIO expander

  This node covers pins 0-31 (P0_0..P3_7). Pins 32-33 (P4_0, P4_1) are
  exposed by an optional "nxp,pca-series-gpio-port" child node, which
  requires #address-cells = <1> and #size-cells = <0> on this node.

compatible: "nxp,pcal6534"

include: nxp,pca_series.yaml

properties:
  ngpios:
    required: true
    const: 32
```

## dts/bindings/gpio/nxp,sc18is606-gpio.yaml
```yaml
#
# SPDX-FileCopyrightText: Copyright tinyvision.ai
#
# SPDX-License-Identifier: Apache-2.0
#
description: |
  GPIO Controller part for the SC18IS606 bridge.
  Any compatible node shall be a child of an nxp,sc18is60x family node.
  Deprecated in favor of nxp,sc18is60x-gpio.

compatible: "nxp,sc18is606-gpio"

on-bus: nxp,sc18is60x

include: gpio-controller.yaml

properties:
  "#gpio-cells":
    required: true
    const: 2

  ngpios:
    const: 3

gpio-cells:
  - pin
  - flags
```

## dts/bindings/gpio/nxp,sc18is60x-gpio.yaml
```yaml
#
# SPDX-FileCopyrightText: Copyright Alif Semiconductor
#
# SPDX-License-Identifier: Apache-2.0
#
description: |
  GPIO controller part for an NXP SC18IS60x bridge.
  Any compatible node shall be a child of an SC18IS60x MFD parent.

compatible: "nxp,sc18is60x-gpio"

include: gpio-controller.yaml

on-bus: nxp,sc18is60x

properties:
  "#gpio-cells":
    required: true
    const: 2

  ngpios:
    required: true

gpio-cells:
  - pin
  - flags
```

## dts/bindings/gpio/pixhawk-full-gps-connector.yaml
```yaml
# SPDX-FileCopyrightText: Copyright The Zephyr Project Contributors
# SPDX-License-Identifier: Apache-2.0

title: Pixhawk full GPS connector

description: |
  10-pin JST-GH port combining a serial port, an I2C bus, a safety switch,
  its LED and a buzzer, as defined by the Pixhawk Connector Standard
  (DS-009) as the Full GPS plus Safety Switch port. Flight controllers use
  it for GNSS units with an integrated magnetometer, safety switch and
  buzzer.

  This binding provides a nexus mapping for the signal pins, indexed by
  connector pin number. Use the PIXHAWK_FULL_GPS_* constants in
  <zephyr/dt-bindings/gpio/pixhawk-connector.h> to refer to them.

    1  VCC (5 V)
    2  TX (output)
    3  RX (input)
    4  SCL
    5  SDA
    6  Safety switch (input)
    7  Safety LED (output)
    8  VDD 3.3 V (powers the switch and the LED)
    9  Buzzer (output, from a buzzer driver)
    10 GND

  See https://github.com/pixhawk/Pixhawk-Standards for the standard.

compatible: "pixhawk-full-gps-connector"

include: [gpio-nexus.yaml, base.yaml]
```

## dts/bindings/gpio/pixhawk-gps-connector.yaml
```yaml
# SPDX-FileCopyrightText: Copyright The Zephyr Project Contributors
# SPDX-License-Identifier: Apache-2.0

title: Pixhawk GPS connector

description: |
  6-pin JST-GH port combining a serial port and an I2C bus, as defined by
  the Pixhawk Connector Standard (DS-009). Flight controllers use it for
  GNSS receivers with an integrated magnetometer. See
  pixhawk-full-gps-connector for the 10-pin full GPS port.

  This binding provides a nexus mapping for the signal pins, indexed by
  connector pin number. Use the PIXHAWK_GPS_* constants in
  <zephyr/dt-bindings/gpio/pixhawk-connector.h> to refer to them.

    1  VCC (5 V)
    2  TX (output)
    3  RX (input)
    4  SCL
    5  SDA
    6  GND

  See https://github.com/pixhawk/Pixhawk-Standards for the standard.

compatible: "pixhawk-gps-connector"

include: [gpio-nexus.yaml, base.yaml]
```

## dts/bindings/gpio/pixhawk-i2c-connector.yaml
```yaml
# SPDX-FileCopyrightText: Copyright The Zephyr Project Contributors
# SPDX-License-Identifier: Apache-2.0

title: Pixhawk I2C connector

description: |
  4-pin JST-GH I2C port, as defined by the Pixhawk Connector Standard
  (DS-009).

  This binding provides a nexus mapping for the signal pins, indexed by
  connector pin number. Use the PIXHAWK_I2C_* constants in
  <zephyr/dt-bindings/gpio/pixhawk-connector.h> to refer to them.

    1  VCC (5 V)
    2  SCL
    3  SDA
    4  GND

  See https://github.com/pixhawk/Pixhawk-Standards for the standard.

compatible: "pixhawk-i2c-connector"

include: [gpio-nexus.yaml, base.yaml]
```

## dts/bindings/gpio/pixhawk-telem-connector.yaml
```yaml
# SPDX-FileCopyrightText: Copyright The Zephyr Project Contributors
# SPDX-License-Identifier: Apache-2.0

title: Pixhawk TELEM connector

description: |
  6-pin JST-GH serial port with hardware flow control, as defined by the
  Pixhawk Connector Standard (DS-009). Flight controllers use TELEM ports
  for telemetry radios and companion computers.

  This binding provides a nexus mapping for the signal pins, indexed by
  connector pin number. Use the PIXHAWK_TELEM_* constants in
  <zephyr/dt-bindings/gpio/pixhawk-connector.h> to refer to them.

    1  VCC (5 V)
    2  TX (output)
    3  RX (input)
    4  CTS (input)
    5  RTS (output)
    6  GND

  See https://github.com/pixhawk/Pixhawk-Standards for the standard.

compatible: "pixhawk-telem-connector"

include: [gpio-nexus.yaml, base.yaml]
```

## dts/bindings/gpio/raspberrypi,touchscreen-panel-regulator-v2.yaml
```yaml
# Copyright (c) 2026 Texas Instruments Incorporated
# SPDX-License-Identifier: Apache-2.0

description: |
  Raspberry Pi Touch Display 2 panel-regulator/GPIO board (v2).

  This chip sits on I2C and exposes GPIO-like control lines used by the
  official 7-inch DSI touchscreen daughter card:
    pin 0 - panel reset / backlight enable
    pin 1 - touch controller AVDD28 power-cycle (acts as the touch IC's
            reset, per the upstream vc4-kms-dsi-ili9881-7inch-overlay.dts)

compatible: "raspberrypi,touchscreen-panel-regulator-v2"

include: [i2c-device.yaml, gpio-controller.yaml]

properties:
  "#gpio-cells":
    const: 2

gpio-cells:
  - pin
  - flags
```

## dts/bindings/gpio/renesas,rafw-gpio.yaml
```yaml
# SPDX-FileCopyrightText: 2026 Renesas Electronics Corporation
# SPDX-License-Identifier: Apache-2.0

description: Renesas RAFW GPIO node

compatible: "renesas,rafw-gpio"

include: [gpio-controller.yaml, base.yaml]

properties:
  reg:
    required: true

  port:
    type: int
    required: true

  "#gpio-cells":
    const: 2

gpio-cells:
  - pin
  - flags
```
