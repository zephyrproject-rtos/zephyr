## dts/bindings/gpio/intel,qmsi-ss-gpio.yaml
```yaml
# Copyright (c) 2018 Intel Corporation
# SPDX-License-Identifier: Apache-2.0

title: Intel QMSI SS GPIO

description: >
    This is a representation of the Intel QMSI SS GPIO nodes

compatible: "intel,qmsi-ss-gpio"

include: [gpio-controller.yaml, base.yaml]

properties:
    reg:
      required: true

    interrupts:
      required: true

    label:
      required: true

    "#gpio-cells":
      const: 2

"#cells":
  - pin
  - flags
```

## dts/bindings/gpio/intel,sedi-gpio.yaml
```yaml
#
# Copyright (c) 2023 Intel Corporation.
#
# SPDX-License-Identifier: Apache-2.0
#

description: Intel SEDI GPIO

compatible: "intel,sedi-gpio"

include: [gpio-controller.yaml, base.yaml]

properties:
  reg:
    required: true

  interrupts:
    required: true

  peripheral-id:
    type: int
    description: Peripheral Instance ID
    required: true

  "#gpio-cells":
    const: 2

gpio-cells:
  - pin
  - flags
```

## dts/bindings/gpio/intel,socfpga-gpio.yaml
```yaml
# Copyright (C) 2022-2023 Intel Corporation
# SPDX-License-Identifier: Apache-2.0

description: Intel SoCFPGA GPIO node

compatible: "intel,socfpga-gpio"

include: [gpio-controller.yaml, base.yaml, reset-device.yaml]

properties:
    reg:
      required: true

    "#gpio-cells":
      const: 2

gpio-cells:
  - pin
  - flags
```

## dts/bindings/gpio/ite,it51xxx-gpio.yaml
```yaml
# Copyright (c) 2025 ITE Corporation. All Rights Reserved.
# SPDX-License-Identifier: Apache-2.0

description: This binding gives a base representation of the it51xxx series gpio

compatible: "ite,it51xxx-gpio"

include: [gpio-controller.yaml, base.yaml]

properties:
  reg:
    required: true

  has-volt-sel:
    type: array
    description: |
      Selection of support input voltage 3.3V or 1.8V.

  wucctrl:
    type: phandles
    description: |
      WUC groups internal and external inputs, and asserts wake-up
      signals to INTC that allows the CPU to exit a Doze/Deep
      Doze/Sleep mode.

gpio-cells:
  - pin
  - flags
```

## dts/bindings/gpio/ite,it8801-gpio.yaml
```yaml
# Copyright (c) 2024 ITE Corporation. All Rights Reserved.
# SPDX-License-Identifier: Apache-2.0

description: ITE IT8801 I2C-based GPIO

compatible: "ite,it8801-gpio"

include: [base.yaml, gpio-controller.yaml]

properties:
  reg:
    required: true

  pin-mask:
    type: int
    required: true
    description: |
      Not every GPIO pins are usable for IT8801. This property
      indicates the usable GPIO pin mask.

gpio-cells:
  - pin
  - flags
```

## dts/bindings/gpio/ite,it8xxx2-gpio-v2.yaml
```yaml
# Copyright (c) 2023 ITE Corporation. All Rights Reserved.
# SPDX-License-Identifier: Apache-2.0

description: ITE IT8xxx2 GPIO V2

compatible: "ite,it8xxx2-gpio-v2"

include: [gpio-controller.yaml, base.yaml]

properties:
  reg:
    required: true

  has-volt-sel:
    type: array
    description: |
      Selection of support input voltage 3.3V or 1.8V.

  wuc-base:
    type: array
    description: |
      WUCs are mapped to the pins of GPIO.
      The WUC groups internal and external inputs, and asserts
      a wake-up signal to the INTC, allowing the CPU to exit
      Doze/Deep Doze/Sleep modes.

  wuc-mask:
    type: array

  keyboard-controller:
    type: boolean
    description: |
      When set, this GPIO controller has pins associated with the
      keyboard controller. In this case the reg_gpcr property is
      overloaded and used to write the keyboard GCTRL register.
      This setting will be found in the gpio_ite_configure function
      when the judgment of gpio_config->ksb_ctrl is true.
      The GPIO control register that will be set for these three
      nodes is as follows:
      gpioksi:  0xf01d40-0xf01d47
      gpioksol: 0xf01d48-0xf01d4f
      gpioksoh: 0xf01d50-0xf01d57

gpio-cells:
  - pin
  - flags
```

## dts/bindings/gpio/ite,it8xxx2-gpio.yaml
```yaml
# Copyright (c) 2020 ITE Corporation. All Rights Reserved.
# SPDX-License-Identifier: Apache-2.0

description: ITE IT8xxx2 GPIO

compatible: "ite,it8xxx2-gpio"

include: [gpio-controller.yaml, base.yaml]

properties:
  reg:
    required: true

gpio-cells:
  - pin
  - flags
```

## dts/bindings/gpio/ite,it8xxx2-gpiokscan.yaml
```yaml
# Copyright (c) 2022 ITE Corporation. All Rights Reserved.
# SPDX-License-Identifier: Apache-2.0

description: ITE IT8xxx2 Kscan Pins as GPIO

compatible: "ite,it8xxx2-gpiokscan"

include: [base.yaml, gpio-controller.yaml]

properties:
  reg:
    required: true

gpio-cells:
  - pin
  - flags
```

## dts/bindings/gpio/kinetic,kts162x.yaml
```yaml
# Copyright (c) 2025 Atmosic
#
# SPDX-License-Identifier: Apache-2.0

description: KTS162x 16/24-bit I2C-based I/O expander

compatible: "kinetic,kts162x"

include: [i2c-device.yaml, gpio-controller.yaml]

properties:
  ngpios:
    required: true
    enum:
      - 16
      - 24

  int-gpios:
    type: phandle-array
    description: |
      GPIO connected to the controller INT pin. This pin is active-low.

  "#gpio-cells":
    const: 2

gpio-cells:
  - pin
  - flags
```

## dts/bindings/gpio/linaro,96b-lscon-1v8.yaml
```yaml
# Copyright (c) 2019 Linaro Ltd.
# SPDX-License-Identifier: Apache-2.0

description: GPIO Pin exposed on the 96Boards 1.8v low-speed header

compatible: "linaro,96b-lscon-1v8"

include: [gpio-nexus.yaml, base.yaml]
```

## dts/bindings/gpio/litex,gpio.yaml
```yaml
#
# Copyright (c) 2019 Antmicro <www.antmicro.com>
#
# SPDX-License-Identifier: Apache-2.0
#

description: Litex GPIO

compatible: "litex,gpio"

include: [gpio-controller.yaml, base.yaml]

properties:
  reg:
    required: true

  ngpios:
    required: true

  "#gpio-cells":
    const: 2

gpio-cells:
  - pin
  - flags
```

## dts/bindings/gpio/m5stack,atom-header.yaml
```yaml
# Copyright (c) 2023 Martin Kiepfer <mrmarteng@teleschirm.org>
# SPDX-License-Identifier: Apache-2.0

description: |
    Pin-header exposed on M5Stack Atom devices.

    This binding provides a nexus mapping for 9 pins as depicted below.

        x  3.3V
        0  GPIO                 1  SCL
        2  GPIO/MOSI            3  GPIO/DAC0/SDA
        4  GPIO/CLK             5  5V
        6  GPIO/ADC0/MISO       7  GND

compatible: "m5stack,atom-header"

include: [gpio-nexus.yaml, base.yaml]
```

## dts/bindings/gpio/m5stack,m5pm1-gpio.yaml
```yaml
# Copyright (c) 2026 The Zephyr Project Contributors
# SPDX-License-Identifier: Apache-2.0

description: M5Stack M5PM1 GPIO controller

compatible: "m5stack,m5pm1-gpio"

include: gpio-controller.yaml

on-bus: m5pm1

properties:
  "#gpio-cells":
    const: 2

gpio-cells:
  - pin
  - flags
```

## dts/bindings/gpio/m5stack,mbus-header.yaml
```yaml
# Copyright (c) 2023 Martin Kiepfer
# SPDX-License-Identifier: Apache-2.0

description: |
    GPIO pins exposed on M5Stack M-Bus headers.

    This binding provides a nexus mapping for 30 pins as depicted below.

        0  GND                  1  ADC0
        2  GND                  3  ADC1
        4  GND                  5  RESET
        6  MOSI                 7  DAC0
        8  MISO                 9  DAC1
        10 SCK                  11 3.3V
        12 RXD0                 13 TXD0
        14 RXD1                 15 TXD1
        16 intSDA               17 intSCL
        18 SDA                  19 SCL
        20 GPIO                 21 GPIO
        22 GPIO                 23 GPIO
        24 NC                   25 GPIO
        26 NC                   27 5V
        28 NC                   29 BAT


compatible: "m5stack,mbus-header"

include: [gpio-nexus.yaml, base.yaml]
```

## dts/bindings/gpio/m5stack,stamps3-header.yaml
```yaml
# Copyright (c) 2023 Martin Kiepfer
# SPDX-License-Identifier: Apache-2.0

description: |
    GPIO pins exposed on M5Stack StampS3 module headers.

    This binding provides a nexus mapping for 28 pins as depicted below.

         0 GPIO
         1 GPIO
         2 GPIO/CLKOUT0
         3 GPIO
         4 GPIO/SPILCD
         5 GPIO/SPILCD
         6 GPIO/SPILCD      27 3V3
         7 GPIO             26 GPIO
         8 GPIO/CLKOUT0     25 GPIO/CLKOUT/TXD
         9 GPIO             24 GPIO
        10 GND              23 GPIO/CLKOUT/RXD
        11 GPIO/SDA1        22 GPIO/CLKOUT
        12 5V               21 EN
        13 GPIO/SCL1        20 GPIO/CLKOUT
        14 GPIO/SDA0        19 GPIO
        15 GPIO             18 GPIO/CLKOUT
        16 GPIO/SCL0        17 GND

    Note: Please note that the StampS3 is not pin compatible to the
    other Stamp variantes like StampC3 or Stamp-Pico.


compatible: "m5stack,stamps3-header"

include: [gpio-nexus.yaml, base.yaml]
```

## dts/bindings/gpio/microbit,edge-connector.yaml
```yaml
# Copyright (c) 2020 Micro:bit Educational Foundation
# SPDX-License-Identifier: Apache-2.0

description: |
    GPIO pins exposed on BBC MicroBit headers.

    The edge connector on the micro:bit is used to connect to external
    circuits and components.

    There are 25 strips/pins including 5 rings for using with 4mm banana
    plugs or crocodile clips. 3 of these rings are for general purpose
    input and output (GPIO) and are also capable of analog, PWM and touch
    sensing, and two are connected to the micro:bit power supply.

    The smaller strips spaced at 1.27mm on the edge connector have additional
    signals, some of which are used by the micro:bit, and others that are free
    for you to use. There are a number of external PCB connectors for purchase
    with an 80w 1.27mm pitch that can be used to easily access these extra pins.

    Only the pins on the front are connected to signals. The back rings are
    connected to the front rings, but the back small strips are unconnected.

    Pin assignments can be found at:
    https://tech.microbit.org/hardware/edgeconnector/#edge-connector-pins

compatible: "microbit,edge-connector"

include: [gpio-nexus.yaml, base.yaml]
```

## dts/bindings/gpio/microchip,dspic-gpio.yaml
```yaml
# microchip,dspic-gpio.yaml

description: |
  Group of GPIO-controlled LEDs.

  Each LED is defined in a child node of the gpio-leds node.

  Here is an example which defines three LEDs in the node /leds:

  / {
    leds {
      compatible = "gpio-leds";
      led_0 {
        gpios = <&gpio0 1 GPIO_ACTIVE_LOW>;
      };
      led_1 {
        gpios = <&gpio0 2 GPIO_ACTIVE_HIGH>;
      };
      led_2 {
        gpios = <&gpio1 15 (GPIO_PULL_UP | GPIO_ACTIVE_LOW)>;
      };
    };
  };

  Above:

  - led_0 is pin 1 on gpio0. The LED is on when the pin is low,
    and off when the pin is high.
  - led_1 is pin 2 on gpio0. The LED is on when the pin is high,
    and off when it is low.
  - led_2 is pin 15 on gpio1. The LED is on when the pin is low,
    and the pin's internal pull-up resistor should be enabled.

compatible: "microchip,dspic-gpio"

include: [gpio-controller.yaml]

properties:
  reg:
    type: array
    required: true

  gpio-controller: {}

  "#gpio-cells":
    type: int
    const: 2

gpio-cells:
  - pin
  - flags
```

## dts/bindings/gpio/microchip,gpio-g2.yaml
```yaml
# Copyright (c) 2025 Microchip Technology Inc.
# SPDX-License-Identifier: Apache-2.0

description: MICROCHIP GPIO PORT node

compatible: "microchip,gpio-g2"

include: [gpio-controller.yaml, base.yaml]

properties:
  reg:
    required: true

  "#gpio-cells":
    const: 2

gpio-cells:
  - pin
  - flags
```

## dts/bindings/gpio/microchip,mcp23008-gpio.yaml
```yaml
# Copyright (c) 2020 Ioannis Papamanoglou
# SPDX-License-Identifier: Apache-2.0

description: MCP23008 GPIO node

compatible: "microchip,mcp23008"

include: [i2c-device.yaml, gpio-controller.yaml]

properties:
    label:
      required: true

    "#gpio-cells":
      const: 2

    ngpios:
      required: true
      const: 8

    irq-enable:
      type: boolean
      required: false
      description: "Enable non-polling-based irq functionality"

    irq-gpios:
      type: phandle-array
      required: false
      description: "INT pin"

    int-pol:
      type: boolean
      required: false
      description: "Set INT pin to Active-high"

    int-odr:
      type: boolean
      required: false
      description: "Configure INT pin as open drain"

    reset-enable:
      type: boolean
      required: false
      description: "Enables hardware reset functionality"

    reset-gpios:
      type: phandle-array
      required: false
      description: "RESET pin"

    i2c-disslw:
      type: boolean
      required: false
      description: "Disable slew rate on SDA output"

gpio-cells:
  - pin
  - flags
```

## dts/bindings/gpio/microchip,mcp23008.yaml
```yaml
#
# Copyright (c) 2021 metraTec GmbH
#
# SPDX-License-Identifier: Apache-2.0
#

description: |
    This is a representation of the Microchip MCP23008 I2C Gpio Expander.

compatible: "microchip,mcp23008"

include: [gpio-controller.yaml, i2c-device.yaml]

properties:
    label:
      required: true

    ngpios:
      const: 8
      required: true
      description: |
        Number of gpios supported by the chip.

gpio-cells:
  - pin
  - flags
```

## dts/bindings/gpio/microchip,mcp23009.yaml
```yaml
#
# Copyright (c) 2024 SILA Embedded Solutions GmbH
#
# SPDX-License-Identifier: Apache-2.0
#

description: Microchip MCP23009 I2C GPIO Expander.

compatible: "microchip,mcp23009"

include: ["microchip,mcp23xxx.yaml", i2c-device.yaml]
```

## dts/bindings/gpio/microchip,mcp23016.yaml
```yaml
#
# Copyright (c) 2024 SILA Embedded Solutions GmbH
#
# SPDX-License-Identifier: Apache-2.0
#

description: This is a representation of the Microchip MCP23016 I2C GPIO Expander.

compatible: "microchip,mcp23016"

include: ["microchip,mcp23xxx.yaml", i2c-device.yaml]
```

## dts/bindings/gpio/microchip,mcp23017.yaml
```yaml
#
# Copyright (c) 2024 SILA Embedded Solutions GmbH
#
# SPDX-License-Identifier: Apache-2.0
#

description: Microchip MCP23017 I2C GPIO Expander.

compatible: "microchip,mcp23017"

include: ["microchip,mcp23xxx.yaml", i2c-device.yaml]
```

## dts/bindings/gpio/microchip,mcp23018.yaml
```yaml
#
# Copyright (c) 2024 SILA Embedded Solutions GmbH
#
# SPDX-License-Identifier: Apache-2.0
#

description: Microchip MCP23018 I2C GPIO Expander.

compatible: "microchip,mcp23018"

include: ["microchip,mcp23xxx.yaml", i2c-device.yaml]
```

## dts/bindings/gpio/microchip,mcp230xx.yaml
```yaml
#
# Copyright (c) 2021 metraTec GmbH
#
# SPDX-License-Identifier: Apache-2.0
#

description: |
    This is a representation of the Microchip MCP230xx I2C Gpio Expander.

compatible: "microchip,mcp230xx"

include: ["microchip,mcp23xxx.yaml", i2c-device.yaml]
```
