## dts/bindings/clock/at,at32-hext.yaml
```yaml
# Copyright (c) 2021, Linaro ltd
# SPDX-License-Identifier: Apache-2.0

description: AT32 HEXT Clock

compatible: "at,at32-hext"

include: [fixed-clock.yaml]

properties:
  hext-bypass:
    type: boolean
    description: |
      HEXT crystal oscillator bypass
      Set to the property to by-pass the oscillator with an external clock.

  css-enabled:
    type: boolean
    description: |
      HEXT clock security system enabled.

      If a failure is detected on the HSE clock, the HSE oscillator is automatically disabled,
      a clock failure event is sent to timers, and a non-maskable interrupt is generated to
      inform the software about the failure, allowing the MCU to perform rescue operations.
      See the MCU reference manual for details.

      The interaction of CSS and low-power modes is unclear from the documentation.
      For at least some devices Zephyr will reconfigure the clocks on resuming from low-power
      modes; this will include re-enabling CSS. However it is important that you verify
      this for your own hardware.
```

## dts/bindings/clock/at,at32-pll.yaml
```yaml
# Copyright (c) 2021, Linaro ltd
# SPDX-License-Identifier: Apache-2.0

description: |
  AT32 Main PLL node binding:

  Takes one of clk_hext or clk_hick as input clock.


compatible: "at,at32-pll"

include: [clock-controller.yaml, base.yaml]

properties:
  "#clock-cells":
    const: 0

  clocks:
    required: true

  div-ms:
    type: int
    required: true
    description: |
        Division factor for the PLL input clock
        Valid range: 2 - 63

  mul-ns:
    type: int
    required: true
    description: |
        Main PLL multiplication factor for VCO
        Valid range: 50 - 432

  div-fp:
    type: int
    required: true
    description: |
        Main PLL division factor for PLLSAI2CLK
    enum:
      - 2
      - 4
      - 6
      - 8

  div-fu:
    type: int
    description: |
        Main PLL (PLL) division factor for USB OTG FS, SDMMC and random number
        generator clocks.
        Valid range: 2 - 15
```

## dts/bindings/clock/atmel,assigned-clocks.yaml
```yaml
# Copyright (c) 2024, Gerson Fernando Budke <nandojve@gmail.com>
# SPDX-License-Identifier: Apache-2.0

properties:
  atmel,assigned-clocks:
    type: phandle-array
    description: Assigned-clock information

  atmel,assigned-clock-names:
    type: string-array
    description: Name of each assigned-clock
```

## dts/bindings/clock/atmel,sam0-dfll.yaml
```yaml
#
# Copyright (c) 2019 Derek Hageman <hageman@inthat.cloud>
#
# SPDX-License-Identifier: Apache-2.0
#

title: SAM0 Digital Frequency Locked Loop (DFLL)
version: 0.1

description: >
    This is a representation of a SAM0 fixed frequency Digital Frequency
    Locked loop.  This is a fixed frequency clock that can optionally use
    a reference input to adjust its calibration dynamically.

inherits:
    !include clock.yaml

properties:
    compatible:
      constraint: "atmel,sam0-dfll"

    clock-output-names:
      category: required

    clock-frequency:
      type: int
      description: >
        Output frequency of the DFLL.  This is fixed but determined by the
        SoC hardware.
      category: required
```

## dts/bindings/clock/atmel,sam0-fdpll.yaml
```yaml
#
# Copyright (c) 2019 Derek Hageman <hageman@inthat.cloud>
#
# SPDX-License-Identifier: Apache-2.0
#

title: SAM0 Fractional Digital Phase Locked Loop (FDPLL)
version: 0.1

description: >
    This is a representation of a SAM0 Fractional Digital Phase Locked Loop.
    This is a programmable multiplier on an input reference clock.

inherits:
    !include clock.yaml

properties:
    compatible:
      constraint: "atmel,sam0-fdpll"

    clock-output-names:
      category: required

    clocks:
      category: required

    clock-frequency:
      type: int
      description: >
        Final output frequency of the the FDPLL.  This is used to calculate
        the hardware parameters of the FDPLL required to produce the requested
        frequency.
      category: required
```

## dts/bindings/clock/atmel,sam0-gclk.yaml
```yaml
# Copyright (c) 2024 Gerson Fernando Budke <nandojve@gmail.com>
# SPDX-License-Identifier: Apache-2.0

description: Atmel SAMD0 Generic Clock Controller (GCLK)

compatible: "atmel,sam0-gclk"

include:
  - base.yaml
  - clock-controller.yaml
  - atmel,assigned-clocks.yaml

properties:
  reg:
    required: true

  "#clock-cells":
    const: 1
    description: |
      - The ID cell is the peripheral identification.

      These information are used on GCLK->CLKCTRL register to select the
      clock for an specific peripheral.

      Example 1: Connect the XOSC32K to RTC on SAMD2x
        Assuming that generator 2 have the following configuration:
          GLKC->GENCTRL:
            SRC: 5 (XOSC32K)
            ID:  2 (Generator 2)

        Then to enable the clock to the peripheral
        Generator:     2
        Identificator: 4 (GCLK_RTC)

          &rtc {
            /* The peripheral is fixed and it is defined at soc devictree
             * clocks property
             */
            clocks = <&gclk 4>, <&pm 0x18 5>;
            clock-names = "GCLK", "PM";

            /* The generator is user selectable and because of that it is
             * defined at board
             */
            atmel,assigned-clocks = <&gclk 2>;
            atmel,assigned-clock-names = "GCLK";
          };

      Example 2: Connect the XOSC32K to RTC on SAMD5x
        In the SAMD5x the RTC is direct connected on the OSC32KCTRL and no
        generator is used. See atmel,sam0-osc32kctrl.yaml for reference.

  "#atmel,assigned-clock-cells":
    required: true
    type: int
    const: 1
    description: |
      - The GEN cell is an integer number that represents the index of
      the generic clock generator. It is usually a number between 0~8
      but could be more depending of the SoC.

clock-cells:
  - id

atmel,assigned-clock-cells:
  - gen
```

## dts/bindings/clock/atmel,sam0-mclk.yaml
```yaml
# Copyright (c) 2024 Gerson Fernando Budke <nandojve@gmail.com>
# SPDX-License-Identifier: Apache-2.0

description: Atmel SAM0 Main Clock Controller (MCLK)

compatible: "atmel,sam0-mclk"

include:
  - base.yaml
  - clock-controller.yaml

properties:
  reg:
    required: true

  "#clock-cells":
    const: 2
    description: |
      - The OFFSET cell is an address of a bus mask. The buses can be
      AHB and APB[A-D]. Each bus mask can enable a paripheral clock
      selecting the BIT position in the mask.
      - The BIT cell is the peripheral bit mask.

      These information are used on PM and MCLK register to select the
      clock for an specific peripheral. The generator 2 is used on this
      example and can be defined by the user at board.

      Example: Enable SERCOM0 on SAMD21
        &sercom0 {
          clocks = <&gclk 0x14>, <&pm 0x20 2>;
          clock-names = "GCLK", "PM";

          atmel,assigned-clocks = <&gclk 2>;
          atmel,assigned-clock-names = "GCLK";
        };

      Example: Enable SERCOM0 on SAME54
        &sercom0 {
          clocks = <&gclk 7>, <&mclk 0x14 12>;
          clock-names = "GCLK", "MCLK";

          atmel,assigned-clocks = <&gclk 2>;
          atmel,assigned-clock-names = "GCLK";
        };

clock-cells:
  - offset
  - bit
```

## dts/bindings/clock/atmel,sam0-osc32kctrl.yaml
```yaml
# Copyright (c) 2024 Gerson Fernando Budke <nandojve@gmail.com>
# SPDX-License-Identifier: Apache-2.0

description: Atmel SAM0 32kHz Oscillator Controller (OSC32KCTRL)

compatible: "atmel,sam0-osc32kctrl"

include:
  - base.yaml
  - clock-controller.yaml
  - atmel,assigned-clocks.yaml

properties:
  reg:
    required: true

  "#clock-cells":
    const: 0

  "#atmel,assigned-clock-cells":
    required: true
    type: int
    const: 1
    description: |
      It selects the OSC32CTRL clock to be routed to RTC peripheral

      Example: Connect the XOSC32K to RTC on SAMD5x

        &rtc {
          clocks = <&mclk 0x14 9 &osc32kctrl>;
          clock-names = "MCLK", "OSC32KCTRL";

          atmel,assigned-clocks = <&osc32kctrl 4>;
          atmel,assigned-clock-names = "OSC32KCTRL";
        };

atmel,assigned-clock-cells:
  - src
```

## dts/bindings/clock/atmel,samc2x-gclk.yaml
```yaml
# Copyright (c) 2022 Kamil Serwus
# SPDX-License-Identifier: Apache-2.0

description: Atmel SAMC2x Generic Clock Controller (GCLK)

compatible: "atmel,samc2x-gclk"

include: [clock-controller.yaml, base.yaml]

properties:
  reg:
    required: true

  "#clock-cells":
    const: 1

clock-cells:
  - periph_ch
```

## dts/bindings/clock/atmel,samc2x-mclk.yaml
```yaml
# Copyright (c) 2022, Kamil Serwus
# SPDX-License-Identifier: Apache-2.0

description: Atmel SAMC2x Generic Clock Controller (MCLK)

compatible: "atmel,samc2x-mclk"

include: [clock-controller.yaml, base.yaml]

properties:
  reg:
    required: true

  "#clock-cells":
    const: 2

clock-cells:
  - offset
  - bit
```

## dts/bindings/clock/atmel,samd2x-gclk.yaml
```yaml
# Copyright (c) 2020, Linaro Limited
# SPDX-License-Identifier: Apache-2.0

description: Atmel SAMD2x Generic Clock Controller (GCLK)

compatible: "atmel,samd2x-gclk"

include: [clock-controller.yaml, base.yaml]

properties:
    reg:
      required: true

    "#clock-cells":
      const: 1

clock-cells:
  - clkctrl_id
```

## dts/bindings/clock/atmel,samd5x-gclk.yaml
```yaml
# Copyright (c) 2020, Linaro Limited
# SPDX-License-Identifier: Apache-2.0

description: Atmel SAMD5x Generic Clock Controller (GCLK)

compatible: "atmel,samd5x-gclk"

include: [clock-controller.yaml, base.yaml]

properties:
    reg:
      required: true

    "#clock-cells":
      const: 1

clock-cells:
  - periph_ch
```

## dts/bindings/clock/atmel,samd5x-mclk.yaml
```yaml
# Copyright (c) 2020, Linaro Limited
# SPDX-License-Identifier: Apache-2.0

description: Atmel SAMD5x Generic Clock Controller (MCLK)

compatible: "atmel,samd5x-mclk"

include: [clock-controller.yaml, base.yaml]

properties:
    reg:
      required: true

    "#clock-cells":
      const: 2

clock-cells:
  - offset
  - bit
```
