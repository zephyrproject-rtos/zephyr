## dts/bindings/clock-mgmt/nxp-syscon/nxp,syscon-clock-mux.yaml
```yaml
# Copyright 2024 NXP
# SPDX-License-Identifier: Apache-2.0

description: |
  LPC SYSCON multiplexer clock node. Accepts one specifier, which sets the
  clock multiplexer selection to the given zero based index in the
  "input-sources" phandle array for the given node.

compatible: "nxp,syscon-clock-mux"

include: [clock-node.yaml]

properties:
  reg:
    required: true
    description: |
      Tuple containing address of register and width of the bitfield
      to set to set the multiplexer selection

  input-sources:
    type: phandles
    required: true
    description: |
      List of all input sources provided to the multiplexer. These sources
      should be references to other clock nodes within the clock tree.

  offset:
    type: int
    required: true
    description: |
      Offset of bitfield within register to set to configure multiplexer

  safe-mux:
    type: boolean
    description: |
      Indicates that the mux uses a synchronized input. Safe muxes will not
      switch clock sources unless both their current source and new source
      are ungated

  "#clock-cells":
    const: 1

clock-cells:
  - multiplexer
```

## dts/bindings/clock-monitor/nxp,cmu-fc.yaml
```yaml
# Copyright (c) 2026 NXP
# SPDX-License-Identifier: Apache-2.0

description: |
  NXP Clock Monitoring Unit - Frequency Check (CMU_FC).

  Continuously compares the frequency of a monitored clock against
  programmable high/low thresholds derived from the nominal expected
  frequency (queried from the `monitored` clock via clock_control) and
  the user-supplied tolerance. Exposed through the Zephyr clock_monitor
  subsystem.

compatible: "nxp,cmu-fc"

include: base.yaml

properties:
  reg:
    required: true

  interrupts:
    description: |
      NVIC interrupt for synchronous threshold-crossing events.

  clocks:
    required: true

  clock-names:
    required: true
    description: |
      Exactly two entries, in order: "reference" (the CMU's timebase
      clock used to size the measurement window) and "monitored" (the
      clock whose frequency is being checked). The driver queries both
      rates via clock_control_get_rate().

  tolerance-ppm:
    type: int
    description: |
      Optional +/- tolerance in parts-per-million. Consumed by
      CLOCK_MONITOR_DT_SPEC_GET() as a convenience for applications.

  nxp,fault-reaction:
    type: string
    default: "interrupt"
    enum:
      - "interrupt"
      - "reset"
    description: |
      HW output path the CMU_FC uses when SR[FHH] or SR[FLL] fires.

      "interrupt" (default):
        Sets IER[FHHIE/FLLIE]. Event is routed synchronously through
        the NVIC line listed in "interrupts"; the driver ISR then
        dispatches to the user-installed clock_monitor callback.

      "reset":
        Escalates to a destructive reset. The application observes
        the fault only as a reboot and must rely on reset-cause registers
        to identify the source after the system comes back up.
```

## dts/bindings/clock-monitor/nxp,cmu-fm.yaml
```yaml
# Copyright (c) 2026 NXP
# SPDX-License-Identifier: Apache-2.0

description: |
  NXP Clock Monitoring Unit - Frequency Meter (CMU_FM).

  Measures the frequency of a metered clock against a reference clock
  and returns the result in Hz. Exposed through the Zephyr
  clock_monitor subsystem (METER mode).

compatible: "nxp,cmu-fm"

include: base.yaml

properties:
  reg:
    required: true

  interrupts:
    required: true
    description: |
      NVIC interrupt for measurement-complete (and timeout) events.

  clocks:
    required: true

  clock-names:
    required: true
    const: ["reference", "monitored"]
    description: |
      Exactly two entries, in order: "reference" (the CMU's timebase
      clock, queried by the driver to (1) size the measurement window
      via REF_CNT and (2) convert the metered count back to Hz) and
      "monitored" (the clock whose frequency is measured; kept for
      symmetry with CMU_FC bindings and diagnostic use).
```

## dts/bindings/clock-monitor/nxp,freqme.yaml
```yaml
# SPDX-FileCopyrightText: 2026 NXP
# SPDX-License-Identifier: Apache-2.0

description: |
  NXP Frequency Measurement (FREQME) module.

  Measures a target clock against a reference clock and returns the result
  in Hz. The reference and target inputs are routed through the INPUTMUX
  peripheral. Exposed through the Zephyr clock_monitor API: MEASURE
  (one-shot) and WINDOW (continuous MIN/MAX threshold) modes are both
  supported, built on the FREQME frequency measurement operate mode.

  Selectable clock sources are declared with two container child nodes,
  "reference-sources" and "target-sources". Each container holds one child
  node per selectable source, pairing an INPUTMUX route with a frequency
  provider. The child marked "default-source" is the power-on selection.
  clock_monitor_set_source() switches between the declared sources at
  runtime, keyed by the INPUTMUX connection cookie (see inputmux-connection).

  A source's frequency provider is either "clock-frequency" (a fixed
  constant in Hz, used verbatim) or "clocks" (queried through
  clock_control_get_rate()). When both are present "clock-frequency" wins
  and "clocks" is ignored. A reference source must resolve to a nonzero
  frequency; a target source only needs one for WINDOW auto-derive
  (window.expected_hz == 0).

  The driver does not enable the selected source clocks. The application must
  ensure the chosen reference and target clocks are running before configure()/start();
  a source left off simply measures zero edges and is reported as CLOCK_LOST.

  Place NXP_FREQME_REF_* cookies in "reference-sources" and NXP_FREQME_TAR_*
  cookies in "target-sources"; the axis is not checked at build time. See
  <zephyr/dt-bindings/clock-monitor/nxp-freqme.h>.

compatible: "nxp,freqme"

include: [base.yaml]

properties:
  reg:
    required: true

  interrupts:
    required: true
    description: |
      NVIC interrupt for measurement-ready, over-range, and under-range events.

  clocks:
    required: true
    description: |
      The FREQME peripheral gate clock, enabled by the driver via
      clock_control_on().

child-binding:
  description: |
    Container for a set of selectable FREQME clock sources. Instantiated
    twice per FREQME node, as "reference-sources" and "target-sources".

  child-binding:
    description: |
      One selectable FREQME clock source: an INPUTMUX route paired with a
      frequency provider. The source's status property is not consulted;
      every child is a candidate source.

    properties:
      inputmux-connection:
        type: phandle-array
        specifier-space: inputmux
        required: true
        description: |
          INPUTMUX route for this source, given as
          <&inputmuxN channel connection> where:
            - &inputmuxN is the INPUTMUX node providing the route
            - channel is the destination index (0 for FREQME)
            - connection is an inputmux_connection_t cookie from
              fsl_inputmux_connections.h. Use the NXP_FREQME_REF_* /
              NXP_FREQME_TAR_* macros in
              <zephyr/dt-bindings/clock-monitor/nxp-freqme.h>.
          This cookie is also the runtime clock_monitor_set_source() selector
          for this source.

      clocks:
        type: phandle-array
        description: |
          Frequency provider queried through clock_control_get_rate().
          Ignored when clock-frequency is present.

      clock-frequency:
        type: int
        description: |
          Fixed frequency provider in Hz, used verbatim without querying
          clock_control. Takes precedence over clocks. Use for sources whose
          rate the clock_control driver cannot report (e.g. an external
          crystal).

      default-source:
        type: boolean
        description: |
          Marks this source as the power-on selection for its container.
          Exactly one child of each container must set it.
```

## dts/bindings/clock/acts,cmu.yaml
```yaml
# Copyright (c) 2019 Manivannan Sadhasivam <mani@kernel.org>
# SPDX-License-Identifier: Apache-2.0

description: |
    This is a representation of the Actions Semi Clock Management Unit node

compatible: "acts,cmu"

include: [clock-controller.yaml, base.yaml]

properties:
    label:
      required: true

    reg:
      required: true

    "#clock-cells":
      const: 1

clock-cells:
  - name
```

## dts/bindings/clock/adi,max32-gcr.yaml
```yaml
# Copyright (c) 2023-2024 Analog Devices, Inc.
# SPDX-License-Identifier: Apache-2.0

description: MAX32 Global Control

compatible: "adi,max32-gcr"

include: [clock-controller.yaml, base.yaml]

properties:
  reg:
    required: true

  "#clock-cells":
    const: 2

  sysclk-prescaler:
    type: int
    enum:
      - 1
      - 2
      - 4
      - 8
      - 16
      - 32
      - 64
      - 128

    description: |
        SYSCLK prescaler. Defines actual core clock frequency SYSCLK
        based on system frequency input. Some MAX32xxx devices does not
        support this feature, check your device user guide before using it.

clock-cells:
  - offset
  - bit
```

## dts/bindings/clock/alif,clockctrl.yaml
```yaml
# Copyright (c) 2025 Alif Semiconductor
# SPDX-License-Identifier: Apache-2.0

description: |
  Alif Semiconductor clock controller

  This binding describes the clock controller for Alif Semiconductor SoCs
  that manages clocks for various peripherals.

  The clock controller requires 7 register regions to control different
  aspects of the clock tree:
  - cgu: Clock Generation Unit
  - clkctl_per_mst: Peripheral clock control (Master)
  - clkctl_per_slv: Peripheral clock control (Slave)
  - aon: Always-on domain
  - vbat: Vbat domain
  - m55he_cfg: Cortex-M55 HE cluster configuration
  - m55hp_cfg: Cortex-M55 HP cluster configuration

compatible: "alif,clockctrl"

include: [base.yaml, clock-controller.yaml]

properties:
  reg:
    required: true
    description: |
      Clock controller register regions. 7 regions are required in the
      following order: cgu, clkctl_per_mst, clkctl_per_slv, aon, vbat,
      m55he_cfg, m55hp_cfg

  reg-names:
    required: true
    description: |
      Names for the register regions. Each name corresponds to a clock
      control module and is used by the driver to locate the appropriate
      register base address. See the description above for valid names.

  "#clock-cells":
    const: 1

clock-cells:
  - clkid

examples:
  - |
    #include <zephyr/dt-bindings/clock/alif-ensemble-clocks.h>

    uart0: uart@49018000 {
        clocks = <&clockctrl ALIF_UART0_SYST_PCLK>;
    };
```

## dts/bindings/clock/allwinner,sun50i-h618-ccu.yaml
```yaml
description: Allwinner H618 Clock Control Unit (CCU)

compatible: "allwinner,sun50i-h618-ccu"

include: [clock-controller.yaml, reset-controller.yaml, base.yaml]

clock-cells:
  - clkid

reset-cells:
  - id

properties:
  reg:
    required: true
  clocks:
    required: true
  clock-names:
    required: true
  "#clock-cells":
    type: int
    const: 1
  "#reset-cells":
    type: int
    const: 1
```

## dts/bindings/clock/ambiq,clkctrl.yaml
```yaml
# Copyright (c) 2023 Ambiq Micro Inc.
# SPDX-License-Identifier: Apache-2.0

description: Ambiq Apollo Series SoC Clock Controller

compatible: "ambiq,clkctrl"

include: [clock-controller.yaml, pinctrl-device.yaml, base.yaml]

properties:
  clock-frequency:
    type: int
    description: output clock frequency (Hz)
    required: true

  pinctrl-0:
    required: true

  pinctrl-names:
    required: true

  "#clock-cells":
    const: 1
```

## dts/bindings/clock/aspeed,ast10x0-clock.yaml
```yaml
# Copyright (c) 2022 Aspeed Technology Inc.
# SPDX-License-Identifier: Apache-2.0

description: Aspeed AST10X0 Clock Controller

compatible: "aspeed,ast10x0-clock"

include: [clock-controller.yaml, base.yaml]

properties:
  "#clock-cells":
    const: 1

clock-cells:
  - clk_id
```

## dts/bindings/clock/at,at32-cctl.yaml
```yaml
# Copyright (c) 2022, Teslabs Engineering S.L.
# SPDX-License-Identifier: Apache-2.0

description: |
  AT32 Clock and Reset (CRM) if a multi-function peripheral in
  charge of reset control (RCTL) and clock control (CCTL) for all SoC
  peripherals. This binding represents the clock controller (CCTL).

  To specify the clocks in a peripheral, the standard clocks property needs
  to be used, e.g.:

    gpioa: gpio@xxx {
        ...
        /* cell encodes CRM register offset and control bit position */
        clocks = <&cctl AT32_CLOCK_GPIOA>;
        ...
    }

  Predefined crm clock cells are available in
  include/zephyr/dts-bindings/clock/at32{xxx}_clocks.h header files, where {xxx}
  corresponds to the SoC series, e.g. f4xx.

compatible: "at,at32-cctl"

include: [clock-controller.yaml, base.yaml]

properties:
  "#clock-cells":
    const: 1

clock-cells:
  - id
```

## dts/bindings/clock/at,at32-crm.yaml
```yaml
# Copyright (c) 2021, Linaro ltd
# SPDX-License-Identifier: Apache-2.0

description: |
  AT32 Clock and Reset controller node.
  This node is in charge of system clock ('SYSCLK') source selection and controlling
  clocks for AHB (Advanced High Performance) and APB (Advanced Peripheral) bus domains.

  Configuring AT32 Clock and Reset controller node:

  System clock source should be selected amongst the clock nodes available in "clocks"
  node (typically 'clk_hext, clk_hick', 'pll', ...).
  Core clock frequency should also be defined, using "clock-frequency" property.
  Note:
          Core clock frequency  = SYSCLK / AHB prescaler
  Last, peripheral bus clocks (typically PCLK1, PCLK2) should be configured using matching
  prescaler properties.
  Here is an example of correctly configured rcc node:
  &rcc {
           clocks = <&pll>;  /* Select 80MHz pll as SYSCLK source */
           ahb-prescaler = <2>;
           clock-frequency = <DT_FREQ_M(40)>; /* = SYSCLK / AHB prescaler */
           apb1-presacler = <1>;
           apb2-presacler = <1>;
  }

compatible: "at,at32-crm"

include: [clock-controller.yaml, base.yaml]

properties:
  reg:
    required: true

  "#clock-cells":
    const: 2

  clock-frequency:
    required: true
    type: int
    description: |
      default frequency in Hz for clock output

  ahb-prescaler:
    type: int
    required: true
    enum:
      - 1
      - 2
      - 4
      - 8
      - 16
      - 64
      - 128
      - 256
      - 512
    description: |
        AHB prescaler. Defines actual core clock frequency (HCLK)
        based on system frequency input.
        The HCLK clocks CPU, AHB, memories and DMA.

  apb1-prescaler:
    type: int
    required: true
    enum:
      - 1
      - 2
      - 4
      - 8
      - 16

  apb2-prescaler:
    type: int
    required: true
    enum:
      - 1
      - 2
      - 4
      - 8
      - 16

  undershoot-prevention:
    type: boolean
    description: |
      On some parts, it could be required to set up highest core frequencies
      (>80MHz) in two steps in order to prevent undershoot.
      This is done by applying an intermediate AHB prescaler before switching
      System Clock source to PLL. Once done, prescaler is set back to expected
      value.

clock-cells:
  - bus
  - bits
```
