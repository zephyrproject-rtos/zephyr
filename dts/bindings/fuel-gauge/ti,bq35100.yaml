## dts/bindings/gpio/infineon,ioss-gpio.yaml
```yaml
# SPDX-FileCopyrightText: Copyright (c) 2026 Infineon Technologies AG
# SPDX-FileCopyrightText: Copyright (c) 2026 Linumiz
# SPDX-License-Identifier: Apache-2.0

description: |
  Infineon IOSS GPIO port

  Each node describes one GPIO port of the IOSS block. The "gpio" reg
  entry is the GPIO port register block and the "hsiom" reg entry is
  the HSIOM port register block, which routes the pins of the port to
  the GPIO function:

    gpio_prt7: gpio@40310380 {
        compatible = "infineon,ioss-gpio";
        reg = <0x40310380 0x80>, <0x40300070 0x10>;
        reg-names = "gpio", "hsiom";
        interrupt-parent = <&intmux_ch0>;
        interrupts = <31 0>;
        gpio-controller;
        ngpios = <8>;
        #gpio-cells = <2>;
    };

  The port supports edge triggered interrupts only.

compatible: "infineon,ioss-gpio"

include: [gpio-controller.yaml, base.yaml]

properties:
  reg:
    required: true

  reg-names:
    required: true

  "#gpio-cells":
    const: 2

gpio-cells:
  - pin
  - flags
```

## dts/bindings/gpio/infineon,mxs22-ioss-gpio.yaml
```yaml
# SPDX-FileCopyrightText: Copyright (c) 2026 Infineon Technologies AG
# SPDX-FileCopyrightText: Copyright (c) 2026 Linumiz
# SPDX-License-Identifier: Apache-2.0

description: |
  Infineon MXS22IOSS GPIO port

  Variant of the IOSS GPIO port found on PSOC Edge devices. A high
  impedance pin also has its CFG_OUT3 drive mode cleared.

    gpio_prt8: gpio@42810400 {
        compatible = "infineon,mxs22-ioss-gpio", "infineon,ioss-gpio";
        reg = <0x42810400 0x80>, <0x42800080 0x10>;
        reg-names = "gpio", "hsiom";
        interrupts = <6 4>;
        gpio-controller;
        ngpios = <8>;
        #gpio-cells = <2>;
    };

compatible: "infineon,mxs22-ioss-gpio"

include: "infineon,ioss-gpio.yaml"
```

## dts/bindings/gpio/ite,it8300-gpio.yaml
```yaml
# Copyright (c) 2026 ITE Corporation. All Rights Reserved.
# SPDX-License-Identifier: Apache-2.0

description: |
  GPIO controller for one ITE IT8300 GPIO group (A through E).
  Must be a child of an ite,it8300 node.

  An example configuration using the it8300-gpio-cfg.dtsi template:

      ioex_it8300_gpa: gpio@1 {
          compatible = "ite,it8300-gpio";
          reg = <0x01 1    /* PDRG  */
                 0x06 1    /* GPISR */
                 0x10 8    /* GPCR  */
                 0x29 1    /* PDMR  */
                 0x39 1>;  /* OODER */
          gpio-controller;
          #gpio-cells = <2>;
          ngpios = <8>;
      };

compatible: "ite,it8300-gpio"

include: [base.yaml, gpio-controller.yaml]

properties:
  reg:
    required: true

gpio-cells:
  - pin
  - flags
```

## dts/bindings/gpio/ite,it8300.yaml
```yaml
description: |
  ITE IT8300 GPIO expander with an I2C interface.

  The parent device manages the shared ALERT# interrupt. Each GPIO group
  is represented by an ite,it8300-gpio child node. The I2C address is
  0x20 through 0x23, selected by the CHIP_ID0 and CHIP_ID1 pins.

  For example, attach the device to an ITE I2C controller and include the
  GPIO group definitions. Adjust the bus, pinctrl, and ALERT# GPIO to match
  the board. The included file extends the it8300_external_gpio label with
  the address and size cells and all five GPIO group child nodes.

    &i2c4 {
        status = "okay";
        clock-frequency = <I2C_BITRATE_FAST>;
        pinctrl-0 = <&i2c4_clk_gpe0_default
                     &i2c4_data_gpe7_default>;
        pinctrl-names = "default";

        it8300_external_gpio: it8300@20 {
            compatible = "ite,it8300";
            reg = <0x20>;
            alert-gpios = <&gpiob 2 GPIO_ACTIVE_LOW>;
        };
    };

    #include <ite/it8300-gpio-cfg.dtsi>

compatible: "ite,it8300"

include: i2c-device.yaml

properties:
  alert-gpios:
    type: phandle-array
    description: |
      Optional GPIO connected to the chip's CHIP_CS#/ALERT# pin.
      The host GPIO is configured as an input; specify GPIO_ACTIVE_LOW.
      If omitted, only polled GPIO access is available.
```

## dts/bindings/gpio/lowrisc,opentitan-gpio.yaml
```yaml
# SPDX-FileCopyrightText: 2026 Yousef Kitaneh
# SPDX-License-Identifier: Apache-2.0

description: |
  lowRISC OpenTitan GPIO controller providing:
  - 32 GPIO pins
  - Configurable interrupt per GPIO for detecting rising edge, falling edge,
    or active low/high input
  - Two ways to update GPIO output: direct-write and masked (thread-safe) update

compatible: "lowrisc,opentitan-gpio"

include: [gpio-controller.yaml, base.yaml]

properties:
  reg:
    required: true

  interrupts:
    required: true

  "#gpio-cells":
    const: 2

gpio-cells:
  - pin
  - flags
```

## dts/bindings/gpio/mediatek,mt8188-gpio.yaml
```yaml
# Copyright (c) 2026 MediaTek Inc.
# SPDX-License-Identifier: Apache-2.0

description: |
  MediaTek MT8188 GPIO bank.

  The GPIO registers are a single block owned by the pin controller, in which
  each register holds one bit per pin for a group of 32 pins.  A bank is
  therefore selected by index rather than by address, and these nodes appear as
  children of the pin controller they belong to.

  Because Zephyr addresses at most 32 pins per GPIO device, the 177 pins of this
  SoC are described as six banks.

compatible: "mediatek,mt8188-gpio"

include: [gpio-controller.yaml, base.yaml, pinctrl-device.yaml]

properties:
  mediatek,gpio-bank:
    type: int
    required: true
    description: |
      Index of this bank within the GPIO register block.  Bank n covers pins
      n * 32 to n * 32 + 31, and selects bit n of each register group.

  mediatek,eint:
    type: phandle
    required: true
    description: |
      The external interrupt controller that delivers edge and level events for
      the pins in this bank.

  ngpios:
    required: true
    description: |
      Number of pins in this bank.  32 for all banks except the last, which is
      partially populated.

  "#gpio-cells":
    const: 2

gpio-cells:
  - pin
  - flags
```

## dts/bindings/gpio/microchip,mcp23sxx.yaml
```yaml
#
# SPDX-License-Identifier: Apache-2.0
#

include: ["microchip,mcp23xxx.yaml"]

properties:
  address-used:
    type: int
    description: |
      The address bits A1-A0 of the chip if they are used. The driver
      sets the HAEN bit in the IOCON register and set the bits in the
      device opcode, if this property is provided.
```
