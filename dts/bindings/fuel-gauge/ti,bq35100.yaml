## dts/bindings/fuel-gauge/ti,bq35100.yaml
```yaml
# Copyright (c) 2024 Orgatex GmbH
#
# SPDX-License-Identifier: Apache-2.0
description: |
  Texas Instruments, BQ35100, Battery fuel gauge for
  non-rechargeable batteries (lithium primary) and end-of-service monitor

compatible: "ti,bq35100"

include: [i2c-device.yaml, fuel-gauge.yaml]

properties:
  int-gpios:
    type: phandle-array
    description: |
      This pin can be used to reflect an internal warning. The
      warnings can be configured using I2C communication.
      Possible Warnings: Battery low, Temperature low,
      Temperature high, Battery low SOH, Battery EOS OCV

  supply-gpios:
    type: phandle-array
    description: |
      Gauge enable (GE) pin. The gauge only draws its quiescent current while
      this pin is driven high, so boards that keep it under software control
      can take the gauge out of the battery budget while it is not needed.
```

## dts/bindings/fuel-gauge/ti,bq41z50.yaml
```yaml
# Copyright (c) 2026 Open Device Partnership and Contributors
#
# SPDX-License-Identifier: Apache-2.0

description: |
  Texas Instruments BQ41Z50 battery pack manager with Impedance Track
  fuel gauge. For more info visit
  https://www.ti.com/product/BQ41Z50

compatible: "ti,bq41z50"

include: [i2c-device.yaml, fuel-gauge.yaml]
```

## dts/bindings/fuel-gauge/zephyr,native-linux-fuel-gauge.yaml
```yaml
# SPDX-FileCopyrightText: 2026 Muhammad Waleed Badar
# SPDX-License-Identifier: Apache-2.0

description: |
  Native Linux fuel gauge

  Fuel gauge that reads the sysfs attributes of a Linux power_supply device
  of the host (e.g. /sys/class/power_supply/BAT0). The device must be of the
  Battery type.

compatible: "zephyr,native-linux-fuel-gauge"

include: fuel-gauge.yaml

properties:
  path:
    type: string
    required: true
    description: |
      Directory of the host power supply, e.g. "/sys/class/power_supply/BAT0".
      The name of the battery depends on the host, set it as needed before
      enabling the node. A directory holding the attribute files of a fake
      power supply serves on a host without a battery. The --fuel-gauge-path
      command line option overrides this property.

examples:
  - |
      / {
          fuel_gauge: fuel_gauge {
            compatible = "zephyr,native-linux-fuel-gauge";

            path = "/sys/class/power_supply/BAT0";
          };
      };
```

## dts/bindings/gnss/gnss-nmea-generic.yaml
```yaml
# Copyright 2023 Google LLC
# SPDX-License-Identifier: Apache-2.0

description: |
  Generic GNSS NMEA receiver

  Implement a generic NMEA based GNSS device.

compatible: "gnss-nmea-generic"

include:
  - uart-device.yaml

properties:
  enable-gpios:
    type: phandle-array
    description: |
      GPIO that enables the receiver when active and puts it into standby
      when inactive. The driver asserts this signal on resume and deasserts
      it on suspend.

  reset-gpios:
    type: phandle-array
    description: |
      GPIO that resets the receiver when active. The driver pulses this
      signal during initialization. Requires reset-pulse-duration-ms.

  reset-pulse-duration-ms:
    type: int
    description: Minimum reset pulse duration in milliseconds.

  startup-time-ms:
    type: int
    default: 0
    description: |
      Time in milliseconds for the receiver to start after asserting enable-gpios.
      The driver waits this long before communicating with the receiver.
      The default preserves operation without an enable signal. Set this to
      the receiver's wake-up time when enable-gpios is used.

examples:
  - |
    &uart0 {
            current-speed = <9600>;
            /* ... */
            gnss: gnss-nmea-generic {
                    compatible = "gnss-nmea-generic";
            };
    };
```

## dts/bindings/gpio/abov,abov32-gpio.yaml
```yaml
# Copyright (c) 2026 ABOV Semiconductor Co., Ltd.
# SPDX-License-Identifier: Apache-2.0

description: |
  ABOV32 Port Control Unit (PCU) GPIO port. Each PCU port (A..G) is exposed
  as one gpio-controller node.

compatible: "abov,abov32-gpio"

include: [gpio-controller.yaml, base.yaml]

properties:
  reg:
    required: true

  "#gpio-cells":
    const: 2

gpio-cells:
  - pin
  - flags
```

## dts/bindings/gpio/adi,max20356-gpio.yaml
```yaml
# Copyright (c) 2026 Analog Devices, Inc.
# SPDX-License-Identifier: Apache-2.0

description: |
  Analog Devices MAX20356/MAX20358 PMIC GPIO controller.

  Child node of the MAX20356 MFD parent. Exposes the eight multi-purpose control
  pins (MPC0..MPC7) through the standard Zephyr GPIO API. Pins configured for DVS,
  power-good or the SPI DVS interface must not be claimed as GPIOs.

compatible: "adi,max20356-gpio"

include: [gpio-controller.yaml, base.yaml]

properties:
  "#gpio-cells":
    const: 2

  ngpios:
    type: int
    required: true
    const: 8
    description: Number of MPC pins exposed (always 8).

gpio-cells:
  - pin
  - flags
```

## dts/bindings/gpio/adi,max7321.yaml
```yaml
# SPDX-FileCopyrightText: 2026 Analog Devices, Inc.
# SPDX-License-Identifier: Apache-2.0

description: |
  MAX7321 I2C port expander with 8 open-drain I/Os.
  The internal pull-up selection is not configurable through this driver.
  Writing a 1 to a port makes it high-impedance (input with pull-up).
  Writing a 0 to a port pulls it low (output driven low).

compatible: "adi,max7321"

include: [i2c-device.yaml, gpio-controller.yaml]

properties:
  ngpios:
    required: true
    const: 8
    description: Number of GPIOs. MAX7321 always has 8 I/O pins.

  int-gpios:
    type: phandle-array
    description: |
      GPIO connected to the controller INT pin. This pin is active-low,
      open-drain. Asserted when any input pin changes state.

  "#gpio-cells":
    const: 2

gpio-cells:
  - pin
  - flags
```

## dts/bindings/gpio/adi,max96717-gpio.yaml
```yaml
# Copyright (c) 2026 Charles Dias
# SPDX-License-Identifier: Apache-2.0

description: |
  GPIO controller of the MAX96717 serializer: its MFP pins, numbered as in the datasheet, MFP0
  being pin 0. A child node of the serializer, which brings the pins within reach over the GMSL2
  link before this controller initializes.

  Pins with another function on a board, such as the MFPs carrying the camera I2C bus, are taken
  out of use with gpio-reserved-ranges. Interrupts and GPIO forwarding over the link are not
  supported.

  Example:

    max96717: max96717@40 {
        compatible = "adi,max96717";
        reg = <0x40>;

        ser_gpio: gpio {
            compatible = "adi,max96717-gpio";
            gpio-controller;
            #gpio-cells = <2>;
            ngpios = <11>;
            gpio-reserved-ranges = <9 2>;
        };
    };

compatible: "adi,max96717-gpio"

include: gpio-controller.yaml

properties:
  "#gpio-cells":
    const: 2

  ngpios:
    type: int
    const: 11

gpio-cells:
  - pin
  - flags
```

## dts/bindings/gpio/brcm,bcm2711-gpio.yaml
```yaml
# Copyright (c) 2023 Chen Xingyu <hi@xingrz.me>
# SPDX-License-Identifier: Apache-2.0

description: BCM2711 GPIO

compatible: "brcm,bcm2711-gpio"

include: [gpio-controller.yaml, base.yaml]

properties:
  reg:
    required: true

  interrupts:
    required: true

  "#gpio-cells":
    const: 2

  legacy-pull-control:
    type: boolean
    description: |
      Use the BCM2835-family GPPUD/GPPUDCLK pull-control sequence instead
      of the BCM2711 GPPULL registers, which are reserved on BCM2835,
      BCM2836, BCM2837 and BCM2710.

gpio-cells:
  - pin
  - flags
```

## dts/bindings/gpio/cirrus,cs47l63-gpio.yaml
```yaml
# SPDX-FileCopyrightText: Copyright The Zephyr Project Contributors
# SPDX-License-Identifier: Apache-2.0

title: Cirrus Logic CS47L63 GPIO controller

description: |
  GPIO1 to GPIO12 of a Cirrus Logic CS47L63 audio codec. A child node of the
  cirrus,cs47l63 node. Pin 0 is GPIO1 and pin 11 is GPIO12. GPIO1 to GPIO4
  double as the ASP1 pins and GPIO5 to GPIO8 as the ASP2 pins.

compatible: "cirrus,cs47l63-gpio"

include: gpio-controller.yaml

properties:
  "#gpio-cells":
    const: 2

  ngpios:
    const: 12

gpio-cells:
  - pin
  - flags

examples:
  - |
    #include <zephyr/dt-bindings/gpio/gpio.h>

    &spi1 {
        codec@2 {
            compatible = "cirrus,cs47l63";
            reg = <2>;
            spi-max-frequency = <8000000>;
            reset-gpios = <&gpio0 18 GPIO_ACTIVE_LOW>;

            cs47l63_gpio: gpio {
                compatible = "cirrus,cs47l63-gpio";
                gpio-controller;
                #gpio-cells = <2>;
                ngpios = <12>;
            };
        };
    };
```

## dts/bindings/gpio/dvp-24pin-connector.yaml
```yaml
# SPDX-FIle-CopyrightText: Copyright Panoramix Labs
# SPDX-License-Identifier: Apache-2.0

title: 24-pin FPC camera connector

description: |
  De-facto standard FPC connector used by multiple camera modules. The ESP-CAM by Ai-Thinker made it
  popular, but is not tied to a particular vendor. It is a loose standard, and (often compatible)
  variations exist.

  The most frequent 24-pin connector has a 0.5mm pitch and a single row of 24 pin.

  Zephyr uses the pinout of the camera module, (also used by some PCB schematics).
  See <zephyr/dt-bindings/gpio/dvp-24pin-connector.h> for pin description.

    8-bit variant           10-bit variant

    1                        1
    2   AGND                 2   AGND
    3   SDA                  3   SDA
    4   AVDD                 4   AVDD
    5   SCL                  5   SCL
    6   RST                  6   RST
    7   VSYNC                7   VSYNC
    8   PWDN                 8   PWDN
    9   HSYNC                9   HSYNC
    10  DVDD                 10  DVDD
    11  IOVDD                11  IOVDD
    12  D7                   12  D9
    13  MCLK                 13  MCLK
    14  D6                   14  D8
    15  GND                  15  GND
    16  D5                   16  D7
    17  PCLK                 17  PCLK
    18  D4                   18  D6
    19  D0                   19  D2
    20  D3                   20  D5
    21  D1                   21  D3
    22  D2                   22  D4
    23                       23  D1
    24                       24  D0

  Mind that the I/O voltage are not compatible between every module and every system.

  In some variants, the last two pins are set to the first DVP signals, then ranging from 1 to 10.

  The following node labels can be used in devicetree:

  - dvp_24pin_interface: the video interface that receives the video feed and use with the
    zephyr,camera chosen node.

  - dvp_24pin_i2c: the I2C device of the devkit on which the camera module is instantiated.

  - dvp_24pin_connector: the GPIO nexus using the dvp-24pin-connector that defines the camera pins
    ('reset' (RST), 'power-down' (PWDN)...)

  - Provide a clock at the correct frequency fed into the MCLK signal of the camera module.

compatible: "dvp-24pin-connector"

include: [gpio-nexus.yaml, base.yaml]
```

## dts/bindings/gpio/efinix,sapphire-gpio.yaml
```yaml
description: Efinix Sapphire GPIO

compatible: "efinix,sapphire-gpio"

include: [gpio-controller.yaml, base.yaml]

properties:
  reg:
    required: true

  ngpios:
    required: true
    enum:
      - 1
      - 2
      - 4
      - 8
      - 16
      - 32

  "#gpio-cells":
    const: 2

gpio-cells:
  - pin
  - flags
```

## dts/bindings/gpio/fastbit,nano-header.yaml
```yaml
# Copyright (c) 2026 Fastbit Embedded Technologies
# SPDX-License-Identifier: Apache-2.0

description: |
    GPIO pins exposed on the Fastbit STM32 Nano 2x5 expansion headers.

    The board provides three 2x5 (10 pin) headers, called P1, P2 and P3 in
    the schematic. In every header the odd pins form one column and the even
    pins form the other column, with pin 1 being the 3V3 or first signal pin.

    This binding provides a nexus mapping where the parent pin index is
    (header number - 1) * 10 + (header pin number - 1). Power pins (3V3 and
    GND) are not mapped. The mapped pins are:

        P1 (indices 0 to 9)         P2 (indices 10 to 19)
         1 3V3                       1 PB0   (10)
         2 PC13  (1)                 2 PB1   (11)
         3 PA1   (2)                 3 PB10  (12)
         4 PA2   (3)                 4 PB11  (13)
         5 PA3   (4)                 5 PB12  (14)
         6 PA4   (5)                 6 PB13  (15)
         7 PA5   (6)                 7 PB14  (16)
         8 PA6   (7)                 8 PB15  (17)
         9 PA7   (8)                 9 PA9   (18)
        10 GND                      10 PA10  (19)

        P3 (indices 20 to 29)
         1 3V3
         2 PA8   (21)
         3 PA15  (22)
         4 PB4   (23)
         5 PB5   (24)
         6 PB6   (25)
         7 PB7   (26)
         8 PB8   (27)
         9 PB9   (28)
        10 GND

compatible: "fastbit,nano-header"

include: [gpio-nexus.yaml, base.yaml]
```

## dts/bindings/gpio/gpio-fast.yaml
```yaml
# Copyright (c) 2026 Perry Naseck, MIT Media Lab <pnaseck@media.mit.edu>
# SPDX-License-Identifier: Apache-2.0

description: |
  Optional Fast GPIO properties.

  Include this binding in any driver that uses the Fast GPIO API to allow
  the backend to be overridden from the default (the GPIO controller's
  DT compatible) and to configure the CPU clock frequency used for
  NOP delay calculations.

properties:
  fast-gpio-backend:
    type: string
    description: |
      Override the Fast GPIO backend used for this device. When set, the
      dispatch macros use this value instead of the GPIO controller's DT
      compatible. The value must match a backend's compat token
      (e.g. "atmel_sam0_gpio", "generic").

  fast-gpio-cpu-clock-reference:
    type: phandle
    description: |
      Reference to the CPU node whose clock-frequency property is used
      for NOP delay calculations. Defaults to /cpus/cpu@0 if not set.

  fast-gpio-cpu-clock-frequency:
    type: int
    description: |
      Explicit CPU clock frequency in Hz for NOP delay calculations.
      Takes precedence over fast-gpio-cpu-clock-reference and the
      default cpu@0 clock-frequency. Use this when the CPU node lacks
      a clock-frequency property or when the frequency differs from
      the DT value at runtime.
```

## dts/bindings/gpio/hpmicro,hpm-gpio.yaml
```yaml
# Copyright (c) 2022 HPMicro
# Copyright (c) 2026 Cody Gu <gujiaqi@iscas.ac.cn>
# SPDX-License-Identifier: Apache-2.0

description: HPMicro GPIO controller

compatible: "hpmicro,hpm-gpio"

include: [gpio-controller.yaml, base.yaml]

properties:
  reg:
    description: |
      GPIO port index within the controller's shared register block. GPIOA is
      0, GPIOB is 1, GPIOX is 13, and GPIOY is 14.
    required: true

  "#gpio-cells":
    const: 2

gpio-cells:
  - pin
  - flags
```

## dts/bindings/gpio/infineon,aurix-gpio.yaml
```yaml
# SPDX-FileCopyrightText: Copyright (c) 2024 Infineon Technologies AG,
# SPDX-FileCopyrightText: or an affiliate of Infineon Technologies AG. All rights reserved.
# SPDX-FileCopyrightText: Copyright (c) 2026 Linumiz
#
# SPDX-License-Identifier: Apache-2.0

description: |
  Infineon AURIX port as GPIO controller.

  The node is a child of the pin controller node and covers the register
  block of one port, with at most 16 pins (ngpios). Interrupts are not
  supported.

compatible: "infineon,aurix-gpio"

include: [gpio-controller.yaml, base.yaml]

properties:
  reg:
    required: true

  "#gpio-cells":
    const: 2

gpio-cells:
  - pin
  - flags
```

## dts/bindings/gpio/infineon,aurix-tc4x-gpio.yaml
```yaml
# SPDX-FileCopyrightText: Copyright (c) 2024 Infineon Technologies AG,
# SPDX-FileCopyrightText: or an affiliate of Infineon Technologies AG. All rights reserved.
# SPDX-FileCopyrightText: Copyright (c) 2026 Linumiz
#
# SPDX-License-Identifier: Apache-2.0

description: Infineon AURIX TC4X port as GPIO controller.

compatible: "infineon,aurix-tc4x-gpio"

include: infineon,aurix-gpio.yaml
```
