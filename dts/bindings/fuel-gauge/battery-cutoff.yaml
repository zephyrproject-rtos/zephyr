## dts/bindings/fuel-gauge/battery-cutoff.yaml
```yaml
#
# Copyright 2023 Google LLC
#
# SPDX-License-Identifier: Apache-2.0
#

description: |

  Properties for fuel-gauges that may control battery cutoff, this is common in SBS-compliant or
  similarly smart battery fuel gauges.

  Note: These properties are to be used with meaningful defaults in fuel gauge ICs that can cut off
  their associated battery from the system. See the default fuel gauge SBS Gauge compatible as an
  example.

properties:
  battery-cutoff-support:
    description: |
      Helper prop that indicates whether this device can cutoff the battery; this is also often
      referred to as ship or sleep mode.
    type: boolean
  battery-cutoff-reg-addr:
    description: |
       Address of register to receive cutoff payload for battery cutoff.
    type: int
  battery-cutoff-payload:
    description: |
       Payload to write to cutoff battery register. This must be array of maximum 2 integers.
    type: array
```

## dts/bindings/fuel-gauge/fuel-gauge.yaml
```yaml
#
# Copyright 2022 Google LLC
#
# SPDX-License-Identifier: Apache-2.0
#

include: base.yaml

description: |
   Battery fuel-gauge parameters and info
```

## dts/bindings/fuel-gauge/hycon,hy4245.yaml
```yaml
# Copyright (c) 2025, Linumiz GmbH
#
# SPDX-License-Identifier: Apache-2.0

description: |
  Hycon Technology HY4245 fuel gauge.

compatible: "hycon,hy4245"

include: [i2c-device.yaml, fuel-gauge.yaml]
```

## dts/bindings/fuel-gauge/maxim,max17043.yaml
```yaml
# Copyright (c) 2025 Mohammed Billoo <mab@mab-labs.com>
# SPDX-License-Identifier: Apache-2.0

description: |
  Maxim MAX17043 Fuel Gauge with ModelGauge. See more info at:
  https://www.analog.com/media/en/technical-documentation/data-sheets/max17043-max17044.pdf

compatible: "maxim,max17043"

include: [i2c-device.yaml, fuel-gauge.yaml]
```

## dts/bindings/fuel-gauge/maxim,max17048.yaml
```yaml
# Copyright (c) 2023 Alvaro Garcia Gomez <maxpowel@gmail.com>
# SPDX-License-Identifier: Apache-2.0

description: |
  Maxim MAX17048 Fuel Gauge with ModelGauge. See more info at:
  https://www.maximintegrated.com/en/products/power/battery-management/MAX17048.html

compatible: "maxim,max17048"

include: [i2c-device.yaml, fuel-gauge.yaml]
```

## dts/bindings/fuel-gauge/onnn,lc709203f.yaml
```yaml
# Copyright (c) 2025 Philipp Steiner <philipp.steiner1987@gmail.com>
# SPDX-License-Identifier: Apache-2.0

description: |
  ON Semiconductor LC709203F fuel gauge. For more info visit
  https://www.onsemi.com/products/power-management/battery-management/battery-fuel-gauges/LC709204F

compatible: "onnn,lc709203f"

include: [i2c-device.yaml, fuel-gauge.yaml]

properties:
  initial-rsoc:
    type: boolean
    description: |
      The LSI can be forced to initialize RSOC by sending the he Initial RSOC Command.
      The LSI initializes RSOC by the measured voltage at that time when the Initial
      RSOC command is written

  apa:
    type: string
    required: true
    description: |
      Adjustment Pack Application: Value for a battery type to improve the RSOC precision.
      Typical values are provided and should be selected approximately.
    enum:
      - "100mAh"
      - "200mAh"
      - "500mAh"
      - "1000mAh"
      - "2000mAh"
      - "3000mAh"

  battery-profile:
    type: int
    description: |
      The LSI contains a data file comprised of two battery profiles.
      This register is used to select the battery profile to be used.
      Register Number of the Parameter (0x1A) contains identity of the data file.
      The Data file is loaded during final test depending on the part number ordered.
      To decide which battery-profile should be used please refer to the LC709203F data sheet.
    enum:
      - 0x0
      - 0x1

  thermistor:
    type: boolean
    description: |
      Specifies if the device is used with a thermistor or not.

  thermistor-b-value:
    type: int
    description: |
      Sets B-constant of the thermistor to be measured. Refer to
      the specification sheet of the thermistor for the set value to used.
      The default is set to 0x0D34 which is the initial value of the IC.
      Note: This value will only be set if a thermistor is used.
    default: 0x0D34

  apt:
    type: int
    description: |
      This is used to compensate for the delay of the thermistor
      measurement caused by a capacitor across the thermistor.
      The default value has been found to meet most of circuits
      where a capacitor is not put. For details please refer to the
      LC709203F data sheet.
      Note: This value will only be set if a thermistor is used.
    default: 0x1E

  thermistor-mode:
    type: int
    description: |
      This selects the Thermistor mode.
      Thermistor mode (0x1): The LSI measures the attached thermistor and
      loads the temperature into the Cell Temperature register.
      I2C mode (0x0): the temperature is provided by the host processor.
      The default is set to 0x1, because if a thermistor is used, the
      thermistor mode should be selected.
      Note: This value will only be necessary if a thermistor is used,
      otherwise the initial value of the IC is 0x0 and setting is not necessary.
    enum:
      - 0x0
      - 0x1
    default: 0x1
```

## dts/bindings/fuel-gauge/sbs,default-sbs-gauge.yaml
```yaml
#
# Copyright 2023 Google LLC
#
# SPDX-License-Identifier: Apache-2.0
#

compatible: "sbs,default-sbs-gauge"

include: ["sbs,sbs-gauge-new-api.yaml", "battery-cutoff.yaml"]

description: |
  Default generic smart battery fuel gauge driver. Includes support for battery cutoff if enabled.

  This compatible is intended to be used with the abstract SBS Gauge compatible because it is
  actuated by the SBS driver for SBS compliant fuel gauge ICs.

properties:
  battery-cutoff-reg-addr:
    # For SBS compliant fuel gauges this is usually "ManufactuerAccess"
    default: 0x0
  battery-cutoff-payload:
    default: [0x0010, 0x0010]
```

## dts/bindings/fuel-gauge/sbs,sbs-gauge-new-api.yaml
```yaml
description: SBS 1.1 compliant fuel gauge (http://www.sbs-forum.org/specs)

compatible: "sbs,sbs-gauge-new-api"

include: [i2c-device.yaml, fuel-gauge.yaml]
```

## dts/bindings/fuel-gauge/silergy,sy24561.yaml
```yaml
description: |
  SY24561 is a simple gas gauge IC for single cell lithium-ion (Li+) batteries in handheld
  and portable equipment.

  SY24561 senses battery terminal voltage and use the proprietary algorithm to calculate the
  corresponding State of Charge (SOC). Comparing with conventional voltage-based gauge which
  translates terminal voltage directly to SOC, the advanced algorithm in SY24561 shows great
  advantage in SOC accuracy. SY24561 can be classified as advanced voltage-based gauge without
  current sensor and the SOC accuracy will not degrade with time. Temperature of the battery
  pack is measured by the host microcontroller and feed to SY24561 through the I2C interface.
  SY24561 can automatically compensate temperature, load variation and battery age.

  https://www.silergy.com/productsview/SY24561DFC

compatible: "silergy,sy24561"

include: [i2c-device.yaml, fuel-gauge.yaml]
```

## dts/bindings/fuel-gauge/ti,bq27427.yaml
```yaml
# SPDX-FileCopyrightText: Copyright The Zephyr Project Contributors
# SPDX-License-Identifier: Apache-2.0

description: |
  Texas Instruments BQ27427 fuel gauge. For more info visit
  https://www.ti.com/product/BQ27427


compatible: "ti,bq27427"

include: [i2c-device.yaml, fuel-gauge.yaml]
```

## dts/bindings/fuel-gauge/ti,bq27z746.yaml
```yaml
# Copyright (c) 2023, ithinx GmbH
# Copyright (c) 2023, Tonies GmbH
#
# SPDX-License-Identifier: Apache-2.0

description: |
  Texas Instruments BQ27Z746 fuel gauge. For more info visit
  https://www.ti.com/product/BQ27Z746


compatible: "ti,bq27z746"

include: [i2c-device.yaml, fuel-gauge.yaml]
```

## dts/bindings/fuel-gauge/ti,bq40z50.yaml
```yaml
# Copyright (c) Qualcomm Technologies, Inc. and/or its subsidiaries.
#
# SPDX-License-Identifier: Apache-2.0

description: |
  Texas Instruments BQ40Z50 fuel gauge. For more info visit
  https://www.ti.com/product/BQ40Z50.


compatible: "ti,bq40z50"

include: [i2c-device.yaml, fuel-gauge.yaml]
```

## dts/bindings/fuel-gauge/x-powers,axp2101-fuel-gauge.yaml
```yaml
# Copyright (c) 2025 Felix Moessbauer <felix.moessbauer@gmail.com>
# SPDX-License-Identifier: Apache-2.0

description: |
  X-Powers AXP2101 Fuel Gauge

compatible: "x-powers,axp2101-fuel-gauge"

include: [fuel-gauge.yaml]
```

## dts/bindings/fuel-gauge/zephyr,fuel-gauge-composite.yaml
```yaml
# Copyright (c) 2024 Embeint Inc
# SPDX-License-Identifier: Apache-2.0

description: |
  Composite fuel-gauge constructed from sensor devices

compatible: "zephyr,fuel-gauge-composite"

include: [fuel-gauge.yaml, battery.yaml]

properties:
  source-primary:
    type: phandle
    required: true
    description: |
      Primary device to read sensor data from.
      Device must implement the sensor API.

  source-secondary:
    type: phandle
    description: |
      Secondary device to read sensor data from.
      This device will be used if input-primary does not expose
      a channel.

      Device must implement the sensor API.

  fuel-gauge-channels:
    type: boolean
    description: |
      Sources should be queried by the sensor API fuel gauge
      channels (SENSOR_CHAN_GAUGE_*), instead of the generic
      channels (SENSOR_CHAN_VOLTAGE, etc).
```

## dts/bindings/gnss/ericsson,f5521gw.yaml
```yaml
# Copyright (c) 2026 Muhammad Waleed Badar
# SPDX-License-Identifier: Apache-2.0

description: |
  Ericsson F5521gw (HP HS2340) WWAN module with integrated GPS

compatible: "ericsson,f5521gw"

include:
  - uart-device.yaml
```

## dts/bindings/gnss/globaltop,pa6h.yaml
```yaml
# Copyright 2026 Hong Nguyen
# SPDX-License-Identifier: Apache-2.0

description: GlobalTop PA6H GNSS module (MediaTek MT3339 chipset).

compatible: "globaltop,pa6h"

include:
  - uart-device.yaml

properties:
  fix-interval-ms:
    type: int
    default: 1000
    description: |
      Initial fix update interval in milliseconds.
      Valid range is 100 to 10000 ms.
```

## dts/bindings/gnss/gnss-pps.yaml
```yaml
# Copyright (c) 2023 Trackunit Corporation
# SPDX-License-Identifier: Apache-2.0

properties:
  pps-mode:
    type: string
    required: true
    description: |
      PPS output mode:
      - GNSS_PPS_MODE_DISABLED: Output disabled
      - GNSS_PPS_MODE_ENABLED: Output always enabled
      - GNSS_PPS_MODE_ENABLED_AFTER_LOCK: Output enabled from first lock
      - GNSS_PPS_MODE_ENABLED_WHILE_LOCKED: Output enabled only while locked
    enum:
      - GNSS_PPS_MODE_DISABLED
      - GNSS_PPS_MODE_ENABLED
      - GNSS_PPS_MODE_ENABLED_AFTER_LOCK
      - GNSS_PPS_MODE_ENABLED_WHILE_LOCKED

  pps-pulse-width:
    type: int
    description: 1PPS pulse width
    default: 100
```

## dts/bindings/gnss/gnss-timepulse.yaml
```yaml
# Copyright (c) 2026 RAKwireless Technology Limited
# SPDX-License-Identifier: Apache-2.0

description: |
  Location of the GNSS PPS signal on the MCU.

  The capture backend is selected through Kconfig (CONFIG_GNSS_TIMEPULSE_*),
  not devicetree. The current in-tree backend uses a GPIO interrupt to capture
  a recurring PPS input. The pulse output itself is
  configured chip-side through gnss-pps.yaml where the receiver supports it.

properties:
  timepulse-gpios:
    type: phandle-array
    description: |
      MCU input pin the receiver PPS output is wired to. The active
      edge is selected through the GPIO flags. Optional.
```

## dts/bindings/gnss/luatos,air530z.yaml
```yaml
# Copyright 2024 Jerónimo Agulló
# SPDX-License-Identifier: Apache-2.0

description: AIR530Z Luatos GNSS modem

compatible: "luatos,air530z"

include:
  - uart-device.yaml

properties:
  on-off-gpios:
    type: phandle-array
    description: |
      Identifies the On-Off pin for entering into low-power mode.
```

## dts/bindings/gnss/nordic,nrf9160-gnss.yaml
```yaml
# Copyright (c) 2023 Sendrato B.V.
# SPDX-License-Identifier: Apache-2.0

description: Nordic nRF9160 GNSS modem

compatible: "nordic,nrf9160-gnss"

include:
  - uart-device.yaml
  - gnss-pps.yaml
```

## dts/bindings/gnss/quectel,bg96-gnss.yaml
```yaml
# Copyright (c) 2022 Trackunit A/S
# SPDX-License-Identifier: Apache-2.0

description: Quectel BG96 GNSS interface

compatible: "quectel,bg96-gnss"

include: [base.yaml]

on-bus: quectel,bg96
```

## dts/bindings/gnss/quectel,l96-common.yaml
```yaml
# Copyright (c) 2025 Nick Ward
# SPDX-License-Identifier: Apache-2.0

include:
  - gnss-pps.yaml

properties:
  reset-gpios:
    type: phandle-array
    description: |
      GPIO connected to the RESET pin of the Quectel L96 GNSS module.
      - Drive low for at least 10ms to reset the module.
      - Drive high (or release if open-drain) to complete the reset cycle.
      Volatile RAM data may be lost, but backup RAM is retained,
      allowing faster time to first fix (TTFF) after reset.

  vcc-gpios:
    type: phandle-array
    description: |
      Cutting off VCC and keeping V_BCKP powered will make the
      module enter into backup mode from full on mode. As long as
      the VCC pin is powered, the module will enter into full on
      mode immediately.
```

## dts/bindings/gnss/quectel,l96-i2c.yaml
```yaml
# Copyright (c) 2025 Nick Ward
# SPDX-License-Identifier: Apache-2.0

description: Quectel L96 GNSS modem accessed through I2C bus

compatible: "quectel,l96"

include:
  - i2c-device.yaml
  - quectel,l96-common.yaml
```

## dts/bindings/gnss/quectel,l96-uart.yaml
```yaml
# Copyright (c) 2025 Nick Ward
# SPDX-License-Identifier: Apache-2.0

description: Quectel L96 GNSS modem accessed through UART bus

compatible: "quectel,l96"

include:
  - uart-device.yaml
  - quectel,l96-common.yaml
```

## dts/bindings/gnss/quectel,lc26g.yaml
```yaml
# Copyright (c) 2023 Trackunit Corporation
# Copyright (c) 2023 Bjarki Arge Andreasen
# SPDX-License-Identifier: Apache-2.0

description: Quectel LC26G GNSS modem

compatible: "quectel,lc26g"

include:
  - uart-device.yaml
  - gnss-pps.yaml
```
