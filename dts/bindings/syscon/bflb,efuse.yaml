## dts/bindings/syscon/bflb,efuse.yaml
```yaml
# Copyright (c) 2024-2025 MASSDRIVER EI (massdriver.space)
# SPDX-License-Identifier: Apache-2.0

description: BouffaloLab Efuse

compatible: "bflb,efuse"

include: base.yaml

properties:
  reg:
    required: true

  size:
    required: true
    type: int
    description: Size of efuse storage (bytes)
```

## dts/bindings/syscon/nxp,imx-ocotp.yaml
```yaml
# Copyright (c) 2025 Basalte bv
# SPDX-License-Identifier: Apache-2.0

description: NXP i.MX On-Chip OTP

compatible: "nxp,imx-ocotp"

include: base.yaml

properties:
  reg:
    required: true

  size:
    required: true
    type: int
    description: Size of OTP storage (bytes)
```

## dts/bindings/syscon/rapidsi,scu.yaml
```yaml
# Copyright (c) 2024 Rapid Silicon
# SPDX-License-Identifier: Apache-2.0

description: System Controller Registers R/W

compatible: "rapidsi,scu"

include: base.yaml

properties:
  reg:
    required: true
```

## dts/bindings/syscon/sifli,sf32lb-cfg.yaml
```yaml
# Copyright (c) 2025 Core Devices LLC
# SPDX-License-Identifier: Apache-2.0

description: SiFli System Configuration (HPSYS_CFG)

compatible: "sifli,sf32lb-cfg"

include: base.yaml

properties:
  reg:
    required: true
```

## dts/bindings/syscon/sifli,sf32lb-efuse.yaml
```yaml
# Copyright (c) 2025 SiFli Technologies(Nanjing) Co., Ltd
# SPDX-License-Identifier: Apache-2.0

description: SiFli SF32LB eFuse Controller

compatible: "sifli,sf32lb-efuse"

include: base.yaml

properties:
  reg:
    required: true

  sifli,pmuc:
    type: phandle
    required: true
    description: Reference to PMUC syscon for voltage control during eFuse read
```

## dts/bindings/syscon/sifli-sf32lb-cfg.yaml
```yaml
# Copyright (c) 2025 Core Devices LLC
# SPDX-License-Identifier: Apache-2.0

properties:
  sifli,cfg:
    type: phandle
    description: Phandle to the SiFli SF32LB System Configuration (HPSYS_CFG)
```

## dts/bindings/syscon/syscon.yaml
```yaml
# Copyright (c) 2021 Carlo Caione <ccaione@baylibre.com>
# SPDX-License-Identifier: Apache-2.0

description: System Controller Registers R/W

compatible: "syscon"

include: base.yaml

properties:
    reg:
      required: true
    reg-io-width:
      type: int
      required: false
      description: The width of the registers in the syscon region in bytes. Default is 4 bytes.
```

## dts/bindings/syscon/ti,control-module.yaml
```yaml
# Copyright (c) 2026 Texas Instruments
# SPDX-License-Identifier: Apache-2.0

description: TI-K3 device level control register module

compatible: "ti,control-module"

include: syscon.yaml

properties:
  ti,unlock-offsets:
    type: array
    description: |
      Unlock configuration consisting of offsets to the KICK0 registers for
      the partitions that require unlocking. Two 32-bit magic numbers will
      be written at this location to unlock the partition.

      Example:
        ti,unlock-offsets = <0x1008   /* Partition 1  */
                             0x5008>; /* Partition 2 */
```

## dts/bindings/syscon/ti,k3-ctrl-partition.yaml
```yaml
# Copyright (c) 2025 Texas Instruments
# SPDX-License-Identifier: Apache-2.0

description: |
  The control module controls top-level device behavior in various states.
  It contains registers for configuration, bootstrap signals, I/O pad multiplexing,
  clock selection, and many others.
  This binding defines a single partition in a control module.

compatible: "ti,k3-ctrl-partition"

include: syscon.yaml

properties:
  lock-offset:
    type: int
    default: 0x1008
    description: Offset for the KICK0 register
```

## dts/bindings/tach/ene,kb1200-tach.yaml
```yaml
# Copyright (c) 2024 ENE Technology Inc.
# SPDX-License-Identifier: Apache-2.0

description: ENE, KB1200-Tachometer node

compatible: "ene,kb1200-tach"

include: [tach.yaml, pinctrl-device.yaml]

properties:
  reg:
    required: true

  pulses-per-round:
    required: true
    type: int
    description: number of pulses (holes) per round of tachometer's input (encoder)

  sample-time-us:
    required: true
    type: int
    enum:
      - 2
      - 8
      - 16
      - 64
    description: |
      sampling time of tachometer. Please notice that it must be 2/8/16/64 us.

  pinctrl-0:
    required: true

  pinctrl-names:
    required: true
```

## dts/bindings/tach/ite,it51xxx-tach.yaml
```yaml
# Copyright (c) 2025 ITE Technology Corporation.
# SPDX-License-Identifier: Apache-2.0

description: ITE, it51xxx Tachometer node

compatible: "ite,it51xxx-tach"

include: [tach.yaml, pinctrl-device.yaml]

properties:
  reg:
    required: true

  input-pin:
    type: int
    required: true
    enum:
      - 0
      - 1
    description: 0 = TACH_INPUT_PIN_A, 1 = TACH_INPUT_PIN_B

  pulses-per-round:
    type: int
    required: true
    description: number of pulses per round of tachometer's input

  pinctrl-0:
    required: true

  pinctrl-names:
    required: true
```

## dts/bindings/tach/ite,it8xxx2-tach.yaml
```yaml
# Copyright (c) 2021 ITE Technology Corporation.
# SPDX-License-Identifier: Apache-2.0

description: ITE IT8xxx2 Tachometer

compatible: "ite,it8xxx2-tach"

include: [tach.yaml, pinctrl-device.yaml]

properties:
  reg:
    required: true

  dvs-bit:
    type: int
    required: true
    description: tachometer data valid bit of tswctlr register

  chsel-bit:
    type: int
    required: true
    description: tachometer data valid status bit of tswctlr register

  channel:
    type: int
    required: true
    enum:
      - 0
      - 1
    description: 0 = TACH_CHANNEL_A, 1 = TACH_CHANNEL_B

  pulses-per-round:
    type: int
    required: true
    description: number of pulses per round of tachometer's input

  pinctrl-0:
    required: true

  pinctrl-names:
    required: true
```

## dts/bindings/tach/microchip,mec5-tach.yaml
```yaml
# Copyright (c) 2024, Microchip Technology Inc.
# SPDX-License-Identifier: Apache-2.0

description: Microchip MEC5 HAL based tachometer

compatible: "microchip,mec5-tach"

include: [tach.yaml, pinctrl-device.yaml]

properties:
  reg:
    required: true

  interrupts:
    required: true

  read-mode:
    type: string
    description: |
      Select the method to increment the tachometer counter. Power on default
      is to increment the counter on the rising edge of the tachometer input.
      The second method is increment on the rising edge of the internal 100KHz
      clock. The counter is latched into the tachometers counter read-only bit
      field in its control register and reset when the programmed number of edges
      is detected.
    enum:
      - "input rising edge"
      - "internal 100kHz rising edge"

  edges-count:
    type: string
    description: |
      The number of edges on the tachometer input triggering capture of the
      100 KHz counter. Typically, two periods of the input represent one fan
      revolution. A tachometer input period consists of three edges. This value
      is the number of edges used to determine the interval over which the
      tachometers 100KHz internal pulses will be counted.
      Nine tach edges is 4 Tach periods.
      Five tach edges is 2 Tach periods.
      Three tach edges is 1 Tach period.
      Two tach edges is 1/2 Tach period.
    enum:
      - "9"
      - "5"
      - "3"
      - "2"

  "#address-cells":
    required: true
    const: 1
  "#size-cells":
    type: int
    const: 0
```

## dts/bindings/tach/nuvoton,nct-tach.yaml
```yaml
# Copyright (c) 2025 Nuvoton Technology Corporation.
# SPDX-License-Identifier: Apache-2.0

description: Nuvoton, NCT-Tachometer node

compatible: "nuvoton,nct-tach"

include: [tach.yaml, pinctrl-device.yaml]

properties:
  reg:
    required: true
  clocks:
    required: true
  pinctrl-0:
    required: true
  pinctrl-names:
    required: true
  tach-channel:
    type: int
    description: |
      A index to indicate TACH module that received transition signal.
      Please don't overwrite it in the board-level DT driver.
  sample-clk:
    required: true
    type: int
    description: |
      sampling clock frequency of tachometer. Please notice that it must be
      fixed to 32768 if bus in clocks property is NCT_CLOCK_BUS_LFCLK.
  pin-select:
    type: int
    description: selected pin of tachometer.
  pin-static:
    type: boolean
    description: |
        tachometer doesn't support select I/O pin. (pin-select)
        Please don't overwrite it in the board-level DT driver.
  pulses-per-round:
    required: true
    type: int
    description: number of pulses (holes) per round of tachometer's input (encoder)
```

## dts/bindings/tach/nuvoton,npcx-tach.yaml
```yaml
# Copyright (c) 2021 Nuvoton Technology Corporation.
# SPDX-License-Identifier: Apache-2.0

description: Nuvoton, NPCX-Tachometer node

compatible: "nuvoton,npcx-tach"

include: [tach.yaml, pinctrl-device.yaml]

properties:
    reg:
        required: true
    clocks:
        required: true
    pinctrl-0:
        required: true
    pinctrl-names:
        required: true
    sample-clk:
        type: int
        required: false
        description: |
          sampling clock frequency of tachometer. Please notice that it must be
          fixed to 32768 if bus in clocks property is NPCX_CLOCK_BUS_LFCLK.
    port:
        type: int
        required: false
        description: selected port of tachometer (port-A is 0 and port-B is 1)
    pulses-per-round:
        type: int
        required: false
        description: number of pulses (holes) per round of tachometer's input (encoder)
```

## dts/bindings/tach/realtek,rts5912-tach.yaml
```yaml
# SPDX-License-Identifier: Apache-2.0
#
# Copyright (c) 2025 Realtek Semiconductor Corporation, SIBG-SD7
#

description: Realtek rts5912 tachometer controller

compatible: "realtek,rts5912-tach"

include: [tach.yaml, pinctrl-device.yaml, sensor-device.yaml]

properties:
  reg:
    required: true

  interrupts:
    required: true

  pinctrl-0:
    required: true

  pinctrl-names:
    required: true

  pulses-per-round:
    type: int
    required: true
    description: number of pulses per round of tachometer's input
```

## dts/bindings/tach/tach.yaml
```yaml
# Copyright (c) 2020, Intel Corporation
# SPDX-License-Identifier: Apache-2.0

# Common properties for HW supported tachometers

include: base.yaml

bus: tach
```

## dts/bindings/tach/zephyr,tach-gpio.yaml
```yaml
# Copyright (c) 2025, Prevas A/S
# SPDX-License-Identifier: Apache-2.0

title: Tachometer sensor using GPIO.

description: |
  This tachometer sensor uses GPIO interrupts to measure the duration of one
  pulse to calculate the RPM.

compatible: "zephyr,tach-gpio"

include: tach.yaml

properties:
  gpios:
    type: phandle-array
    description: GPIO used to measure pulses.

  timeout-ms:
    type: int
    default: 1000
    description: |
      Milliseconds to wait for a complete pulse.
      Default is 1 s. This allows reading down to about 120 RPM (not 60
      because the measurement might start right after a pulse start).

  pulses-per-round:
    type: int
    description: Number of pulses per round.
    required: true
```

## dts/bindings/tcpc/nuvoton,numaker-tcpc.yaml
```yaml
# Copyright (c) 2024 Nuvoton Technology Corporation
# SPDX-License-Identifier: Apache-2.0

description: Nuvoton NuMaker USB Type-C port controller

compatible: "nuvoton,numaker-tcpc"

include: [base.yaml, reset-device.yaml, pinctrl-device.yaml]

properties:
  reg:
    required: true

  interrupts:
    required: true

  resets:
    required: true

  clocks:
    required: true

  vconn-overcurrent-event-polarity:
    type: string
    description: |
      Polarity of VCONN overcurrent event
    enum:
      - "low-active"
      - "high-active"

  vconn-discharge-polarity:
    type: string
    description: |
      Polarity of VCONN discharge
    enum:
      - "low-active"
      - "high-active"

  vconn-enable-polarity:
    type: string
    description: |
      Polarity of VCONN enable
    enum:
      - "low-active"
      - "high-active"

  vbus-overcurrent-event-polarity:
    type: string
    description: |
      Polarity of VBUS overcurrent event
    enum:
      - "low-active"
      - "high-active"

  vbus-forceoff-event-polarity:
    type: string
    description: |
      Polarity of VBUS force-off event
    enum:
      - "low-active"
      - "high-active"

  frs-tx-polarity:
    type: string
    description: |
      Polarity of fast role swap tx
    enum:
      - "low-active"
      - "high-active"

  vbus-discharge-enable-polarity:
    type: string
    description: |
      Polarity of VBUS discharge enable
    enum:
      - "low-active"
      - "high-active"

  vbus-sink-enable-polarity:
    type: string
    description: |
      Polarity of VBUS sink enable
    enum:
      - "low-active"
      - "high-active"

  vbus-source-enable-polarity:
    type: string
    description: |
      Polarity of VBUS source enable
    enum:
      - "low-active"
      - "high-active"

  vbus-divide:
    type: string
    required: true
    description: |
      VBUS measurement divider
    enum:
      - "no-divide"
      - "divide-10"
      - "divide-20"

  dead-battery:
    type: boolean
    description: |
      Determine if USB-C Dead Battery pull-down resistor should be
      applied to the CC lines.

  pinctrl-0:
    required: true

  pinctrl-names:
    required: true

  gpios:
    type: phandle-array
    required: true

  gpio-names:
    type: string-array
    required: true
    description: |
      Valid names of GPIO:
      "vbus-detect": GPIO for VBUS detect (must)
      "vbus-discharge": GPIO for VBUS discharge (option)
      "vconn-discharge": GPIO for VCONN discharge (option)

  io-channels:
    type: phandle-array
    description: |
      EADC channels for measuring VBUS/VCONN voltage

  io-channel-names:
    type: string-array
    description: |
      Valid names of EADC channels:
      "chn-vbus": EADC channel for measuring VBUS voltage (option)
      "chn-vconn": EADC channel for measuring VCONN voltage (option)

  adc-measure-timer-trigger-rate:
    type: int
    description: |
      Rate of timer-triggered EADC measurement (Hz).
      This is ignored when none of above is specified.
      The default is chosen by following BSP sample,
      and is to update UTCPD in a proper rate.
    default: 100
```

## dts/bindings/tcpc/onnn,fusb307-tcpc.yaml
```yaml
# Copyright (c) 2025 Jianxiong Gu <jianxiong.gu@outlook.com>
# SPDX-License-Identifier: Apache-2.0

description: |
    Onsemi FUSB307 USB Type-C port controller

    Example:

    ports {
      #address-cells = <1>;
      #size-cells = <0>;
      port0: usbc-port@0 {
        compatible = "usb-c-connector";
        reg = <0>;
        tcpc = <&fusb307_tcpc0>;
        vbus = <&fusb307_vbus0>;
        power-role = "sink";
        sink-pdos = <PDO_FIXED(5000, 100, 0)>;
      };
    };

    i2c1 {
      status = "okay";
      clock-frequency = <I2C_BITRATE_FAST_PLUS>;
      fusb307_tcpc0: fusb307_tcpc0@50 {
        compatible = "onnn,fusb307-tcpc";
        reg = <0x50>;
        irq-gpios = <&gpioa 8 GPIO_ACTIVE_LOW>;
        status = "okay";

        fusb307_vbus0: fusb307_vbus0 {
          compatible = "zephyr,usb-c-vbus-tcpci";
          status = "okay";
        };
      };
    };

compatible: "onnn,fusb307-tcpc"

include: [base.yaml, pinctrl-device.yaml]

properties:
  reg:
    required: true

  irq-gpios:
    type: phandle-array
    required: true
    description: |
      Interrupt GPIO pin connected from the chip.

  transmit-retries:
    type: int
    default: 2
    description: |
      Maximum number of packet retransmissions done by TCPC. Valid values are <0, 3>.
      This value is used to fill the Retry Counter part of the TCPCI Transmit register.

  vconn-disc-gpios:
    type: phandle-array
    description: |
      GPIO pin for VCONN discharge control. FUSB307 does not have VCONN discharge capability.
      If VCONN discharge is not needed, this pin does not need to be defined in the device
      tree. Otherwise, this pin and a discharge path are required.
```
