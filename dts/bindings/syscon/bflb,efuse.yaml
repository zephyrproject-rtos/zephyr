## dts/bindings/tcpc/parade,ps8xxx.yaml
```yaml
# Copyright 2024 Google LLC
# SPDX-License-Identifier: Apache-2.0

description: |
    Parade PS8xxx series TCPC chip

compatible: "parade,ps8xxx"

include: [base.yaml, pinctrl-device.yaml]

properties:
  reg:
    required: true

  irq-gpios:
    type: phandle-array
    description: |
      Alert pin from the TCPC triggering interrupt

  transmit-retries:
    type: int
    default: 2
    description: |
      Maximum number of packet retransmissions done by TCPC. Valid values are <0, 3>.
      This value is used to fill the Retry Counter part of the TCPCI Transmit register.
```

## dts/bindings/tcpc/richtek,rt1715.yaml
```yaml
# Copyright (c) 2024 Jianxiong Gu <jianxiong.gu@outlook.com>
# SPDX-License-Identifier: Apache-2.0

description: |
    The Richtek RT1715 is a Type-C Port Controller (TCPC) chip.

    Example:

    ports {
        #address-cells = <1>;
        #size-cells = <0>;
        port0: usbc-port@0 {
          compatible = "usb-c-connector";
          reg = <0>;
          tcpc = <&rt1715_tcpc0>;
          vbus = <&vbus0>;
          power-role = "sink";
          sink-pdos = <PDO_FIXED(5000, 100, 0)>;
        };
    };

    vbus0: vbus {
      compatible = "zephyr,usb-c-vbus-adc";
      status = "okay";
      io-channels = <&adc 2>;
      output-ohms = <10000>;
      full-ohms = <(100000 + 10000)>;
    };

    i2c1 {
      status = "okay";
      clock-frequency = <I2C_BITRATE_FAST_PLUS>;
      rt1715_tcpc0: rt1715@4e {
        compatible = "richtek,rt1715";
        reg = <0x4e>;
        irq-gpios = <&gpio0 16 GPIO_ACTIVE_LOW>;
        status = "okay";
      };
    };

compatible: "richtek,rt1715"

include: [base.yaml, pinctrl-device.yaml]

properties:
  reg:
    required: true

  irq-gpios:
    type: phandle-array
    required: true
    description: |
      Interrupt GPIO pin connected from the chip.

  transmit-retries:
    type: int
    default: 2
    description: |
      Maximum number of packet retransmissions done by TCPC. Valid values are <0, 3>.
      This value is used to fill the Retry Counter part of the TCPCI Transmit register.

  vconn-ctrl-gpios:
    type: phandle-array
    description: |
      GPIO pin for VCONN control. RT1715 does not have built-in VCONN power supply. If the
      state of the VCONN power supply need to be toggled, this pin and a switchable power
      supply are required.

  vconn-disc-gpios:
    type: phandle-array
    description: |
      GPIO pin for VCONN discharge control. RT1715 does not have VCONN discharge capability.
      If VCONN discharge is not needed, this pin does not need to be defined in the device
      tree. Otherwise, this pin and a discharge path are required.
```

## dts/bindings/tcpc/st,stm32-ucpd.yaml
```yaml
# Copyright 2021 The Chromium OS Authors
# SPDX-License-Identifier: Apache-2.0

description: |
    STM32 USB Type-C / Power Delivery.

    The default values were taken from the LL_UCPD_StructInit function defined in the HAL.

compatible: "st,stm32-ucpd"

include: [base.yaml, pinctrl-device.yaml]

properties:
  reg:
    required: true

  clocks:
    required: true

  interrupts:
    required: true

  psc-ucpdclk:
    default: 2
    type: int
    enum:
      - 1
      - 2
      - 4
      - 8
      - 16
      - 32
      - 64
      - 128
    description: |
      Determines the division ratio of a kernel clock pre-scaler
      producing UCPD peripheral clock (ucpd_clk). It is recommended
      to use the pre-scaler so as to set the ucpd_clk frequency in
      the range from 6 to 9 MHz.

  ifrgap:
    type: int
    default: 17
    description: |
      Determines the division ratio of a ucpd_clk divider producing
      inter-frame gap timer clock (tInterFrameGap).
      The division ratio 15 is to apply for Tx clock at the USB PD 2.0
      specification nominal value.
      Valid range: 2 - 32

  transwin:
    type: int
    default: 8
    description: |
      Determines the division ratio of a hbit_clk divider producing
      tTransitionWindow interval.
      Valid range: 2 - 32

  hbitclkdiv:
    type: int
    default: 14
    description: |
      Determines the division ratio of a ucpd_clk divider producing
      half-bit clock (hbit_clk)
      Valid range: 1 - 64

  dead-battery:
    type: boolean
    description: |
      Determine if USB-C Dead Battery pull-down's should be
      applied to the CC lines.

  pinctrl-0:
    required: true

  pinctrl-names:
    required: true
```

## dts/bindings/tcpc/ti,tps25750.yaml
```yaml
# Copyright (c) 2023, ithinx GmbH
# Copyright (c) 2023, Tonies GmbH
#
# SPDX-License-Identifier: Apache-2.0

description: |
    TI TPS25750 Type-C Port Switch / Power Delivery (PD) Controller device.
    The default values were taken from the LL_UCPD_StructInit function defined in the HAL.

compatible: "ti,tps25750"

include: [base.yaml, i2c-device.yaml]

properties:
    irq-gpios:
      type: phandle-array
      required: true
```

## dts/bindings/test/test-gpio-enable-disable-interrupt.yaml
```yaml
#
# Copyright (c) 2022 Google Inc
#
# SPDX-License-Identifier: Apache-2.0
#

description: |
    This binding provides resources required to build and run the
    tests/drivers/gpio/gpio_enable_disable_interrupt test in Zephyr.

compatible: "test-gpio-enable-disable-interrupt"

properties:
  irq-gpios:
    type: phandle-array
    required: true
    description: |
      Identity of a GPIO that will be configured as an input for interrupt.
```
