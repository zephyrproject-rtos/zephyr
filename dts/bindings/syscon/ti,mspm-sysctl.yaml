## dts/bindings/timer/hisilicon,hi3861-timer.yaml
```yaml
# SPDX-FileCopyrightText: Copyright The Zephyr Project Contributors
# SPDX-License-Identifier: Apache-2.0

description: |
  Hi3861 APB timer pair with reload counters and software-triggered
  snapshots of the current counter values.

compatible: "hisilicon,hi3861-timer"

include: base.yaml

properties:
  reg:
    required: true

  reg-names:
    required: true

  interrupts:
    required: true

  clock-frequency:
    type: int
    required: true
```

## dts/bindings/timer/infineon,aurix-stm.yaml
```yaml
# SPDX-FileCopyrightText: Copyright (c) 2026 Infineon Technologies AG,
# SPDX-FileCopyrightText: or an affiliate of Infineon Technologies AG. All rights reserved.
# SPDX-FileCopyrightText: Copyright (c) 2026 Linumiz
#
# SPDX-License-Identifier: Apache-2.0

description: AURIX System Timer Module (STM)

compatible: "infineon,aurix-stm"

include: base.yaml

properties:
  reg:
    required: true

  interrupts:
    required: true

  clocks:
    required: true

  freeze:
    type: boolean
    description: Stops the timer when the chip enters Debug mode.
```

## dts/bindings/timer/infineon,tcpwm-system-timer.yaml
```yaml
# SPDX-FileCopyrightText: Copyright (c) 2026 Linumiz
#
# SPDX-License-Identifier: Apache-2.0

description: |
  Infineon TCPWM counter used as the system timer

    &tcpwm2_0 {
            status = "okay";

            system-timer {
                    compatible = "infineon,tcpwm-system-timer";
                    clocks = <&peri0_group0_16bit_0>;
                    status = "okay";
            };
    };

compatible: "infineon,tcpwm-system-timer"

include: base.yaml

properties:
  clocks:
    required: true
    description: Peripheral clock divider feeding the counter
```

## dts/bindings/timer/infineon,tcpwm.yaml
```yaml
# SPDX-FileCopyrightText: Copyright (c) 2026 Infineon Technologies AG,
# SPDX-FileCopyrightText: or an affiliate of Infineon Technologies AG. All rights reserved.
#
# SPDX-License-Identifier: Apache-2.0

description: Infineon TCPWM Timer

compatible: "infineon,tcpwm"

include: base.yaml

properties:
  reg:
    type: array
    required: true
    description: Register base address and size information

  interrupts:
    type: array
    description: Interrupt mapping for TCPWM instance

  resolution:
    type: int
    required: true
    description: Counter/timer resolution (16 or 32 bits)
    enum:
      - 16
      - 32

  clk-dst:
    type: int
    required: true
    description: Peripheral clock destination ID for this TCPWM instance

  index:
    type: int
    description: Index of the TCPWM channel

  clock-frequency:
    type: int
    description: |
      TCPWM peripheral clock frequency in Hz. Required on devices using
      CONFIG_CLOCK_CONTROL_IFX_PERI_CLOCK_V2, where the driver requests this
      rate from the peripheral clock controller at init. This is the
      peripheral clock feeding the counter, not the observed PWM output
      frequency.
```

## dts/bindings/timer/intel,apic-tsc.yaml
```yaml
# SPDX-FileCopyrightText: Copyright The Zephyr Project Contributors
# SPDX-License-Identifier: Apache-2.0

description: |
  Local APIC timer driven from the TSC deadline.

  The timer is a CPU or architecture feature rather than a memory mapped
  peripheral, so the node carries neither reg nor interrupts. It exists so that
  the timer can be named by /chosen/zephyr,system-timer and so that its
  frequency can be described alongside the hardware.

compatible: "intel,apic-tsc"

include: base.yaml

properties:
  clock-frequency:
    type: int
    description: |
      The clock source frequency for this timer, in Hz. This value can be used as
      the default setting for SYS_CLOCK_HW_CYCLES_PER_SEC at the SoC level.
```

## dts/bindings/timer/microchip,pit-g1-timer.yaml
```yaml
# Copyright (C) 2026 Microchip Technology Inc.
#
# SPDX-License-Identifier: Apache-2.0
#

title: Microchip G1 PIT

description: |
  Microchip Periodic Interval Timer driver.

  Group G1 PIT driver supports following hardware peripherals:
    - module name="PIT" id="6079" version="C"

compatible: "microchip,pit-g1-timer"

include: base.yaml

properties:
  reg:
    required: true

  interrupts:
    required: true

  clocks:
    required: true

  clock-frequency:
    type: int
    required: true
    description: |
      PIT input clock frequency in Hz. Used by the build system to derive
      CONFIG_SYS_CLOCK_HW_CYCLES_PER_SEC via Kconfig.defconfig.
```

## dts/bindings/timer/mips,cp0-timer.yaml
```yaml
# SPDX-FileCopyrightText: Copyright The Zephyr Project Contributors
# SPDX-License-Identifier: Apache-2.0

description: |
  MIPS CP0 count/compare timer.

  The timer is part of the CPU rather than a memory mapped peripheral, so the
  node carries no reg. It exists so that the timer can be named by
  /chosen/zephyr,system-timer and so that its frequency can be described
  alongside the hardware.

compatible: "mips,cp0-timer"

include: base.yaml

properties:
  clock-frequency:
    type: int
    description: |
      The clock source frequency for this timer, in Hz. This value can be used as
      the default setting for SYS_CLOCK_HW_CYCLES_PER_SEC at the SoC level.
```

## dts/bindings/timer/openrisc,tick-timer.yaml
```yaml
# SPDX-FileCopyrightText: Copyright The Zephyr Project Contributors
# SPDX-License-Identifier: Apache-2.0

description: |
  OpenRISC tick timer.

  The timer is part of the CPU rather than a memory mapped peripheral, so the
  node carries no reg. It exists so that the timer can be named by
  /chosen/zephyr,system-timer and so that its frequency can be described
  alongside the hardware.

compatible: "openrisc,tick-timer"

include: base.yaml

properties:
  clock-frequency:
    type: int
    description: |
      The clock source frequency for this timer, in Hz. This value can be used as
      the default setting for SYS_CLOCK_HW_CYCLES_PER_SEC at the SoC level.
```
