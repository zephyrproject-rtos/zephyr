## dts/bindings/syscon/ti,mspm-sysctl.yaml
```yaml
# SPDX-FileCopyrightText: Copyright (c) 2026 Texas Instruments
# SPDX-License-Identifier: Apache-2.0

description: TI MSPM System Control (SYSCTL) register module

compatible: "ti,mspm-sysctl"

include: syscon.yaml

properties:
  "#pwren-cells":
    type: int
    const: 2
    description: Number of items in a PWREN specifier (<offset bit>).

pwren-cells:
  - offset
  - bit
```

## dts/bindings/tach/microchip,xec-tach.yaml
```yaml
# Copyright (c) 2020, Intel Corporation
# SPDX-License-Identifier: Apache-2.0

description: Microchip XEC tachometer controller

compatible: "microchip,xec-tach"

include:
  - name: tach.yaml
  - name: pinctrl-device.yaml
  - name: microchip,dmec-ecia-girq.yaml

properties:
  "#address-cells":
    required: true
    const: 1
  "#size-cells":
    type: int
    const: 0
  reg:
    required: true

  interrupts:
    required: true

  pcr-scr:
    type: int
    required: true
    description: |
      TACH Power Clock Reset(PCR) peripheral index and bit position

  tach-edges:
    type: int
    default: 5
    enum:
      - 2
      - 3
      - 5
      - 9
    description: |
      Number of TACH edges the hardware counts 100 kHz clocks over. A TACH
      period is three edges, so the measurement window is 1/2, 1, 2 or 4 TACH
      periods for 2, 3, 5 or 9 edges respectively. A wider window is more
      accurate but takes longer to latch and saturates at a higher fan speed.
      The default of 5 edges matches a fan producing two TACH periods per
      revolution and is the hardware reset value's typical use.

  pulses-per-round:
    type: int
    default: 2
    description: |
      Number of TACH periods the fan generates per revolution. Typical DC
      brushless fans emit a 50% duty cycle, two-period square wave per
      revolution, hence the default of 2.

  clock-frequency:
    type: int
    default: 100000
    description: |
      Frequency in Hz of the clock the hardware counts while the TACH edges are
      observed. Nominally 100 kHz, and the default, but the block divides the
      48 MHz PLL by 480 and that PLL is only specified to 46.56 to 49.44 MHz
      when it is referenced to the internal silicon oscillator, narrowing to
      47.5 to 48.5 MHz with an external reference. The driver takes this value
      as exact, so whatever the real clock differs from it by appears in every
      reported RPM as a flat multiplicative bias. Set it from a measurement of
      the divided clock on the part, or leave it at the nominal value and
      accept the tolerance.
```

## dts/bindings/test/test-counter-capture.yaml
```yaml
#
# Copyright (c) 2026 Meta Platforms
#
# SPDX-License-Identifier: Apache-2.0
#

description: |
    This binding provides resources required to build and run the
    tests/drivers/counter/counter_capture test in Zephyr, in a board's
    vane for the counter.capture test setup.

compatible: "test-counter-capture"

properties:
  test-counter-captures:
    type: phandle-array
    required: true
    description: |
      Counter pins that will be used for capturing a rising and falling edge of a
      gpio signal. The first index is the channel number.

  capture-tolerance-us:
    type: int
    default: 100
    description: |
      Largest difference, in microseconds, between the counter value read
      just before the trigger toggles and the timestamp the capture records,
      for the signal path of this board.
```

## dts/bindings/test/test-dma-memory-to-memory.yaml
```yaml
# Copyright The Zephyr Project Contributors
# SPDX-License-Identifier: Apache-2.0

description: |
  A DMA controller a board makes available for memory-to-memory transfer
  tests, with the channels and the memory the tests may use on it.

  Example:

    / {
            dma_test_dma1: dma-test-dma1 {
                    compatible = "test-dma-memory-to-memory";
                    dma = <&dma1>;
                    channels = <4 6>;
                    max-transfer-size = <4094>;
                    memory-region = <&sram4>;
            };
    };

compatible: "test-dma-memory-to-memory"

properties:
  dma:
    type: phandle
    required: true
    description: The DMA controller under test.

  channels:
    type: array
    description: |
      Channels the tests may use on the controller, in the order they take
      them. Tests first ask the driver for a channel and use this list only
      when the driver does not allocate channels; without the list they use
      channels 0 and 1.

  max-transfer-size:
    type: int
    description: |
      Largest block the tests transfer on this controller, in bytes. Lower it
      for controllers with a block size limit or boards with little RAM. The
      tests use the smallest value of all controllers under test, 8192 bytes
      when no controller sets it.

  channel-link:
    type: boolean
    description: |
      The controller links channels, a transfer on one triggering the next,
      which the chan_link_transfer test exercises.

  scatter-gather:
    type: boolean
    description: |
      The controller runs scatter-gather transfers, which the scatter_gather
      test exercises.

  cyclic:
    type: boolean
    description: |
      The controller runs cyclic transfers, which the cyclic test exercises.

  max-burst-length:
    type: int
    description: |
      Longest burst the controller transfers, in bytes. The chan_blen_transfer
      test skips its 16-byte bursts on a controller limited below that.

  memory-region:
    type: phandle
    description: |
      Memory region node (compatible zephyr,memory-region) the transfer
      buffers are placed in, for controllers that only reach part of the
      memory or need it uncached. The buffers are shared by every controller
      under test, so the first controller naming a region decides. Without it
      the buffers are in the nocache section when CONFIG_NOCACHE_MEMORY is
      enabled, otherwise in ordinary RAM.
```

## dts/bindings/test/vnd,classed-device.yaml
```yaml
# SPDX-FileCopyrightText: Copyright (c) 2026 Silicon Laboratories Inc.
# SPDX-License-Identifier: Apache-2.0

description: Test device declaring device classes

compatible: "vnd,classed-device"

include: vnd,class-base.yaml

class: [vnd-class-a, vnd-class-b]
```

## dts/bindings/test/vnd,mspi.yaml
```yaml
#
# Copyright (c) 2026 Muhammad Waleed Badar
#
# SPDX-License-Identifier: Apache-2.0
#

description: Test MSPI node

compatible: "vnd,mspi"

include: [mspi-controller.yaml]
```

## dts/bindings/test/vnd,pinctrl-hogs.yaml
```yaml
# SPDX-FileCopyrightText: Copyright (c) 2026 Axonne Inc.
# SPDX-License-Identifier: Apache-2.0

description: Test pin controller with pin control hogs

compatible: "vnd,pinctrl-hogs"

include:
  - base.yaml
  - pinctrl-hogs.yaml

child-binding:
  child-binding:
    properties:
      pins:
        type: array
        required: true
```

## dts/bindings/test/vnd,uint32-or-uint64-holder.yaml
```yaml
# Copyright (c) Qualcomm Technologies, Inc. and/or its subsidiaries.
# SPDX-License-Identifier: Apache-2.0

description: Test uint32-or-uint64 property type

compatible: "vnd,uint32-or-uint64-holder"

include: [base.yaml]

properties:
  val-32:
    type: uint32-or-uint64
    description: 1-cell (32-bit) uint32-or-uint64 value

  val-64:
    type: uint32-or-uint64
    description: 2-cell (64-bit) uint32-or-uint64 value

  val-with-default:
    type: uint32-or-uint64
    default: 42
    description: uint32-or-uint64 with a default; omitted from DTS to exercise the default path

  val-with-or:
    type: uint32-or-uint64
    description: uint32-or-uint64 with no default; omitted from DTS to exercise DT_PROP_OR fallback
```

## dts/bindings/test/vnd,uint64-holder.yaml
```yaml
# Copyright (c) 2026 Qualcomm Technologies, Inc.
# SPDX-License-Identifier: Apache-2.0

description: Test uint64 property type

compatible: "vnd,uint64-holder"

include: [base.yaml]

properties:
  val-32:
    type: uint64
    description: 1-cell (32-bit) uint64 value

  val-64:
    type: uint64
    description: 2-cell (64-bit) uint64 value

  val-with-default:
    type: uint64
    default: 42
    description: uint64 with a default; omitted from DTS to exercise the default path

  val-with-or:
    type: uint64
    description: uint64 with no default; omitted from DTS to exercise DT_PROP_OR fallback
```

## dts/bindings/test/vnd,var-uint64-holder.yaml
```yaml
# Copyright (c) Qualcomm Technologies, Inc. and/or its subsidiaries.
# SPDX-License-Identifier: Apache-2.0

description: Test var-uint64 property type

compatible: "vnd,var-uint64-holder"

include: [base.yaml]

properties:
  val-32:
    type: var-uint64
    description: 1-cell (32-bit) var-uint64 value

  val-64:
    type: var-uint64
    description: 2-cell (64-bit) var-uint64 value

  val-with-default:
    type: var-uint64
    default: 42
    description: var-uint64 with a default; omitted from DTS to exercise the default path

  val-with-or:
    type: var-uint64
    description: var-uint64 with no default; omitted from DTS to exercise DT_PROP_OR fallback
```

## dts/bindings/test/zephyr,mbox-consumer.yaml
```yaml
# SPDX-FileCopyrightText: Copyright The Zephyr Project Contributors
# SPDX-License-Identifier: Apache-2.0

description: |
  MBOX test consumer.

  Declares the mailbox channels a platform provides for exercising the
  MBOX API. Unlike the test-only "vnd,mbox-consumer" compatible, this
  node may be placed in a board or SoC devicetree, so MBOX tests can run
  on the platform without a per-board test overlay.

  Channels are listed in transmit/receive pairs named "txN"/"rxN",
  starting at pair 0:

    mbox-consumer {
            compatible = "zephyr,mbox-consumer";
            mboxes = <&mbox 0>, <&mbox 1>, <&mbox 2>, <&mbox 3>;
            mbox-names = "tx0", "rx0", "tx1", "rx1";
    };

  Data sent on a "txN" channel must reach the core running the test
  peer, which answers on the matching "rxN" channel. On platforms where
  both ends of every pair are instead serviced by the core under test
  itself (no remote core relaying messages), set the "loopback" property
  so tests know sent data comes back unmodified.

compatible: "zephyr,mbox-consumer"

include: base.yaml

properties:
  mboxes:
    required: true

  mbox-names:
    required: true

  loopback:
    type: boolean
    description: |
      Messages sent on a "txN" channel are received on the matching
      "rxN" channel by the sending core itself; no remote core is
      involved.

  bidirectional-channels:
    type: boolean
    description: |
      The declared channels can each be used for both sending and
      receiving, so operations that are undefined on unidirectional
      channels (sending on an RX channel, registering a callback on a
      TX channel) do not fail with -ENOSYS.

  mtu:
    type: int
    description: |
      Maximum transfer unit in bytes that mbox_mtu_get() reports for
      the TX channels. Omit for signalling-only mailboxes (MTU 0).

  remote-busy-detection:
    type: boolean
    description: |
      The sender can detect that the remote has not yet read the last
      data sent, making mbox_send() fail with -EBUSY meanwhile.
```

## dts/bindings/timer/amd,acp-timer.yaml
```yaml
# SPDX-FileCopyrightText: Copyright (c) 2026 AMD
# SPDX-License-Identifier: Apache-2.0

description: AMD ACP External Countdown Timer

compatible: "amd,acp-timer"

include: base.yaml

properties:
  interrupts:
    required: true

  clock-frequency:
    type: int
    required: true
    description: Timer clock frequency in Hz (typically 24000000 for ACPRefClk)
```

## dts/bindings/timer/amd,xps-timer-1.00.a.yaml
```yaml
#
# Copyright (c) 2026 Advanced Micro Devices, Inc.
#
# SPDX-License-Identifier: Apache-2.0
#

description: |
  AMD/Xilinx AXI Timer IP node.

  When used as the Zephyr system clock, the node must provide register space,
  interrupts, and a clocks phandle whose target node exposes a clock-frequency
  property.

compatible: "amd,xps-timer-1.00.a"

include: [base.yaml]

properties:
  reg:
    required: true

  interrupts:
    required: true
    description: |
      Interrupt generated by the timer counter used as the Zephyr system clock
      clockevent.

  clocks:
    required: true
    description: |
      Reference to the timer input clock.

      The Zephyr system clock driver obtains the timer frequency from the
      clock-frequency property on the devicetree node referenced by this
      phandle (for example, a fixed-clock node). That property must be present
      on the clock provider node.

  xlnx,one-timer-only:
    type: int
    required: true
    enum:
      - 0
      - 1
    description: |
      0 if both timers are enabled, 1 if only the first timer is enabled.
      When used as the Zephyr system clock (CONFIG_AMD_TMRCTR), this property
      must be 0. Single-timer configurations are not supported.
```

## dts/bindings/timer/arm,sp804.yaml
```yaml
# Copyright (c) 2026 Takayuki Goto
# SPDX-License-Identifier: Apache-2.0

description: |
  ARM SP804 dual timer module.

  The two timers in the block share a single interrupt line. This driver uses
  the first one to generate the kernel tick and leaves the second one free
  running as the cycle counter.

compatible: "arm,sp804"

include: base.yaml

properties:
  reg:
    required: true

  interrupts:
    required: true

  clock-frequency:
    type: int
    required: true
    description: Frequency of the timer input clock (TIMCLK), in Hz.
```

## dts/bindings/timer/aspeed,ast2700-bootmcu-timer.yaml
```yaml
# Copyright (c) 2026 ASPEED Technology Inc.
# SPDX-License-Identifier: Apache-2.0

description: |
  ASPEED AST2700 BootMCU system timer with a free-running 64-bit counter
  clocked at 1 MHz and a 64-bit alarm. The alarm drives the RISC-V machine
  timer interrupt.

compatible: "aspeed,ast2700-bootmcu-timer"

include: base.yaml

properties:
  reg:
    required: true

  interrupts-extended:
    required: true
```

## dts/bindings/timer/cortex-m-systick.yaml
```yaml
# Copyright (c) 2023 MUNIC SA
# SPDX-License-Identifier: Apache-2.0

# Common fields for SysTick of ARM Cortex-M chips
include: base.yaml

properties:
  reg:
    required: true

  external-clock-source:
    type: boolean
    description: |
      For ARM Cortex-M SysTick timer, the CLKSOURCE bit in the
      SysTick Control and Status Register (CSR) selects the clock source.
      If this property is present, the external reference clock is selected.
      If absent, the processor/core clock is selected.

  zephyr,min-timeout-cycles:
    type: int
    description: |
      Minimum SysTick timeout, in SysTick cycles. This is the smallest value the
      SysTick driver will program into the timer LOAD register. It determines the
      kernel's minimum available timing granularity (resolution) in conjunction
      with the clock frequency (CONFIG_SYS_CLOCK_HW_CYCLES_PER_SEC).

      When specified, the minimum timing granularity is
      (<value> cycles / CONFIG_SYS_CLOCK_HW_CYCLES_PER_SEC) seconds, subject to
      a hardware floor of two cycles (a LOAD of zero stops the counter).

      Otherwise, the default is derived from a fixed wall-clock budget
      (SYSTICK_MIN_DELAY_US, 10 us) converted to cycles at the actual clock
      frequency and floored at two cycles.

      Set this property only when the default budget is unsuitable, for example
      to enlarge the floor when the SysTick interrupt can be masked for longer
      than 10 us (see CONFIG_CORTEX_M_SYSTICK_INTERRUPT_PRIORITY).
```
