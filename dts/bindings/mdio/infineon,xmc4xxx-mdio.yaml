## dts/bindings/mdio/infineon,xmc4xxx-mdio.yaml
```yaml
# Copyright (c) 2023 SLB
# SPDX-License-Identifier: Apache-2.0

description: Infineon xmc4xxx Family MDIO Driver node

compatible: "infineon,xmc4xxx-mdio"

include:
  - name: mdio-controller.yaml
  - name: pinctrl-device.yaml

properties:
  mdi-port-ctrl:
    description: |
      The MDIO input is connected to several port/pins via a mux.
      This is not handled by pinctrl because the mux is located at the
      peripheral and not GPIO. The possible connections are defined by
      an enum.
    type: string

    enum:
      - "P0_9"
      - "P2_0"
      - "P1_11"
    required: true

  pinctrl-0:
    required: true

  pinctrl-names:
    required: true
```

## dts/bindings/mdio/intel,igc-mdio.yaml
```yaml
# Copyright 2025 Intel Corporation
# SPDX-License-Identifier: Apache-2.0

description: Intel IGC MDIO device.

compatible: "intel,igc-mdio"

include: [mdio-controller.yaml, base.yaml]
```

## dts/bindings/mdio/mdio-controller.yaml
```yaml
# Copyright (c) 2021 IP-Logix Inc.
# SPDX-License-Identifier: Apache-2.0

# Common fields for MDIO controllers

include: base.yaml

bus: mdio

properties:
  "#address-cells":
    required: true
    const: 1

  "#size-cells":
    required: true
    const: 0

  suppress-preamble:
    type: boolean
    description: |
      When present, the SMA suppresses the 32-bit preamble and transmits
      MDIO frames with only 1 preamble bit. By default, the MDIO frame
      always has 32 bits of preamble as defined in the IEEE 802.3 specs.
```

## dts/bindings/mdio/microchip,gmac-u2005-mdio.yaml
```yaml
# Copyright (c) 2025 Microchip Technology Inc.
# SPDX-License-Identifier: Apache-2.0

description: Microchip GMAC MDIO binding

compatible: "microchip,gmac-u2005-mdio"

include:
  - name: mdio-controller.yaml
  - name: pinctrl-device.yaml

properties:
  clocks:
    type: phandle-array
```

## dts/bindings/mdio/microchip,pic32cxsg-mdio.yaml
```yaml
# Copyright (c) 2021 IP-Logix Inc.
# SPDX-License-Identifier: Apache-2.0

description: Microchip PIC32CXSG Family MDIO Driver node

compatible: "microchip,pic32cxsg-mdio"

include:
  - name: mdio-controller.yaml
  - name: pinctrl-device.yaml

properties:
  clocks:
    type: phandle-array
```

## dts/bindings/mdio/nxp,enet-mdio.yaml
```yaml
# Copyright 2023 NXP
# SPDX-License-Identifier: Apache-2.0

description: NXP ENET MDIO Features

compatible: "nxp,enet-mdio"

include: [mdio-controller.yaml, pinctrl-device.yaml]

properties:
  pinctrl-0:
    required: true

  pinctrl-names:
    required: true
```

## dts/bindings/mdio/nxp,enet-qos-mdio.yaml
```yaml
# Copyright 2024 NXP
# SPDX-License-Identifier: Apache-2.0

description: NXP ENET QOS MDIO Controller

compatible: "nxp,enet-qos-mdio"

include: [mdio-controller.yaml]
```

## dts/bindings/mdio/nxp,imx-netc-emdio.yaml
```yaml
# Copyright 2024 NXP
# SPDX-License-Identifier: Apache-2.0

description: NXP i.MX NETC External MDIO controller

compatible: "nxp,imx-netc-emdio"

include: [mdio-controller.yaml, pinctrl-device.yaml]

properties:
  reg:
    required: true

  clocks:
    required: true

  pinctrl-0:
    required: true

  pinctrl-names:
    required: true
```

## dts/bindings/mdio/nxp,kinetis-mdio.yaml
```yaml
# Copyright (c) 2021 Bernhard Kraemer
# SPDX-License-Identifier: Apache-2.0

description: NXP Kinetis Family MDIO Driver node

compatible: "nxp,kinetis-mdio"

include: mdio-controller.yaml

properties:
  reg:
    required: false
```

## dts/bindings/mdio/renesas,ra-mdio-rmac.yaml
```yaml
# Copyright (c) 2025 Renesas Electronics Corporation
# SPDX-License-Identifier: Apache-2.0

description: Renesas RA External MDIO controller

compatible: "renesas,ra-mdio-rmac"

include: [mdio-controller.yaml, pinctrl-device.yaml]

properties:
  channel:
    type: int
    required: true

  pinctrl-0:
    required: true

  pinctrl-names:
    required: true

  phy-connection-type:
    type: string
    description: |
      Specifies the interface connection type between ethernet MAC and PHY.
    enum:
      - "mii"
      - "rmii"
      - "gmii"
      - "rgmii"
```

## dts/bindings/mdio/sensry,sy1xx-mdio.yaml
```yaml
# Copyright (c) 2024 sensry.io
# SPDX-License-Identifier: Apache-2.0

description: Sensry SY1XX MDIO Driver node

compatible: "sensry,sy1xx-mdio"

include: [base.yaml, mdio-controller.yaml, pinctrl-device.yaml]

properties:
  reg:
    required: true

  pinctrl-0:
    required: true

  pinctrl-names:
    required: true
```

## dts/bindings/mdio/snps,dwcxgmac-mdio.yaml
```yaml
# Copyright(c) 2024 Intel Corporation.
# SPDX - License - Identifier : Apache - 2.0

description: Synopsys DWC XGMAC MDIO SMA Driver node

compatible: "snps,dwcxgmac-mdio"

include:
  - name: mdio-controller.yaml

properties:
  csr-clock-indx:
    type: int
    default: 1
    description: |
      MDIO csr reference clock speed
      - 0: "100_150MHZ"
      - 1: "150_250MHZ"
      - 2: "250_300MHZ"
      - 3: "300_350MHZ"
      - 4: "350_400MHZ"
      - 5: "450_500MHZ"
  clock-range-sel:
    type: boolean
    description: |
      When this field is true, it overrides the default
      MDIO clock generation based on CSR clock.

  resets:
    type: phandle-array
    description: get reset line value
```

## dts/bindings/mdio/st,stm32-mdio.yaml
```yaml
# Copyright (c) 2024 BayLibre, SAS
# Copyright (c) 2024 Analog Devices Inc.
# SPDX-License-Identifier: Apache-2.0

description: ST MDIO Features

compatible: "st,stm32-mdio"

include: [mdio-controller.yaml, pinctrl-device.yaml]

properties:
  "#address-cells":
    required: true
    const: 1

  "#size-cells":
    required: true
    const: 0

  pinctrl-0:
    required: true

  pinctrl-names:
    required: true
```

## dts/bindings/mdio/ti,am62l-cpsw-mdio.yaml
```yaml
# Copyright (c) 2026 Texas Instruments Incorporated
# Author: Siddharth Vadapalli <s-vadapalli@ti.com>
# SPDX-License-Identifier: Apache-2.0

description: TI AM62L CPSW MDIO controller

compatible: "ti,am62l-cpsw-mdio"

include: mdio-controller.yaml
```

## dts/bindings/mdio/xilinx,axi-ethernet-1.00.a-mdio.yaml
```yaml
# Copyright (c) 2024 CISPA Helmholtz Center for Information Security
# SPDX-License-Identifier: Apache-2.0

# Common fields for MDIO controllers

include: mdio-controller.yaml

compatible: xlnx,axi-ethernet-1.00.a-mdio

description: MDIO interface of Xilinx AXI 1G/2.5G Ethernet Subsystem.

properties:
  reg:
    type: array
    description: |
      Control registers of the MDIO device are also used for the Ethernet MAC controller.
      Thus, both devices should have a parent node with compatible "xlnx,axi-ethernet-subsystem-7.2"
      which defines the reg property, and MAC and MDIO should NOT have a reg property.
```

## dts/bindings/mdio/xilinx,axi-ethernet-7.-2-mdio.yaml
```yaml
# Copyright (c) 2024 CISPA Helmholtz Center for Information Security
# SPDX-License-Identifier: Apache-2.0

# Common fields for MDIO controllers

include: mdio-controller.yaml

compatible: xlnx,axi-ethernet-7.2-mdio

description: MDIO interface of Xilinx AXI 1G/2.5G Ethernet Subsystem.

properties:
  reg:
    required: true
    type: array
    description: |
      Control registers of the MDIO device. Should be the same value that is also
      used for the Ethernet MAC controller. The driver uses the appropriate offsets.

  clock-frequency:
    type: int
    required: true
    description: |
      Clock frequency supplied to the MDIO bus. Required for calculating MDC divider.
```

## dts/bindings/mdio/xlnx,axi-ethernet-subsystem.yaml
```yaml
# Copyright (c) 2024 CISPA Helmholtz Center for Information Security
# SPDX-License-Identifier: Apache-2.0

description: Xilinx AXI 1G/2.5G Ethernet Subsystem wrapper node (contains mdio/mac) bindings.

include: [base.yaml]

compatible: "xlnx,axi-ethernet-subsystem-7.2"
```

## dts/bindings/mdio/xlnx,gem-mdio.yaml
```yaml
# Copyright (c) 2025 Immo Birnbaum
# SPDX-License-Identifier: Apache-2.0

description: Xilinx GEM MDIO node

compatible: "xlnx,gem-mdio"

include: mdio-controller.yaml
```

## dts/bindings/mdio/zephyr,mdio-gpio.yaml
```yaml
# Copyright (c) 2023 Aleksandr Senin
# SPDX-License-Identifier: Apache-2.0

description: Zephyr MDIO bitbang driver

compatible: "zephyr,mdio-gpio"

include: mdio-controller.yaml

properties:
  mdc-gpios:
    type: phandle-array
    required: true
    description: GPIO pin for the MDC

  mdio-gpios:
    type: phandle-array
    required: true
    description: GPIO pin for the MDIO
```

## dts/bindings/mdio/zephyr,mdio-i2c.yaml
```yaml
# Copyright The Zephyr Project Contributors
# SPDX-License-Identifier: Apache-2.0

description: Zephyr MDIO bitbang driver

compatible: "zephyr,mdio-i2c"

include: mdio-controller.yaml

on-bus: i2c
```

## dts/bindings/mech/zephyr,mech-joint.yaml
```yaml
# Copyright (c) 2026 Sylvain Mosnier
# SPDX-License-Identifier: Apache-2.0

description: |
  Kinematic joint between two links in a kinematic tree.

  A joint defines the transform from the parent link frame to the child link
  frame and the type of motion allowed between them. The root joint of the 
  kinematic tree has no parent link.

  Joint types:
    fixed      No motion. Child is rigidly attached to parent.
    revolute   Single-axis rotation with position limits.
    continuous Single-axis rotation without limits (e.g. a wheel).
    prismatic  Single-axis translation with position limits.
    floating   6-DOF unconstrained (e.g. a tracked object or free body).

  Example — fixed camera mount:

    camera_joint: camera-joint {
        compatible = "zephyr,mech-joint";
        joint-type = "fixed";
        parent-link = <&base_link>;
        origin-translation-mm          = <120 0 80>;
        origin-rotation-euler-zyx-urad = <0 (-261799) 0>; /* -15° */
    };

  Example — revolute elbow with limits:

    elbow_joint: elbow-joint {
        compatible = "zephyr,mech-joint";
        joint-type = "revolute";
        parent-link = <&upper_arm_link>;
        origin-translation-mm          = <0 0 280>;
        origin-rotation-euler-zyx-urad = <0 0 0>;
        axis = <0 1 0>;

        lower     = <(-1571)>; /* -90° in mrad */
        upper     = <1571>;    /* +90° in mrad */
        effort-mN = <5000>;    /* 5 N·m */
        velocity  = <3142>;    /* ~180°/s in mrad/s */
    };

compatible: "zephyr,mech-joint"

properties:
  joint-type:
    type: string
    required: true
    enum:
      - "fixed"
      - "revolute"
      - "continuous"
      - "prismatic"
      - "floating"
    description: Type of kinematic constraint between parent and child links.

  parent-link:
    type: phandle
    required: true
    description: Parent link node.

  origin-translation-mm:
    type: array
    default: [0, 0, 0]
    description: |
      Translation [x, y, z] of the joint frame relative to the parent link
      frame, in millimetres.

  origin-rotation-euler-zyx-urad:
    type: array
    default: [0, 0, 0]
    description: |
      Rotation of the joint frame relative to the parent link frame, as ZYX
      Euler angles [roll, pitch, yaw] in microradians.

  axis:
    type: array
    default: [1, 0, 0]
    description: |
      Unit vector [x, y, z] defining the axis of motion in the joint frame.
      Used for revolute, continuous, and prismatic joints.

  limit-lower:
    type: int
    description: |
      Lower position limit.
      - revolute/continuous: milliradians. 
      - prismatic: millimetres.
      - fixed/floating: unused.

  limit-upper:
    type: int
    description: |
      Upper position limit.
      - revolute/continuous: milliradians. 
      - prismatic: millimetres.
      - fixed/floating: unused.

  limit-effort-mN:
    type: int
    description: |
      Maximum effort.
      - revolute/continuous: mN·m (torque). 
      - prismatic: mN (force).
      - fixed/floating: unused.

  limit-velocity:
    type: int
    description: |
      Maximum velocity.
      - revolute/continuous: mrad/s. 
      - prismatic: mm/s.
      - fixed/floating: unused.
```

## dts/bindings/mech/zephyr,mech-link.yaml
```yaml
# Copyright (c) 2026 Sylvain Mosnier
# SPDX-License-Identifier: Apache-2.0

description: |
  Rigid link in a kinematic tree.

  A link represents a rigid body. Its frame origin coincides with the child
  frame of its parent joint.

  Inertial properties are optional and only meaningful when
  CONFIG_MECH_INERTIAL is enabled.

  Child nodes declare devices (sensors, actuators) physically mounted on
  this link, with their local mounting transform. Each child node describes
  one mounted device.

  Example — upper arm link with an IMU and a proximity sensor:

    upper_arm_link: upper-arm-link {
        compatible = "zephyr,mech-link";
        parent-joint = <&shoulder_joint>
        mass-g = <540>;
        center-of-mass-mm = <0 0 140>;

        imu_mount: imu-mount {
            device = <&imu_0>;
            translation-mm = <0 0 10>;
            rotation-euler-zyx-urad = <0 0 0>;
        };

        prox_mount: prox-mount {
            device = <&prox_sensor_0>;
            translation-mm = <30 0 280>;
            rotation-euler-zyx-urad = <0 (-261799) 0>; /* -15° */
        };
    };

compatible: "zephyr,mech-link"

properties:
  parent-joint:
    type: phandle
    description: Parent joint; absent on the root link.

  mass-g:
    type: int
    description: Link mass in grams (CONFIG_MECH_INERTIAL).

  center-of-mass-mm:
    type: array
    description: |
      Center of mass [x, y, z] in millimetres, in the link frame
      (CONFIG_MECH_INERTIAL).

  inertia-tensor-gmm2:
    type: array
    description: |
      Symmetric 3x3 inertia tensor, upper triangle only, as 6 elements
      [ixx, ixy, ixz, iyy, iyz, izz] in g·mm^2 (CONFIG_MECH_INERTIAL).

child-binding:
  description: |
    A device mounted on this link, with its local mounting transform.

    The device phandle can point to any Zephyr device node (sensor, actuator,
    camera, etc.). The transform describes the device frame relative to the
    link frame.

  properties:
    device:
      type: phandle
      required: true
      description: Phandle to the Zephyr device node mounted at this location.

    translation-mm:
      type: array
      required: true
      description: |
        Translation [x, y, z] of the device frame origin relative to the
        link frame, in millimetres.

    rotation-euler-zyx-urad:
      type: array
      required: true
      description: |
        Rotation of the device frame relative to the link frame, as ZYX
        Euler angles [roll, pitch, yaw] in microradians.
```
