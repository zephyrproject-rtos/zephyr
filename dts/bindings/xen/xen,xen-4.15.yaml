## ext/hal/cmsis/DSP/Kconfig
```kconfig
# Copyright (c) 2019 Stephanos Ioannidis <root@stephanos.io>
# SPDX-License-Identifier: Apache-2.0

comment "Components"

config CMSIS_DSP_BASICMATH
	bool "Basic Math Functions"
	default y

config CMSIS_DSP_COMPLEXMATH
	bool "Complex Math Functions"
	imply CMSIS_DSP_FASTMATH

config CMSIS_DSP_CONTROLLER
	bool "Controller Functions"

config CMSIS_DSP_FASTMATH
	bool "Fast Math Functions"
	select CMSIS_DSP_TABLES
	imply CMSIS_DSP_TABLES_ALL_FAST

config CMSIS_DSP_FILTERING
	bool "Filtering Functions"

config CMSIS_DSP_MATRIX
	bool "Matrix Functions"

config CMSIS_DSP_STATISTICS
	bool "Statistics Functions"
	imply CMSIS_DSP_BASICMATH
	imply CMSIS_DSP_FASTMATH

config CMSIS_DSP_SUPPORT
	bool "Support Functions"

config CMSIS_DSP_TRANSFORM
	bool "Transform Functions"
	select CMSIS_DSP_TABLES
	imply CMSIS_DSP_TABLES_ALL_FFT

config CMSIS_DSP_SVM
	bool "Support Vector Machine Functions"

config CMSIS_DSP_BAYES
	bool "Bayesian Estimators"
	imply CMSIS_DSP_STATISTICS

config CMSIS_DSP_DISTANCE
	bool "Distance Functions"
	imply CMSIS_DSP_STATISTICS

menuconfig CMSIS_DSP_TABLES
	bool "Look-up Tables"

if CMSIS_DSP_TABLES

config CMSIS_DSP_TABLES_ALL_FAST
	bool "Include all fast interpolation tables"
	select CMSIS_DSP_TABLES_ARM_COS_F32
	select CMSIS_DSP_TABLES_ARM_COS_Q31
	select CMSIS_DSP_TABLES_ARM_COS_Q15
	select CMSIS_DSP_TABLES_ARM_SIN_F32
	select CMSIS_DSP_TABLES_ARM_SIN_Q31
	select CMSIS_DSP_TABLES_ARM_SIN_Q15
	select CMSIS_DSP_TABLES_ARM_SIN_COS_F32
	select CMSIS_DSP_TABLES_ARM_SIN_COS_Q31
	select CMSIS_DSP_TABLES_ARM_LMS_NORM_Q31
	select CMSIS_DSP_TABLES_ARM_LMS_NORM_Q15
	select CMSIS_DSP_TABLES_ARM_CMPLX_MAG_Q31
	select CMSIS_DSP_TABLES_ARM_CMPLX_MAG_Q15

config CMSIS_DSP_TABLES_ALL_FFT
	bool "Include all FFT tables"
	select CMSIS_DSP_TABLES_CFFT_F64_16
	select CMSIS_DSP_TABLES_CFFT_F64_32
	select CMSIS_DSP_TABLES_CFFT_F64_64
	select CMSIS_DSP_TABLES_CFFT_F64_128
	select CMSIS_DSP_TABLES_CFFT_F64_256
	select CMSIS_DSP_TABLES_CFFT_F64_512
	select CMSIS_DSP_TABLES_CFFT_F64_1024
	select CMSIS_DSP_TABLES_CFFT_F64_2048
	select CMSIS_DSP_TABLES_CFFT_F64_4096
	select CMSIS_DSP_TABLES_CFFT_F32_16
	select CMSIS_DSP_TABLES_CFFT_F32_32
	select CMSIS_DSP_TABLES_CFFT_F32_64
	select CMSIS_DSP_TABLES_CFFT_F32_128
	select CMSIS_DSP_TABLES_CFFT_F32_256
	select CMSIS_DSP_TABLES_CFFT_F32_512
	select CMSIS_DSP_TABLES_CFFT_F32_1024
	select CMSIS_DSP_TABLES_CFFT_F32_2048
	select CMSIS_DSP_TABLES_CFFT_F32_4096
	select CMSIS_DSP_TABLES_CFFT_Q31_16
	select CMSIS_DSP_TABLES_CFFT_Q31_32
	select CMSIS_DSP_TABLES_CFFT_Q31_64
	select CMSIS_DSP_TABLES_CFFT_Q31_128
	select CMSIS_DSP_TABLES_CFFT_Q31_256
	select CMSIS_DSP_TABLES_CFFT_Q31_512
	select CMSIS_DSP_TABLES_CFFT_Q31_1024
	select CMSIS_DSP_TABLES_CFFT_Q31_2048
	select CMSIS_DSP_TABLES_CFFT_Q31_4096
	select CMSIS_DSP_TABLES_CFFT_Q15_16
	select CMSIS_DSP_TABLES_CFFT_Q15_32
	select CMSIS_DSP_TABLES_CFFT_Q15_64
	select CMSIS_DSP_TABLES_CFFT_Q15_128
	select CMSIS_DSP_TABLES_CFFT_Q15_256
	select CMSIS_DSP_TABLES_CFFT_Q15_512
	select CMSIS_DSP_TABLES_CFFT_Q15_1024
	select CMSIS_DSP_TABLES_CFFT_Q15_2048
	select CMSIS_DSP_TABLES_CFFT_Q15_4096
	select CMSIS_DSP_TABLES_RFFT_FAST_F64_32
	select CMSIS_DSP_TABLES_RFFT_FAST_F64_64
	select CMSIS_DSP_TABLES_RFFT_FAST_F64_128
	select CMSIS_DSP_TABLES_RFFT_FAST_F64_256
	select CMSIS_DSP_TABLES_RFFT_FAST_F64_512
	select CMSIS_DSP_TABLES_RFFT_FAST_F64_1024
	select CMSIS_DSP_TABLES_RFFT_FAST_F64_2048
	select CMSIS_DSP_TABLES_RFFT_FAST_F64_4096
	select CMSIS_DSP_TABLES_RFFT_FAST_F32_32
	select CMSIS_DSP_TABLES_RFFT_FAST_F32_64
	select CMSIS_DSP_TABLES_RFFT_FAST_F32_128
	select CMSIS_DSP_TABLES_RFFT_FAST_F32_256
	select CMSIS_DSP_TABLES_RFFT_FAST_F32_512
	select CMSIS_DSP_TABLES_RFFT_FAST_F32_1024
	select CMSIS_DSP_TABLES_RFFT_FAST_F32_2048
	select CMSIS_DSP_TABLES_RFFT_FAST_F32_4096
	select CMSIS_DSP_TABLES_RFFT_F64_128
	select CMSIS_DSP_TABLES_RFFT_F64_512
	select CMSIS_DSP_TABLES_RFFT_F64_2048
	select CMSIS_DSP_TABLES_RFFT_F64_8192
	select CMSIS_DSP_TABLES_RFFT_F32_128
	select CMSIS_DSP_TABLES_RFFT_F32_512
	select CMSIS_DSP_TABLES_RFFT_F32_2048
	select CMSIS_DSP_TABLES_RFFT_F32_8192
	select CMSIS_DSP_TABLES_RFFT_Q31_32
	select CMSIS_DSP_TABLES_RFFT_Q31_64
	select CMSIS_DSP_TABLES_RFFT_Q31_128
	select CMSIS_DSP_TABLES_RFFT_Q31_256
	select CMSIS_DSP_TABLES_RFFT_Q31_512
	select CMSIS_DSP_TABLES_RFFT_Q31_1024
	select CMSIS_DSP_TABLES_RFFT_Q31_2048
	select CMSIS_DSP_TABLES_RFFT_Q31_4096
	select CMSIS_DSP_TABLES_RFFT_Q31_8192
	select CMSIS_DSP_TABLES_RFFT_Q15_32
	select CMSIS_DSP_TABLES_RFFT_Q15_64
	select CMSIS_DSP_TABLES_RFFT_Q15_128
	select CMSIS_DSP_TABLES_RFFT_Q15_256
	select CMSIS_DSP_TABLES_RFFT_Q15_512
	select CMSIS_DSP_TABLES_RFFT_Q15_1024
	select CMSIS_DSP_TABLES_RFFT_Q15_2048
	select CMSIS_DSP_TABLES_RFFT_Q15_4096
	select CMSIS_DSP_TABLES_RFFT_Q15_8192
	select CMSIS_DSP_TABLES_DCT4_F32_128
	select CMSIS_DSP_TABLES_DCT4_F32_512
	select CMSIS_DSP_TABLES_DCT4_F32_2048
	select CMSIS_DSP_TABLES_DCT4_F32_8192
	select CMSIS_DSP_TABLES_DCT4_Q31_128
	select CMSIS_DSP_TABLES_DCT4_Q31_512
	select CMSIS_DSP_TABLES_DCT4_Q31_2048
	select CMSIS_DSP_TABLES_DCT4_Q31_8192
	select CMSIS_DSP_TABLES_DCT4_Q15_128
	select CMSIS_DSP_TABLES_DCT4_Q15_512
	select CMSIS_DSP_TABLES_DCT4_Q15_2048
	select CMSIS_DSP_TABLES_DCT4_Q15_8192

comment "Interpolation Tables"

config CMSIS_DSP_TABLES_ARM_COS_F32
	bool "cos f32"

config CMSIS_DSP_TABLES_ARM_COS_Q31
	bool "cos q31"

config CMSIS_DSP_TABLES_ARM_COS_Q15
	bool "cos q15"

config CMSIS_DSP_TABLES_ARM_SIN_F32
	bool "sin f32"

config CMSIS_DSP_TABLES_ARM_SIN_Q31
	bool "sin q31"

config CMSIS_DSP_TABLES_ARM_SIN_Q15
	bool "sin q15"

config CMSIS_DSP_TABLES_ARM_SIN_COS_F32
	bool "sin cos f32"

config CMSIS_DSP_TABLES_ARM_SIN_COS_Q31
	bool "sin cos q31"

config CMSIS_DSP_TABLES_ARM_LMS_NORM_Q31
	bool "lms norm q31"

config CMSIS_DSP_TABLES_ARM_LMS_NORM_Q15
	bool "lms norm q15"

config CMSIS_DSP_TABLES_ARM_CMPLX_MAG_Q31
	bool "cmplx mag q31"

config CMSIS_DSP_TABLES_ARM_CMPLX_MAG_Q15
	bool "cmplx mag q15"

comment "Transform Tables"

config CMSIS_DSP_TABLES_CFFT_F64_16
	bool "cfft f64 16"

config CMSIS_DSP_TABLES_CFFT_F64_32
	bool "cfft f64 32"

config CMSIS_DSP_TABLES_CFFT_F64_64
	bool "cfft f64 64"

config CMSIS_DSP_TABLES_CFFT_F64_128
	bool "cfft f64 128"

config CMSIS_DSP_TABLES_CFFT_F64_256
	bool "cfft f64 256"

config CMSIS_DSP_TABLES_CFFT_F64_512
	bool "cfft f64 512"

config CMSIS_DSP_TABLES_CFFT_F64_1024
	bool "cfft f64 1024"

config CMSIS_DSP_TABLES_CFFT_F64_2048
	bool "cfft f64 2048"

config CMSIS_DSP_TABLES_CFFT_F64_4096
	bool "cfft f64 4096"

config CMSIS_DSP_TABLES_CFFT_F32_16
	bool "cfft f32 16"

config CMSIS_DSP_TABLES_CFFT_F32_32
	bool "cfft f32 32"

config CMSIS_DSP_TABLES_CFFT_F32_64
	bool "cfft f32 64"

config CMSIS_DSP_TABLES_CFFT_F32_128
	bool "cfft f32 128"

config CMSIS_DSP_TABLES_CFFT_F32_256
	bool "cfft f32 256"

config CMSIS_DSP_TABLES_CFFT_F32_512
	bool "cfft f32 512"

config CMSIS_DSP_TABLES_CFFT_F32_1024
	bool "cfft f32 1024"

config CMSIS_DSP_TABLES_CFFT_F32_2048
	bool "cfft f32 2048"

config CMSIS_DSP_TABLES_CFFT_F32_4096
	bool "cfft f32 4096"

config CMSIS_DSP_TABLES_CFFT_Q31_16
	bool "cfft q31 16"

config CMSIS_DSP_TABLES_CFFT_Q31_32
	bool "cfft q31 32"

config CMSIS_DSP_TABLES_CFFT_Q31_64
	bool "cfft q31 64"

config CMSIS_DSP_TABLES_CFFT_Q31_128
	bool "cfft q31 128"

config CMSIS_DSP_TABLES_CFFT_Q31_256
	bool "cfft q31 256"

config CMSIS_DSP_TABLES_CFFT_Q31_512
	bool "cfft q31 512"

config CMSIS_DSP_TABLES_CFFT_Q31_1024
	bool "cfft q31 1024"

config CMSIS_DSP_TABLES_CFFT_Q31_2048
	bool "cfft q31 2048"

config CMSIS_DSP_TABLES_CFFT_Q31_4096
	bool "cfft q31 4096"

config CMSIS_DSP_TABLES_CFFT_Q15_16
	bool "cfft q15 16"

config CMSIS_DSP_TABLES_CFFT_Q15_32
	bool "cfft q15 32"

config CMSIS_DSP_TABLES_CFFT_Q15_64
	bool "cfft q15 64"

config CMSIS_DSP_TABLES_CFFT_Q15_128
	bool "cfft q15 128"

config CMSIS_DSP_TABLES_CFFT_Q15_256
	bool "cfft q15 256"

config CMSIS_DSP_TABLES_CFFT_Q15_512
	bool "cfft q15 512"

config CMSIS_DSP_TABLES_CFFT_Q15_1024
	bool "cfft q15 1024"

config CMSIS_DSP_TABLES_CFFT_Q15_2048
	bool "cfft q15 2048"

config CMSIS_DSP_TABLES_CFFT_Q15_4096
	bool "cfft q15 4096"

config CMSIS_DSP_TABLES_RFFT_FAST_F64_32
	bool "rfft fast f64 32"

config CMSIS_DSP_TABLES_RFFT_FAST_F64_64
	bool "rfft fast f64 64"

config CMSIS_DSP_TABLES_RFFT_FAST_F64_128
	bool "rfft fast f64 128"

config CMSIS_DSP_TABLES_RFFT_FAST_F64_256
	bool "rfft fast f64 256"

config CMSIS_DSP_TABLES_RFFT_FAST_F64_512
	bool "rfft fast f64 512"

config CMSIS_DSP_TABLES_RFFT_FAST_F64_1024
	bool "rfft fast f64 1024"

config CMSIS_DSP_TABLES_RFFT_FAST_F64_2048
	bool "rfft fast f64 2048"

config CMSIS_DSP_TABLES_RFFT_FAST_F64_4096
	bool "rfft fast f64 4096"

config CMSIS_DSP_TABLES_RFFT_FAST_F32_32
	bool "rfft fast f32 32"

config CMSIS_DSP_TABLES_RFFT_FAST_F32_64
	bool "rfft fast f32 64"

config CMSIS_DSP_TABLES_RFFT_FAST_F32_128
	bool "rfft fast f32 128"

config CMSIS_DSP_TABLES_RFFT_FAST_F32_256
	bool "rfft fast f32 256"

config CMSIS_DSP_TABLES_RFFT_FAST_F32_512
	bool "rfft fast f32 512"

config CMSIS_DSP_TABLES_RFFT_FAST_F32_1024
	bool "rfft fast f32 1024"

config CMSIS_DSP_TABLES_RFFT_FAST_F32_2048
	bool "rfft fast f32 2048"

config CMSIS_DSP_TABLES_RFFT_FAST_F32_4096
	bool "rfft fast f32 4096"

config CMSIS_DSP_TABLES_RFFT_F64_128
	bool "rfft f64 128"

config CMSIS_DSP_TABLES_RFFT_F64_512
	bool "rfft f64 512"

config CMSIS_DSP_TABLES_RFFT_F64_2048
	bool "rfft f64 2048"

config CMSIS_DSP_TABLES_RFFT_F64_8192
	bool "rfft f64 8192"

config CMSIS_DSP_TABLES_RFFT_F32_128
	bool "rfft f32 128"

config CMSIS_DSP_TABLES_RFFT_F32_512
	bool "rfft f32 512"

config CMSIS_DSP_TABLES_RFFT_F32_2048
	bool "rfft f32 2048"

config CMSIS_DSP_TABLES_RFFT_F32_8192
	bool "rfft f32 8192"

config CMSIS_DSP_TABLES_RFFT_Q31_32
	bool "rfft q31 32"

config CMSIS_DSP_TABLES_RFFT_Q31_64
	bool "rfft q31 64"

config CMSIS_DSP_TABLES_RFFT_Q31_128
	bool "rfft q31 128"

config CMSIS_DSP_TABLES_RFFT_Q31_256
	bool "rfft q31 256"

config CMSIS_DSP_TABLES_RFFT_Q31_512
	bool "rfft q31 512"

config CMSIS_DSP_TABLES_RFFT_Q31_1024
	bool "rfft q31 1024"

config CMSIS_DSP_TABLES_RFFT_Q31_2048
	bool "rfft q31 2048"

config CMSIS_DSP_TABLES_RFFT_Q31_4096
	bool "rfft q31 4096"

config CMSIS_DSP_TABLES_RFFT_Q31_8192
	bool "rfft q31 8192"

config CMSIS_DSP_TABLES_RFFT_Q15_32
	bool "rfft q15 32"

config CMSIS_DSP_TABLES_RFFT_Q15_64
	bool "rfft q15 64"

config CMSIS_DSP_TABLES_RFFT_Q15_128
	bool "rfft q15 128"

config CMSIS_DSP_TABLES_RFFT_Q15_256
	bool "rfft q15 256"

config CMSIS_DSP_TABLES_RFFT_Q15_512
	bool "rfft q15 512"

config CMSIS_DSP_TABLES_RFFT_Q15_1024
	bool "rfft q15 1024"

config CMSIS_DSP_TABLES_RFFT_Q15_2048
	bool "rfft q15 2048"

config CMSIS_DSP_TABLES_RFFT_Q15_4096
	bool "rfft q15 4096"

config CMSIS_DSP_TABLES_RFFT_Q15_8192
	bool "rfft q15 8192"

config CMSIS_DSP_TABLES_DCT4_F32_128
	bool "dct4 f32 128"

config CMSIS_DSP_TABLES_DCT4_F32_512
	bool "dct4 f32 512"

config CMSIS_DSP_TABLES_DCT4_F32_2048
	bool "dct4 f32 2048"

config CMSIS_DSP_TABLES_DCT4_F32_8192
	bool "dct4 f32 8192"

config CMSIS_DSP_TABLES_DCT4_Q31_128
	bool "dct4 q31 128"

config CMSIS_DSP_TABLES_DCT4_Q31_512
	bool "dct4 q31 512"

config CMSIS_DSP_TABLES_DCT4_Q31_2048
	bool "dct4 q31 2048"

config CMSIS_DSP_TABLES_DCT4_Q31_8192
	bool "dct4 q31 8192"

config CMSIS_DSP_TABLES_DCT4_Q15_128
	bool "dct4 q15 128"

config CMSIS_DSP_TABLES_DCT4_Q15_512
	bool "dct4 q15 512"

config CMSIS_DSP_TABLES_DCT4_Q15_2048
	bool "dct4 q15 2048"

config CMSIS_DSP_TABLES_DCT4_Q15_8192
	bool "dct4 q15 8192"

endif # CMSIS_DSP_TABLES

comment "Instruction Set"

config CMSIS_DSP_NEON
	bool "Neon Instruction Set"
	# depends on CPU_CORTEX_A

config CMSIS_DSP_HELIUM
	bool "Helium Instruction Set"
	depends on CPU_CORTEX_M
	select CMSIS_DSP_MVEF
	select CMSIS_DSP_MVEI

config CMSIS_DSP_MVEF
	bool "MVEF Intrinsics"
	depends on CPU_CORTEX_M

config CMSIS_DSP_MVEI
	bool "MVEI Instructions"
	depends on CPU_CORTEX_M

comment "Features"

config CMSIS_DSP_LOOPUNROLL
	bool "Loop Unrolling"

config CMSIS_DSP_ROUNDING
	bool "Rounding"

config CMSIS_DSP_MATRIXCHECK
	bool "Matrix Check"

config CMSIS_DSP_AUTOVECTORIZE
	bool "Auto Vectorize"
```

## ext/hal/cmsis/Kconfig
```kconfig
# Copyright (c) 2016 Intel Corporation
# SPDX-License-Identifier: Apache-2.0

config HAS_CMSIS_CORE
	bool
	select HAS_CMSIS_CORE_M if CPU_CORTEX_M
	select HAS_CMSIS_CORE_R if CPU_CORTEX_R

if HAS_CMSIS_CORE

config HAS_CMSIS_CORE_M
	bool

config HAS_CMSIS_CORE_R
	bool

endif
```

## ext/hal/libmetal/Kconfig
```kconfig
#
# Copyright (c) 2018 Linaro Limited
#
# SPDX-License-Identifier: Apache-2.0
#

config LIBMETAL
	bool "libmetal Support"
	help
	  This option enables the libmetal HAL abstraction layer

config LIBMETAL_SRC_PATH
	string "libmetal library source path"
	default "libmetal"
	help
	  This option specifies the path to the source for the libmetal library
```
