## dts/bindings/zbus/zephyr,zbus-proxy-agent-base.yaml
```yaml
# Copyright (c) 2025 Nordic Semiconductor ASA
# SPDX-License-Identifier: Apache-2.0
description: |
    Base properties for Zbus proxy agent.
    This binding is not used directly but provides common properties
    for all proxy agent backends.

properties:
  ack-timeout-start-ms:
    type: int
    default: 10
    description: |
      Initial timeout in milliseconds to wait for an acknowledgment
      when sending a message via this proxy agent.
      The timeout will be increased exponentially for each retry until
      reaching ack-timeout-end-ms.
  ack-timeout-max-ms:
    type: int
    default: 1000
    description: |
      Maximum timeout in milliseconds to wait for an acknowledgment
      when sending a message via this proxy agent.
  ack-attempt-limit:
    type: int
    default: 10
    description: |
      Number of retries to attempt when waiting for an acknowledgment
      after sending a message via this proxy agent.
      Set to -1 to retry indefinitely until an acknowledgment is received.
  tracking-msg-pool-size:
    type: int
    default: 4
    description: |
      Number of message tracking slots to allocate for messages
      that are pending acknowledgment.
  receive-msgq-size:
    type: int
    default: 2
    description: |
      Number of messages that can be queued in the receive message queue
      for incoming messages from the remote proxy agent.
  duplicate-detection-size:
    type: int
    default: 8
    description: |
      Size of the duplicate detection buffer. This is a ring buffer
      that keeps track of recently received message IDs to detect
      and filter out duplicate messages.
```

## dts/bindings/zbus/zephyr,zbus-proxy-agent-ipc.yaml
```yaml
# Copyright (c) 2025 Nordic Semiconductor ASA
# SPDX-License-Identifier: Apache-2.0
description: Zbus proxy agent IPC backend

compatible: "zephyr,zbus-proxy-agent-ipc"

include: zephyr,zbus-proxy-agent-base.yaml

properties:
  ipc-device:
    required: true
    type: phandle
    description: |
      Phandle to the IPC device node used for interprocessor communication.
```

## dts/bindings/zbus/zephyr,zbus-proxy-agent-uart.yaml
```yaml
# Copyright (c) 2025 Nordic Semiconductor ASA
# SPDX-License-Identifier: Apache-2.0
description: Zbus proxy agent UART backend

compatible: "zephyr,zbus-proxy-agent-uart"

include: zephyr,zbus-proxy-agent-base.yaml

properties:
  uart-device:
    required: true
    type: phandle
    description: |
      Phandle to the UART device node used for interprocessor communication.
  rx-buf-count:
    type: int
    default: 2
    description: |
      Number of UART RX buffers for async reception.
      Must be at least 2
  rx-chunk-size:
    type: int
    default: 32
    description: |
      UART chunk size in bytes for framed message transmission.
  rx-buf-timeout-us:
    type: int
    default: 1000
    description: |
      Inactivity period after receiving at least a byte which triggers #UART_RX_RDY event
      for processing the current RX buffer fragment (needed in case of partial fragments).
```

## dts/bindings/zsai/zephyr,zsai-simulator.yaml
```yaml
# Copyright (c) 2023 Nordic Semiconductor ASA
#
# SPDX-License-Identifier: Apache-2.0

description: Simulated ZSAI device

compatible: "zephyr,zsai-simulator"

include: base.yaml

properties:
  simulated-size:
    type: int
    description: |
      Size of simulated device. This is mutually exclusive with reg property.

  erase-value:
    type: int
    description: Set to value of erased cell in case erase is needed.

  erase-block-size:
    type: int
    description: address alignment required by flash erase operations

  write-block-size:
    type: int
    description: address alignment required by flash write operations
```

## ext/Kconfig
```kconfig
# External source code configuration options

# Copyright (c) 2016 Linaro Ltd.
# SPDX-License-Identifier: Apache-2.0

menu "External Sources"

source "ext/lib/crypto/Kconfig"

source "ext/lib/fnmatch/Kconfig"

endmenu
```

## ext/debug/Kconfig
```kconfig
# Kconfig - external debug source code configuration options

#
# Copyright (c) 2016 Nordic Semiconductor ASA.
#
# SPDX-License-Identifier: Apache-2.0
#

# When adding new entries keep the list in alphabetical order

menu "Debug libraries"

source "ext/debug/segger/Kconfig"

endmenu
```

## ext/debug/ctf/Kconfig
```kconfig
#
# Copyright (c) 2018 Oticon A/S
#
# SPDX-License-Identifier: Apache-2.0
#

config CTF
	bool
	prompt "Tracing via Common Trace Format support"
	default n
	select THREAD_MONITOR
	select TRACING

config CTF_BOTTOM_POSIX
	bool
	prompt "CTF backed by POSIX fwrite"
	default n
	depends on CTF
```

## ext/debug/segger/Kconfig
```kconfig
#
# Copyright (c) 2016 Nordic Semiconductor ASA
#
# SPDX-License-Identifier: Apache-2.0
#

config HAS_SEGGER_RTT
	bool

config SEGGER_SYSTEMVIEW
	bool
	prompt "Segger SystemView support"
	depends on HAS_SEGGER_RTT
	select RTT_CONSOLE
```

## ext/fs/Kconfig
```kconfig
# Kconfig - external file system  source code configuration options

#
# Copyright (c) 2016 Intel Corporation
#
# SPDX-License-Identifier: Apache-2.0
#

# When adding new entries keep the list in alphabetical order

menu "File Systems"

source "ext/fs/fat/Kconfig"

endmenu
```

## ext/fs/fat/Kconfig
```kconfig
config FAT_FILESYSTEM_ELM
	bool "ELM FAT File System"
	depends on FILE_SYSTEM_FAT
	default y
	help
	Use the ELM FAT File system implementation.
```

## ext/fs/nffs/Kconfig
```kconfig
config NFFS_FILESYSTEM_MAX_AREAS
	int "Maximum number of areas"
	depends on FILE_SYSTEM_NFFS
	range 2 64
	default 8
	help
	  This defines maximum number of areas located on flash. Each area can
	  be erased without affecting other areas thus the size of area can
	  affect performance of GC where single area has to be rewritten.
	  At least one scratch and one non-scratch area is required.

config NFFS_FILESYSTEM_MAX_BLOCK_SIZE
	int "Maximum block size"
	depends on FILE_SYSTEM_NFFS
	range 16 2048
	default 2048
	help
	  This determines the maximum size of data block written to flash.
	  Writes larger than this size are split into multiple write operations.
```

## ext/hal/Kconfig
```kconfig
# Kconfig - external HAL source code configuration options

#
# Copyright (c) 2016-2017 Linaro Ltd.
#
# SPDX-License-Identifier: Apache-2.0
#

# When adding new entries keep the list in alphabetical order

menu "HALs"

source "ext/hal/altera/Kconfig"

source "ext/hal/cmsis/Kconfig"

endmenu
```

## ext/hal/altera/Kconfig
```kconfig
# Kconfig - Altera HAL drivers configuration

#
# Copyright (c) 2017 Intel Corporation
#
# SPDX-License-Identifier: Apache-2.0

config HAS_ALTERA_HAL
	bool "Altera HAL drivers support"
	depends on NIOS2
```
