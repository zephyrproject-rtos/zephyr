## dts/bindings/reset/aspeed,ast10x0-reset.yaml
```yaml
# Copyright (c) 2022 Aspeed Technology Inc.
# SPDX-License-Identifier: Apache-2.0

description: Aspeed AST10X0 Reset Controller

compatible: "aspeed,ast10x0-reset"

include: [base.yaml, reset-controller.yaml]

properties:
  "#reset-cells":
    const: 1

clock-cells:
  - reset_id
```

## dts/bindings/reset/focaltech,ft9001-cpm-rctl.yaml
```yaml
# Copyright (c) 2025, FocalTech Systems CO.,Ltd
# SPDX-License-Identifier: Apache-2.0

description: |
  FocalTech FT9001 Reset controller (CPM subnode).
  Reset specifiers use the packed IDs defined in
  include/zephyr/dt-bindings/reset/focaltech_ft9001_reset.h

compatible: "focaltech,ft9001-cpm-rctl"

include: [reset-controller.yaml]

properties:
  "#reset-cells":
    const: 1

reset-cells:
  - id
```

## dts/bindings/reset/focaltech,ft9001-reset.yaml
```yaml
# Copyright (c) 2025, FocalTech Systems CO.,Ltd
# SPDX-License-Identifier: Apache-2.0

description: |
  Reset controller for FocalTech FT9001 SoC.
  Reset specifiers use the IDs defined in
  include/zephyr/dt-bindings/reset/focaltech_ft9001_reset.h

compatible: "focaltech,ft9001-reset"

include: [reset-controller.yaml, base.yaml]

properties:
  "#reset-cells":
    const: 1

reset-cells:
  - id
```

## dts/bindings/reset/gd,gd32-rctl.yaml
```yaml
# Copyright (c) 2022, Teslabs Engineering S.L.
# SPDX-License-Identifier: Apache-2.0

description: |
  Gigadevice Reset and Clock Unit (RCU) if a multi-function peripheral in
  charge of reset control (RCTL) and clock control (CCTL) for all SoC
  peripherals. This binding represents the reset controller (RCTL).

  To specify the reset line in a peripheral, the standard resets property needs
  to be used, e.g.:

    gpioa: gpio@xxx {
        ...
        /* cell encodes RCU register offset and control bit position */
        resets = <&rctl GD32_RESET_GPIOA>;
        ...
    }

  Predefined RCU reset cells are available in
  include/zephyr/dts-bindings/reset/gd32{xxx}.h header files, where {xxx}
  corresponds to the SoC series, e.g. f4xx.

compatible: "gd,gd32-rctl"

include: [reset-controller.yaml, base.yaml]

properties:
  "#reset-cells":
    const: 1

reset-cells:
  - id
```

## dts/bindings/reset/intel,socfpga-reset.yaml
```yaml
# Copyright (c) 2022, Intel Corporation
# SPDX-License-Identifier: Apache-2.0

description: Intel SoC FPGA Reset Controller

compatible: "intel,socfpga-reset"

include: [base.yaml, reset-controller.yaml]

properties:
  reg:
    required: true
  active-low:
    type: boolean
    description: Add this property in dts node if the reset line is active_low, otherwise do not
                   include this property for active_high lines.
  "#reset-cells":
    const: 1

reset-cells:
- id
```

## dts/bindings/reset/microchip,mpfs-reset.yaml
```yaml
#
# Copyright (C) 2025 embedded brains GmbH & Co. KG
#
# SPDX-License-Identifier: Apache-2.0
#

description: Microchip MPFS Reset Controller (SOFT_RESET_CR, SUBBLK_CLOCK_CR)

compatible: "microchip,mpfs-reset"

include: [base.yaml, reset-controller.yaml]

properties:
  "#reset-cells":
    const: 1

reset-cells:
- id
```

## dts/bindings/reset/microchip,rstc-g1-reset.yaml
```yaml
# Copyright (c) 2025 Microchip Technology Inc.
# SPDX-License-Identifier: Apache-2.0

title: Microchip RSTC Reset driver

description: |
  Microchip RSTC Reset driver bindings.

  Group g1 RSTC Reset driver supports following hardware peripherals:
    - module name="RSTC" id="U2239" version="4.0.0"

include: base.yaml

compatible: "microchip,rstc-g1-reset"

properties:
  reg:
    required: true
    description: |
      Base address and size of the RSTC register block.
```

## dts/bindings/reset/microchip,xec-pcr-rctl.yaml
```yaml
# Copyright (c) 2023, Silicom Connectivity Solutions, Ltd
# SPDX-License-Identifier: Apache-2.0

description: |
  Microchip XEC Reset Control (RC) node.
  This node is in charge of reset control APB (Advanced Peripheral) bus domains.

  To specify the reset line in a peripheral, the standard resets property needs
  to be used, e.g.:

    pwm1: pwm@xxx {
        ...
        /* Cell contains information about RC register offset and bit */
        resets = <&rctl XEC_RESET(1, 20U)>;
        ...
    };

  RC reset cells are available in
  include/zephyr/dts-bindings/reset/mec{soc_family}_reset.h header files.

compatible: "microchip,xec-pcr-rctl"

include: [reset-controller.yaml, base.yaml]

properties:
  "#reset-cells":
    const: 1

reset-cells:
  - id
```

## dts/bindings/reset/nuvoton,npcx-rst.yaml
```yaml
# Copyright (c) 2024 Nuvoton Technology Corporation.
# SPDX-License-Identifier: Apache-2.0

description: NPCX Reset Controller

compatible: "nuvoton,npcx-rst"

include: [reset-controller.yaml, base.yaml]

properties:
  reg:
    required: true

  "#reset-cells":
    const: 1

reset-cells:
- id
```

## dts/bindings/reset/nuvoton,numaker-rst.yaml
```yaml
# (c) Nuvoton Technology Corp. All rights reserved.
# SPDX-License-Identifier: Apache-2.0

description: Nuvoton, Numaker-RESET

compatible: "nuvoton,numaker-rst"

include: [reset-controller.yaml, base.yaml]

properties:
  reg:
    required: true

  "#reset-cells":
    const: 1

reset-cells:
- id
```

## dts/bindings/reset/nxp,lpc-syscon-reset.yaml
```yaml
# Copyright 2024 NXP
# SPDX-License-Identifier: Apache-2.0

description: LPC SYSCON Peripheral reset controller

compatible: "nxp,lpc-syscon-reset"

include: [reset-controller.yaml]

properties:
  "#reset-cells":
    const: 1

reset-cells:
  - id
```

## dts/bindings/reset/nxp,mrcc-reset.yaml
```yaml
# Copyright 2025 NXP
# SPDX-License-Identifier: Apache-2.0

description: NXP MRCC Peripheral reset controller

compatible: "nxp,mrcc-reset"

include: [reset-controller.yaml]

properties:
  "#reset-cells":
    const: 1

reset-cells:
  - id
```

## dts/bindings/reset/nxp,rstctl.yaml
```yaml
# Copyright 2024 NXP
# SPDX-License-Identifier: Apache-2.0

description: NXP RSTCTL Peripheral reset controller

compatible: "nxp,rstctl"

include: [reset-controller.yaml, base.yaml]

properties:
  reg:
    required: true

  offset-base:
    type: int
    description: |
      Base PRSTCTL register index for this RSTCTL instance when a SoC encodes
      reset IDs in a single global namespace across multiple reset-controller
      instances. If omitted, reset IDs are interpreted as instance-local.

  "#reset-cells":
    const: 1

reset-cells:
  - id
```

## dts/bindings/reset/raspberrypi,pico-reset.yaml
```yaml
# Copyright (c) 2022 Andrei-Edward Popa
# SPDX-License-Identifier: Apache-2.0

description: Raspberry Pi Pico Reset Controller

compatible: "raspberrypi,pico-reset"

include: [base.yaml, reset-controller.yaml]

properties:
  reg:
    required: true

  "#reset-cells":
    const: 1

reset-cells:
- id
```

## dts/bindings/reset/realtek,rts5817-reset.yaml
```yaml
# Copyright (c) 2024 Realtek Semiconductor, Inc.
# SPDX-License-Identifier: Apache-2.0

description: Realtek RTS5817 Peripheral reset controller

compatible: "realtek,rts5817-reset"

include: [reset-controller.yaml, base.yaml]

properties:
  "#reset-cells":
    const: 1

reset-cells:
  - id
```

## dts/bindings/reset/reset-controller.yaml
```yaml
# Copyright (c) 2022 Andrei-Edward Popa <andrei.popa105@yahoo.com>
# SPDX-License-Identifier: Apache-2.0

description: Reset Controller

properties:
  "#reset-cells":
    type: int
    required: true
    description: |
      Number of cells in reset property. There must be a cell
      named "id" to use the reset_dt_spec macros.
```

## dts/bindings/reset/reset-device.yaml
```yaml
# Copyright (c) 2022 Andrei-Edward Popa
# SPDX-License-Identifier: Apache-2.0

description: This file needs to be included by devices that need a reset controller.

properties:
  resets:
    type: phandle-array
    description: Reset information

  reset-names:
    type: string-array
    description: Name of each reset
```

## dts/bindings/reset/reset-mmio.yaml
```yaml
# Copyright (c) 2025 Google, LLC
# SPDX-License-Identifier: Apache-2.0

description: |
  Generic MMIO Reset driver for devices with a single memory mapped reset bit
  required to take them out of reset.

compatible: "reset-mmio"

include: [base.yaml]

properties:
  reg:
    required: true
  num-resets:
    type: int
    required: true
    description: |
      Number of resets controlled by the register.
      Can be in the range [1, 31].
  active-low:
    description: Reset is active in low state.
    type: boolean
```

## dts/bindings/reset/sifli,sf32lb-rcc-rctl.yaml
```yaml
# Copyright (c) 2025 Qingsong Gou <gouqs@hotmail.com>
# SPDX-License-Identifier: Apache-2.0

description: SiFli SF32LB Reset Controller

compatible: "sifli,sf32lb-rcc-rctl"

include: reset-controller.yaml

properties:
  "#reset-cells":
    const: 1

reset-cells:
  - id
```

## dts/bindings/reset/st,stm32-rcc-rctl.yaml
```yaml
# Copyright (c) 2022, Google Inc
# SPDX-License-Identifier: Apache-2.0

description: |
  STM32 Reset and Clock Control (RCC) Controller.

  This node is in charge of reset control for AHB (Advanced High Performance)
  and APB (Advanced Peripheral) bus domains.

  To specify the reset line in a peripheral, the standard resets property needs
  to be used, e.g.:

    usart1: serial@xxx {
        ...
        /* Cell contains information about RCU register offset and bit */
        resets = <&rctl STM32_RESET(ABP2, 4U)>;
        ...
    };

  RCC reset cells are available in
  include/zephyr/dts-bindings/reset/stm32{soc_family}_reset.h header files.

compatible: "st,stm32-rcc-rctl"

include: [reset-controller.yaml, base.yaml]

properties:
  "#reset-cells":
    const: 1

  set-bit-to-deassert:
    type: boolean
    description: |
      Indicates if the driver should set bit in clear register to
      deassert reset.

reset-cells:
  - id
```

## dts/bindings/reset/syna,sr100-reset.yaml
```yaml
# Copyright (c) 2025 Synaptics, Inc.
# SPDX-License-Identifier: Apache-2.0

title: Synaptics SR100 Reset Driver

description: |
  Synaptics SR100 Reset driver bindings.

include: [base.yaml, reset-controller.yaml]

compatible: "syna,sr100-reset"


properties:
  reg:
    required: true

  "#reset-cells":
    const: 1

reset-cells:
- id
```

## dts/bindings/reset/zephyr,reset-mmio.yaml
```yaml
# Copyright (c) 2025 Google, LLC
# SPDX-License-Identifier: Apache-2.0

description: MMIO Reset

compatible: "zephyr,reset-mmio"

include: [base.yaml]

properties:
  reg:
    required: true
  num_resets:
    type: int
    default: 1
    description: Number of resets controlled by the register.
  active_low:
    description: Reset is active in low state.
    type: boolean
```

## dts/bindings/retained_mem/gd,gd32-backup-sram.yaml
```yaml
# Copyright (c) 2026 Aleksandr Senin <al@meshium.net>
#
# SPDX-License-Identifier: Apache-2.0

title: GD32 Backup SRAM retained memory

description: |
  Retained memory driver for GD32 Backup SRAM. The device enables the Backup SRAM
  clock gate. To retain contents while VBAT is supplied, BLDO (Backup SRAM LDO)
  should be enabled using a regulator referenced by vin-supply.

compatible: "gd,gd32-backup-sram"

include: base.yaml

properties:
  reg:
    required: true

  clocks:
    required: true
    description: Reference to BKPSRAM clock gate (AHB1EN BKPSRAM bit)

  vin-supply:
    type: phandle
    description: Regulator that powers/controls Backup SRAM retention (BLDO)
```

## dts/bindings/retained_mem/microcrystal,rv3028-retmem.yaml
```yaml
# Copyright (c) 2024 ANITRA system s.r.o.
# SPDX-License-Identifier: Apache-2.0

description: |
  Micro Crystal RV3028 RTC User RAM

  There are two free RAM bytes for general use at addresses 0x1f and 0x20.

  Example configuration:
    rtc: rv3028@52 {
      compatible = "microcrystal,rv3028";
      status = "okay";
      reg = <0x52>;
      backup-switch-mode = "disabled";

      #address-cells = <1>;
      #size-cells = <1>;

      rtc_retmem: rv3028-retmem@1f {
        compatible: "microcrystal,rv3028-retmem";
        reg = <0x1f 0x2>;
        status = "okay";
      };
    };

compatible: "microcrystal,rv3028-retmem"

include: base.yaml

on-bus: microcrystal,rv3028

properties:
  reg:
    required: true
    description: RAM base address and size in bytes
```

## dts/bindings/retained_mem/nordic,nrf-gpreget.yaml
```yaml
# Copyright (c) 2023 Nordic Semiconductor ASA
# SPDX-License-Identifier: Apache-2.0

description: Nordic GPREGRET (General Purpose Register Retention) device.

compatible: "nordic,nrf-gpregret"

include: base.yaml

properties:
  "#address-cells":
    const: 1

  "#size-cells":
    const: 1

  reg:
    required: true
```
