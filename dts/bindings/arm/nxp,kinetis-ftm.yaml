## dts/bindings/arm/nxp,kinetis-ftm.yaml
```yaml
# Copyright (c) 2017, NXP
# SPDX-License-Identifier: Apache-2.0

description: Kinetis FTM

compatible: "nxp,kinetis-ftm"

include: base.yaml

properties:
    reg:
      required: true

    interrupts:
      required: true

    prescaler:
      type: int
      required: true
      enum:
        - 1
        - 2
        - 4
        - 8
        - 16
        - 32
        - 64
        - 128
      description: Input clock prescaler
```

## dts/bindings/arm/nxp,kinetis-ke1xf-sim.yaml
```yaml
# Copyright (c) 2017, NXP
# SPDX-License-Identifier: Apache-2.0

description: Kinetis KE1xF System Integration Module (SIM) IP node

compatible: "nxp,kinetis-ke1xf-sim"

include: base.yaml

properties:
    reg:
      required: true

    label:
      required: true

    clkout-source:
      type: int
      required: false
      description: clkout clock source

    clkout-divider:
      type: int
      required: false
      description: clkout divider
```

## dts/bindings/arm/nxp,kinetis-mcg.yaml
```yaml
# Copyright (c) 2019 Vestas Wind Systems A/S
# SPDX-License-Identifier: Apache-2.0

description: NXP Kinetis Multipurpose Clock generator (MCG) IP node

compatible: "nxp,kinetis-mcg"

include: [clock-controller.yaml, base.yaml]

properties:
    reg:
      required: true

    label:
      required: true

    "#clock-cells":
      const: 1

clock-cells:
  - name
```

## dts/bindings/arm/nxp,kinetis-pcc.yaml
```yaml
# Copyright (c) 2019 Vestas Wind Systems A/S
# SPDX-License-Identifier: Apache-2.0

description: NXP Kinetis PCC (Peripheral Clock Controller) IP node

compatible: "nxp,kinetis-pcc"

include: [clock-controller.yaml, base.yaml]

properties:
    reg:
      required: true

    label:
      required: true

    "#clock-cells":
      const: 2

clock-cells:
  - name
  - ip-source
```

## dts/bindings/arm/nxp,kinetis-scg.yaml
```yaml
# Copyright (c) 2019-2021 Vestas Wind Systems A/S
# SPDX-License-Identifier: Apache-2.0

description: NXP Kinetis SCG (System Clock Generator) IP node

compatible: "nxp,kinetis-scg"

include: [clock-controller.yaml, base.yaml]

properties:
    reg:
      required: true

    sosc-mode:
      type: int
      description: system oscillator mode
      required: false

    "#clock-cells":
      const: 1

clock-cells:
  - name
```

## dts/bindings/arm/nxp,kinetis-sim.yaml
```yaml
# Copyright (c) 2017, NXP
# SPDX-License-Identifier: Apache-2.0

description: Kinetis System Integration Module (SIM) IP node

compatible: "nxp,kinetis-sim"

include: base.yaml

properties:
    reg:
      required: true

    label:
      required: true

    clkout-source:
      type: int
      required: false
      description: clkout clock source

    clkout-divider:
      type: int
      required: false
      description: clkout divider

    "#clock-cells":
      type: int
      required: false
      const: 3

clock-cells:
  - name
  - offset
  - bits
```

## dts/bindings/arm/nxp,kw41z-sim.yaml
```yaml
---
title: KW41Z System Integration Module (SIM)
version: 0.1

description: >
    This is a representation of the KW41Z SIM IP node

properties:
    compatible:
      type: string
      category: required
      description: compatible strings
      constraint: "nxp,kw41z-sim"

    reg:
      type: int
      description: mmio register space
      generation: define
      category: required

cell_string: SIM_CLK

"#cells":
  - offset
  - bits
...
```

## dts/bindings/arm/nxp,lpc-flexcomm.yaml
```yaml
# Copyright (c) 2020 NXP
# SPDX-License-Identifier: Apache-2.0

description: LPC Flexcomm node

compatible: "nxp,lpc-flexcomm"

include: [base.yaml, pinctrl-device.yaml, reset-device.yaml]

properties:
  reg:
    required: true

  interrupts:
    required: true

  low-power-states:
    type: phandles
    description: |
      power states which will put the uart into a "low power mode" in which it cannot
      function with normal baud rate but will retain state
      and activity on the RX line can cause wakeup if wakeup function is also enabled.
```

## dts/bindings/arm/nxp,lpc-mailbox.yaml
```yaml
# Copyright (c) 2017, NXP
# SPDX-License-Identifier: Apache-2.0

title: LPC MAILBOX

description: |
    This binding gives a base representation of the LPC MAILBOX

compatible: "nxp,lpc-mailbox"

include: base.yaml

properties:
  reg:
      required: true

  interrupts:
      required: true

  label:
      required: true
```

## dts/bindings/arm/nxp,mcux-xbar-1.yaml
```yaml
# Copyright 2026 NXP
# SPDX-License-Identifier: Apache-2.0

description: MCUX Inter-Peripheral Crossbar Switch 1 (XBAR_1)

compatible: "nxp,mcux-xbar-1"

include: nxp,mcux-xbar.yaml

properties:

  xbar-instance:
    type: int
    description: |
      XBAR instance number. The desired values can be
      found by searching for 'xbar_instance_t' enum in
      modules/hal/nxp/mcux/mcux-sdk/devices/<device>/<device>_COMMON.h.
    required: true

  xbar-maps:
    required: true
```

## dts/bindings/arm/nxp,mcux-xbar.yaml
```yaml
# Copyright (c) 2023, Prevas A/S
# Copyright 2026 NXP
# SPDX-License-Identifier: Apache-2.0

description: |
  NXP MCUX XBAR (Crossbar Switch).

  Acts as a generic mux controller: each SEL register selects one input
  signal to route to one output line. The driver writes the SEL registers
  directly via DEVICE_MMIO and supports both 16-bit and 32-bit register
  layouts (selected at compile time by FSL_FEATURE_XBAR_DSC_REG_WIDTH).

  Cell layout (mux-controls / mux-states):
    cell[0] = "output" -- xbar output signal id (the SEL register that
                          will be programmed; addressing).
    state              -- xbar input signal id (the value to write into
                          the SEL register). For mux-states the trailing
                          cell is named "input" and carries this value.

  Legacy "xbar-maps" property is still accepted by drivers (e.g.
  qdec_mcux) that have not yet migrated to the mux-states API.

compatible: "nxp,mcux-xbar"

include: [base.yaml, mux-controller.yaml]

properties:
  reg:
    required: true

  clocks:
    required: true

  "#mux-control-cells":
    const: 1

  "#mux-state-cells":
    const: 2

mux-control-cells:
  # xbar output signal id (which SEL register to program).
  - output

mux-state-cells:
  - output
  # xbar input signal id (value written into the SEL register).
  - input
```

## dts/bindings/arm/nxp,mcux-xbara.yaml
```yaml
# Copyright 2026 NXP
# SPDX-License-Identifier: Apache-2.0

description: MCUX Inter-Peripheral Crossbar Switch A (XBARA)

compatible: "nxp,mcux-xbara"

include: nxp,mcux-xbar.yaml

properties:
  xbar-maps:
    required: true
```

## dts/bindings/arm/nxp,mcux-xbarb.yaml
```yaml
# Copyright 2026 NXP
# SPDX-License-Identifier: Apache-2.0

description: MCUX Inter-Peripheral Crossbar Switch B (XBARB)

compatible: "nxp,mcux-xbarb"

include: nxp,mcux-xbar.yaml

properties:
  xbar-maps:
    required: true
```

## dts/bindings/arm/nxp,rw-soc-ctrl.yaml
```yaml
# Copyright 2022 NXP
# SPDX-License-Identifier: Apache-2.0

description: RW SOC controller node

compatible: "nxp,rw-soc-ctrl"

include: base.yaml

properties:
  reg:
    required: true
```

## dts/bindings/arm/nxp,wifi.yaml
```yaml
# Copyright 2023 NXP
# SPDX-License-Identifier: Apache-2.0

description: IMU interrupt info

compatible: "nxp,wifi"

include: base.yaml

properties:
  interrupts:
    required: true
```

## dts/bindings/arm/renesas,ra-npu.yaml
```yaml
# Copyright (c) 2025 Renesas Electronics Corporation
# SPDX-License-Identifier: Apache-2.0

description: Renesas RA frontend of Arm Ethos-U NPU

compatible: "renesas,ra-npu"

include: "arm,ethos-u.yaml"

properties:
  clocks:
    required: true

  interrupt-names:
    required: true
    enum:
      - "npu-irq"
```

## dts/bindings/arm/silabs,gecko-usart.yaml
```yaml
---
title: GECKO USART
version: 0.1

description: >
    Binding for the Silabs Gecko multi-protocol (UART, SPI, ...) USART unit.

properties:
    compatible:
      type: string
      category: required
      description: compatible strings
      constraint: "silabs,gecko-usart"
      generation: define

    reg:
      type: array
      description: mmio register space
      generation: define
      category: required

    interrupts:
      type: compound
      category: required
      description: required interrupts
      generation: define
...
```

## dts/bindings/arm/st,stm32-bootloader.yaml
```yaml
# Copyright (c) 2025 Peter Johanson
# SPDX-License-Identifier: Apache-2.0

description: ST STM32 ROM Bootloader Details

compatible: "st,stm32-bootloader"

include: base.yaml

properties:
  reg:
    required: true
```

## dts/bindings/arm/st,stm32-ccm.yaml
```yaml
# SPDX-License-Identifier: Apache-2.0

description: STM32 CCM (Core Coupled Memory)

compatible: "st,stm32-ccm"

include: [base.yaml, mem-region.yaml]

properties:
    reg:
      required: true
```

## dts/bindings/arm/ti,cc2650-prcm.yaml
```yaml
# SPDX-License-Identifier: Apache-2.0

description: TI CC2650 PRCM (Power, Reset, and Clock control Module)

compatible: "ti,cc2650-prcm"

include: base.yaml

properties:
    reg:
      required: true
```

## dts/bindings/arm/xlnx,zynq-ocm.yaml
```yaml
# SPDX-License-Identifier: Apache-2.0

description: Xilinx Zynq OCM (On-Chip Memory)

compatible: "xlnx,zynq-ocm"

include: base.yaml

properties:
    reg:
      required: true
```

## dts/bindings/ata/ahci.yaml
```yaml
# Copyright (c) 2023 Arm Limited (or its affiliates). All rights reserved.
# SPDX-License-Identifier: Apache-2.0

description: ATA AHCI

compatible: "ata-ahci"

include: [base.yaml, pcie-device.yaml]
```

## dts/bindings/audio/ambiq,audadc.yaml
```yaml
# Copyright (c) 2025 Ambiq Micro Inc.
# SPDX-License-Identifier: Apache-2.0

description: Ambiq AUDADC

compatible: "ambiq,audadc"

include: ["base.yaml"]

properties:
  reg:
    required: true

  interrupts:
    required: true

  audadc-buf-location:
    type: string
    description: |
      Define AUDADC DMA buffer location section

  audadc-buf-size-samples:
    type: int
    description: |
      Define the AUDADC DMA buffer size in 4-byte words (samples)
```

## dts/bindings/audio/ambiq,pdm.yaml
```yaml
# Copyright (c) 2024 Ambiq Micro Inc.
# SPDX-License-Identifier: Apache-2.0

description: Ambiq PDM

compatible: "ambiq,pdm"

include: ["base.yaml", "pinctrl-device.yaml"]

properties:
  reg:
    required: true

  interrupts:
    required: true

  pinctrl-0:
    required: true

  pinctrl-names:
    required: true

  pdm-buffer-location:
    type: string
    description: |
      Define PDM DMA buffer location section

  pdm-buffer-size:
    type: int
    description: |
      Define the PDM DMA buffer size in (4-byte) words
```

## dts/bindings/audio/awinic,aw88298.yaml
```yaml
# Copyright (c) 2025 TOKITA Hiroshi
#
# SPDX-License-Identifier: Apache-2.0

description: Awinic AW88298 smart audio power amplifier

include: [i2c-device.yaml]

compatible: "awinic,aw88298"

properties:
  reg:
    required: true

  reset-gpios:
    type: phandle-array
    description:
      GPIO connected to the controller RSTN pin.

  int-gpios:
    type: phandle-array
    description:
      GPIO connected to the controller INTN pin.
```
