## dts/bindings/arm/atmel,sam0-device_id.yaml
```yaml
title: Atmel Device ID (Serial Number) binding

description: |
    Binding for locating the Device ID (serial number) on Atmel SAM0 devices.

compatible: "atmel,sam0-id"

include: base.yaml

properties:
    reg:
      required: true
```

## dts/bindings/arm/atmel,sam0-dma.yaml
```yaml
---
title: Atmel DMA binding
version: 0.1

description: >
    Binding for the Atmel SAM0 DMA controller.

properties:
    compatible:
      type: string
      category: required
      description: compatible strings
      constraint: "atmel,sam0-dma"
      generation: define

    reg:
      type: array
      description: mmio register space
      generation: define
      category: required

    interrupts:
      type: array
      category: required
      description: required interrupts
      generation: define

    label:
      type: string
      category: required
      description: Human readable string describing the device (used by Zephyr for API name)
      generation: define
...
```

## dts/bindings/arm/atmel,sam0-dmac.yaml
```yaml
description: Atmel SAM0 DMA controller

compatible: "atmel,sam0-dmac"

include: base.yaml

properties:
    reg:
      required: true

    interrupts:
      required: true
```

## dts/bindings/arm/atmel,sam0-eic.yaml
```yaml
---
title: Atmel External Interrupt Controller binding
version: 0.1

description: >
    Binding for the Atmel SAM0 External Interrupt Controller.

properties:
    compatible:
      type: string
      category: required
      description: compatible strings
      constraint: "atmel,sam0-eic"

    reg:
      type: array
      description: mmio register space
      generation: define
      category: required

    interrupts:
      type: array
      category: required
      description: required interrupts
      generation: define

    label:
      type: string
      category: required
      description: Human readable string describing the device (used by Zephyr for API name)
      generation: define
...
```

## dts/bindings/arm/atmel,sam0-id.yaml
```yaml
description: |
    For locating the Device ID (serial number) on Atmel SAM0 devices

compatible: "atmel,sam0-id"

include: base.yaml

properties:
    reg:
      required: true
```

## dts/bindings/arm/atmel,sam0-sercom.yaml
```yaml
# Copyright (c) 2024, Gerson Fernando Budke <nandojve@gmail.com>
# SPDX-License-Identifier: Apache-2.0

description: Atmel SAM0 multi-protocol (UART, SPI, I2C) SERCOM unit

compatible: "atmel,sam0-sercom"

include:
  - name: base.yaml
  - name: atmel,assigned-clocks.yaml

properties:
  reg:
    required: true

  interrupts:
    required: true

  clocks:
    required: true
```

## dts/bindings/arm/atmel,samd2x-pm.yaml
```yaml
# Copyright (c) 2020, Linaro Limited
# SPDX-License-Identifier: Apache-2.0

description: Atmel SAMD2x Power Manager (PM)

compatible: "atmel,samd2x-pm"

include: [clock-controller.yaml, base.yaml]

properties:
  reg:
    required: true

  "#clock-cells":
    const: 2

clock-cells:
  - offset
  - bit
```

## dts/bindings/arm/atmosic,atmx3-pmu.yaml
```yaml
# Copyright (c) 2024 Atmosic
# SPDX-License-Identifier: Apache-2.0

description: Atmosic PMU

compatible: "atmosic,atmx3-pmu"

include: base.yaml

properties:
  reg:
    required: true

  interrupts:
    required: true

  batt-type:
    type: int
    required: false
    description:
        The battery type is specified through OTP and is equal to BATT_TYPE_NON_RECHARGEABLE by default. It can be overwritten through this compile time flag based on the board design. Valid battery types are given below.
        - BATT_TYPE_LI_ION
        - BATT_TYPE_RECHARGEABLE
        - BATT_TYPE_NO_BATTERY
        - BATT_TYPE_NON_RECHARGEABLE
        If you wish to use BATT_TYPE_LI_ION, you will need to first power the board using a power source that is NOT lithium ion then load a program with CONFIG_BATT_TYPE=0. This will enable the lithium ion power ciruit, at which point you can disconnect the non lithium ion power source, hook up the lithium ion battery and proceed like normal.

  batt-level:
    type: int
    required: false
    description:
        The battery level is specified through OTP and is equal to BATT_LEVEL_GT_1P8V by default. It can be overwritten through this compile time flag. Valid battery levels.
        - BATT_LEVEL_LE_1P8V (<= 1.8V)
        - BATT_LEVEL_GT_1P8V (> 1.8V)

  vddio-type:
    type: int
    required: false
    description:
        The 'vddio' type is equal to VDDIO_TYPE_INTERNAL by default and can be overwritten through this compile time flag based on the board design. Valid vddio types.
        - VDDIO_TYPE_INTERNAL
        - VDDIO_TYPE_EXTERNAL
        Note that the external VDDIO type is determined by the source on the board, which is commonly assumed to be VBAT. Therefore, it is supported for battery level greater than 1.8V.

  vstore-max:
    type: int
    required: false
    description:
        The vstore max is specified through OTP. It can be overwritten through this compile time flag. Suppported Vstore max values given below.
        - Between 1500 mV - 3000 mV with 50 mV step,
        - 3100 mV
        - 3300 mV (default)

  vddpa-src:
    type: int
    required: false
    description:
        Suppported Vddpa src values given below.
        - VDDPA_SRC_VDDIOP
        - VDDPA_SRC_VDDPAP

  nonrf-harv:
    type: boolean
    required: false
    description:
        Enables PhotoVoltaic (PV) harvesting. Can be specified with RF_HARV to enable combined harvesting.

  vharv-range:
    type: int
    required: false
    description:
        Harvesting range needs to be specified for PV harvesting. It can be done at compile time using this flag. Valid vharv range values are given below.
        - VHARV_RANGE_0P4V_0P45V
        - VHARV_RANGE_0P45V_0P5V
        - VHARV_RANGE_0P525V_0P6V
        - VHARV_RANGE_0P6V_0P7V
        - VHARV_RANGE_0P675V_0P8V
        - VHARV_RANGE_0P75V_0P9V
        - VHARV_RANGE_0P825V_1P0V
        - VHARV_RANGE_0P9V_1P1V
        - VHARV_RANGE_0P975V_1P2V
        - VHARV_RANGE_1P05V_1P3V
        - VHARV_RANGE_1P175V_1P45V
        - VHARV_RANGE_1P3V_1P6V
        - VHARV_RANGE_1P5V_1P8V
        - VHARV_RANGE_1P7V_2P0V
        - VHARV_RANGE_1P95V_2P25V
        - VHARV_RANGE_2P2V_2P5V

  boost-from-vharv-inductor:
    type: boolean
    required: false
    description:
        This option is only available with BATT_TYPE=BATT_TYPE_LI_ION, and PV harvesting (CFG_NONRF_HARV and corresponding VHARV_RANGE option). Please refer to the application notes for the applicable scenarios, hardware connections and performance. Based on the characteristic of the selected PV cell, the user needs to choose the upper level or lower level of the VHARV_RANGE by enabling one of the 2 options - vharv-ll or vharv-ul

  vharv-ll:
    type: boolean
    required: false
    description:
        VHARV range lower level

  vharv-ul:
    type: boolean
    required: false
    description:
        VHARV range upper level

  dig-test-out-pin:
    type: int
    required: false
    description:
        dig test out pin

  boost-io-pin:
    type: int
    required: false
    description:
        boost io pin

  boost-from-vharv-two-diode:
    type: boolean
    required: false
    description:
        This option is only available with BATT_TYPE=BATT_TYPE_LI_ION, and PV harvesting (CFG_NONRF_HARV and corresponding VHARV_RANGE option). Please refer to the application notes for the applicable scenarios, hardware connections and performance.

  rf-harv:
    type: boolean
    required: false
    description:
        Enables RF harvesting. Can be specified with NONRF_HARV to enable combined harvesting.

  harv-meter:
    type: boolean
    required: false
    description:
        Supported only when MPPT is disabled. The application needs to call the pmu_set_harv_meter() API to start/stop the meter. The instantaneous power computation depends on the vharv range and the inductor used.

  inductor-nhenry:
    type: int
    required: false
    description:
        Inductor being used in the board design for harvesting meter
```

## dts/bindings/arm/cypress,psoc6-mailbox.yaml
```yaml
#
# Copyright (c) 2018, Cypress Semiconductor
#
# SPDX-License-Identifier: Apache-2.0
#
---
title: PSOC6 MAILBOX
version: 0.1

description: >
    This binding gives a base representation of the PSOC6 MAILBOX

properties:
  compatible:
      type: string
      category: required
      description: compatible strings
      constraint: "cypress,psoc6-mailbox"
      generation: define

  reg:
      type: array
      description: mmio register space
      generation: define
      category: required

  channels:
      type: array
      category: required
      description: used IPC channels
      generation: define

  interrupts:
      type: array
      category: required
      description: required interrupts
      generation: define

  label:
      type: string
      category: required
      description: Human readable string describing the device (used by Zephyr for API name)
      generation: define

...
```

## dts/bindings/arm/infineon,cat1-scb.yaml
```yaml
# Copyright (c) 2023 Cypress Semiconductor Corporation (an Infineon company) or
# an affiliate of Cypress Semiconductor Corporation
#
# SPDX-License-Identifier: Apache-2.0

description: Infineon Serial Communication Blocks (SCB) node

compatible: "infineon,cat1-scb"

include: [base.yaml, "infineon,system-interrupts.yaml"]

properties:
  reg:
    required: true

  interrupts:
    description: Required for non-cat1c devices

  system-interrupts:
    description: Required for cat1c devices
```

## dts/bindings/arm/infineon,cat2-scb.yaml
```yaml
# Copyright (c) 2023 Cypress Semiconductor Corporation (an Infineon company) or
# an affiliate of Cypress Semiconductor Corporation
#
# SPDX-License-Identifier: Apache-2.0

description: Infineon Serial Communication Blocks (SCB) node

compatible: "infineon,cat2-scb"

include: [base.yaml, "infineon,system-interrupts.yaml"]

properties:
  reg:
    required: true

  interrupts:
    description: Required for non-cat2 devices

  system-interrupts:
    description: Required for cat2 devices
```

## dts/bindings/arm/infineon,edge-npu.yaml
```yaml
# SPDX-FileCopyrightText: <text>Copyright (c) 2026 Infineon Technologies AG,
# or an affiliate of Infineon Technologies AG. All rights reserved.</text>
#
# SPDX-License-Identifier: Apache-2.0

description: Infineon PSE84 frontend of Arm Ethos-U NPU

compatible: "infineon,edge-npu"

include: "arm,ethos-u.yaml"

properties:
  reg:
    required: true
```

## dts/bindings/arm/infineon,ifx-npu.yaml
```yaml
# Copyright (c) 2026 Infineon Technologies AG,
# or an affiliate of Infineon Technologies AG.
# SPDX-License-Identifier: Apache-2.0

description: Infineon PSE84 frontend of Arm Ethos-U NPU driver

compatible: "infineon,ifx-npu"

include: "arm,ethos-u.yaml"

properties:
  reg:
    required: true
```

## dts/bindings/arm/infineon,scb.yaml
```yaml
# Copyright (c) 2023 Cypress Semiconductor Corporation (an Infineon company) or
# an affiliate of Cypress Semiconductor Corporation
#
# SPDX-License-Identifier: Apache-2.0

description: Infineon Serial Communication Blocks (SCB) node

compatible: "infineon,scb"

include: [base.yaml, "infineon,system-interrupts.yaml"]

properties:
  reg:
    required: true

  clk-dst:
    type: int
    required: true
    description: Peripheral clock destination ID for this SCB instance

  interrupts:
    description: Required for non-cat1c devices

  system-interrupts:
    description: Required for cat1c devices
```

## dts/bindings/arm/linaro,optee-tz.yaml
```yaml
# Copyright (c) 2023 EPAM Systems
# SPDX-License-Identifier: Apache-2.0

description: OPTEE

compatible: "linaro,optee-tz"

include: base.yaml

properties:
  method:
    type: string
    required: true
    description: The method of calling the OP-TEE Trusted OS.
    enum:
      - smc
      - hvc
```

## dts/bindings/arm/microchip,pic32cxsg-id.yaml
```yaml
description: |
    For locating the Device ID (serial number) on Microchip PIC32CXSG devices

compatible: "microchip,pic32cxsg-id"

include: base.yaml

properties:
  reg:
    required: true
```

## dts/bindings/arm/microchip,pic32cxsg-sercom.yaml
```yaml
description: Microchip PIC32CXSG multi-protocol (UART, SPI, I2C) SERCOM unit

compatible: "microchip,pic32cxsg-sercom"

include:
  - name: base.yaml
  - name: atmel,assigned-clocks.yaml

properties:
  reg:
    required: true

  interrupts:
    required: true

  clocks:
    required: true
```

## dts/bindings/arm/microchip,sercom-g1.yaml
```yaml
# Copyright (c) 2025 Microchip Technology Inc.
# SPDX-License-Identifier: Apache-2.0

title: Microchip SERCOM (Serial Communication) module

description: |
  Microchip SERCOM multi-protocol (UART, SPI, I2C) SERCOM unit, group g1

compatible: "microchip,sercom-g1"

include: base.yaml

properties:
  reg:
    required: true

  interrupts:
    required: true

  clocks:
    required: true
```

## dts/bindings/arm/nordic,nrf-acl.yaml
```yaml
# Copyright (c) 2022 Nordic Semiconductor ASA
# SPDX-License-Identifier: Apache-2.0

description: Nordic nRF family ACL (Access Control List)

compatible: "nordic,nrf-acl"

include: base.yaml

properties:
  reg:
    required: true
```

## dts/bindings/arm/nordic,nrf-bprot.yaml
```yaml
# Copyright (c) 2022 Nordic Semiconductor ASA
# SPDX-License-Identifier: Apache-2.0

description: Nordic nRF family BPROT (Block Protection)

compatible: "nordic,nrf-bprot"

include: base.yaml

properties:
  reg:
    required: true
```

## dts/bindings/arm/nordic,nrf-ctrlapperi.yaml
```yaml
# Copyright (c) 2022 Nordic Semiconductor ASA
# SPDX-License-Identifier: Apache-2.0

description: Nordic nRF family CTRL-AP (Control Access Port)

compatible: "nordic,nrf-ctrlapperi"

include: base.yaml

properties:
  reg:
    required: true
```

## dts/bindings/arm/nordic,nrf-dcnf.yaml
```yaml
# Copyright (c) 2022 Nordic Semiconductor ASA
# SPDX-License-Identifier: Apache-2.0

description: Nordic nRF family DCNF (Domain Configuration)

compatible: "nordic,nrf-dcnf"

include: base.yaml

properties:
    reg:
      required: true
```

## dts/bindings/arm/nordic,nrf-dppic.yaml
```yaml
# Copyright (c) 2019 Nordic Semiconductor ASA
# SPDX-License-Identifier: Apache-2.0

title: Nordic DPPIC

description: |
    Binding for the Nordic DPPIC
    Distributed Programmable Peripheral Interconnect Controller

compatible: "nordic,nrf-dppic"

include: base.yaml

properties:
    reg:
      required: true
```

## dts/bindings/arm/nordic,nrf-egu.yaml
```yaml
# Copyright (c) 2019 Nordic Semiconductor ASA
# SPDX-License-Identifier: Apache-2.0

description: Nordic EGU (Event Generator Unit)

compatible: "nordic,nrf-egu"

interrupt-source: true

include: base.yaml

properties:
  reg:
    required: true
```

## dts/bindings/arm/nordic,nrf-ficr.yaml
```yaml
description: Nordic FICR (Factory Information Configuration Registers)

compatible: "nordic,nrf-ficr"

include: base.yaml

properties:
    reg:
      required: true
```
