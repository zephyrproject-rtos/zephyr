## dts/bindings/arm/nordic,nrf-kmu.yaml
```yaml
# Copyright (c) 2019 Nordic Semiconductor ASA
# SPDX-License-Identifier: Apache-2.0

description: Nordic KMU (Key Management Unit)

compatible: "nordic,nrf-kmu"

interrupt-source: true

include: base.yaml

properties:
  reg:
    required: true
```

## dts/bindings/arm/nordic,nrf-mpu.yaml
```yaml
# Copyright (c) 2022 Nordic Semiconductor ASA
# SPDX-License-Identifier: Apache-2.0

description: Nordic nRF family MPU (Memory Protection Unit)

compatible: "nordic,nrf-mpu"

include: base.yaml

properties:
    reg:
      required: true
```

## dts/bindings/arm/nordic,nrf-mwu.yaml
```yaml
# Copyright (c) 2022 Nordic Semiconductor ASA
# SPDX-License-Identifier: Apache-2.0

description: Nordic nRF family MWU (Memory Watch Unit)

compatible: "nordic,nrf-mwu"

include: base.yaml

properties:
  reg:
    required: true
```

## dts/bindings/arm/nordic,nrf-ppi.yaml
```yaml
# Copyright (c) 2022 Nordic Semiconductor ASA
# SPDX-License-Identifier: Apache-2.0

description: Nordic nRF family PPI (Programmable Peripheral Interconnect)

compatible: "nordic,nrf-ppi"

include: base.yaml

properties:
    reg:
      required: true
```

## dts/bindings/arm/nordic,nrf-pwr-antswc.yaml
```yaml
# Copyright (c) 2025 Nordic Semiconductor ASA
# SPDX-License-Identifier: Apache-2.0

description: |

  Nordic nRF family pwr-antswc (Powering Antenna Switch)

  Uses pwr-gpios to control the 1.8V supply for the antenna switch. This
  pin is SoC specific and cannot be modified at a board level.
  Relevant configuration is implemented in soc_early_init_hook().

compatible: "nordic,nrf-pwr-antswc"

include: base.yaml

properties:
  pwr-gpios:
    type: phandle-array
    description: |
      GPIO specifier that controls power to the antenna switch controller.
```

## dts/bindings/arm/nordic,nrf-reset.yaml
```yaml
# Copyright (c) 2022 Nordic Semiconductor ASA
# SPDX-License-Identifier: Apache-2.0

description: Nordic nRF family RESET (Reset Control)

compatible: "nordic,nrf-reset"

include: base.yaml

properties:
  reg:
    required: true
```

## dts/bindings/arm/nordic,nrf-resetinfo.yaml
```yaml
# Copyright (c) 2024 Nordic Semiconductor ASA
# SPDX-License-Identifier: Apache-2.0

description: Nordic RESETINFO (Reset Information)

compatible: "nordic,nrf-resetinfo"

include: base.yaml

properties:
  reg:
    required: true
```

## dts/bindings/arm/nordic,nrf-spu.yaml
```yaml
description: Nordic SPU (System Protection Unit)

compatible: "nordic,nrf-spu"

interrupt-source: true

include: base.yaml

properties:
  reg:
    required: true
```

## dts/bindings/arm/nordic,nrf-swi.yaml
```yaml
# Copyright (c) 2022 Nordic Semiconductor ASA
# SPDX-License-Identifier: Apache-2.0

description: Nordic nRF family SWI (Software Interrupt)

compatible: "nordic,nrf-swi"

interrupt-source: true

include: base.yaml

properties:
  reg:
    required: true
```

## dts/bindings/arm/nordic,nrf-tampc.yaml
```yaml
description: Nordic TAMPC (Tamper Controller)

compatible: "nordic,nrf-tampc"

include: base.yaml

properties:
  reg:
    required: true

  swd-pins-as-gpios:
    type: boolean
    description: |
      When enabled this property will configure pins dedicated to SWD
      peripheral as regular GPIOs.

      SWD pins in nRF54LS05B: P1.29 and P1.30

      This setting, once applied, can only be unset by device reset.
```

## dts/bindings/arm/nordic,nrf-tddconf.yaml
```yaml
# Copyright (c) 2024 Nordic Semiconductor ASA
# SPDX-License-Identifier: Apache-2.0

description: |
  Nordic TRACE and Debug Domain

  Configuration for the Trace and Debug subsystem

compatible: "nordic,nrf-tddconf"

include: base.yaml

properties:
  etbsources:
    type: int
    description: |
      Bitmask of enabled sources for the ETB sink. Valid values can be found in
      dt-bindings/misc/nordic-tddconf.h

  tpiusources:
    type: int
    description: |
      Bitmask of enabled sources for the TPIU sink. Valid values can be found in
      dt-bindings/misc/nordic-tddconf.h

  etrsources:
    type: int
    description: |
      Bitmask of enabled sources for the ETR sink. Valid values can be found in
      dt-bindings/misc/nordic-tddconf.h

  portconfig:
    type: int
    default: 3
    description: TPIU clock divider - TDD HSFLL / 2^(2 + portconfig)
    enum:
      - 0
      - 1
      - 2
      - 3

  etrbuffer:
    description: phandle to the memory region used for the ETR buffer
    type: phandle
```

## dts/bindings/arm/nordic,nrf-uicr-config-only.yaml
```yaml
description: Nordic UICR (User Information Configuration Registers) for configuration purposes only

compatible: "nordic,nrf-uicr-config-only"

include: base.yaml

properties:
  nfct-pins-as-gpios:
    type: boolean
    description: |
      When enabled this property will configure pins dedicated to NFCT
      peripheral as regular GPIOs.

      NFC pins in nRF5340: P0.02 and P0.03

      This setting, once applied, can only be unset by erasing the UICR
      registers. Refer to the reference manual for more details.
```

## dts/bindings/arm/nordic,nrf-uicr-v2.yaml
```yaml
# Copyright (c) 2024 Nordic Semiconductor ASA
# SPDX-License-Identifier: Apache-2.0

description: Nordic UICR v2 (User Information Configuration Registers)

compatible: "nordic,nrf-uicr-v2"

include: base.yaml

properties:
  reg:
    required: true

  domain:
    type: int
    required: true
    description: |
      Domain ID of the domain associated with this UICR instance. Must be unique
      across all UICR instances in the system.
```

## dts/bindings/arm/nordic,nrf-uicr.yaml
```yaml
description: Nordic UICR (User Information Configuration Registers)

compatible: "nordic,nrf-uicr"

include: base.yaml

properties:
  reg:
    required: true

  nfct-pins-as-gpios:
    type: boolean
    description: |
      When enabled this property will configure pins dedicated to NFCT
      peripheral as regular GPIOs.

      NFC pins in nRF52 series: P0.09 and P0.10
      NFC pins in nRF5340: P0.02 and P0.03

      This setting, once applied, can only be unset by erasing the UICR
      registers. Refer to the reference manual for more details.

  gpio-as-nreset:
    type: boolean
    description: |
      When enabled, this property will configure the reset GPIO as nRESET.

      nRESET pin in nRF52805/52810/52811/52832 series: P0.21
      nRESET pin in nRF52820/52833/52840 series: P0.18

      This setting, once applied, can only be unset by erasing the UICR
      registers. Refer to the reference manual for more details.
```

## dts/bindings/arm/nordic,nrf-wicr.yaml
```yaml
# Copyright (c) 2026 Nordic Semiconductor ASA
# SPDX-License-Identifier: Apache-2.0

description: Nordic WICR (Wi-Fi Information Configuration Registers)

compatible: "nordic,nrf-wicr"

include: base.yaml

properties:
  reg:
    required: true

  firmware-lmacinitpc:
    type: phandle
    description: |
      Phandle to boot address for LMAC processor.

  firmware-umacinitpc:
    type: phandle
    description: |
      Phandle to boot address for UMAC processor.

  firmware-lmacrompatchaddr:
    type: phandle
    description: |
      Phandle to address in MRAM for LMAC ROM patch.

  firmware-umacrompatchaddr:
    type: phandle
    description: |
      Phandle to address in MRAM for UMAC ROM patch.

  ipcconfig-commandmbox:
    type: phandle
    description: |
      Phandle to shared-memory region used as command mailbox.

  ipcconfig-eventmbox:
    type: phandle
    description: |
      Phandle to shared-memory region used as event mailbox.

  ipcconfig-sparembox:
    type: phandle
    description: |
      Phandle to shared-memory region used as spare mailbox.
```

## dts/bindings/arm/nordic,nrf71-uicr.yaml
```yaml
# Copyright (c) 2026 Nordic Semiconductor ASA
# SPDX-License-Identifier: Apache-2.0

description: Nordic nRF71 UICR (User Information Configuration Registers)

compatible: "nordic,nrf71-uicr"

include: base.yaml

properties:
  reg:
    required: true

  supply-config1v8:
    type: string
    enum:
      - "normal"
      - "external"
      - "high-load"
    description: |
      Configuration of the VDD_AO_1V8 supply rail.

        normal    - Autonomous control by the internal power management block.
                    The LDO_VBAT_1V8 regulator operates in its default mode.
        external  - 1.8 V supplied externally on VDD_AO_1V8 pin.
                    Internal LDO_VBAT_1V8 regulator disabled to prevent
                    conflict with external supply.
        high-load - Up to 10mA can be consumed from 1V8 supply for other
                    devices/IO. Keep LDO_VBAT_1V8 in high power mode at
                    all times (including system OFF).

      This setting, once applied, can only be unset by erasing the UICR
      registers.  Refer to the nRF7120 Product Specification for details.
```

## dts/bindings/arm/nuvoton,numaker-npu.yaml
```yaml
# Copyright (c) 2025 Nuvoton Technology Corporation
# SPDX-License-Identifier: Apache-2.0

description: Nuvoton NuMaker frontend of Arm Ethos-U NPU driver

compatible: "nuvoton,numaker-npu"

include: ["arm,ethos-u.yaml", reset-device.yaml]

properties:
  reg:
    required: true

  interrupts:
    required: true

  resets:
    required: true

  clocks:
    required: true
```

## dts/bindings/arm/nxp,hci-ble.yaml
```yaml
# Copyright 2023 NXP
# SPDX-License-Identifier: Apache-2.0

description: NXP BLE HCI information

compatible: "nxp,hci-ble"

include: base.yaml

properties:
  interrupts:
    required: true
```

## dts/bindings/arm/nxp,imx-dtcm.yaml
```yaml
# Copyright (c) 2018, Linaro Limited
# SPDX-License-Identifier: Apache-2.0

description: i.MX DTCM (Data Tightly Coupled Memory)

compatible: "nxp,imx-dtcm"

include: base.yaml

properties:
  reg:
    required: true
```

## dts/bindings/arm/nxp,imx-epit.yaml
```yaml
# Copyright 2018, 2024 NXP
# SPDX-License-Identifier: Apache-2.0

description: i.MX Enhanced Periodic Interrupt Timer (EPIT)

compatible: "nxp,imx-epit"

include: [base.yaml, "nxp,rdc-policy.yaml"]

properties:
  reg:
    required: true

  interrupts:
    required: true

  prescaler:
    type: int
    required: true
    description: Set the EPIT prescaler between 0 and 4095
```

## dts/bindings/arm/nxp,imx-itcm.yaml
```yaml
# Copyright (c) 2018, Linaro Limited
# SPDX-License-Identifier: Apache-2.0

description: i.MX ITCM (Instruction Tightly Coupled Memory)

compatible: "nxp,imx-itcm"

include: base.yaml

properties:
  reg:
    required: true
```

## dts/bindings/arm/nxp,imx-mu.yaml
```yaml
# Copyright (c) 2018, NXP
# SPDX-License-Identifier: Apache-2.0

description: i.MX Messaging Unit

compatible: "nxp,imx-mu"

include: base.yaml

properties:
  reg:
      required: true

  interrupts:
      required: true

  rdc:
     type: int
     required: true
     description: Set the RDC permission for this peripheral
```

## dts/bindings/arm/nxp,imx-rt-dtcm.yaml
```yaml
#
# Copyright (c) 2018, Linaro Limited
#
# SPDX-License-Identifier: Apache-2.0
#
---
title: i.MX RT DTCM (Data Tightly Coupled Memory)
version: 0.1

description: >
  This binding gives a base representation of the i.MX-RT DTCM

properties:
    compatible:
      type: string
      category: required
      constraint: "nxp,imx-rt-dtcm"
      generation: define

    reg:
      type: int
      description: mmio register space
      generation: define
      category: required

...
```

## dts/bindings/arm/nxp,imx-rt-itcm.yaml
```yaml
#
# Copyright (c) 2018, Linaro Limited
#
# SPDX-License-Identifier: Apache-2.0
#
---
title: i.MX RT ITCM (Instruction Tightly Coupled Memory)
version: 0.1

description: >
  This binding gives a base representation of the i.MX-RT ITCM

properties:
    compatible:
      type: string
      category: required
      constraint: "nxp,imx-rt-itcm"
      generation: define

    reg:
      type: int
      description: mmio register space
      generation: define
      category: required

...
```

## dts/bindings/arm/nxp,imx7d-ccm.yaml
```yaml
# Copyright (c) 2024 MAKEEN Energy A/S
# SPDX-License-Identifier: Apache-2.0

description: NXP IMX7D CCM Prescalers definitons

properties:

  ccm-pre:
    type: int
    default: 0
    enum:
      - 0
      - 1
      - 2
      - 3
      - 4
      - 5
      - 6
      - 7
    description: CCM Pre divider value (0-7, divider=n+1)

  ccm-post:
    type: int
    default: 0
    description: Post divider value (0-63, divider=n+1)
```
