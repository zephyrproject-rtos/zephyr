## dts/bindings/sdhc/microchip,sam-sdmmc.yaml
```yaml
# Copyright (C) 2025 Microchip Technology Inc. and its subsidiaries
#
# SPDX-License-Identifier: Apache-2.0
#

description: Microchip SAM SDMMC SD host controller

compatible: "microchip,sama7g5-sdhci"

include: [sdhc.yaml, pinctrl-device.yaml]

properties:
  reg:
    required: true

  interrupts:
    required: true

  pinctrl-0:
    required: true

  pinctrl-names:
    required: true

  clocks:
    required: true

  assigned-clock-rates:
    type: int
    required: true

  cd-gpios:
    type: phandle-array

  non-removable:
    type: boolean

  bus-width:
    type: int
    default: 4
    enum:
      - 1
      - 4
      - 8

  no-1-8-v:
    type: boolean
    description: |
      The SD/MMC bus on the board doesn't support the 1.8V voltage,
      Which disables UHS-I, HS200 and HS400 support.

  voltage-300:
    type: boolean

  rstn-power-en:
    type: boolean

  auto-cmd12:
    type: boolean

  auto-cmd23:
    type: boolean

  max-bus-clk:
    type: int
    default: 200000000
```
