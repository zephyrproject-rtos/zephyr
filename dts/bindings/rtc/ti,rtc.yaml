## dts/bindings/rtc/ti,rtc.yaml
```yaml
# Copyright 2024 Linumiz
# SPDX-License-Identifier: Apache-2.0

description: Texas Instruments RTC Driver

compatible: "ti,rtc"

include:
  - name: rtc.yaml
  - name: rtc-device.yaml

properties:
  reg:
    required: true

  ti,rtc_x:
    type: boolean
    description: |
      Indicate as Real-Time-Clock_x(RTC_x) instances.
      RTC, RTC_x shares same features but RTC_x has additional features
      which fall under Low-Frequency Subsystem(LFSS) peripherals.
```

## dts/bindings/rtc/xlnx,rtc.yaml
```yaml
# Copyright (c) 2025 Advanced Micro Devices, Inc. (AMD)
# SPDX-License-Identifier: Apache-2.0

description: Xilinx RTC controller

compatible: "xlnx,zynqmp-rtc"

include: ["rtc.yaml", "rtc-device.yaml"]

properties:
  reg:
    required: true
```

## dts/bindings/rtc/xlnx,xps-timer-1.00.a.yaml
```yaml
description: Xilinx AXI Timer IP node

compatible: "xlnx,xps-timer-1.00.a"

include: rtc.yaml

# Property names correspond to those used by Xilinx PetaLinux:
# https://github.com/Xilinx/meta-xilinx

properties:
    clock-frequency:
      required: true

    xlnx,count-width:
      type: int
      required: true
      enum:
        - 8
        - 16
        - 32
      description: |
        Individual timer/counter width in bits.

    xlnx,gen0-assert:
      type: int
      required: false
      enum:
        - 0
        - 1
      description: |
        Active state of the generateout0 signal (0 for active-low, 1 for
        active-high).

    xlnx,gen1-assert:
      type: int
      required: false
      enum:
        - 0
        - 1
      description: |
        Active state of the generateout1 signal (0 for active-low, 1 for
        active-high).

    xlnx,one-timer-only:
      type: int
      required: true
      enum:
        - 0
        - 1
      description: |
        0 if both Timer 1 and Timer 2 are enabled, 1 if only Timer 1 is enabled.

    xlnx,trig0-assert:
      type: int
      required: false
      enum:
        - 0
        - 1
      description: |
        Active state of the capturetrig0 signal (0 for active-low, 1 for
        active-high).

    xlnx,trig1-assert:
      type: int
      required: false
      enum:
        - 0
        - 1
      description: |
        Active state of the capturetrig1 signal (0 for active-low, 1 for
        active-high).
```

## dts/bindings/rtc/zephyr,counter-rtc.yaml
```yaml
# Copyright 2025 NXP
# SPDX-License-Identifier: Apache-2.0

description: Counter-based Virtual Real Time Clock (RTC)

compatible: "zephyr,counter-rtc"

include: rtc-device.yaml
```

## dts/bindings/rtc/zephyr,fake-rtc.yaml
```yaml
# Copyright (c) 2023 Prevas A/S
# SPDX-License-Identifier: Apache-2.0

description: |
    A Fake RTC controller for use as either a stub or a mock in Zephyr
    testing.

compatible: "zephyr,fake-rtc"

include: rtc-device.yaml
```

## dts/bindings/rtc/zephyr,rtc-counter.yaml
```yaml
# Copyright 2025 NXP
# SPDX-License-Identifier: Apache-2.0

title: Counter-based Virtual Real Time Clock (RTC).

description: |
  Some counters continue running in lower power modes. The epoch offset
  can be stored in NVMEM so it is preserved across resets, allowing the
  RTC to maintain wall-clock time as long as the underlying counter keeps
  running.

compatible: "zephyr,rtc-counter"

include:
- rtc-device.yaml
- nvmem-consumer.yaml

examples:
- |
  &rtc {
          counter_rtc: counter-rtc {
                  compatible = "zephyr,rtc-counter";
                  status = "okay";
                  alarms-count = <1>;

                  nvmem-cells = <&epoch_offset>;
                  nvmem-cell-names = "epoch-offset";
          };
  };
```

## dts/bindings/rtc/zephyr,rtc-emul.yaml
```yaml
# Copyright (c) 2022 Bjarki Arge Andreasen
# SPDX-License-Identifier: Apache-2.0

description: Emulated RTC device

compatible: "zephyr,rtc-emul"

include: rtc-device.yaml
```

## dts/bindings/rx/renesas,rx-swint.yaml
```yaml
# Copyright (c) 2025 Renesas Electronics Corporation
# SPDX-License-Identifier: Apache-2.0

description: Renesas RX SWINT (Software Interrupt)

compatible: "renesas,rx-swint"

include: base.yaml

properties:
  reg:
    required: true

  interrupts:
    required: true
```

## dts/bindings/satellite/kineis,kim1.yaml
```yaml
# Copyright (c) 2022 Kickmaker
# SPDX-License-Identifier: Apache-2.0

description: Kinéis KIM1 satellite module (AT Commands)

compatible: "kineis,kim1"

include: uart-device.yaml

properties:

    power-gpios:
      type: phandle-array

    reset-gpios:
      type: phandle-array

    pgood-gpios:
      type: phandle-array

    tx-status-gpios:
      type: phandle-array
```

## dts/bindings/sd/sd-device.yaml
```yaml
# Copyright 2022 NXP

# Fields common to all SD devices

on-bus: sd

include: [base.yaml]
```

## dts/bindings/sd/zephyr,mmc-disk.yaml
```yaml
description: |
  Zephyr MMC disk node. A binding with this compatible present within an SD
  host controller device node indicates that an MMC chip is attached to that
  SD bus. This binding will enable that to be used with the disk driver
  API and any subsystems that utilize it.

compatible: "zephyr,mmc-disk"

include: [sd-device.yaml]

properties:
  bus-width:
    type: int
    default: 8
    description: |
      Indicates the way the MMC device is connected to the bus.
      Defaults to the maximum possible number of bus lines.
    enum:
      - 1
      - 4
      - 8
```

## dts/bindings/sd/zephyr,sdmmc-disk.yaml
```yaml
description: |
  Zephyr SDMMC disk node. A binding with this compatible present within an SD
  host controller device node indicates that an SDMMC disk is attached to that
  SD bus. This binding will enable that disk to be used with the disk driver
  API and any subsystems that utilize it.

compatible: "zephyr,sdmmc-disk"

include: [sd-device.yaml]

properties:
  disk-name:
    type: string
    required: true
    description: |
      Disk name.
```

## dts/bindings/sd_dev/nxp,rw6xx-sdio-device.yaml
```yaml
# SPDX-License-Identifier: Apache-2.0

description: NXP RW6xx SDIO Device Controller

compatible: "nxp,rw6xx-sdio-device"

include:
  - base.yaml
  - pinctrl-device.yaml
  - sdio-device.yaml

properties:
  reg:
    type: array
    required: true
    description: SDIO device register window

  vendor-id:
    type: int
    default: 0x0000
    description: SDIO vendor ID

  device-id:
    type: int
    default: 0x0000
    description: SDIO device ID

  card-type:
    type: int
    required: true
    enum: [0, 1, 2]
    description: SD card type
```

## dts/bindings/sd_dev/sdio-device.yaml
```yaml
# SPDX-License-Identifier: Apache-2.0

description: Generic SDIO device


properties:
  num-funcs:
    type: int
    required: true
    enum: [1, 2, 3, 4, 5, 6, 7]
    description: Number of SDIO functions supported by the device.
```

## dts/bindings/sdev/nxp,rw6xx-sdio-device.yaml
```yaml
# SPDX-License-Identifier: Apache-2.0

description: NXP RW6xx SDIO Device Controller

compatible: "nxp,rw6xx-sdio-device"

include:
  - base.yaml
  - pinctrl-device.yaml

properties:
  reg:
    type: array
    required: true
    description: SDIO device register window

  num-funcs:
    type: int
    required: true
    enum: [1, 2, 3, 4, 5, 6, 7]
    description: Number of SDIO functions supported

  vendor-id:
    type: int
    default: 0x0000
    description: SDIO vendor ID

  device-id:
    type: int
    default: 0x0000
    description: SDIO device ID

  card-type:
    type: int
    required: true
    enum: [0, 1, 2]
    description: SD card type
```

## dts/bindings/sdhc/adi,max32-sdhc.yaml
```yaml
# Copyright (c) 2024 Analog Devices, Inc.
# SPDX-License-Identifier: Apache-2.0

description: ADI MAX32 SDHC

compatible: "adi,max32-sdhc"

include: [sdhc.yaml, pinctrl-device.yaml]

properties:
  reg:
    required: true
```

## dts/bindings/sdhc/ambiq,sdhc.yaml
```yaml
# Copyright 2025, Ambiq Micro Inc.
# SPDX-License-Identifier: Apache-2.0

description: Ambiq SDIO host controller

compatible: "ambiq,sdio"

include: [sdhc.yaml, pinctrl-device.yaml]

properties:
  reg:
    required: true

  pinctrl-0:
    required: true

  pinctrl-names:
    required: true

  txdelay:
    type: int
    required: true
    description: SDIO TX delay tap setting. Range 0 - 15.

  rxdelay:
    type: int
    required: true
    description: SDIO RX delay tap setting. Range 0 - 31.
```

## dts/bindings/sdhc/brcm,bcm2835-sdhci.yaml
```yaml
# Copyright (c) 2026 Jonathan Elliot Peace <jep@alphabetiq.com>
# SPDX-License-Identifier: Apache-2.0

description: |
  Broadcom BCM283x Arasan SDHCI host controller. Standard SDHCI
  register layout with two silicon quirks: all register accesses
  must be 32-bit aligned and 32-bit wide, and the CAPABILITIES
  register reads as zero (capability values are hardcoded by the
  driver).

compatible: "brcm,bcm2835-sdhci"

include: [sdhc.yaml, pinctrl-device.yaml]

properties:
  reg:
    required: true

  interrupts:
    required: true

  clock-frequency:
    type: int
    required: true
    description: |
      Frequency in Hz of clk_emmc, the input clock provided by the
      BCM2835 clock manager. The SDHCI clock divider scales this
      down to the bus SD clock. Typical 100 MHz with core_freq=250
      in config.txt; consult the board doc.

  bus-width:
    type: int
    default: 4
    enum:
      - 1
      - 4
    description: |
      Number of data lines wired between the controller and the
      attached card / chip. The Arasan core does not support 8-bit.

  dmas:
    required: true
    description: |
      Single DMA channel specifier for the controller's data phase.
      The Arasan core's built-in DMA (SDMA / ADMA2) is not usable on
      this silicon (CAPABILITIES register reads zero); instead the
      external BCM2835 DMA engine drains/fills the BUFFER FIFO via
      a DREQ. The single dma-cell is that DREQ number — 11 for the
      Arasan SDHCI per the BCM2835 ARM Peripherals datasheet.

  dma-names:
    required: true
    description: |
      Must be "rx-tx" — a single shared channel is reconfigured for
      each direction at request() time rather than holding two
      channels open simultaneously (only one transfer is ever in
      flight on this controller).
```

## dts/bindings/sdhc/espressif,esp32-sdhc-slot.yaml
```yaml
# Copyright (c) 2024 Espressif Systems (Shanghai) Co., Ltd.
# SPDX-License-Identifier: Apache-2.0

description: ESP32 SDHC controller slot

compatible: "espressif,esp32-sdhc-slot"

include: [sdhc.yaml, pinctrl-device.yaml]

properties:
  reg:
    required: true

  pinctrl-0:
    required: true

  pinctrl-names:
    required: true

  bus-width:
    type: int
    enum:
      - 1
      - 4
    default: 4
    description: SD bus width in bits

  clk-pin:
    type: int
    description: |
      Clock pin for ESP32 and SoC models with fixed pins for SDIO.
      For devices with GPIO matrix support, configuration shall be done
      using pin control (pinctrl-0 field).

  cmd-pin:
    type: int
    description: |
      Command pin for ESP32 and SoC models with fixed pins for SDIO.
      For devices with GPIO matrix support, configuration shall be done
      using pin control (pinctrl-0 field).

  d0-pin:
    type: int
    description: |
      Data 0 pin for ESP32 and SoC models with fixed pins for SDIO.
      For devices with GPIO matrix support, configuration shall be done
      using pin control (pinctrl-0 field).

  d1-pin:
    type: int
    description: |
      Data 1 pin for ESP32 and SoC models with fixed pins for SDIO.
      For devices with GPIO matrix support, configuration shall be done
      using pin control (pinctrl-0 field).

  d2-pin:
    type: int
    description: |
      Data 2 pin for ESP32 and SoC models with fixed pins for SDIO.
      For devices with GPIO matrix support, configuration shall be done
      using pin control (pinctrl-0 field).

  d3-pin:
    type: int
    description: |
      Data 3 pin for ESP32 and SoC models with fixed pins for SDIO.
      For devices with GPIO matrix support, configuration shall be done
      using pin control (pinctrl-0 field).

  pwr-gpios:
    type: phandle-array
    description: |
      Power pin
      This is a configurable pin to deliver power supply to the SD card.
      It is configured as a GPIO in order to execute power toggles and
      reinitialize the SD slave when necessary.
```

## dts/bindings/sdhc/espressif,esp32-sdhc.yaml
```yaml
# Copyright (c) 2024 Espressif Systems (Shanghai) Co., Ltd.
# SPDX-License-Identifier: Apache-2.0

description: ESP32 SDHC controller

compatible: "espressif,esp32-sdhc"

include: [base.yaml]

properties:
  reg:
    required: true

  interrupts:
    required: true
```

## dts/bindings/sdhc/infineon,cat1-sdhc-sdio.yaml
```yaml
# Copyright (c) 2023 Cypress Semiconductor Corporation (an Infineon company) or
# an affiliate of Cypress Semiconductor Corporation
#
# SPDX-License-Identifier: Apache-2.0

description: Infineon CAT1 SDHC/SDIO controller

compatible: "infineon,cat1-sdhc-sdio"

include: [sdhc.yaml, pinctrl-device.yaml, "infineon,system-interrupts.yaml"]

properties:
  reg:
    required: true

  pinctrl-0:
    required: true

  pinctrl-names:
    required: true

  interrupts:
    description: Required for non-cat1c devices

  system-interrupts:
    description: Required for cat1c devices
```

## dts/bindings/sdhc/infineon,sdhc-sdio.yaml
```yaml
# Copyright (c) 2025 Infineon Technologies AG,
# or an affiliate of Infineon Technologies AG.
#
# SPDX-License-Identifier: Apache-2.0

description: Infineon CAT1 SDHC/SDIO controller

compatible: "infineon,sdhc-sdio"

include: [sdhc.yaml, pinctrl-device.yaml, "infineon,system-interrupts.yaml"]

properties:
  reg:
    required: true

  pinctrl-0:
    required: true

  pinctrl-names:
    required: true

  interrupts:
    description: Required for non-cat1c devices

  system-interrupts:
    description: Required for cat1c devices

  bus-width:
    type: int
    default: 4
    description: |
      bus width for SDMMC access, defaults to the minimum necessary
      number of bus lines
    enum:
      - 1
      - 4
      - 8

  no-1-8-v:
    type: boolean
    description: |
      The SD/MMC bus on the board doesn't support the 1.8V voltage,
      Which disables UHS-I, HS200 and HS400 support.

  cd-gpios:
    type: phandle-array
    description: Card Detect pin

  clk-dst:
    type: int
    description: Peripheral clock destination ID for this TCPWM instance
```

## dts/bindings/sdhc/intel,emmc-host.yaml
```yaml
# Copyright (c) 2023 Intel Corporation
# SPDX-License-Identifier: Apache-2.0

description: eMMC host controller

compatible: "intel,emmc-host"

include: [sdhc.yaml, pcie-device.yaml]
```

## dts/bindings/sdhc/litex,litesdcard-sdhc.yaml
```yaml
# Copyright The Zephyr Project Contributors
# SPDX-License-Identifier: Apache-2.0

description: LiteX SDHC

compatible: "litex,litesdcard-sdhc"

include: [sdhc.yaml]

properties:
  bus-width:
    type: int
    enum:
      - 1
      - 4
      - 8
    default: 4

  interrupts:
    required: true
```
