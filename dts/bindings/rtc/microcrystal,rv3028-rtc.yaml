## dts/bindings/rtc/microcrystal,rv3028-rtc.yaml
```yaml
# Copyright (c) 2024 ANITRA system s.r.o.
# Copyright (c) 2026 Janez Ugovsek <janez@ugovsek.info>
# SPDX-License-Identifier: Apache-2.0

description: Micro Crystal RV3028 RTC, periodic time update, alarm device and timestamp feature

compatible: "microcrystal,rv3028-rtc"

include: rtc-device.yaml

properties:
  timestamp-edge-detection:
    type: string
    enum:
      - "falling"
      - "rising"
    default: "falling"
    description: |
      Edge selection for timestamp events on the EVI pin. If omitted, the
      driver uses falling-edge detection.

  timestamp-filtering:
    type: string
    enum:
      - "no"
      - "256Hz"
      - "64Hz"
      - "8Hz"
    default: "no"
    description: |
      Digital filter setting for the EVI pin. If omitted, no digital filtering
      is used.

  timestamp-overwrite:
    type: string
    enum:
      - "first"
      - "last"
    default: "first"
    description: |
      Controls whether timestamp registers are overwritten when another event
      occurs before software reads the previous timestamp. The timestamp count
      register continues counting events independently of this setting.

      first - The timestamp of the first event is recorded
      last - The timestamp of the last event is recorded

  timestamp-source-backup:
    type: boolean
    description: |
      Automatic backup switchover is selected as timestamp source.
      A timestamp is generated and an interrupt is issued when the
      circuit goes to VBACKUP power state. Otherwise the source is
      the external EVI pin.

examples:
  - |
    /* Example node for an RV3028 RTC on the i2c0 bus. */
    &i2c0 {
      status = "okay";
      clock-frequency = <I2C_BITRATE_STANDARD>;

      rv3028: rv3028@52 {
        compatible = "microcrystal,rv3028";
        reg = <0x52>;
        int-gpios = <&gpiob 7 (GPIO_PULL_UP | GPIO_ACTIVE_LOW)>;
        backup-switch-mode = "disabled";
        status = "okay";

        rv3028_rtc: rtc {
          compatible = "microcrystal,rv3028-rtc";
          timestamp-edge-detection = "rising";
          timestamp-filtering = "256Hz";
          timestamp-source-backup;
          timestamp-overwrite = "last";
          status = "okay";
        };
      };
    };
```

## dts/bindings/rtc/nxp,lpc-rtc.yaml
```yaml
# Copyright (c) 2022, Kumar Gala <galak@kernel.org>
# SPDX-FileCopyrightText: Copyright 2026 NXP
# SPDX-License-Identifier: Apache-2.0

description: NXP LPC RTC

compatible: "nxp,lpc-rtc"

include: [base.yaml, wuc-device.yaml]

properties:
  reg:
    required: true
```

## dts/bindings/rtc/nxp,pcf85263a.yaml
```yaml
# Copyright (c) 2026 Foss Analytical A/S
# SPDX-License-Identifier: Apache-2.0

description: NXP PCF85263A RTC

compatible: "nxp,pcf85263a"

include:
  - name: rtc-device.yaml
  - name: i2c-device.yaml

properties:
  inta-gpios:
    type: phandle-array
    description: |
      GPIO connected to the PCF85263A INTA interrupt output. This signal is open-drain, active low.

  quartz-load-femtofarads:
    type: int
    default: 7000
    enum:
      - 6000
      - 7000
      - 12500
    description: |
      Quartz crystal load capacitance in femtofarads, written to CL[1:0] of the
      Oscillator register (25h). Defaults to the chip reset value of 7000 (7 pF).
```

## dts/bindings/rtc/nxp,rtc.yaml
```yaml
# Copyright (c) 2018, blik GmbH
# Copyright 2024,2026 NXP
# SPDX-License-Identifier: Apache-2.0

description: NXP Real Time Clock (RTC)

compatible: "nxp,rtc"

include: rtc.yaml

properties:
  reg:
    required: true

  clock-source:
    type: string
    default: "RTC"
    enum:
      - "RTC"
      - "LPO"
    description: |
      Select the RTC prescaler input, where supported by the SoC:
        * RTC: RTC prescaler increments using RTC clock.
        * LPO: RTC prescaler increments using the dedicated LPO input.
      The LPO frequency depends on the SoC, for example 1 kHz or 16.384 kHz.
      The RTC clock can come from an oscillator, an external clock input,
      or an upstream clock provider, depending on the SoC clock tree.
      This property does not select those upstream clock sources.
      The default corresponds to the reset value of the prescaler input
      selection field.

  oscillator-startup-time-ms:
    type: int
    default: 1000
    description: |
      Startup budget in milliseconds for the oscillator enabled by the RTC
      driver. Must be positive. When the hardware provides a stable flag,
      initialization polls it and can finish before the budget elapses.
      The readiness check must complete before the startup deadline; at or
      after that deadline, initialization fails even if the flag is set.
      Scheduling delays can therefore cause a timeout even if the oscillator
      stabilized earlier.
      Without a stable flag, initialization waits for the full duration;
      it cannot detect oscillator failure.
      This does not apply to the dedicated LPO input, an upstream input
      selected by the SoC RTC clock mux, or clocks managed by an upstream
      provider on SoCs without RTC oscillator enable control. The driver
      does not change the upstream clock selection.
      The default is a configurable waiting budget, not a guaranteed maximum
      oscillator startup time. Set it according to the oscillator and board
      requirements.
      On hardware without a stable flag this adds the full default delay,
      including on warm resets; an enabled oscillator is not proof of
      stability. Boards may override the delay when supported by their
      oscillator specifications or qualification results.
      Without a system timer the driver uses a bounded busy wait, whose
      timing accuracy depends on the platform's busy-wait implementation.
```

## dts/bindings/rtc/silabs,siwx91x-rtc.yaml
```yaml
# Copyright (c) 2025 Silicon Labatoratories Inc.
# SPDX-License-Identifier: Apache-2.0

description: Silabs Siwx91x RTC (Real-Time Counter)

compatible: "silabs,siwx91x-rtc"

include:
  - rtc.yaml
  - rtc-device.yaml
  - wuc-device.yaml

properties:
  reg:
    required: true

  wakeup-ctrls:
    description: |
      Optional SiWx91x WUC source used to wake the system from an RTC alarm.
      Set to <&wuc0 SIWX91X_WUC_RTC_ALARM>.
```

## dts/bindings/rtc/ti,cc35xx-rtc-timer.yaml
```yaml
# Copyright (c) 2025 Conclusive Engineering Sp. z o.o.
#
# SPDX-License-Identifier: Apache-2.0

description: TI SimpleLink cc35xx RTC

compatible: "ti,cc35xx-rtc-timer"

include: rtc.yaml

properties:
  reg:
    required: true
```

## dts/bindings/rtc/ti,lpf3-rtc-timer.yaml
```yaml
# Copyright (c) 2026 Texas Instruments.
#
# SPDX-License-Identifier: Apache-2.0
#

description: TI SimpleLink LPF3 RTC

compatible: "ti,lpf3-rtc-timer"

include: rtc.yaml

properties:
  reg:
    required: true
```

## dts/bindings/rtc/ti,msp432p4xx-rtc.yaml
```yaml
# Copyright (c) 2026 Gail Rojas
# SPDX-License-Identifier: Apache-2.0

description: TI MSP432P4XX RTC_C real-time clock

compatible: "ti,msp432p4xx-rtc"

include: rtc-device.yaml

properties:
  reg:
    required: true
  interrupts:
    required: true
```

## dts/bindings/sdhc/arasan,sdhci-8.9a.yaml
```yaml
# Copyright (c) 2026 David Paul-Beier
# SPDX-License-Identifier: Apache-2.0

description: |
  Arasan SDHCI 8.9a host controller, as used for the Zynq-7000 PS SD/SDIO
  controllers. The compatible follows the Linux zynq-7000.dtsi. It is driven
  by the Xilinx SDHC driver with the Zynq-7000 configuration.

compatible: "arasan,sdhci-8.9a"

include: [sdhc.yaml]

properties:
  reg:
    required: true

  clocks:
    required: true

  broken-cd:
    type: boolean
    description:
      There is no card detection available; polling must be used.
```

## dts/bindings/sdhc/atmel,sam-hsmci.yaml
```yaml
# Copyright 2023, Nikhef
# SPDX-License-Identifier: Apache-2.0

description: ATMEL (Microchip) SAM HSMCI SD host controller

compatible: "atmel,sam-hsmci"

include: [sdhc.yaml, pinctrl-device.yaml]

properties:
  reg:
    required: true

  pinctrl-0:
    required: true

  pinctrl-names:
    required: true

  clocks:
    required: true

  cd-gpios:
    type: phandle-array

  bus-width:
    type: int
    default: 1
    enum:
      - 1
      - 4
    description: |
      Number of data lines wired to the card (MCDA0 only, or MCDA0-3).
      The default of 1 works with either wiring and matches the
      controller's 1-bit reset state. Set 4 only if all four data lines
      are routed; this also enables high speed mode, since the SD stack
      only switches to the 4-bit bus during high speed init.
```

## dts/bindings/sdhc/bflb,sdhc.yaml
```yaml
# Copyright The Zephyr Project Contributors
# SPDX-License-Identifier: Apache-2.0

description: Bouffalo Lab SD Host Controller

compatible: "bflb,sdhc"

include: [sdhc.yaml, pinctrl-device.yaml]

properties:
  reg:
    required: true

  interrupts:
    required: true

  bus-width:
    default: 4
    description: |
      Data bus width. 1 for 1-bit, 4 for 4-bit. 1-bit width is rarely used.
      No 8-bit support in hardware.
```

## dts/bindings/sdhc/brcm,bcm2712-sdhci.yaml
```yaml
# SPDX-FileCopyrightText: Copyright (c) 2026 Process Mission
# SPDX-License-Identifier: Apache-2.0

description: |
  Broadcom BCM2712 SD host controller. Main-bank SDIO pins may be configured
  through pinctrl. Dedicated EMMC pads used by the SD card slot are not
  covered by the BCM2712 pinctrl driver and must retain the boot firmware
  configuration.

compatible: "brcm,bcm2712-sdhci"

include: [sdhc.yaml, pinctrl-device.yaml]

properties:
  sd-uhs-sdr50:
    type: boolean
    description: |
      The board supports SD UHS-I SDR50 signalling at 1.8 V. Drivers that
      implement this property may enable SDR50 when the host and card support it.

  sd-uhs-sdr104:
    type: boolean
    description: |
      The board supports SD UHS-I SDR104 signalling at 1.8 V. Drivers that
      implement this property may enable SDR104 when the host and card support it.

  no-1-8-v:
    type: boolean
    description: |
      The board does not support 1.8 V signalling, even if the host does.
      This property takes precedence over SD UHS capability properties.

  bus-width:
    type: int
    required: true
    description: Number of data lines connected to the SD or SDIO device.

  reg:
    required: true

  reg-names:
    required: true
    description: SDHCI host registers followed by the Broadcom cfg registers.

  clocks:
    required: true

  non-removable:
    type: boolean
    description: Permanently connected device; no card-detect GPIO is needed.

  cd-gpios:
    type: phandle-array
    description: Card detect GPIO, required for removable cards.

  vmmc-supply:
    type: phandle
    required: true
    description: Card power regulator.

  vqmmc-supply:
    type: phandle
    description: |
      SD signalling voltage regulator; absent for fixed 3.3 V signalling.
      When provided, this supply must remain enabled independently, for example
      through regulator-always-on. The driver sets its voltage but does not
      enable or disable it.
```

## dts/bindings/sdhc/brcm,bcm2835-sdhost.yaml
```yaml
# Copyright (c) 2026 Jonathan Elliot Peace <jep@alphabetiq.com>
# SPDX-License-Identifier: Apache-2.0

description: |
  Broadcom BCM283x legacy SD Host Controller.

  Non-Arasan SD controller on the BCM283x SoCs, with a proprietary
  Broadcom register layout (SDCMD/SDARG/SDHSTS/SDEDM/SDDATA/SDCDIV
  at offsets 0x00..0x50), distinct from the Arasan SDHCI block on the
  same SoC. Drives the external microSD card slot via GPIO 48..53 at
  ALT0.

compatible: "brcm,bcm2835-sdhost"

include: [sdhc.yaml, pinctrl-device.yaml]

properties:
  reg:
    required: true

  clock-frequency:
    type: int
    required: true
    description: |
      Frequency in Hz of the VPU core clock feeding the SDHost
      reference. The driver scales this down to the bus SD clock
      via SDCDIV.

  bus-width:
    type: int
    default: 4
    enum:
      - 1
      - 4
    description: |
      Number of data lines wired between the controller and the
      card.
```

## dts/bindings/sdhc/cdns,sd6hc.yaml
```yaml
# Copyright (c) 2023 Intel Corporation
# SPDX-License-Identifier: Apache-2.0

description: |
  Cadence SD Host Controller (SD6HC)

  The cdns,phy-cfg-* properties hold the Combo PHY registers programmed for
  a group of timing modes: <DQS timing, gate/loopback control, DLL slave
  control, DQ timing, DLL master control>. The cdns,ctrl-cfg-* properties
  hold the host registers for the same group: <HRS09 HRS10 HRS16 HRS07>.
  Only the HRS09 read-data/read-command enable and extended mode bits and
  the HRS10 SDCLK adjust field are taken from the given values. The defaults
  are the values from the Agilex 5 HPS Technical Reference Manual.

compatible: "cdns,sd6hc"

include: ["cdns,sdhc.yaml"]

properties:
  cdns,phy-cfg-sd-ds:
    type: array
    default: [0x00380004, 0x01a00040, 0x0, 0x1, 0x00800004]
    description: Combo PHY settings for SD default speed and UHS-I SDR12.

  cdns,phy-cfg-sd-hs:
    type: array
    default: [0x00380004, 0x01a00040, 0x0, 0x1, 0x00800004]
    description: Combo PHY settings for SD high speed and UHS-I SDR25.

  cdns,ctrl-cfg-sd-ds:
    type: array
    default: [0x0001800c, 0x00020000, 0x0, 0x00080000]
    description: Controller settings for SD default speed and UHS-I SDR12.

  cdns,ctrl-cfg-sd-hs:
    type: array
    default: [0x0001800c, 0x00030000, 0x0, 0x00080000]
    description: Controller settings for SD high speed and UHS-I SDR25.
```

## dts/bindings/sdhc/cdns,sdhc.yaml
```yaml
# Copyright (c) 2023 Intel Corporation
# SPDX-License-Identifier: Apache-2.0

description: Cadence SD Host Controller

compatible: "cdns,sdhc"

include: [sdhc.yaml, reset-device.yaml]

properties:
  clock-frequency:
    type: int
    description: clock-frequency for SDHC

  reg:
    required: true

  reg-names:
    required: true
    description: |
      "slot" for the slot register set (SRS) and "host" for the optional
      host register set (HRS).

  broken-cd:
    type: boolean
    description:
      There is no card detection available; polling must be used.

  vqmmc-supply:
    type: phandle
    description: |
      Supply of the bus IO lines, such as a level shifter. When it cannot
      provide 1.8 V, 1.8 V signalling is not offered to the card.

  has-host:
    type: boolean
    description: |
      Whether this instance exposes a separate "host" MMIO region.
```

## dts/bindings/sdhc/litex,mmc.yaml
```yaml
# SPDX-FileCopyrightText: Copyright The Zephyr Project Contributors
# SPDX-License-Identifier: Apache-2.0

description: LiteX LiteSDCard SDHC

compatible: "litex,mmc"

include: [sdhc.yaml]

properties:
  bus-width:
    default: 4

  interrupts:
    required: true
```
