## dts/bindings/sdhc/sdhc-emul-common.yaml
```yaml
# Copyright 2026 Alif Semiconductor
# SPDX-License-Identifier: Apache-2.0

description: |
  Common properties for the Zephyr SDHC emulator bindings.

  Shared by "zephyr,sdhc-emul" (standalone emulator) and
  "zephyr,sdhc-emul-card" (emulated card peripheral on the
  emul framework bus). Not a standalone binding.

properties:
  card-type:
    type: string
    default: "sdhc"
    enum:
      - "sd"
      - "sdhc"
      - "sdxc"
      - "emmc"
      - "sdio"
    description: |
      Virtual card personality.
        sd    - SDSC up to 2 GB
        sdhc  - SDHC 4-32 GB (default)
        sdxc  - SDXC above 32 GB
        emmc  - eMMC 5.1, supports CMD6 EXT_CSD, HS200/HS400
        sdio  - SDIO-only, triggers function enumeration

  capacity-blocks:
    type: int
    default: 131072
    description: |
      Number of blocks in the virtual storage.
      Default 131072 blocks = 64 MiB at 512 bytes/block.

  sector-size:
    type: int
    default: 512
    description: |
      Block (sector) size in bytes.

  inject-error-cmd:
    type: int
    default: 255
    description: |
      CMD index that returns an error for fault injection.
      255 disables fault injection.

  card-inserted:
    type: boolean
    description: |
      If present, the virtual card is inserted at boot.

  host-ocr:
    type: int
    default: 0x00FF8000
    description: |
      OCR (Operating Conditions Register) value reported by the emulated
      card in response to CMD1 (eMMC) or ACMD41 (SD).

      The default 0x00FF8000 sets bits 15-23, advertising every supported
      VDD window from 2.7 V to 3.6 V (equivalent to MMC_OCR_VDD27_36FLAG).

      Notable bits:
        bit 7      - VDD 1.65-1.95 V supported (eMMC only)
        bits 15-23 - VDD 2.7-3.6 V windows, one bit per 100 mV step
        bit 24     - S18A: card supports switching to 1.8 V signalling
        bit 30     - CCS / sector mode: card is high capacity and
                     block-addressed rather than byte-addressed
        bit 31     - power-up busy status; set by the emulator at
                     runtime and must not be set here

      Clearing bit 30 in the default means the emulated card reports
      byte addressing. Set 0x40FF8000 to exercise the high-capacity
      code paths in the SD/MMC subsystem.

  sdio-func-count:
    type: int
    default: 1
    description: |
      Number of SDIO functions to emulate (1-7).
```

## dts/bindings/sdhc/sdhc-emul-host.yaml
```yaml
# Copyright 2026 Alif Semiconductor
# SPDX-License-Identifier: Apache-2.0

description: |
  Common host-controller capability properties for the Zephyr SDHC
  emulator bindings. Shared by "zephyr,sdhc-emul" (standalone) and
  "zephyr,sdhc-emul-controller". Not a standalone binding.

properties:
  bus-width:
    type: int
    default: 4
    enum: [1, 4, 8]
    description: |
      Widest data bus the emulated host controller supports.
      1 = 1-bit only, 4 = SD 4-bit, 8 = eMMC 8-bit.

  high-speed:
    type: boolean
    description: |
      Host controller supports SD/eMMC high speed (up to 50 MHz) timing.

  voltage-330:
    type: boolean
    description: |
      Host controller can supply 3.3 V to the card.

  voltage-180:
    type: boolean
    description: |
      Host controller can supply 1.8 V signalling.
```

## dts/bindings/sdhc/sdhc.yaml
```yaml
# Copyright (c) 2022, NXP
# SPDX-License-Identifier: Apache-2.0

# Common fields for SD host controllers

include: base.yaml

bus: sd

properties:
  max-current-330:
    type: int
    default: 0
    description: |
      Max drive current in mA at 3.3V. A value of zero indicates no maximum
      is specified by the driver.

  max-current-300:
    type: int
    default: 0
    description: |
      Max drive current in mA at 3.0V. A value of zero indicates no maximum
      is specified by the driver.

  max-current-180:
    type: int
    default: 0
    description: |
      Max drive current in mA at 1.8V. A value of zero indicates no maximum
      is specified by the driver.

  max-bus-freq:
    type: int
    default: 400000
    description: |
      Maximum bus frequency for SD card. This should be the highest frequency
      the SDHC is capable of negotiating with cards on the bus.

  min-bus-freq:
    type: int
    default: 400000
    description: |
      Minimum bus frequency for SD card. This should be the frequency that
      cards first will select when attached to the SDHC bus

  power-delay-ms:
    type: int
    default: 500
    description: |
      time in ms for SDHC to delay when toggling power to the SD card. This
      delay gives the card time to power up or down fully

  sd-uhs-modes:
    type: string-array
    enum:
      - "sdr50"
      - "ddr50"
      - "sdr104"
    description: |
      UHS-I bus speed modes the slot supports for SD and SDIO cards. The
      host reports a mode only if it is in this list and the controller
      supports it. Without this property, the modes the controller
      supports are not restricted.

      Use this property when a mode the controller supports is not
      reliable on the board, for example on a bus that is shared between
      slots. A slot where SDR104 tuning fails can be limited to DDR50:

        sd-uhs-modes = "ddr50";

  mmc-hs200-1_8v:
    type: boolean
    description: |
      The host controller supports HS200 at 1.8V

  mmc-hs400-1_8v:
    type: boolean
    description: |
      The host controller supports HS400 at 1.8V

  mmc-hs400-enhanced-strobe:
    type: boolean
    description: |
      The host controller and board support eMMC HS400 enhanced strobe.
      This mode also requires HS400 at 1.8V and an 8-bit data bus.

  bus-width:
    type: int
    description: |
      SDHC data bus width (in bits).
    enum: [1, 4, 8]
```

## dts/bindings/sdhc/ti,cc35xx-sdhc.yaml
```yaml
# Copyright (c) 2026 Conclusive Engineering Sp. z o.o.
# SPDX-License-Identifier: Apache-2.0

description: TI SDHC Controller node

compatible: "ti,cc35xx-sdhc"

include: [sdhc.yaml, pinctrl-device.yaml]

properties:
  card-always-present:
    type: boolean
    description: |
      This switch can be used with boards which do not connect
      the card detect signal to the MCU to assume card is always present.

  base-bus-freq:
    type: int
    description: |
      Base SD clock frequency generated by SDMMC module.
      Used as reference for calculating SD clock divider.

  reg:
    required: true
    description: register space
```

## dts/bindings/sdhc/xlnx,zynq-8.9a.yaml
```yaml
# Copyright (c) 2026 David Paul-Beier
# SPDX-License-Identifier: Apache-2.0

description: |
  Xilinx Zynq-7000 PS SD/SDIO host controller (Arasan-derived SDHCI 8.9a IP,
  UG585 ch. 13). Served by the shared drivers/sdhc/xlnx_sdhc.c driver, one
  generation older than Versal: no PHY/tap-delay block (so no UHS), no
  clock_control provider in Zephyr (the input clock is fixed), and the ADMA2
  path is not yet hardware-verified. A node therefore sets "pio-mode" and
  "clock-frequency" and omits "clocks"; the driver selects the PIO transfer
  path and the fixed input clock from those devicetree properties.

compatible: "xlnx,zynq-8.9a"

include: [sdhc.yaml]

properties:
  reg:
    required: true

  clock-frequency:
    type: int
    required: true
    description:
      Input clock to the SD controller, in Hz. Used in place of a
      clock_control provider (which does not exist for Zynq-7000 in Zephyr).

  pio-mode:
    type: boolean
    description:
      Use PIO/polling transfers instead of ADMA2. Required on Zynq-7000 until
      the ADMA2 path is hardware-verified on this controller generation.

  broken-cd:
    type: boolean
    description:
      There is no usable card-detect signal into the controller on this board;
      always report a card present instead of polling the CARD_INSRT bit.
```

## dts/bindings/sdhc/zephyr,sdhc-emul-card.yaml
```yaml
# Copyright 2026 Alif Semiconductor
# SPDX-License-Identifier: Apache-2.0

description: |
  Zephyr SDHC emulated card peripheral.

  Emulates SD, SDHC, SDXC, eMMC, or SDIO card personalities.
  Must be a child of a "zephyr,sdhc-emul-controller" node.

compatible: "zephyr,sdhc-emul-card"

include: sdhc-emul-common.yaml

on-bus: sd

properties:
  reg:
    type: array
    required: true
```

## dts/bindings/sdhc/zephyr,sdhc-emul.yaml
```yaml
# Copyright 2026 Alif Semiconductor
# SPDX-License-Identifier: Apache-2.0

description: |
  Zephyr SDHC emulator.

  Software emulation of an SD host controller that supports SD, SDHC,
  SDXC, eMMC, and SDIO card personalities.  Intended for native_sim
  testing and CI pipelines.

compatible: "zephyr,sdhc-emul"

include: [sdhc.yaml, sdhc-emul-host.yaml, sdhc-emul-common.yaml]
```

## dts/bindings/sdio_dc/zephyr,sdio-device-virtual.yaml
```yaml
# Copyright 2026 Nordic Semiconductor ASA
# SPDX-License-Identifier: Apache-2.0

description: |
  Virtual SDIO device controller. Implements the SDIO device controller class
  purely in software and lets host accesses be injected directly, so the device
  path can be exercised without SDIO hardware. Intended for tests and samples.

compatible: "zephyr,sdio-device-virtual"

include: base.yaml

properties:
  num-functions:
    type: int
    default: 1
    description: Number of I/O functions the controller can expose (1-7).

  max-block-size:
    type: int
    default: 512
    description: Maximum block size supported for block-mode transfers.
```
