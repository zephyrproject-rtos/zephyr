## dts/bindings/rtc/nxp,pcf8523.yaml
```yaml
# Copyright (c) 2019-2023 Henrik Brix Andersen <henrik@brixandersen.dk>
# SPDX-License-Identifier: Apache-2.0

description: NXP PCF8523 RTC

compatible: "nxp,pcf8523"

include:
  - name: rtc-device.yaml
  - name: i2c-device.yaml
  - name: pm.yaml
    property-allowlist:
      - wakeup-source

properties:
  quartz-load-femtofarads:
    type: int
    enum:
      - 7000
      - 12500
    default: 7000
    description: |
      Capacitive load of the quartz crystal in femtofarads (fF). Default is 7000 femtofarads (equal
      to 7pF) which corresponds to the reset value of the CAP_SEL field in the "Control 1" register
      of the PCF8523.

  clkout-frequency:
    type: int
    default: 32768
    enum:
      - 32768
      - 16384
      - 8192
      - 4096
      - 1024
      - 32
      - 1
      - 0
    description: |
      Frequency of the CLKOUT signal in Hertz (Hz). Default is 32768 Hz which corresponds to the
      reset value of the COF field in the Tmr_CLKOUT_ctrl register of the PCF8523. Set to 0 to
      disable the CLKOUT signal (High-Z).

  battery-switch-over:
    type: string
    required: true
    enum:
      - standard
      - direct
      - disabled
    description: |
      Battery switch-over function selection:
        - standard: The power failure condition happens when VDD < VBAT and VDD < Vth(sw)bat
        - direct: The power failure condition happens when VDD < VBAT
        - disabled: Battery switch-over disabled - only one power supply (VDD)

  int1-gpios:
    type: phandle-array
    description: |
      GPIO connected to the PC8523 INT1 interrupt output. This signal is open-drain, active low.
```

## dts/bindings/rtc/nxp,pcf85363a.yaml
```yaml
# Copyright (c) 2025 Byteflies NV
# SPDX-License-Identifier: Apache-2.0

description: NXP PCF85363A RTC

compatible: "nxp,pcf85363a"

include:
  - name: rtc-device.yaml
  - name: i2c-device.yaml
  - name: pm.yaml
    property-allowlist:
      - wakeup-source


properties:
  int_a_gpios:
    type: phandle-array
    description: |
      GPIO connected to the PCF85363A INT_A interrupt output. This signal is open-drain, active low.

  int_b_gpios:
    type: phandle-array
    description: |
      GPIO connected to the PCF85363A INT_B interrupt output. This signal is open-drain, active low.
```

## dts/bindings/rtc/nxp,pcf8563.yaml
```yaml
# Copyright (c) 2023 Alvaro Garcia Gomez <maxpowel@gmail.com>
# SPDX-License-Identifier: Apache-2.0

description: NXP PCF8563 RTC

compatible: "nxp,pcf8563"

include:
  - name: rtc-device.yaml
  - name: i2c-device.yaml
  - name: pm.yaml
    property-allowlist:
      - wakeup-source

properties:
  int1-gpios:
    type: phandle-array
    description: |
      GPIO connected to the PC8563 INT1 interrupt output. This signal is open-drain, active low.
```

## dts/bindings/rtc/nxp,rtc-analog.yaml
```yaml
# Copyright 2026 NXP
# SPDX-License-Identifier: Apache-2.0

description: |
  NXP RTC Analog module.

  Sub-second resolution is 10ms (hundredths of a second). The tm_nsec
  field is truncated to 10ms granularity for both time setting and alarm
  matching.

compatible: "nxp,rtc-analog"

include:
  - name: rtc-device.yaml

properties:
  reg:
    required: true
```

## dts/bindings/rtc/nxp,rtc-jdp.yaml
```yaml
# Copyright 2025 NXP
# SPDX-License-Identifier: Apache-2.0

description: |
  NXP Real Time Clock (RTC) — JDP-generation RTC IP.

  This RTC device features a SoC-specific clock-source
  mux and a programmable prescaler. It is not interchangeable with
  "nxp,rtc" compatible device.

compatible: "nxp,rtc-jdp"

include:
  - rtc.yaml
  - rtc-device.yaml

properties:
  reg:
    required: true

  clock-source:
    type: int
    required: true
    enum:
      - 0
      - 1
      - 2
      - 3
    description: |
      Select the RTC clock source (chip-specific mux). No binding-wide default
      is provided because the hardware reset default differs by SoC. The SoC
      dtsi must set this to the correct value for each instance.

  prescaler:
    type: int
    default: 1
    enum:
      - 1
      - 32
      - 512
      - 16384
    description: |
      Divider for the RTC clock source. Supported divide values are 1, 32, 512, or 16384.
```

## dts/bindings/rtc/raspberrypi,pico-rtc.yaml
```yaml
# Copyright (c) 2024 Andrew Featherstone <andrew.featherstone@gmail.com>
# SPDX-License-Identifier: Apache-2.0

description: RaspberryPi Pico RTC

compatible: "raspberrypi,pico-rtc"

include: [rtc.yaml, reset-device.yaml]

properties:
  reg:
    required: true
```

## dts/bindings/rtc/realtek,ameba-rtc.yaml
```yaml
# Copyright (c) 2026 Realtek Semiconductor Corp.
# SPDX-License-Identifier: Apache-2.0

description: AMEBA RTC

compatible: "realtek,ameba-rtc"

include: [rtc.yaml, rtc-device.yaml]

properties:
  reg:
    required: true
  alarms-count:
    enum:
      - 0
      - 1
  async-prescaler:
    type: int
    default: 127
    description: Asynchronous prescaler value (0x7F)
  sync-prescaler:
    type: int
    default: 255
    description: Synchronous prescaler value (0xFF)
```

## dts/bindings/rtc/realtek,rts5912-rtc.yaml
```yaml
# Copyright (c) 2025 Realtek, SIBG-SD7
# SPDX-License-Identifier: Apache-2.0

description: RTC on Realtek RTS5912 EC

compatible: "realtek,rts5912-rtc"

include: rtc-device.yaml

properties:
  reg:
    required: true
```

## dts/bindings/rtc/renesas,ra-rtc.yaml
```yaml
# Copyright (c) 2025 Renesas Electronics Corporation
# SPDX-License-Identifier: Apache-2.0

description: Renesas RA RTC

compatible: "renesas,ra-rtc"

include:
  - rtc.yaml
  - rtc-device.yaml

properties:
  reg:
    required: true

  clocks:
    required: true

  interrupts:
    required: true

  interrupt-names:
    required: true
    enum:
      - "cup"
      - "prd"
      - "alm"
    description: |
      - "cup": carry interrupt
      - "prd": perodic interrupt
      - "alm": alarm interrupt
```

## dts/bindings/rtc/renesas,smartbond-rtc.yaml
```yaml
# Copyright (c) 2023 Renesas Electronics Corporation
# SPDX-License-Identifier: Apache-2.0

description: Renesas SmartBond(tm) RTC node

compatible: "renesas,smartbond-rtc"

include: rtc-device.yaml

properties:
  reg:
    required: true

  interrupts:
    required: true
```

## dts/bindings/rtc/rtc-device.yaml
```yaml
# Copyright (c) 2022 Bjarki Arge Andreasen
# SPDX-License-Identifier: Apache-2.0

include: base.yaml

description: RTC (real-time clock) device

properties:
  alarms-count:
    type: int
    default: 0
    description: |
      Number of alarms supported by RTC device. The number of
      alarms defaults to 0, which indicates that the RTC has
      no alarms.
```

## dts/bindings/rtc/rtc.yaml
```yaml
# Copyright (c) 2018, blik GmbH
# SPDX-License-Identifier: Apache-2.0

# Common fields for RTC devices

include: base.yaml

properties:
  clock-frequency:
    type: int
    description: Clock frequency information for RTC operation
  interrupts:
    required: true

  prescaler:
    type: int
    description: RTC frequency equals clock-frequency divided by the prescaler value
```

## dts/bindings/rtc/sifli,sf32lb-rtc.yaml
```yaml
# Copyright (c) 2025 Core Devices LLC
# SPDX-License-Identifier: Apache-2.0

description: SiFli SF32LB RTC

compatible: "sifli,sf32lb-rtc"

include: [base.yaml, sifli-sf32lb-cfg.yaml]

properties:
  reg:
    required: true

  interrupts:
    required: true

  sifli,cfg:
    required: true
```

## dts/bindings/rtc/silabs,gecko-rtcc.yaml
```yaml
# Copyright (c) 2019, Piotr Mienkowski
# SPDX-License-Identifier: Apache-2.0

description: Silabs Gecko RTCC (Real-Time Counter)

compatible: "silabs,gecko-rtcc"

include: rtc.yaml

properties:
    reg:
      required: true
```

## dts/bindings/rtc/silabs,gecko-stimer.yaml
```yaml
# Copyright (c) 2021, Sateesh Kotapati
# SPDX-License-Identifier: Apache-2.0

title: Silicon Labs Series 2 Sleeptimer

description: |
  Generic interface for low-frequency timers using the Sleeptimer HAL on
  Silicon Labs Series 2 SoCs.

compatible: "silabs,gecko-stimer"

include: rtc.yaml

properties:
  reg:
    required: true
```

## dts/bindings/rtc/silabs,rtcc.yaml
```yaml
# Copyright (c) 2025 Silicon Laboratories Inc.
# SPDX-License-Identifier: Apache-2.0

title: Silicon Labs Series 2 RTCC (Real Time Clock with Capture)

description: |
  The Real Time Clock with Capture (RTCC) is a 32-bit counter kept running down to energy mode EM3.
  It can be used as an EM2/3 wakeup source as well as a timekeeping counter during low energy mode.

compatible: "silabs,rtcc"

include: rtc.yaml

properties:
  reg:
    required: true
```

## dts/bindings/rtc/silabs,sysrtc.yaml
```yaml
# Copyright (c) 2025 Silicon Laboratories Inc.
# SPDX-License-Identifier: Apache-2.0

title: Silicon Labs Series 2 SYSRTC (System Real Time Clock)

description: |
  The SYSRTC (System Real Time Counter) is a 32-bit counter kept running down to energy mode EM3.
  It can be used as a sleep timer / wakeup source as well as a timekeeping counter during low energy
  modes. Multiple groups of capture / compare registers are available to different cores in the
  system, allowing the peripheral and time base to be shared across cores and save energy.

compatible: "silabs,sysrtc"

include: rtc.yaml

properties:
  reg:
    required: true
```

## dts/bindings/rtc/st,stm32-rtc.yaml
```yaml
# Copyright (c) 2018, Workaround GmbH
# Copyright (c) 2024 STMicroelectronics
# SPDX-License-Identifier: Apache-2.0

description: STM32 RTC

compatible: "st,stm32-rtc"

include:
  - rtc.yaml
  - rtc-device.yaml

properties:
  reg:
    required: true

  sync-prescaler:
    type: int
    description: |
      RTC synchronous prescaler value. Optional, if not set defaulted in code to:
      - Selected to give 1 Hz tick rate, based on source clock frequency and asynchronous
        prescaler value.

  async-prescaler:
    type: int
    description: |
      RTC asynchronous prescaler value. Optional, if not set defaulted in code to:
      - 0x7F if RTC source clock is LSE/LSI
      - 1 if using counter with CONFIG_COUNTER_RTC_STM32_SUBSECONDS option
      - 0x7C if RTC source clock is HSE

  hse-prescaler:
    type: int
    description: |
      RTC HSE prescaler value. Applies only when RTC source clock is HSE.
      Optional, defaulting to the value calculated based on HSE clock frequency
      to give the highest possibly prescaled source frequency below 1MHz.

  calib-out-freq:
    type: int
    description: |
      Calibration output frequency (1 Hz or 512 Hz).
    enum:
      - 1
      - 512

  alarms-count:
    description: |
      Number of alarms supported by STM32 RTC device.
      Most of STM32 MCU series have 2 RTC alarms, A & B.
      Defaults to 0 when not declared in devicetree.

  alrm-exti-line:
    type: int
    description: |
      Number of the Extended Interrupts and Event Controller (EXTI) interrupt
      line connected to the RTC Alarm event.
      Not required, since RTC Alarm interrupt could be routed directly to Nested
      Vectored Interrupt Controller (NVIC) and to Power Control (PWR) wake-up
      pins on some series.
      Valid range: 0 - 31
```

## dts/bindings/rtc/ti,bq32002.yaml
```yaml
# Copyright (c) 2025 Marcin Lyda <elektromarcin@gmail.com>
# SPDX-License-Identifier: Apache-2.0

description: Texas Instruments BQ32002 Real-Time Clock

compatible: "ti,bq32002"

include:
  - name: rtc-device.yaml
  - name: i2c-device.yaml

properties:
  irq-frequency:
    type: int
    description: |
      IRQ pin frequency

      This field enables to select output frequency on IRQ pin.
      1Hz frequency is periodically corrected by the configured calibration value,
      while the 512Hz frequency is derived directly from the oscillator.

    enum:
      - 1
      - 512
```

## dts/bindings/rtc/ti,cc13xx-cc26xx-rtc-timer.yaml
```yaml
#
# Copyright (c) 2019, Texas Instruments Incorporated
#
# SPDX-License-Identifier: Apache-2.0
#

description: TI SimpleLink CC13xx/CC26xx RTC

compatible: "ti,cc13xx-cc26xx-rtc-timer"

include: rtc.yaml

properties:
  reg:
    required: true
```

## dts/bindings/rtc/ti,cc13xx-cc26xx-rtc.yaml
```yaml
#
# Copyright (c) 2019, Texas Instruments Incorporated
#
# SPDX-License-Identifier: Apache-2.0
#

title: TI SimpleLink CC13xx/CC26xx RTC

description: |
    This binding gives a base representation of the TI SimpleLink CC13xx/CC26xx RTC

compatible: "ti,cc13xx-cc26xx-rtc"

include: rtc.yaml

properties:
    reg:
      required: true
```

## dts/bindings/rtc/ti,mspm0-rtc-a.yaml
```yaml
# Copyright 2026 BeagleBoard.org Foundation
# SPDX-License-Identifier: Apache-2.0

description: Texas Instruments MSPM0 RTC A

compatible: "ti,mspm0-rtc-a"

include: ti,mspm0-rtc-base.yaml
```

## dts/bindings/rtc/ti,mspm0-rtc-b.yaml
```yaml
# Copyright 2026 BeagleBoard.org Foundation
# SPDX-License-Identifier: Apache-2.0

description: Texas Instruments MSPM0 RTC B

compatible: "ti,mspm0-rtc-b"

include: ti,mspm0-rtc-base.yaml
```

## dts/bindings/rtc/ti,mspm0-rtc-base.yaml
```yaml
# Copyright 2025 Linumiz GmbH
# SPDX-License-Identifier: Apache-2.0

description: Texas Instruments MSPM0 RTC

include: rtc-device.yaml

properties:
  reg:
    required: true
```

## dts/bindings/rtc/ti,mspm0-rtc.yaml
```yaml
# Copyright 2025 Linumiz GmbH
# SPDX-License-Identifier: Apache-2.0

description: Texas Instruments MSPM0 RTC Driver

compatible: "ti,mspm0-rtc"

include: rtc-device.yaml

properties:
  reg:
    required: true

  ti,rtc-x:
    type: boolean
    description: |
      Indicate as Real-Time-Clock_x (RTC_x) instances.
      RTC, RTC_x shares same features but RTC_x has additional features
      which fall under Low-Frequency Subsystem(LFSS) peripherals.
```
