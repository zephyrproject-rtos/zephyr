## dts/bindings/rtc/nxp,kinetis-pit.yaml
```yaml
# Copyright 2020,2023 NXP
# SPDX-License-Identifier: Apache-2.0

description: NXP MCUX Periodic Interrupt Timer (PIT)

compatible: "nxp,kinetis-pit"

include: [rtc.yaml]

properties:
  reg:
    required: true

  clocks:
    required: true

  pit-channel:
    type: int
    required: true
    description: pit channel to active

  pit-period:
    type: int
    required: true
    description: pit default period in us

  max-load-value:
    type: int
    required: true
    description: maximum load value supported
```

## dts/bindings/rtc/nxp,kinetis-rtc.yaml
```yaml
# Copyright (c) 2018, blik GmbH
# Copyright 2024 NXP
# SPDX-License-Identifier: Apache-2.0

description: Kinetis RTC

compatible: "nxp,kinetis-rtc"

include: rtc.yaml

properties:
  reg:
    required: true

  clock-source:
    type: string
    default: "RTC"
    enum:
      - "RTC"
      - "LPO"
    description: |
      Select one of two possible clock sources for the RTC:
        * RTC: RTC prescaler increments using RTC clock.
        * LPO: RTC prescaler increments using 1 kHz LPO.
      The default corresponds to the reset value of the register field,
      and there is no additional code configuration in the driver.
```

## dts/bindings/rtc/nxp,pcf2123.yaml
```yaml
# Copyright (c) 2025 Lukas Gunnarsson <lukasgunnarsson@protonmail.com>
# SPDX-License-Identifier: Apache-2.0

description: NXP PCF2123 RTC

compatible: "nxp,pcf2123"

include:
  - name: rtc-device.yaml
  - name: spi-device.yaml

properties:
  clkout-frequency:
    type: int
    default: 32768
    enum:
      - 32768
      - 16384
      - 8192
      - 4096
      - 2048
      - 1024
      - 1
    description: |
      Frequency of the CLKOUT signal in Hertz (Hz). Default is 32768 Hz.

  int1-gpios:
    type: phandle-array
    description: |
      GPIO connected to the PCF2123 INT output, interrupts are unused if none is provided.
```

## dts/bindings/rtc/nxp,pcf85063a.yaml
```yaml
# Copyright (c) 2025 Fabian Blatz <fabianblatz@gmail.com>
# SPDX-License-Identifier: Apache-2.0

description: NXP PCF85063A RTC

compatible: "nxp,pcf85063a"

include:
  - name: rtc-device.yaml
  - name: i2c-device.yaml

properties:
  int1-gpios:
    type: phandle-array
    description: |
      GPIO connected to the PCF85063A INT1 interrupt output. This signal is open-drain, active low.
```
