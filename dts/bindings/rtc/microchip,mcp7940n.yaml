## dts/bindings/rtc/microchip,mcp7940n.yaml
```yaml
#
# Copyright (c) 2021 Laird Connectivity
# Copyright (c) 2023 Nordic Semiconductor ASA
#
# SPDX-License-Identifier: Apache-2.0
#

description: Microchip MCP7940N I2C RTC with battery-backed SRAM

compatible: "microchip,mcp7940n"

include: i2c-device.yaml

properties:
  reg:
    required: true

  int-gpios:
    type: phandle-array
    description: |
      Host input connected to the MCP7940N MFP open drain output pin

      Notifies when an alarm has triggered by asserting this line.
```

## dts/bindings/rtc/microchip,pic32cxsg-rtc.yaml
```yaml
# Copyright (c) 2024 Microchip
# SPDX-License-Identifier: Apache-2.0

description: Microchip PIC32CXSG RTC

compatible: "microchip,pic32cxsg-rtc"

include:
  - name: rtc.yaml
  - name: pinctrl-device.yaml

properties:
  reg:
    required: true

  clock-generator:
    type: int
    description: clock generator index
    required: true
```

## dts/bindings/rtc/microchip,rtc-g1.yaml
```yaml
# Copyright(c) 2025 Microchip Technology Inc.
# SPDX-License-Identifier: Apache-2.0

title: Microchip G1 RTC driver

description: |
  Microchip RTC driver.

  This driver configures the RTC peripheral in Microchip
  microcontrollers for clock and interrupts.

  Group g1 RTC driver supports following hardware peripherals:
    - module name="RTC" id="U2250" version="2.1.0"

  The node has the 'rtc' node label set in your SoC's devicetree, so you can
  modify it like this:

    &rtc {
        /* your modifications go here */
    };

    Example:
    Correction in ppm = (FREQCORR.VALUE * 1e6 ppm) / (8192 * 128)

    &rtc {
      cal-constant = <1048576>; /* 8192 * 128 */
    };

compatible: "microchip,rtc-g1"

include:
  - name: rtc.yaml
  - name: pinctrl-device.yaml

properties:
  reg:
    required: true
    description: |
      Register base address and size for the RTC peripheral.

  clocks:
    required: true
    description: |
      Clock phandles used to drive the RTC.

  clock-names:
    required: true
    description: |
      Clock name corresponding to the `clocks` entry.

  interrupts:
    required: true
    description: |
      Interrupt specifier for the RTC peripheral.

  prescaler:
    type: int
    enum:
      - 1
      - 2
      - 4
      - 8
      - 16
      - 32
      - 64
      - 128
      - 256
      - 512
      - 1024
    description: |
      RTC frequency equals clock-frequency divided by the prescaler value

  alarms-count:
    type: int
    default: 0
    description: |
      Number of alarms supported by RTC device.

      The number of alarms defaults to 0, which indicates that the RTC has
      no alarms.

  cal-constant:
    type: int
    description: |
      Define the constant used to calculate the calibration.

      More information can be found in the datasheet of each SoC series at
      RTC Frequency Correction topic.
```

## dts/bindings/rtc/microchip,rtc-g2.yaml
```yaml
# Copyright(c) 2026 Microchip Technology Inc.
# SPDX-License-Identifier: Apache-2.0

title: Microchip RTC G2 Controller

description: |
  Microchip RTC G2 peripheral.

  RTC Group G2 supports following hardware peripherals:
    - module name="rtc" id="6056" version="0"

compatible: "microchip,rtc-g2"

include: rtc-device.yaml

properties:
  reg:
    required: true

  interrupts:
    required: true

  clocks:
    required: true

  protection:
    type: phandle
    required: true
    description: |
      Reference to the peripheral that protects the read/write of the RTC registers.
```

## dts/bindings/rtc/microchip,rtc-mss.yaml
```yaml
# Copyright(c) 2026 Microchip Technology Inc.
# SPDX-License-Identifier: Apache-2.0

title: Microchip RTC MSS driver

description: |
  Microchip RTC driver.

  This driver configures the RTC peripheral in Microchip
  microcontrollers for clock and interrupts.

compatible: "microchip,rtc-mss"

include: [rtc.yaml, rtc-device.yaml, reset-device.yaml]

properties:
  reg:
    required: true
    description: |
      Register base address and size for the RTC peripheral.

  interrupts:
    required: true
    description: |
      Interrupt specifier for the RTC peripheral.

  clock-frequency:
    required: true

  prescaler:
    type: int
    description: |
      RTC frequency equals clock-frequency divided by the prescaler value
```

## dts/bindings/rtc/microchip,xec-hibtimer.yaml
```yaml
# Copyright (c) 2025, Microchip Technology Inc.
# SPDX-License-Identifier: Apache-2.0

description: |
  Microchip XEC hibernation timer a 16-bit count down
  timer on the 32 KHz clock domain.

compatible: "microchip,xec-hibtimer"

include:
  - "base.yaml"
  - "microchip,dmec-ecia-girq.yaml"

properties:
  reg:
    required: true

  interrupts:
    required: true

  clock-frequency-str:
    type: string
    enum:
      - "32KHz"
      - "8Hz"

  max-value:
    type: int
    const: 0xffff
    description: Maximum counter value the instance can handle
```

## dts/bindings/rtc/microchip,xec-rtc.yaml
```yaml
# Copyright (c) 2026 Microchip Technology Inc.
# SPDX-License-Identifier: Apache-2.0

description: Microchip XEC RTC timer

include: base.yaml

compatible: "microchip,xec-rtc"

properties:
  reg:
    required: true

  interrupts:
    required: true

  girqs:
    type: array
    required: true
    description: Array of GIRQ numbers [8:26] and bit positions [0:31].

  pcr-scr:
    type: int
    required: true
    description: PCR sleep enable register index and bit position.

  ldn:
    type: int
    required: true
    description: logical device number
```

## dts/bindings/rtc/microchip,xec-timer.yaml
```yaml
# Copyright (c) 2019, Intel Corporation
# SPDX-License-Identifier: Apache-2.0

description: Microchip XEC basic timer

compatible: "microchip,xec-timer"

include:
  - name: rtc.yaml
  - name: base.yaml
  - name: microchip,dmec-ecia-girq.yaml

properties:
  reg:
    required: true

  interrupts:
    required: true

  clock-frequency:
    required: true

  prescaler:
    type: int
    required: true
    description: Timer frequency equals clock-frequency divided by the prescaler value

  max-value:
    type: int
    required: true
    description: Maximum counter value the instance can handle

  girqs:
    type: array
    required: true
    description: Array of GIRQ numbers [8:26] and bit positions [0:31].

  pcr-src:
    type: int
    required: true
    description: |
      Timer Power Clock Reset(PCR) peripheral index and bit position.
```

## dts/bindings/rtc/microcrystal,rv-8263-c8.yaml
```yaml
# SPDX-License-Identifier: Apache-2.0
# Copyright (c) 2024 Daniel Kampert
# Author: Daniel Kampert <DanielKampert@Kampis-Elektroecke.de>

description: Micro Crystal RV-8263-C8 RTC

compatible: "microcrystal,rv-8263-c8"

include:
  - name: rtc-device.yaml
  - name: i2c-device.yaml

properties:
  int-gpios:
    type: phandle-array

  clkout:
    type: int
    default: 32768
    enum:
      - 32768
      - 16384
      - 8192
      - 4096
      - 1024
      - 1
      - 0
    description:
      Enable CLKOUT at given frequency. When disabled, CLKOUT pin is LOW. Set to 0 to
      disable the CLKOUT signal.
```

## dts/bindings/rtc/microcrystal,rv3028.yaml
```yaml
# Copyright (c) 2024 ANITRA system s.r.o.
# SPDX-License-Identifier: Apache-2.0

description: Micro Crystal RV3028 RTC

compatible: "microcrystal,rv3028"

include:
  - name: rtc-device.yaml
  - name: i2c-device.yaml

properties:
  clkout-frequency:
    type: int
    enum:
      - 32768
      - 8192
      - 1024
      - 64
      - 32
      - 1
    description: |
      Frequency of the CLKOUT signal in Hertz (Hz). If omitted, the CLKOUT pin is LOW.

  backup-switch-mode:
    type: string
    required: true
    enum:
      - disabled
      - direct
      - level
    description: |
      Automatic backup switchover function selection:
        - disabled: The switchover function is disabled - only one power supply available (VDD)
        - direct: Direct Switching Mode (DSM): when VDD < VBACKUP, switchover occurs from VDD to
          VBACKUP without requiring VDD to drop below VTH:LSM (2.0 V)
        - level: Level Switching Mode (LSM): when VDD < VTH:LSM (2.0 V) AND VBACKUP > VTH:LSM,
          switchover occurs from VDD to VBACKUP

  trickle-resistor-ohms:
    type: int
    enum:
      - 3000
      - 5000
      - 9000
      - 15000
    description: |
      Enable the trickle charger with provided current-limiting resistance in ohms. The trickle
      charger allows a battery or supercapacitor connected to VBACKUP to be charged.

  int-gpios:
    type: phandle-array
    description: |
      GPIO connected to the RV3028 INT interrupt output. This signal is open-drain, active low.
```

## dts/bindings/rtc/microcrystal,rv3032.yaml
```yaml
# Copyright (c) 2024 Dipak Shetty
# SPDX-License-Identifier: Apache-2.0

description: Micro Crystal RV3032 RTC

compatible: "microcrystal,rv3032"

include:
  - name: rtc-device.yaml

properties:
  clkout-frequency:
    type: int
    description: |
      Frequency of the CLKOUT signal in Hertz (Hz).
      Supported frequencies:
      - XTAL mode: 32768, 1024, 64, 1 Hz (crystal-derived, may be affected by
        temperature compensation and aging correction)
      - HF mode: Any value from 8192 to 67108864 Hz in 8192 Hz steps
        (formula: frequency = (HFD + 1) × 8192 Hz where HFD = 0-8191)
        HF mode frequencies are not affected by compensation.

      If this property is omitted, the CLKOUT pin remains LOW (disabled).

      The driver will configure the RTC to use:
      1. Use XTAL mode for frequencies: 1, 64, 1024, 32768 Hz
      2. Use HF mode for other frequencies (must be multiples of 8192 Hz)
```

## dts/bindings/rtc/microcrystal,rv8803.yaml
```yaml
# Copyright (c) 2024 Marcin Lyda <elektromarcin@gmail.com>
# SPDX-License-Identifier: Apache-2.0

description: Micro Crystal RV8803 Extreme Low Power Real-Time Clock Module

compatible: "microcrystal,rv8803"

include:
  - name: rtc-device.yaml
  - name: i2c-device.yaml

properties:
  reg:
    required: true

  int-gpios:
    type: phandle-array
    description: |
      Interrupt output
      Interrupt output used by the chip to notify various
      events, such as alarm event, update event, external
      events etc.

  clkout-frequency:
    type: int
    description: |
      CLKOUT value [Hz]
      This field enables to select output frequency on
      CLKOUT pin.
    enum:
      - 1
      - 1024
      - 32768
```

## dts/bindings/rtc/motorola,mc146818.yaml
```yaml
# Copyright (c) 2022, Intel Corporation
#
# SPDX-License-Identifier: Apache-2.0

description: Motorola MC146818 compatible Real Timer Clock

compatible: "motorola,mc146818"

include: [rtc-device.yaml, acpi.yaml]

on-bus: mc146818-mfd

properties:
  clock-frequency:
    type: int
    default: 32768
    enum:
      - 4194304
      - 1048576
      - 32768
    description: Frequency of the input-clock in Hertz (Hz)
```

## dts/bindings/rtc/nordic,nrf-rtc.yaml
```yaml
# Copyright (c) 2018 Nordic Semiconductor ASA
# SPDX-License-Identifier: Apache-2.0

description: Nordic nRF RTC (Real-Time Counter)

compatible: "nordic,nrf-rtc"

include: rtc.yaml

properties:
  reg:
    required: true

  cc-num:
    type: int
    required: true
    description: |
      Number of compare (CC) registers available.

      On nRF53 these registers can also be used for capture.

  # If enabled, overflow different than full range (24 bits) is handled
  # through PPI channel which ensures precise timing. If disabled then
  # counter is cleared in the interrupt which results in accumulative error
  # of counter period if top value is different than maximal.
  ppi-wrap:
    type: boolean
    description: Enable wrapping with PPI

  # If enabled then counter based on nRF RTC peripheral supports only maximal
  # top value. That results in code optimizations and availability of one more
  # channel
  fixed-top:
    type: boolean
    description: Enable fixed top value

  zli:
    type: boolean
    description: Enable event handler in the ZLI (Zero latency interrupt) context
```

## dts/bindings/rtc/nuvoton,nct-rtc.yaml
```yaml
# Copyright (c) 2025 Nuvoton Technology Corporation.
# SPDX-License-Identifier: Apache-2.0

description: Nuvoton, NCT-RTC node

compatible: "nuvoton,nct-rtc"

include: [base.yaml]

properties:
  reg:
    required: false
  alarms_count:
    type: int
    required: false
  rtc-wk:
    type: phandle
    required: true
    description: |
        Mapping table between Wake-Up Input (WUI) and rtc alarm signal.
        For example, the WUI mapping on NCT6 would be
           rtc-wk = <&wui_rtc>;
```

## dts/bindings/rtc/nuvoton,npcm-rtc.yaml
```yaml
# Copyright (c) 2024 Nuvoton Technology Corporation.
# SPDX-License-Identifier: Apache-2.0

description: Nuvoton, NPCM-RTC node

compatible: "nuvoton,npcm-rtc"

include: [base.yaml]

properties:
  reg:
    required: false
  alarms_count:
    type: int
    required: false
  rtc-wk:
    type: phandle
    required: true
    description: |
        Mapping table between Wake-Up Input (WUI) and rtc alarm signal.
        For example, the WUI mapping on NPCM4 would be
           rtc-wk = <&wui_rtc>;
```

## dts/bindings/rtc/nuvoton,numaker-rtc.yaml
```yaml
# Copyright (c) 2024 Nuvoton Technology Corporation.
# SPDX-License-Identifier: Apache-2.0

description: Nuvoton, NuMaker RTC controller

compatible: "nuvoton,numaker-rtc"

include: rtc-device.yaml

properties:
  reg:
    required: true

  interrupts:
    required: true

  clocks:
    required: true

  oscillator:
    type: string
    description: |
      Specify RTC oscillator source
    enum:
      - "lxt"
      - "lirc"
      - "lirc32k"
```

## dts/bindings/rtc/nxp, pcf85263a.yaml
```yaml
#
# Copyright (c) 2022 Fraunhofer AICOS
#

description: NXP PCF85263A I2C RTC and Stop-watch

compatible: "nxp,pcf85263a"

include: i2c-device.yaml

properties:
  inta-gpios:
    type: phandle-array

  ts-gpios:
    type: phandle-array
```

## dts/bindings/rtc/nxp,imx-snvs-rtc.yaml
```yaml
#
# Copyright (c) 2021 Basalte bv
#
# SPDX-License-Identifier: Apache-2.0
#

description: NXP SNVS LP/HP RTC

compatible: "nxp,imx-snvs-rtc"

include: rtc.yaml
```

## dts/bindings/rtc/nxp,irtc.yaml
```yaml
# Copyright 2024 NXP
# SPDX-License-Identifier: Apache-2.0

description: IRTC

compatible: "nxp,irtc"

include:
  - name: rtc.yaml
  - name: rtc-device.yaml

properties:
  reg:
    required: true

  clock-src:
    type: int
    required: true
    enum:
      - 0
      - 1
    description: |
      The input clock select for IRTC.
      0 <- 16.384 kHz
      1 <- 32.768 kHz

  output-clk-en:
    type: int
    default: 0
    enum:
      - 0
      - 1
      - 2
      - 3
    description: |
      Enable clock as an output for other peripherals to use.
      0 <- No clock output
      1 <- Fine 1Hz
      2 <- Buffered Oscillator Clock
      3 <- Coarse 1Hz
      Default value ensures the output clock is turned off.
      This is the reset value.
```

## dts/bindings/rtc/nxp,kinetis-lptmr.yaml
```yaml
# Copyright (c) 2020 Vestas Wind Systems A/S
# SPDX-License-Identifier: Apache-2.0

description: Kinetis LPTMR

compatible: "nxp,kinetis-lptmr"

include: rtc.yaml

properties:
    reg:
      required: true

    clock-frequency:
      required: true

    prescaler:
      required: true

    clk-source:
      type: int
      required: true
      description: Prescaler clock source (0 to 3)

    input-pin:
      type: int
      required: false
      description: Pulse counter input pin (0 to 3).

    active-low:
      type: boolean
      required: false
      description: Pulse counter input pin is active-low
```
