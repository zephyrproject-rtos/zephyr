## dts/bindings/mdio/atmel,sam-mdio.yaml
```yaml
# Copyright (c) 2021 IP-Logix Inc.
# SPDX-License-Identifier: Apache-2.0

description: Atmel SAM Family MDIO Driver node

compatible: "atmel,sam-mdio"

include: mdio-controller.yaml

properties:
    pinctrl-0:
      type: phandles
      required: false
      description: |
        PIO pin configuration for MDC, and MDIO signals.

        For example the GMAC on SAME7x would be
          pinctrl-0 = <&pd8a_gmac_gmdc &pd9a_gmac_gmdio>;
```

## dts/bindings/mdio/espressif,esp32-mdio.yaml
```yaml
# Copyright (c) 2022 Grant Ramsay <grant.ramsay@hotmail.com>
# SPDX-License-Identifier: Apache-2.0

description: ESP32 MDIO controller

compatible: "espressif,esp32-mdio"

include:
  - name: mdio-controller.yaml
  - name: pinctrl-device.yaml

properties:
  ref-clk-output-gpios:
    type: phandle-array
    description: |
      GPIO to output RMII Clock.
```
