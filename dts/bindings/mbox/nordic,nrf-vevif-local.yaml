## dts/bindings/mbox/renesas,rcar-mfis.yaml
```yaml
# Copyright (c) 2026 BayLibre, SAS
# SPDX-License-Identifier: Apache-2.0

description: |
  Renesas R-Car MFIS MBOX

  The multifunctional interface (MFIS) provides an interface between the
  different CPU Cores, such as AP System Core domain and the Realtime Core
  domain, SCP Core domain and AP System Core domain or Realtime Core domain.
  The MFIS supports both signalling and data transfer modes.

  From the current AP/RT core's perspective, two channel types may be used.
  A channel can be capable of sending (receiving) signal/data to (from)
  another AP/RT core domain XOR to (from) SCP core domain.
  - AP/RT channel IDs = 0 to 63
  - SCP channel IDs = 64 to 95 for AP cores (cores 0 to 31)
    SCP channel IDs = 64 to 75 for RT cores (cores 0 to 11)

compatible: "renesas,rcar-mfis-mbox"

include: [base.yaml, mailbox-controller.yaml]

properties:
  reg:
    required: true

  interrupts:
    required: true

mbox-cells:
  - channel

examples:
- |
  &soc {
    /* MFIS node on RT core */
    mfis: mailbox@18800000 {
      compatible = "renesas,rcar-mfis-mbox";
      reg = <0x18800000 0x1e2000>;
      interrupt-parent = <&gic>;
      interrupts = <GIC_SPI 54 IRQ_TYPE_LEVEL IRQ_DEFAULT_PRIORITY>,  /* AP_00 */
                   <GIC_SPI 56 IRQ_TYPE_LEVEL IRQ_DEFAULT_PRIORITY>,  /* AP_01 */
                   <GIC_SPI 58 IRQ_TYPE_LEVEL IRQ_DEFAULT_PRIORITY>,  /* AP_02 */
                   <GIC_SPI 60 IRQ_TYPE_LEVEL IRQ_DEFAULT_PRIORITY>,  /* AP_03 */
                   <GIC_SPI 62 IRQ_TYPE_LEVEL IRQ_DEFAULT_PRIORITY>,  /* AP_04 */
                   <GIC_SPI 64 IRQ_TYPE_LEVEL IRQ_DEFAULT_PRIORITY>,  /* AP_05 */
                   <GIC_SPI 66 IRQ_TYPE_LEVEL IRQ_DEFAULT_PRIORITY>,  /* AP_06 */
                   <GIC_SPI 68 IRQ_TYPE_LEVEL IRQ_DEFAULT_PRIORITY>,  /* AP_07 */
                   <GIC_SPI 70 IRQ_TYPE_LEVEL IRQ_DEFAULT_PRIORITY>,  /* AP_08 */
                   <GIC_SPI 72 IRQ_TYPE_LEVEL IRQ_DEFAULT_PRIORITY>,  /* AP_09 */
                   <GIC_SPI 74 IRQ_TYPE_LEVEL IRQ_DEFAULT_PRIORITY>,  /* AP_10 */
                   <GIC_SPI 76 IRQ_TYPE_LEVEL IRQ_DEFAULT_PRIORITY>,  /* AP_11 */
                   <GIC_SPI 78 IRQ_TYPE_LEVEL IRQ_DEFAULT_PRIORITY>,  /* AP_12 */
                   <GIC_SPI 80 IRQ_TYPE_LEVEL IRQ_DEFAULT_PRIORITY>,  /* AP_13 */
                   <GIC_SPI 82 IRQ_TYPE_LEVEL IRQ_DEFAULT_PRIORITY>,  /* AP_14 */
                   <GIC_SPI 84 IRQ_TYPE_LEVEL IRQ_DEFAULT_PRIORITY>,  /* AP_15 */
                   <GIC_SPI 86 IRQ_TYPE_LEVEL IRQ_DEFAULT_PRIORITY>,  /* AP_16 */
                   <GIC_SPI 88 IRQ_TYPE_LEVEL IRQ_DEFAULT_PRIORITY>,  /* AP_17 */
                   <GIC_SPI 90 IRQ_TYPE_LEVEL IRQ_DEFAULT_PRIORITY>,  /* AP_18 */
                   <GIC_SPI 92 IRQ_TYPE_LEVEL IRQ_DEFAULT_PRIORITY>,  /* AP_19 */
                   <GIC_SPI 94 IRQ_TYPE_LEVEL IRQ_DEFAULT_PRIORITY>,  /* AP_20 */
                   <GIC_SPI 96 IRQ_TYPE_LEVEL IRQ_DEFAULT_PRIORITY>,  /* AP_21 */
                   <GIC_SPI 98 IRQ_TYPE_LEVEL IRQ_DEFAULT_PRIORITY>,  /* AP_22 */
                   <GIC_SPI 100 IRQ_TYPE_LEVEL IRQ_DEFAULT_PRIORITY>, /* AP_23 */
                   <GIC_SPI 102 IRQ_TYPE_LEVEL IRQ_DEFAULT_PRIORITY>, /* AP_24 */
                   <GIC_SPI 104 IRQ_TYPE_LEVEL IRQ_DEFAULT_PRIORITY>, /* AP_25 */
                   <GIC_SPI 106 IRQ_TYPE_LEVEL IRQ_DEFAULT_PRIORITY>, /* AP_26 */
                   <GIC_SPI 108 IRQ_TYPE_LEVEL IRQ_DEFAULT_PRIORITY>, /* AP_27 */
                   <GIC_SPI 110 IRQ_TYPE_LEVEL IRQ_DEFAULT_PRIORITY>, /* AP_28 */
                   <GIC_SPI 112 IRQ_TYPE_LEVEL IRQ_DEFAULT_PRIORITY>, /* AP_29 */
                   <GIC_SPI 114 IRQ_TYPE_LEVEL IRQ_DEFAULT_PRIORITY>, /* AP_30 */
                   <GIC_SPI 116 IRQ_TYPE_LEVEL IRQ_DEFAULT_PRIORITY>, /* AP_31 */
                   <GIC_SPI 118 IRQ_TYPE_LEVEL IRQ_DEFAULT_PRIORITY>, /* AP_32 */
                   <GIC_SPI 120 IRQ_TYPE_LEVEL IRQ_DEFAULT_PRIORITY>, /* AP_33 */
                   <GIC_SPI 122 IRQ_TYPE_LEVEL IRQ_DEFAULT_PRIORITY>, /* AP_34 */
                   <GIC_SPI 124 IRQ_TYPE_LEVEL IRQ_DEFAULT_PRIORITY>, /* AP_35 */
                   <GIC_SPI 126 IRQ_TYPE_LEVEL IRQ_DEFAULT_PRIORITY>, /* AP_36 */
                   <GIC_SPI 128 IRQ_TYPE_LEVEL IRQ_DEFAULT_PRIORITY>, /* AP_37 */
                   <GIC_SPI 130 IRQ_TYPE_LEVEL IRQ_DEFAULT_PRIORITY>, /* AP_38 */
                   <GIC_SPI 132 IRQ_TYPE_LEVEL IRQ_DEFAULT_PRIORITY>, /* AP_39 */
                   <GIC_SPI 134 IRQ_TYPE_LEVEL IRQ_DEFAULT_PRIORITY>, /* AP_40 */
                   <GIC_SPI 136 IRQ_TYPE_LEVEL IRQ_DEFAULT_PRIORITY>, /* AP_41 */
                   <GIC_SPI 138 IRQ_TYPE_LEVEL IRQ_DEFAULT_PRIORITY>, /* AP_42 */
                   <GIC_SPI 140 IRQ_TYPE_LEVEL IRQ_DEFAULT_PRIORITY>, /* AP_43 */
                   <GIC_SPI 142 IRQ_TYPE_LEVEL IRQ_DEFAULT_PRIORITY>, /* AP_44 */
                   <GIC_SPI 144 IRQ_TYPE_LEVEL IRQ_DEFAULT_PRIORITY>, /* AP_45 */
                   <GIC_SPI 146 IRQ_TYPE_LEVEL IRQ_DEFAULT_PRIORITY>, /* AP_46 */
                   <GIC_SPI 148 IRQ_TYPE_LEVEL IRQ_DEFAULT_PRIORITY>, /* AP_47 */
                   <GIC_SPI 150 IRQ_TYPE_LEVEL IRQ_DEFAULT_PRIORITY>, /* AP_48 */
                   <GIC_SPI 152 IRQ_TYPE_LEVEL IRQ_DEFAULT_PRIORITY>, /* AP_49 */
                   <GIC_SPI 154 IRQ_TYPE_LEVEL IRQ_DEFAULT_PRIORITY>, /* AP_50 */
                   <GIC_SPI 156 IRQ_TYPE_LEVEL IRQ_DEFAULT_PRIORITY>, /* AP_51 */
                   <GIC_SPI 158 IRQ_TYPE_LEVEL IRQ_DEFAULT_PRIORITY>, /* AP_52 */
                   <GIC_SPI 160 IRQ_TYPE_LEVEL IRQ_DEFAULT_PRIORITY>, /* AP_53 */
                   <GIC_SPI 162 IRQ_TYPE_LEVEL IRQ_DEFAULT_PRIORITY>, /* AP_54 */
                   <GIC_SPI 164 IRQ_TYPE_LEVEL IRQ_DEFAULT_PRIORITY>, /* AP_55 */
                   <GIC_SPI 166 IRQ_TYPE_LEVEL IRQ_DEFAULT_PRIORITY>, /* AP_56 */
                   <GIC_SPI 168 IRQ_TYPE_LEVEL IRQ_DEFAULT_PRIORITY>, /* AP_57 */
                   <GIC_SPI 170 IRQ_TYPE_LEVEL IRQ_DEFAULT_PRIORITY>, /* AP_58 */
                   <GIC_SPI 172 IRQ_TYPE_LEVEL IRQ_DEFAULT_PRIORITY>, /* AP_59 */
                   <GIC_SPI 174 IRQ_TYPE_LEVEL IRQ_DEFAULT_PRIORITY>, /* AP_60 */
                   <GIC_SPI 176 IRQ_TYPE_LEVEL IRQ_DEFAULT_PRIORITY>, /* AP_61 */
                   <GIC_SPI 178 IRQ_TYPE_LEVEL IRQ_DEFAULT_PRIORITY>, /* AP_62 */
                   <GIC_SPI 180 IRQ_TYPE_LEVEL IRQ_DEFAULT_PRIORITY>, /* AP_63 */
                   <GIC_SPI 182 IRQ_TYPE_LEVEL IRQ_DEFAULT_PRIORITY>, /* SCP_00 */
                   <GIC_SPI 183 IRQ_TYPE_LEVEL IRQ_DEFAULT_PRIORITY>, /* SCP_01 */
                   <GIC_SPI 184 IRQ_TYPE_LEVEL IRQ_DEFAULT_PRIORITY>, /* SCP_02 */
                   <GIC_SPI 185 IRQ_TYPE_LEVEL IRQ_DEFAULT_PRIORITY>, /* SCP_03 */
                   <GIC_SPI 186 IRQ_TYPE_LEVEL IRQ_DEFAULT_PRIORITY>, /* SCP_04 */
                   <GIC_SPI 187 IRQ_TYPE_LEVEL IRQ_DEFAULT_PRIORITY>, /* SCP_05 */
                   <GIC_SPI 188 IRQ_TYPE_LEVEL IRQ_DEFAULT_PRIORITY>, /* SCP_06 */
                   <GIC_SPI 189 IRQ_TYPE_LEVEL IRQ_DEFAULT_PRIORITY>, /* SCP_07 */
                   <GIC_SPI 190 IRQ_TYPE_LEVEL IRQ_DEFAULT_PRIORITY>, /* SCP_08 */
                   <GIC_SPI 191 IRQ_TYPE_LEVEL IRQ_DEFAULT_PRIORITY>, /* SCP_09 */
                   <GIC_SPI 192 IRQ_TYPE_LEVEL IRQ_DEFAULT_PRIORITY>, /* SCP_10 */
                   <GIC_SPI 193 IRQ_TYPE_LEVEL IRQ_DEFAULT_PRIORITY>; /* SCP_11 */
      #mbox-cells = <1>;
    };

    /* Consumer using MFIS channel 64 (SCP_00) */
    scmi {
      [...]
      mboxes = <&mfis 64>;
      [...]
    };
  };
```

## dts/bindings/mbox/sophgo,cvi-mailbox.yaml
```yaml
# Copyright (c) 2024 honglin leng <a909204013@gmail.com>
# SPDX-License-Identifier: Apache-2.0

description: SOPHGO CVI series Mailbox controller

compatible: "sophgo,cvi-mailbox"

include: [base.yaml, mailbox-controller.yaml]

properties:
  reg:
    required: true

  interrupts:
    required: true

  channel-max:
    type: int
    required: true
    description: Supported channels max

  rx-cpu:
    type: int
    enum: [1, 2, 3, 4]
    description: |
      Receiver CPU Index.

  tx-cpu:
    type: int
    enum: [1, 2, 3, 4]
    description: |
      Sender CPU Index.The CVI platform has a total of 4 CPUs, each with its own
      mailbox.

      The mailbox controller can be used to send messages between CPUs.

mbox-cells:
  - channel
```

## dts/bindings/mbox/st,mbox-stm32-hsem.yaml
```yaml
# Copyright (c) 2024 Celina Sophie Kalus <hello@celinakalus.de>
# SPDX-License-Identifier: Apache-2.0

description: STM32 HSEM MBOX

compatible: "st,mbox-stm32-hsem"

include: [base.yaml, mailbox-controller.yaml]

properties:
  clocks:
    required: true

  interrupts:
    required: true

mbox-cells:
  - channel
```

## dts/bindings/mbox/telink,mbox-ipc-w91.yaml
```yaml
# Copyright (c) 2024 Telink Semiconductor (Shanghai) Co., Ltd.
# SPDX-License-Identifier: Apache-2.0

description: Telink W91 IPC (MBOX Interprocessor Communication)

compatible: "telink,mbox-ipc-w91"

include: [base.yaml, mailbox-controller.yaml]

properties:
  reg:
    required: true

mbox-cells:
  - channel
```

## dts/bindings/mbox/ti,am26x-mailbox.yaml
```yaml
# Copyright (c) 2025 Texas Instruments Incorporated
# SPDX-License-Identifier: Apache-2.0

description: |
  TI AM26x Family Mailbox Controller
  This driver is compatible with the IPC notify V1 from TI's MCU_PLUS_SDK.
  The Client ID in the message is not used in this implementation. Hence,
  the application needs to take care of such message encoding/decoding if
  required.

compatible: "ti,am26x-mailbox"

include: [base.yaml, mailbox-controller.yaml]

properties:
  reg:
    required: true
    description: |
      Register space for the mailbox controller.
      Should include two entries: MSS controller registers and mailbox SRAM.

  reg-names:
    required: true
    type: string-array
    description: |
      Names corresponding to the register areas.
      Should be "ctrl" for MSS controller registers and "mbox-ram" for mailbox SRAM.

  core-id:
    required: true
    type: int
    enum:
      - 0
      - 1
      - 2
      - 3
    description: |
      Identifier for the core this instance is running on.
      The value corresponds to the core ID within the SoC.
      For example, in AM261x:
      0 = R5FSS0_0
      1 = R5FSS0_1

      In other AM26x family SoCs with more cores, this would map to their 
      respective core IDs based on the SoC's core numbering scheme.

  interrupts:
    required: true
    description: |
      Interrupt specifier for the mailbox interrupt.
      
mbox-cells:
  - channel
```

## dts/bindings/mbox/ti,am654-secure-proxy.yaml
```yaml
# Copyright 2024 Texas Instruments Incorporated.
# SPDX-License-Identifier: Apache-2.0

description: TI Secure Proxy MAILBOX

compatible: "ti,am654-secure-proxy"

include: base.yaml

properties:
  reg:
    required: true

  interrupts:
    required: true

mbox-cells:
  - channel
```

## dts/bindings/mbox/ti,omap-mailbox.yaml
```yaml
# Copyright 2024 Texas Instruments Incorporated.
# SPDX-License-Identifier: Apache-2.0

description: TI OMAP MAILBOX

compatible: "ti,omap-mailbox"

include: [base.yaml, mailbox-controller.yaml]

properties:
  reg:
    required: true

  interrupts:
    required: true

  usr-id:
    type: int
    required: true
    description: User ID for processor

mbox-cells:
  - channel
```

## dts/bindings/mbox/ti,secure-proxy.yaml
```yaml
# Copyright 2025 Texas Instruments Incorporated.
# SPDX-License-Identifier: Apache-2.0

description: TI Secure Proxy MAILBOX

compatible: "ti,secure-proxy"

include: base.yaml

properties:
  reg:
    required: true

  interrupts:
    required: true

mbox-cells:
  - channel
```

## dts/bindings/mbox/xlnx,mbox-versal-ipi-mailbox.yaml
```yaml
# Copyright (c) 2025 Advanced Micro Devices, Inc.
#
# SPDX-License-Identifier: Apache-2.0

description: |
  AMD-Xilinx IPI (Inter Processor Interrupt) Mailbox Controller.

  It manages messaging and interrupt handling between two IPI agents (processors).
  Each IPI agent owns registers used for notification and may include buffers for message.

compatible: "xlnx,mbox-versal-ipi-mailbox"

include: [base.yaml]

properties:
  reg:
    required: true
    description: Host IPI agent control and message register space

  reg-names:
    required: true
    description: Identifiers for register spaces with "ctrl" for control and "msg" for message

  interrupts:
    required: true

  xlnx,ipi-id:
    type: int
    required: true
    description: Host IPI Agent ID associated with the mailbox

child-binding:
  description: AMD-Xilinx IPI agent child node

  compatible: "xlnx,mbox-versal-ipi-dest-mailbox"

  include:
    - name: base.yaml
    - name: mailbox-controller.yaml

  properties:
    reg:
      required: true
      description: Remote IPI agent control and message register space

    reg-names:
      required: true
      description: Identifiers for register spaces with "ctrl" for control and "msg" for message

    xlnx,ipi-id:
      required: true
      type: int
      description: Remote IPI Agent ID associated with the mailbox

  mbox-cells:
    - channel

examples:
  - |
    /* Example definition */

    mailbox@ff300000 {
      compatible = "xlnx,versal-ipi-mailbox";
      interrupts = <GIC_SPI 29 IRQ_TYPE_LEVEL_HIGH>;
      reg = <0x0 0xff300000 0x0 0x1000>,
            <0x0 0xff990000 0x0 0x1ff>;
      reg-names = "ctrl", "msg";
      xlnx,ipi-id = <0>;
      #address-cells = <2>;
      #size-cells = <2>;

      /* buffered IPI */
      child_1: mailbox@ff340000 {
        compatible = "xlnx,versal-ipi-dest-mailbox";
        reg = <0x0 0xff340000 0x0 0x1000>,
              <0x0 0xff990400 0x0 0x1ff>;
        reg-names = "ctrl", "msg";
        xlnx,ipi-id = <4>;
        #mbox-cells = <1>;
      };

      /* bufferless IPI */
      child_2: mailbox@ff370000 {
        compatible = "xlnx,versal-ipi-dest-mailbox";
        reg = <0x0 0xff370000 0x0 0x1000>;
        reg-names = "ctrl";
        xlnx,ipi-id = <7>;
        #mbox-cells = <1>;
      };
    };
  - |
    /* Example usage */

    mbox-consumer {
      compatible = "vnd,mbox-consumer";
      mboxes = <&child_1 0>, <&child_1 1>;
      mbox-names = "tx", "rx";
    };
```

## dts/bindings/mbox/zephyr,ipm-mbox.yaml
```yaml
# Copyright (c) 2025 Dmitrii Sharshakov <d3dx12.xx@gmail.com>
# SPDX-License-Identifier: Apache-2.0

description: Mailbox driver based on Zephyr's IPM subsystem.

compatible: "zephyr,ipm-mbox"

include: [base.yaml, mailbox-controller.yaml]

properties:
  channels:
    type: int
    required: true
    description: Number of channels to support.

mbox-cells:
  - channel
```

## dts/bindings/mcumgr/zephyr,smp-spi.yaml
```yaml
# Copyright (c) 2026 Zephyr Project Contributors
# SPDX-License-Identifier: Apache-2.0

title: MCUmgr SMP transport over SPI

description: |
  The device operates as an SPI peripheral and receives raw SMP packets from an
  SPI controller. The peripheral asserts data-ready-gpios when an SMP response
  is available for the controller to read.

compatible: "zephyr,smp-spi"

include: spi-device.yaml

properties:
  data-ready-gpios:
    type: phandle-array
    required: true
    description: |
      GPIO driven by the SPI peripheral to signal the controller.

examples:
  - |
    #include <zephyr/dt-bindings/gpio/gpio.h>

    &spi1 {
        status = "okay";

        smp_spi: smp-spi@0 {
            compatible = "zephyr,smp-spi";
            reg = <0>;
            spi-max-frequency = <1000000>;
            data-ready-gpios = <&gpio0 15 GPIO_ACTIVE_HIGH>;
        };
    };
```

## dts/bindings/mdio/adi,adin2111-mdio.yaml
```yaml
# Copyright (c) 2023 PHOENIX CONTACT Electronics GmbH
# SPDX-License-Identifier: Apache-2.0

description: ADIN2111 MDIO Driver node

compatible: "adi,adin2111-mdio"

include: mdio-controller.yaml

on-bus: adin2111

properties:
  "#address-cells":
    required: true
    const: 1

  "#size-cells":
    required: true
    const: 0
```
