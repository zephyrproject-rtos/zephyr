## dts/bindings/mbox/nordic,nrf-vevif-local.yaml
```yaml
# Copyright (c) 2024 Nordic Semiconductor ASA
# SPDX-License-Identifier: Apache-2.0

description: |
  Nordic VEVIF (VPR Event Interface) - Local

  VEVIF is an event interface for VPR, allowing connection to the domain's DPPI
  system. VEVIF can also generate IRQs to other CPUs.

  Example definition:

    cpuppr: cpu@d {
      ...
      cpuppr_vevif_local: mailbox {
        compatible = "nordic,nrf-vevif-local";
        interrupts = <0 NRF_DEFAULT_IRQ_PRIORITY>,
                     <1 NRF_DEFAULT_IRQ_PRIORITY>,
                     ...
                     <N NRF_DEFAULT_IRQ_PRIORITY>;
        #mbox-cells = <1>;
        nordic,tasks = <16>;
        nordic,tasks-mask: <0xfffffff0>;
      };
    };

compatible: "nordic,nrf-vevif-local"

include: [base.yaml, "nordic,nrf-vevif-common.yaml"]

properties:
  interrupts:
    required: true
```

## dts/bindings/mbox/nordic,nrf-vevif-remote.yaml
```yaml
# Copyright (c) 2024 Nordic Semiconductor ASA
# SPDX-License-Identifier: Apache-2.0

description: |
  Nordic VEVIF (VPR Event Interface) - Remote

  VEVIF is an event interface for VPR, allowing connection to the domain's DPPI
  system. VEVIF can also generate IRQs to other CPUs.

  Example definition:

    cpuppr_vpr: vpr@deadbeef{
      ...
      cpuppr_vevif_remote: mailbox@0 {
        compatible = "nordic,nrf-vevif-remote";
        reg = <0x0 0x1000>;
        #mbox-cells = <1>;
        nordic,tasks = <16>;
        nordic,tasks-mask: <0xfffffff0>;
      };
    };

compatible: "nordic,nrf-vevif-remote"

include: [base.yaml, "nordic,nrf-vevif-common.yaml"]

properties:
  reg:
    required: true
```

## dts/bindings/mbox/nordic,nrf-vevif-task-rx.yaml
```yaml
# Copyright (c) 2024 Nordic Semiconductor ASA
# SPDX-License-Identifier: Apache-2.0

description: |
  Nordic VEVIF (VPR Event Interface) - TASK RX MODE

  VEVIF is an event interface for VPR, allowing connection to the domain's DPPI
  system. VEVIF can also generate IRQs to other CPUs.

  VEVIF provides support for inter-domain software signaling. It implements a set of tasks
  intended for signaling within an interprocessor communication (IPC) framework.
  When used in task rx mode, the VEVIF tasks are used to receive events triggered by other core.

  Example definition:

    cpuppr: cpu@d {
      ...
      cpuppr_vevif_task_rx: mailbox {
        compatible = "nordic,nrf-vevif-task-rx";
        interrupts = <0 NRF_DEFAULT_IRQ_PRIORITY>,
                     <1 NRF_DEFAULT_IRQ_PRIORITY>,
                     ...
                     <N NRF_DEFAULT_IRQ_PRIORITY>;
        #mbox-cells = <1>;
        nordic,tasks = <16>;
        nordic,tasks-mask = <0xfffffff0>;
      };
    };

compatible: "nordic,nrf-vevif-task-rx"

include: [base.yaml, mailbox-controller.yaml]

properties:
  nordic,tasks:
    type: int
    required: true
    description: Number of tasks supported by the VEVIF instance.

  nordic,tasks-mask:
    type: int
    required: true
    description: Mask of tasks supported by the VEVIF instance.

  interrupts:
    required: true

mbox-cells:
  - channel
```

## dts/bindings/mbox/nordic,nrf-vevif-task-tx.yaml
```yaml
# Copyright (c) 2024 Nordic Semiconductor ASA
# SPDX-License-Identifier: Apache-2.0

description: |
  Nordic VEVIF (VPR Event Interface) - TASK TX MODE

  VEVIF is an event interface for VPR, allowing connection to the domain's DPPI
  system. VEVIF can also generate IRQs to other CPUs.

  VEVIF provides support for inter-domain software signaling. It implements a set of tasks
  intended for signaling within an interprocessor communication (IPC) framework.
  When used in task tx mode, the VEVIF tasks are used to trigger IRQs on VPR core.

  Example definition:

    cpuppr_vpr: vpr@deadbeef{
      ...
      cpuppr_vevif_task_tx: mailbox@0 {
        compatible = "nordic,nrf-vevif-task-tx";
        reg = <0x0 0x1000>;
        #mbox-cells = <1>;
        nordic,tasks = <16>;
        nordic,tasks-mask = <0xfffffff0>;
      };
    };

compatible: "nordic,nrf-vevif-task-tx"

include: [base.yaml, mailbox-controller.yaml]

properties:
  nordic,tasks:
    type: int
    required: true
    description: Number of tasks supported by the VEVIF instance.

  nordic,tasks-mask:
    type: int
    required: true
    description: Mask of tasks supported by the VEVIF instance.

  reg:
    required: true

mbox-cells:
  - channel
```

## dts/bindings/mbox/nxp,generic-software-mbox.yaml
```yaml
description: |
  Generic Software Mailbox Controller

  examples:
    / {
      soc {
        /* mailbox controller in shared memory */
        sw_mbox: mailbox@fe000000 {
          compatible = "nxp,generic-software-mbox";
          reg = <0xfe000000 0x1000>;
          #mbox-cells = <1>;
          /* 151 (183 - 32) */
          interrupts = <GIC_SPI 151 IRQ_TYPE_LEVEL IRQ_DEFAULT_PRIORITY>;
          remote-interrupt = <182>;
          status = "okay";
        };
      };

      /* device node using generic software mailbox */
      some_device {
        /* sw_mbox: select chan 0 */
        mboxes = <&sw_mbox 0>;
      };
    };

compatible: "nxp,generic-software-mbox"

include: [base.yaml, mailbox-controller.yaml]

properties:
  reg:
    required: true
    description: |
      Base address of the shared memory region used for mailbox communication.

  interrupts:
    required: true
    description: |
      Interrupt generated when a message is received.

  remote-interrupt:
    type: int
    required: true
    description: |
      Interrupt number to be triggered on the remote core when sending a message.

mbox-cells:
  - channel
```

## dts/bindings/mbox/nxp,mbox-imx-mu.yaml
```yaml
description: |
  NXP i.MX Message Unit as Zephyr MBOX

compatible: "nxp,mbox-imx-mu"

include: [base.yaml, mailbox-controller.yaml]

properties:
  interrupts:
    required: true

  rx-channels:
    type: int
    enum: [1, 2, 3, 4]
    description: |
      Number of receive channels enabled on this instance.
      Setting this value to N, will enable channels 0 to N-1, consecutively.
      It should be set by the receiver core coupled with this MU instance.

      For example, if receiver A wants to Rx on channels 0 to 3, then A must
      set rx-channels of muA as follows:

        mruA {
          rx-channels = <4>;
          status = "okay";
        };

mbox-cells:
  - channel
```

## dts/bindings/mbox/nxp,mbox-mailbox.yaml
```yaml
description: |
  NXP Mailbox Unit as Zephyr MBOX.

  This NXP Mailbox driver implements Multi-Channel Inter-Processor Mailbox (MBOX) API
  around NXP Inter-CPU Mailbox peripheral IP block.

  The NXP Inter-CPU Mailbox provides up to thirty-two user defined interrupts.
  This driver uses 4 interrupts for mbox signalling mode per each channel,
  4 interrupts for mxbox data transfer mode per each channel and 24 as 3 bytes
  for data.

compatible: "nxp,mbox-mailbox"

include: [base.yaml, mailbox-controller.yaml]

properties:
  interrupts:
    required: true

  rx-channels:
    type: int
    enum: [1, 2, 3, 4]
    description: |
      Number of receive channels enabled on this instance.
      Setting this value to N, will enable channels 0 to N-1, consecutively.
      It should be set by the receiver core coupled with this Mailbox instance.

      For example, if receiver A wants to Rx on channels 0 to 3, then A must
      set rx-channels of mailbox as follows:

        mbox {
          rx-channels = <4>;
          status = "okay";
        };

mbox-cells:
  - channel
```

## dts/bindings/mbox/nxp,s32-mru.yaml
```yaml
# Copyright 2022 NXP
# SPDX-License-Identifier: Apache-2.0

description: |
  NXP S32 Message Receive Unit

  The MRU couples with a processor and allows to receive messages from senders,
  which are other modules or processors. The interrupts from each MRU instance
  route to specific Private Peripheral Interrupts (PPIs) of the corresponding
  core.

  This driver offers a simplified operation in order to integrate with Zephyr
  Mbox API:
    - Each channel uses only the first mailbox, as current API does not allow
      to group hardware channel's mailboxes in logical channels.
    - The MTU is fixed to the size of one mailbox, as current API does not
      allow variable length per channel.

  In a normal use-case for IPC, the receiver core must enable and set the number
  of receive channels on the MRU instance coupled with the core, for instance in
  a devicetree overlay. In turn, the sender(s) must enable the MRU instance of the
  receiver to be able to transmit on it. There is no need to define the transmit
  channels on which the sender is intended to transmit.

  For example, core B and C want to send messages to core A in channels 0 and 1,
  respectively, then the devicetree overlays will look like:

    // overlay of core A
    mruA {
      rx-channels = <2>;
      status = "okay";
    };

    // overlays of core B and core C
    mruA {
      status = "okay";
    };

compatible: "nxp,s32-mru"

include: [base.yaml, mailbox-controller.yaml]

properties:
  interrupts:
    required: true

  rx-channels:
    type: int
    enum: [1, 2, 3, 4, 5, 6, 7, 8, 9, 10, 11, 12]
    description: |
      Number of receive channels enabled on this instance.
      Setting this value to N, will enable channels 0 to N-1, consecutively.
      It should be set by the receiver core coupled with this MRU instance.

      For example, if receiver A wants to Rx on channels 0 and 1, then A must
      set rx-channels of mruA as follows:

        mruA {
          rx-channels = <2>;
          status = "okay";
        };

mbox-cells:
  - channel
```

## dts/bindings/mbox/raspberrypi,pico-mbox.yaml
```yaml
# Copyright (c) 2025 Igalia S.L.
# SPDX-License-Identifier: Apache-2.0

description: Raspberry Pi Pico interprocessor mailbox

compatible: "raspberrypi,pico-mbox"

include: [base.yaml, mailbox-controller.yaml]

properties:
  fifo-depth:
    type: int
    description: number of entries that the mailbox FIFO can hold
    required: true
```

## dts/bindings/mbox/renesas,ra-ipc-mbox.yaml
```yaml
# Copyright (c) 2025 Renesas Electronics Corporation
# SPDX-License-Identifier: Apache-2.0

description: |
  Renesas IPC MBOX

  Notes:
  - With Renesas IPC MBOX, both TX and RX functions can be used on a single channel.

compatible: "renesas,ra-ipc-mbox"

include: [base.yaml, mailbox-controller.yaml]

properties:
  unit:
    type: int
    required: true
    description: |
      MBOX unit index number.
      A unit will use 2 FIFO for read and write operation: IPC1x and IPC0x, with x is the unit index
      For example, the MBOX unit 0 will use IPC10 and IPC00

  reg:
    required: true

  interrupts:
    required: true

  channel-mask:
    type: int
    required: true
    description: |
      Bitmask of valid channels. Each bit corresponds to a channel.
      Setting bit n to 1 enables channel n.

  message-channel-select:
    type: int
    default: 0
    description: |
      There is only one channel that supports message mode.
      This property selects the channel that supports message mode,
      while all other channels support only signal mode.
      If the selected channel is not enabled in channel-mask, the driver will return an error.

mbox-cells:
  - channel
```

## dts/bindings/mbox/renesas,rcar-mfis-mbox.yaml
```yaml
# Copyright (c) 2026 BayLibre, SAS
# SPDX-License-Identifier: Apache-2.0

description: |
  Renesas R-Car MFIS MBOX

  The multifunctional interface (MFIS) provides an interface between the
  different CPU Cores, such as AP System Core domain and the Realtime Core
  domain, SCP Core domain and AP System Core domain or Realtime Core domain.
  The MFIS supports both signalling and data transfer modes.

  From the current AP/RT core's perspective, two channel types may be used.
  A channel can be capable of sending (receiving) signal/data to (from)
  another AP/RT core domain XOR to (from) SCP core domain.
  - AP/RT channel IDs = 0 to 63
  - SCP channel IDs = 64 to 95 for AP cores (cores 0 to 31)
    SCP channel IDs = 64 to 75 for RT cores (cores 0 to 11)

compatible: "renesas,rcar-mfis-mbox"

include: [base.yaml, mailbox-controller.yaml]

properties:
  reg:
    required: true

  interrupts:
    required: true
    description: |
      Interrupt index N maps directly to mailbox channel N. As a result, the list
      must contain one entry per supported channel. Partial interrupt lists are not
      supported.

mbox-cells:
  - channel

examples:
  - |
    &soc {
      /* MFIS node on RT core */
      mfis: mailbox@18800000 {
        compatible = "renesas,rcar-mfis-mbox";
        reg = <0x18800000 0x1e2000>;
        interrupt-parent = <&gic>;
        interrupts = <GIC_SPI 54 IRQ_TYPE_LEVEL IRQ_DEFAULT_PRIORITY>,  /* AP_00 */
                     <GIC_SPI 56 IRQ_TYPE_LEVEL IRQ_DEFAULT_PRIORITY>,  /* AP_01 */
                     /* ... */
                     <GIC_SPI 180 IRQ_TYPE_LEVEL IRQ_DEFAULT_PRIORITY>, /* AP_63 */
                     <GIC_SPI 182 IRQ_TYPE_LEVEL IRQ_DEFAULT_PRIORITY>, /* SCP_00 */
                     <GIC_SPI 183 IRQ_TYPE_LEVEL IRQ_DEFAULT_PRIORITY>, /* SCP_01 */
                     /* ... */
                     <GIC_SPI 193 IRQ_TYPE_LEVEL IRQ_DEFAULT_PRIORITY>; /* SCP_11 */
        #mbox-cells = <1>;
      };

      /* Consumer using MFIS channel 64 (SCP_00) */
      scmi {
        /* ... */
        mboxes = <&mfis 64>;
        /* ... */
      };
    };
```
