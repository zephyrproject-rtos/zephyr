## dts/bindings/test/vnd,adc-temp-sensor.yaml
```yaml
# Copyright (c) 2018, Nordic Semiconductor ASA
# SPDX-License-Identifier: Apache-2.0

description: Test ADC-based temperature sensor

compatible: "vnd,adc-temp-sensor"

include: [base.yaml, reset-device.yaml]

properties:
  io-channels:
    required: true
    description: ADC conversion channels

  io-channel-names:
    required: true
    description: conversion channel names

  clocks:
    required: true

  pinctrl-0:
    type: phandles

  pinctrl-1:
    type: phandles

  pinctrl-2:
    type: phandles
```

## dts/bindings/test/vnd,adc.yaml
```yaml
# Copyright (c) 2020, Nordic Semiconductor ASA
# SPDX-License-Identifier: Apache-2.0

description: Test ADC

compatible: "vnd,adc"

include: adc-controller.yaml

properties:
    "#io-channel-cells":
      const: 1

io-channel-cells:
    - input
```

## dts/bindings/test/vnd,array-holder.yaml
```yaml
# Copyright (c) 2020 Nordic Semiconductor ASA
# SPDX-License-Identifier: Apache-2.0

description: Test array container

compatible: "vnd,array-holder"

include: [base.yaml]

properties:
  a: {type: "array"}
  b: {type: "uint8-array"}
  c: {type: "string-array"}

gpio-cells:
  - pin
  - flags
```

## dts/bindings/test/vnd,bool-with-default.yaml
```yaml
description: Test binding for booleans with defaults in the bindings

compatible: "vnd,bool-with-default"

properties:
  compatible:
    type: string
    required: true

  default-true:
    type: boolean
    default: true

  default-false:
    type: boolean

  default-false-explicit:
    type: boolean
    default: false
```

## dts/bindings/test/vnd,busy-sim.yaml
```yaml
# Copyright (c) 2021 Nordic Semiconductor ASA
# SPDX-License-Identifier: Apache-2.0

description: |
    CPU load simulator

compatible: "vnd,busy-sim"

properties:
  counter:
    type: phandle
    required: true
    description: |
      Counter device used for generating intervals.

  active-gpios:
    type: phandle-array
    description: |
      Debug pin is set to active state when cpu load is active.
```

## dts/bindings/test/vnd,can-controller.yaml
```yaml
# Copyright (c) 2020 Vestas Wind Systems A/S
# SPDX-License-Identifier: Apache-2.0

description: Test CAN controller node

compatible: "vnd,can-controller"

include: can-controller.yaml
```

## dts/bindings/test/vnd,can-transceiver.yaml
```yaml
# Copyright (c) 2020 Vestas Wind Systems A/S
# SPDX-License-Identifier: Apache-2.0

description: Test CAN transceiver node

compatible: "vnd,can-transceiver"

include: can-transceiver.yaml
```

## dts/bindings/test/vnd,child-bindings.yaml
```yaml
# Copyright (c) 2020, Teslabs Engineering S.L.
# SPDX-License-Identifier: Apache-2.0

description: Test child bindings

compatible: "vnd,child-bindings"

include: [base.yaml]

child-binding:
  description: Test child binding
  properties:
    val:
      type: int
      required: true
```

## dts/bindings/test/vnd,clock.yaml
```yaml
# Copyright (c) 2020 Linaro Ltd.
# SPDX-License-Identifier: Apache-2.0

description: Test Clock Controller

compatible: "vnd,clock"

include: [clock-controller.yaml, base.yaml]

properties:
  "#clock-cells":
    const: 2

clock-cells:
  - bus
  - bits
```

## dts/bindings/test/vnd,controller-device-setting.yaml
```yaml
description: Controller to device setting in 1 to many mapping

compatible: "vnd,controller-device-setting"

properties:
  val1:
    type: int
    required: true
```

## dts/bindings/test/vnd,controller.yaml
```yaml
# Copyright (c) 2025, Ambiq Micro Inc. <www.ambiq.com>
# SPDX-License-Identifier: Apache-2.0
description: Test Generic Controller Bus

compatible: "vnd,controller"

include: base.yaml

bus: generic

properties:
  reg:
    required: true
```

## dts/bindings/test/vnd,counter.yaml
```yaml
# Copyright (c) 2026 Meta Platforms
# SPDX-License-Identifier: Apache-2.0

description: Test counter node with capture support

compatible: "vnd,counter"

include: base.yaml

properties:
  reg:
    required: true

  "#counter-capture-cells":
    type: int
    const: 2

counter-capture-cells:
  - channel
  - flags
```

## dts/bindings/test/vnd,cpu-freq-thermal-cap-sensor.yaml
```yaml
# Copyright 2026 NXP
# SPDX-License-Identifier: Apache-2.0

description: Test temperature sensor for CPUFreq thermal cap tests

compatible: "vnd,cpu-freq-thermal-cap-sensor"

include: base.yaml
```

## dts/bindings/test/vnd,cpu-intc.yaml
```yaml
# Copyright (c) 2023 Meta
# SPDX-License-Identifier: Apache-2.0

description: Test CPU Interrupt Controller

compatible: "vnd,cpu-intc"

include: [interrupt-controller.yaml, base.yaml]

properties:
  "#interrupt-cells":
    const: 1

interrupt-cells:
  - irq
```

## dts/bindings/test/vnd,dac-outputs.yaml
```yaml
# Copyright (c) 2018, Nordic Semiconductor ASA
# SPDX-License-Identifier: Apache-2.0

description: Test DAC output device

compatible: "vnd,dac-outputs"

include: [base.yaml, pinctrl-device.yaml, reset-device.yaml]

properties:
  io-channels:
    required: true
    description:
      DAC output channels.

  io-channel-names:
    required: true
    description: output channel names
```

## dts/bindings/test/vnd,dac.yaml
```yaml
# Copyright (c) 2024 TOKITA Hiroshi
# SPDX-License-Identifier: Apache-2.0

description: Test DAC node

compatible: "vnd,dac"

include: dac-controller.yaml

properties:
  "#io-channel-cells":
    const: 1

io-channel-cells:
  - output
```

## dts/bindings/test/vnd,device-base.yaml
```yaml
# Copyright (c) 2025 Nordic Semiconductor ASA
# SPDX-License-Identifier: Apache-2.0

description: Test device with base properties

compatible: "vnd,device-base"

include: base.yaml
```

## dts/bindings/test/vnd,device-extender.yaml
```yaml
# Copyright (c) 2025, Ambiq Micro Inc. <www.ambiq.com>
# SPDX-License-Identifier: Apache-2.0
description: Test Generic Device extender

compatible: "vnd,device-extender"

include: base.yaml

on-bus: generic

bus: generic
```

## dts/bindings/test/vnd,device-with-props.yaml
```yaml
# Copyright (c) 2023 Nordic Semiconductor ASA
# SPDX-License-Identifier: Apache-2.0

description: Test device with random properties

compatible: "vnd,device-with-props"

properties:
  foo:
    type: int

  bar:
    type: int

  baz:
    type: int
```

## dts/bindings/test/vnd,device.yaml
```yaml
# Copyright (c) 2025, Ambiq Micro Inc. <www.ambiq.com>
# SPDX-License-Identifier: Apache-2.0
description: Test Generic Device

compatible: "vnd,device"

include: base.yaml

on-bus: generic
```

## dts/bindings/test/vnd,disabled-compat.yaml
```yaml
# Copyright (c) 2020 Nordic Semiconductor ASA
# SPDX-License-Identifier: Apache-2.0

description: Test disabled compatible

compatible: "vnd,disabled-compat"

include: base.yaml
```

## dts/bindings/test/vnd,dma.yaml
```yaml
# Copyright (c) 2020, Linaro Limited
# SPDX-License-Identifier: Apache-2.0

description: VND DMA controller

compatible: "vnd,dma"

include: dma-controller.yaml

properties:
    reg:
      required: true

    interrupts:
      required: true

    "#dma-cells":
      const: 2

dma-cells:
  - channel
  - slot
```

## dts/bindings/test/vnd,emul-tester.yaml
```yaml
# Copyright (c) 2023, Google, LLC
# SPDX-License-Identifier: Apache-2.0

description: VND Emul tester

compatible: "vnd,emul-tester"

include: base.yaml

properties:
  scale:
    type: int
    required: true
    description: |
      Integer scale applied to the set action for testing.
```

## dts/bindings/test/vnd,enum-holder-inst.yaml
```yaml
# Copyright (c) 2021 Nordic Semiconductor ASA
# SPDX-License-Identifier: Apache-2.0

description: Test enum property container (instance based)

compatible: "vnd,enum-holder-inst"

include: [base.yaml, "vnd,enum-holder.yaml"]
```

## dts/bindings/test/vnd,enum-holder.yaml
```yaml
# Copyright (c) 2020 Nordic Semiconductor ASA
# SPDX-License-Identifier: Apache-2.0

description: Test enum property container

compatible: "vnd,enum-holder"

include: [base.yaml]

properties:
  val:
    type: string
    required: true
    enum:
      - "zero"
      - "one"
      - "two"
```
