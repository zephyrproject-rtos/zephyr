## dts/bindings/test/vnd,enum-int-array-holder.yaml
```yaml
# Copyright (c) 2020 Linaro Limited
# SPDX-License-Identifier: Apache-2.0

description: Test enum property container

compatible: "vnd,enum-int-array-holder"

include: [base.yaml]

properties:
  val:
    type: array
    enum:
      - 7
      - 6
      - 5
      - 4
      - 3
      - 2
      - 1
      - 0
```

## dts/bindings/test/vnd,enum-int-required-false-holder.yaml
```yaml
# Copyright (c) 2020 Linaro Limited
# SPDX-License-Identifier: Apache-2.0

description: Test enum property container

compatible: "vnd,enum-int-required-false-holder"

include: [base.yaml]

properties:
  val:
    type: int
    enum:
      - 5
      - 6
      - 7
      - 8
```

## dts/bindings/test/vnd,enum-required-false-holder-inst.yaml
```yaml
# Copyright (c) 2021 Nordic Semiconductor ASA
# SPDX-License-Identifier: Apache-2.0

description: Test enum property container (instance based)

compatible: "vnd,enum-required-false-holder-inst"

include: [base.yaml, "vnd,enum-required-false-holder.yaml"]
```

## dts/bindings/test/vnd,enum-required-false-holder.yaml
```yaml
# Copyright (c) 2020 Linaro Limited
# SPDX-License-Identifier: Apache-2.0

description: Test enum property container

compatible: "vnd,enum-required-false-holder"

include: [base.yaml]

properties:
  val:
    type: string
    enum:
      - "zero"
      - "one"
      - "two"
```

## dts/bindings/test/vnd,enum-string-array-holder.yaml
```yaml
# Copyright (c) 2020 Linaro Limited
# SPDX-License-Identifier: Apache-2.0

description: Test enum property container

compatible: "vnd,enum-string-array-holder"

include: [base.yaml]

properties:
  val:
    type: string-array
    enum:
      - foo
      - bar
      - baz
      - zoo
```

## dts/bindings/test/vnd,ethernet.yaml
```yaml
# Copyright (c) 2024 TOKITA Hiroshi
# SPDX-License-Identifier: Apache-2.0

description: Test Ethernet node

compatible: "vnd,ethernet"

include: ethernet-controller.yaml
```

## dts/bindings/test/vnd,evtc.yaml
```yaml
# Copyright (c) 2024 Nordic Semiconductor ASA
# SPDX-License-Identifier: Apache-2.0

description: Test event controller node

include: "evtc.yaml"

compatible: "vnd,evtc"
```

## dts/bindings/test/vnd,gpio-device.yaml
```yaml
# Copyright (c) 2020 Nordic Semiconductor ASA
# SPDX-License-Identifier: Apache-2.0

description: Test GPIO node

compatible: "vnd,gpio-device"

include:
  - name: gpio-controller.yaml
  - name: base.yaml

properties:
  reg:
    required: true

  "#gpio-cells":
    const: 2

gpio-cells:
  - pin
  - flags

foo-cells:
  - foocell

baz-cells:
  - bazcell
```

## dts/bindings/test/vnd,gpio-expander-common.yaml
```yaml
# Copyright (c) 2020 Nordic Semiconductor ASA
# SPDX-License-Identifier: Apache-2.0

description: Test GPIO node

include: [gpio-controller.yaml, base.yaml]

properties:
  reg:
    required: true

  "#gpio-cells":
    const: 2

gpio-cells:
  - pin
  - flags
```

## dts/bindings/test/vnd,gpio-expander-i2c.yaml
```yaml
# Copyright (c) 2020 Nordic Semiconductor ASA
# SPDX-License-Identifier: Apache-2.0

description: GPIO expander via I2C

compatible: "vnd,gpio-expander"

include:
  - name: "vnd,gpio-expander-common.yaml"
    property-blocklist:
      - label
  - name: i2c-device.yaml
    property-blocklist:
      - label

properties:
  label:
    type: string
```

## dts/bindings/test/vnd,gpio-expander-spi.yaml
```yaml
# Copyright (c) 2020 Nordic Semiconductor ASA
# SPDX-License-Identifier: Apache-2.0

description: GPIO expander via SPI

compatible: "vnd,gpio-expander"

include: ["vnd,gpio-expander-common.yaml", spi-device.yaml]
```

## dts/bindings/test/vnd,gpio-intc-device.yaml
```yaml
# Copyright (c) 2023 Bjarki Arge Andreasen
# SPDX-License-Identifier: Apache-2.0

description: Test GPIO with INTC node

compatible: "vnd,gpio-intc-device"

include:
  - gpio-controller.yaml
  - interrupt-controller.yaml
  - base.yaml

properties:
  reg:
    required: true

  "#gpio-cells":
    const: 2

  "#interrupt-cells":
    const: 2

gpio-cells:
  - pin
  - flags

interrupt-cells:
  - pin
  - flags
```

## dts/bindings/test/vnd,gpio-nexus.yaml
```yaml
# Copyright (c) 2025, TOKITA Hiroshi
# SPDX-License-Identifier: Apache-2.0

description: VND GPIO nexus

include: [gpio-nexus.yaml]

compatible: "vnd,gpio-nexus"
```

## dts/bindings/test/vnd,gpio-one-cell.yaml
```yaml
# Copyright (c) 2020 Nordic Semiconductor ASA
# SPDX-License-Identifier: Apache-2.0

description: Test GPIO node with one cell

compatible: "vnd,gpio-one-cell"

include: [gpio-controller.yaml, base.yaml]

properties:
    reg:
      required: true

    "#gpio-cells":
      const: 1

gpio-cells:
  - pin
```

## dts/bindings/test/vnd,great-grandchild-bindings.yaml
```yaml
# Copyright (c) 2020 Nordic Semiconductor ASA
# SPDX-License-Identifier: Apache-2.0

description: |
  Test binding for 3 levels of "child-binding".

  Previous versions of Zephyr only allowed up to two levels of
  "child-binding:" in a YAML file. This file is used to test that the
  restriction no longer holds.

compatible: "vnd,great-grandchild-bindings"

include: [base.yaml]

child-binding:
  description: child node, no properties

  child-binding:
    description: grandchild node, no properties

    child-binding:
      description: great-grandchild node, ggc-prop property

      properties:
        ggc-prop:
          type: int
          required: true
```

## dts/bindings/test/vnd,hwspinlock-consumer.yaml
```yaml
# Copyright 2025 NXP
# SPDX-License-Identifier: Apache-2.0

description: VND HW spinlock consumer

compatible: "vnd,hwspinlock-consumer"

include: base.yaml

properties:
  hwlocks:
    required: true

  hwlock-names:
    required: true
```

## dts/bindings/test/vnd,hwspinlock-device.yaml
```yaml
# Copyright (c) 2025 Analog Devices, Inc.
# SPDX-License-Identifier: Apache-2.0

description: Test hardware spinlock device node

compatible: "vnd,hwspinlock-device"

include: base.yaml

properties:
  hwlocks:
    required: true
```

## dts/bindings/test/vnd,hwspinlock.yaml
```yaml
# Copyright (c) 2025 Analog Devices, Inc.
# SPDX-License-Identifier: Apache-2.0

description: Test hardware spinlock node

compatible: "vnd,hwspinlock"

include: [base.yaml, hwspinlock-controller.yaml]

hwlock-cells:
  - id
```

## dts/bindings/test/vnd,i2c-device.yaml
```yaml
# Copyright (c) 2020 Nordic Semiconductor ASA
# SPDX-License-Identifier: Apache-2.0

description: Test I2C device

compatible: "vnd,i2c-device"

include:
  - name: i2c-device.yaml
    property-blocklist:
      - label

properties:
    label:
        type: string
        required: false
```

## dts/bindings/test/vnd,i2c-mux.yaml
```yaml
# Copyright (c) 2021 Nordic Semiconductor ASA
# SPDX-License-Identifier: Apache-2.0

description: |
  I2C mux

  This is an I2C device that is also (multiple) I2C controllers. We
  model this as a node which is an I2C device, whose children are I2C
  controllers, and whose grandchildren are therefore I2C devices.

compatible: "vnd,i2c-mux"

include: "i2c-device.yaml"

child-binding:
  description: I2C mux controller
  compatible: "vnd,i2c-mux-controller"
  include: "i2c-controller.yaml"
```

## dts/bindings/test/vnd,i2c.yaml
```yaml
# Copyright (c) 2020 Nordic Semiconductor ASA
# SPDX-License-Identifier: Apache-2.0

description: Test I2C node

compatible: "vnd,i2c"

include:
  - name: i2c-controller.yaml
```

## dts/bindings/test/vnd,i2s.yaml
```yaml
# Copyright (c) 2024 TOKITA Hiroshi
# SPDX-License-Identifier: Apache-2.0

description: Test I2S Controller node

compatible: "vnd,i2s"

include: i2s-controller.yaml
```

## dts/bindings/test/vnd,i3c-device.yaml
```yaml
# Copyright (c) 2020 Nordic Semiconductor ASA
# Copyright (c) 2022 Intel Corporation
#
# SPDX-License-Identifier: Apache-2.0

description: Test I3C device

compatible: "vnd,i3c-device"

include:
  - name: i3c-device.yaml
```

## dts/bindings/test/vnd,i3c-i2c-device.yaml
```yaml
# Copyright (c) 2020 Nordic Semiconductor ASA
# Copyright (c) 2022 Intel Corporation
#
# SPDX-License-Identifier: Apache-2.0

description: Test I2C device under I3C bus

compatible: "vnd,i3c-i2c-device"

include:
  - name: i2c-device.yaml
```

## dts/bindings/test/vnd,i3c.yaml
```yaml
# Copyright (c) 2020 Nordic Semiconductor ASA
# Copyright (c) 2022 Intel Corporation
#
# SPDX-License-Identifier: Apache-2.0

description: Test I3C node

compatible: "vnd,i3c"

include:
  - name: i3c-controller.yaml
```
