## dts/bindings/test/vnd,ieee802154.yaml
```yaml
# Copyright (c) 2022 Nordic Semiconductor ASA
# SPDX-License-Identifier: Apache-2.0

description: Test IEEE 802.15.4

compatible: "vnd,ieee802154"

include: base.yaml
```

## dts/bindings/test/vnd,input-device.yaml
```yaml
# Copyright 2023 Google LLC
# SPDX-License-Identifier: Apache-2.0

description: Test input device

compatible: "vnd,input-device"
```

## dts/bindings/test/vnd,intc.yaml
```yaml
# Copyright (c) 2020 Linaro Ltd.
# SPDX-License-Identifier: Apache-2.0

description: Test Interrupt Controller

compatible: "vnd,intc"

include: [interrupt-controller.yaml, base.yaml]

properties:
    reg:
      required: true

    "#interrupt-cells":
      const: 2

interrupt-cells:
  - irq
  - priority
```

## dts/bindings/test/vnd,interrupt-holder-extended.yaml
```yaml
# Copyright (c) 2023 Bjarki Arge Andreasen
# SPDX-License-Identifier: Apache-2.0

description: Test Interrupt Controller with extended interrupts

compatible: "vnd,interrupt-holder-extended"

include: [base.yaml]

properties:
  interrupts-extended:
    required: true

  interrupt-names:
    required: true
```

## dts/bindings/test/vnd,interrupt-holder.yaml
```yaml
# Copyright (c) 2020 Linaro Ltd.
# SPDX-License-Identifier: Apache-2.0

description: Test Interrupt Controller

compatible: "vnd,interrupt-holder"

include: [base.yaml]

properties:
    interrupts:
      required: true

    interrupt-names:
      required: true
```

## dts/bindings/test/vnd,intr-nexus.yaml
```yaml
# Copyright (c) 2025, TOKITA Hiroshi
# SPDX-License-Identifier: Apache-2.0

description: VND interrupt nexus

include: [interrupt-nexus.yaml]

compatible: "vnd,intr-nexus"
```

## dts/bindings/test/vnd,ipm-zero-cell.yaml
```yaml
# Copyright (c) 2021, Carlo Caione <ccaione@baylibre.com>
# SPDX-License-Identifier: Apache-2.0

description: VND IPM controller (0 cell)

compatible: "vnd,ipm-zero-cell"

properties:
  label:
    type: string
    required: true
```

## dts/bindings/test/vnd,ipm.yaml
```yaml
# Copyright (c) 2021, Carlo Caione <ccaione@baylibre.com>
# SPDX-License-Identifier: Apache-2.0

description: VND IPM controller

compatible: "vnd,ipm"

include: mailbox-controller.yaml

properties:
  label:
    type: string
    required: true

mbox-cells:
  - channel
```

## dts/bindings/test/vnd,mbox-consumer.yaml
```yaml
# Copyright (c) 2021, Carlo Caione <ccaione@baylibre.com>
# SPDX-License-Identifier: Apache-2.0

description: VND MBOX consumer

compatible: "vnd,mbox-consumer"

include: base.yaml

properties:
  mboxes:
    required: true

  mbox-names:
    required: true
```

## dts/bindings/test/vnd,mbox-zero-cell.yaml
```yaml
# Copyright (c) 2021, Carlo Caione <ccaione@baylibre.com>
# SPDX-License-Identifier: Apache-2.0

description: VND MBOX controller (0 cell)

compatible: "vnd,mbox-zero-cell"
```

## dts/bindings/test/vnd,mbox.yaml
```yaml
# Copyright (c) 2021, Carlo Caione <ccaione@baylibre.com>
# SPDX-License-Identifier: Apache-2.0

description: VND MBOX controller

compatible: "vnd,mbox"

include: mailbox-controller.yaml

mbox-cells:
  - channel
```

## dts/bindings/test/vnd,memory-attr.yaml
```yaml
# Copyright (c) 2020 Linaro Ltd.
# SPDX-License-Identifier: Apache-2.0

description: Test memory and memory attributes

compatible: "vnd,memory-attr"

include: [base.yaml, "zephyr,memory-attr.yaml"]
```

## dts/bindings/test/vnd,mipi-dsi.yaml
```yaml
#
# Copyright (c) 2024 TOKITA Hiroshi
#
# SPDX-License-Identifier: Apache-2.0
#

description: Test MIPI DSI host

compatible: "vnd,mipi-dsi"

include: [mipi-dsi-host.yaml]
```

## dts/bindings/test/vnd,non-deprecated-label.yaml
```yaml
# Copyright 2023 Ampere Computing
# SPDX-License-Identifier: Apache-2.0

description: |
  This can be used when we need a label property in tests without risk
  of generating deprecation warnings, which are errors in some
  configurations.

compatible: vnd,non-deprecated-label

properties:
  label:
    type: string
    required: true
```

## dts/bindings/test/vnd,nvmem-consumer.yaml
```yaml
# Copyright (c) 2025 Basalte bv
# SPDX-License-Identifier: Apache-2.0

description: Test NVMEM consumer node

compatible: "vnd,nvmem-consumer"

include: [nvmem-consumer.yaml]
```

## dts/bindings/test/vnd,pcie.yaml
```yaml
# Copyright (c) 2021 Nordic Semiconductor ASA
# SPDX-License-Identifier: Apache-2.0

description: Test PCIe bus controller

compatible: vnd,pcie

include: base.yaml

bus: pcie
```

## dts/bindings/test/vnd,phandle-holder.yaml
```yaml
# Copyright (c) 2020 Nordic Semiconductor ASA
# SPDX-License-Identifier: Apache-2.0

description: Test phandle property container

compatible: "vnd,phandle-holder"

include: [base.yaml]

properties:
  ph: {type: "phandle"}
  phs: {type: "phandles"}
  phs-or: {type: "phandles"}
  pha-gpios: {type: "phandle-array"}
  gpios: {type: "phandle-array"}
  foos: {type: "phandle-array"}
  foo-names: {type: "string-array"}
  pwms: {type: "phandle-array"}
  pwm-names: {type: "string-array"}
  bar:
    type: "phandle-array"
    specifier-space: baz
  baz-names: {type: "string-array"}
```

## dts/bindings/test/vnd,pinctrl-device.yaml
```yaml
# Copyright (c) 2021 Nordic Semiconductor ASA
# SPDX-License-Identifier: Apache-2.0

description: Test device for pin controller.

compatible: "vnd,pinctrl-device"

include: [base.yaml, pinctrl-device.yaml]
```

## dts/bindings/test/vnd,pinctrl-test.yaml
```yaml
# Copyright (c) 2021 Nordic Semiconductor ASA
# SPDX-License-Identifier: Apache-2.0

description: |
    Test pin controller.

compatible: "vnd,pinctrl-test"

include:
    - name: base.yaml
    - name: pincfg-node-group.yaml
      child-binding:
        child-binding:
          property-allowlist:
            - bias-pull-down
            - bias-pull-up

child-binding:
  description: |
    Test pin controller pin configuration nodes. Each node is composed by one or
    more groups, each defining the configuration for a set of pins.

  child-binding:
    description: |
      Test pin controller pin configuration group. Each group contains a list of
      pins sharing the same set of properties. Example:

      /* node representing default state for test_device0 */
      test_device0_default: test_device0_default {
        /* group 1 (name is arbitrary) */
        pins1 {
          /* configure pins 0 and 1 */
          pins = <0>, <1>;
          /* both pins 0 and 1 have pull-up enabled */
          bias-pull-up;
        };
        ...
        /* group N (name is arbitrary) */
        pinsN {
          /* configure pin M */
          pins = <M>;
          /* pin M has pull-down enabled */
          bias-pull-down;
        };
      };

      The list of supported standard properties:

      - bias-pull-up: Enable pull-up resistor.
      - bias-pull-down: Enable pull-down resistor.

    properties:
      pins:
        required: true
        type: array
        description: |
          An array of pins sharing the same group properties. Each entry is a
          32-bit integer that is just used to identify the entry for testing
          purposes.
```

## dts/bindings/test/vnd,pinctrl.yaml
```yaml
# Copyright (c) 2021 Nordic Semiconductor ASA
# SPDX-License-Identifier: Apache-2.0

description: Test pin controller node

compatible: "vnd,pinctrl"

include: pincfg-node.yaml
```

## dts/bindings/test/vnd,pwm.yaml
```yaml
# Copyright (c) 2020, Linaro Limited
# SPDX-License-Identifier: Apache-2.0

description: VND PWM controller

compatible: "vnd,pwm"

include: [pwm-controller.yaml, base.yaml]

properties:
  reg:
    required: true

  "#pwm-cells":
    const: 3

pwm-cells:
  - channel
  - period
  - flags
```

## dts/bindings/test/vnd,reg-holder-64.yaml
```yaml
# Copyright (c) 2023 Syntacore
# SPDX-License-Identifier: Apache-2.0

description: Test 64-bit register property container

compatible: "vnd,reg-holder-64"

include: [base.yaml]

properties:
  reg:
    required: true

  reg-names:
    required: true
```

## dts/bindings/test/vnd,reg-holder.yaml
```yaml
# Copyright (c) 2020 Linaro Ltd.
# SPDX-License-Identifier: Apache-2.0

description: Test register property container

compatible: "vnd,reg-holder"

include: [base.yaml]

properties:
  reg:
    required: true

  reg-names:
    required: true

  misc-prop:
    type: int
```

## dts/bindings/test/vnd,reserved-compat.yaml
```yaml
# Copyright (c) 2023 Nordic Semiconductor ASA
# SPDX-License-Identifier: Apache-2.0

description: Test reserved compatible

compatible: "vnd,reserved-compat"

include: base.yaml
```

## dts/bindings/test/vnd,reset.yaml
```yaml
# Copyright (c) 2022 Andrei-Edward Popa
# SPDX-License-Identifier: Apache-2.0

description: Test Reset Controller

compatible: "vnd,reset"

include: [base.yaml, reset-controller.yaml]

properties:
  reg-width:
    type: int
    description: Register width
  "#reset-cells":
    const: 1

reset-cells:
  - id
```
