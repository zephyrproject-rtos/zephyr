## dts/bindings/test/vnd,sensor-device.yaml
```yaml
# Copyright (c) 2023 Google LLC
# SPDX-License-Identifier: Apache-2.0

description: VND sensor device

compatible: "vnd,sensor-device"

include: [sensor-device.yaml, base.yaml]

properties:
  reg:
    required: true

  "#sensor-cells":
    const: 1

sensor-cells:
  - channel
```

## dts/bindings/test/vnd,serial.yaml
```yaml
description: Test serial port

compatible: "vnd,serial"

include: [uart-controller.yaml, uart-controller-pin-inversion.yaml]

properties:
  baud-rate:
    type: int

  buffer-size:
    type: int
    description: "Size of buffer to capture output data or to queue input data."
```

## dts/bindings/test/vnd,spi-device-2.yaml
```yaml
# Copyright (c) 2020 Nordic Semiconductor ASA
# SPDX-License-Identifier: Apache-2.0

description: Test SPI device 2

compatible: "vnd,spi-device-2"

include: spi-device.yaml
```

## dts/bindings/test/vnd,spi-device.yaml
```yaml
# Copyright (c) 2020 Nordic Semiconductor ASA
# SPDX-License-Identifier: Apache-2.0

description: Test SPI device

compatible: "vnd,spi-device"

include:
  - name: spi-device.yaml
    property-blocklist:
      - label

properties:
    label:
        type: string
        required: false
```

## dts/bindings/test/vnd,spi-nor.yaml
```yaml
# Copyright (c) 2020 Nordic Semiconductor ASA
# SPDX-License-Identifier: Apache-2.0

description: Test NOR Flash SPI device

compatible: "vnd,spi-nor"

on-bus: spi

include: spi-device.yaml
```

## dts/bindings/test/vnd,spi.yaml
```yaml
# Copyright (c) 2020 Nordic Semiconductor ASA
# SPDX-License-Identifier: Apache-2.0

description: Test SPI node

compatible: "vnd,spi"

include:
  - name: spi-controller.yaml
    property-blocklist:
      - label

properties:
  label:
    type: string
```

## dts/bindings/test/vnd,string-array-token.yaml
```yaml
# Copyright (c) 2022 Intel Corp.
# SPDX-License-Identifier: Apache-2.0

description: Test string array token property container

compatible: "vnd,string-array-token"

properties:
  val:
    type: string-array
    required: true
```

## dts/bindings/test/vnd,string-array-unquoted.yaml
```yaml
# Copyright (c) 2023 Intel Corp.
# SPDX-License-Identifier: Apache-2.0

description: Test string array unquoted property container

compatible: "vnd,string-array-unquoted"

properties:
  val:
    type: string-array
    required: true
```

## dts/bindings/test/vnd,string-array.yaml
```yaml
# Copyright (c) 2024 Zephyr Contributors
# SPDX-License-Identifier: Apache-2.0

description: Test string array property container

compatible: "vnd,string-array"

properties:
  val:
    type: string-array
    required: true
```

## dts/bindings/test/vnd,string-token.yaml
```yaml
# Copyright (c) 2022 Intel Corp.
# SPDX-License-Identifier: Apache-2.0

description: Test string token property container

compatible: "vnd,string-token"

properties:
  val:
    type: string
    enum:
      - token_zero
      - token_one
      - token_two
```

## dts/bindings/test/vnd,string-unquoted.yaml
```yaml
# Copyright (c) 2023 Intel Corp.
# SPDX-License-Identifier: Apache-2.0

description: Test string unquoted property container

compatible: "vnd,string-unquoted"

properties:
  val:
    type: string
```

## dts/bindings/test/vnd,string.yaml
```yaml
# Copyright (c) 2024 Zephyr Contributors
# SPDX-License-Identifier: Apache-2.0

description: Test string property container

compatible: "vnd,string"

properties:
  val:
    type: string
    required: true
```

## dts/bindings/test/vnd,temperature-sensor.yaml
```yaml
# Copyright (c) 2018, Nordic Semiconductor ASA
# SPDX-License-Identifier: Apache-2.0

description: Test ADC-based temperature sensor

compatible: "vnd,adc-temp-sensor"

include: base.yaml

properties:
    label:
      required: true

    io-channels:
      required: true
      description: ADC conversion channels

    io-channel-names:
      required: true
      description: conversion channel names

    clocks:
      required: true
```

## dts/bindings/test/vnd,test-foreach-reg-unique.yaml
```yaml
# Copyright (c) 2026 EPAM Systems
# SPDX-License-Identifier: Apache-2.0

description: Test inst foreach region node

compatible: "vnd,test-foreach-reg-unique"

include: [base.yaml]

properties:
  reg:
    required: true
```

## dts/bindings/test/vnd,test-foreach-reg.yaml
```yaml
# Copyright (c) 2026 EPAM Systems
# SPDX-License-Identifier: Apache-2.0

description: Test foreach region node

compatible: "vnd,test-foreach-reg"

include: [base.yaml]
```

## dts/bindings/test/vnd,video-multi-port.yaml
```yaml
# Copyright (c) 2024 tinyVision.ai Inc.
# SPDX-License-Identifier: Apache-2.0

description: Test Video device

compatible: "vnd,video-multi-port"

child-binding:
  child-binding:
    child-binding:
      include: video-interfaces.yaml
      properties:
        reg:
          type: array
```

## dts/bindings/test/vnd,video-single-port.yaml
```yaml
# Copyright (c) 2024 tinyVision.ai Inc.
# SPDX-License-Identifier: Apache-2.0

description: Test Video device

compatible: "vnd,video-single-port"

child-binding:
  child-binding:
    include: video-interfaces.yaml
    properties:
      reg:
        type: array
```

## dts/bindings/test/vnd,video.yaml
```yaml
# Copyright (c) 2024 tinyVision.ai Inc.
# SPDX-License-Identifier: Apache-2.0

description: Test Video device

compatible: "vnd,video"

child-binding:
  child-binding:
    include: video-interfaces.yaml
```

## dts/bindings/test/vnd,w1.yaml
```yaml
# Copyright (c) 2022 Thomas Stranger
# SPDX-License-Identifier: Apache-2.0

description: Test W1 bus master node

compatible: "vnd,w1"

include: [w1-master.yaml]
```

## dts/bindings/timer/adi,max32-rv32-sys-timer.yaml
```yaml
# Copyright (c) 2026 Analog Devices, Inc.
# SPDX-License-Identifier: Apache-2.0

description: ADI MAX32 RV32 system timer

compatible: "adi,max32-rv32-sys-timer"

include: ["adi,max32-timer-common.yaml"]

properties:
  clock-source:
    enum: [6]
    description: |
      Clock source to be used by the timer peripheral. The following options
      are available:
      - 6: "ADI_MAX32_PRPH_CLK_SRC_ISO" Internal Secondary Oscillator
      The system timer clock source needs to match the source for the RV32
      core.
```

## dts/bindings/timer/adi,max32-timer-common.yaml
```yaml
# Copyright (c) 2023-2026 Analog Devices, Inc.
# SPDX-License-Identifier: Apache-2.0

description: ADI MAX32 timer common

include: [base.yaml, reset-device.yaml]

properties:
  reg:
    required: true

  clocks:
    description: Source clock controller configuration

  clock-source:
    type: int

  prescaler:
    type: int
    required: true
    enum:
      - 1
      - 2
      - 4
      - 8
      - 16
      - 32
      - 64
      - 128
      - 256
      - 512
      - 1024
      - 2048
      - 4096
    description: |
      The prescaler that divides the timers source clock to set the timers count clock as follows:
      F_cnt_clk = F_clock_source / prescaler
```

## dts/bindings/timer/adi,max32-timer.yaml
```yaml
# Copyright (c) 2023-2024 Analog Devices, Inc.
# SPDX-License-Identifier: Apache-2.0

description: ADI MAX32 timer

compatible: "adi,max32-timer"

include: [base.yaml, reset-device.yaml]

properties:
  reg:
    required: true

  clocks:
    required: true

  clock-source:
    type: int
    enum: [0, 1, 2, 3, 4, 5, 6, 7]
    description: |
      Clock source to be used by the WDT peripheral. The following options
      are available:
      - 0: "ADI_MAX32_PRPH_CLK_SRC_PCLK" Peripheral clock
      - 1: "ADI_MAX32_PRPH_CLK_SRC_EXTCLK" External Clock
      - 2: "ADI_MAX32_PRPH_CLK_SRC_IBRO" Internal Baud Rate Oscillator
      - 3: "ADI_MAX32_PRPH_CLK_SRC_ERFO" External Radio Frequency Oscillator
      - 4: "ADI_MAX32_PRPH_CLK_SRC_ERTCO" External Real-Time Clock Oscillator
      - 5: "ADI_MAX32_PRPH_CLK_SRC_INRO" Internal Ring Oscillator
      - 6: "ADI_MAX32_PRPH_CLK_SRC_ISO" Internal Secondary Oscillator
      - 7: "ADI_MAX32_PRPH_CLK_SRC_IBRO_DIV8" IBRO/8
      The target device might not support every option please take a look on
      target device user guide

  prescaler:
    type: int
    required: true
    enum:
      - 1
      - 2
      - 4
      - 8
      - 16
      - 32
      - 64
      - 128
      - 256
      - 512
      - 1024
      - 2048
      - 4096
    description: |
      The prescaler that divides the timers source clock to set the timers count clock as follows:
      F_cnt_clk = F_clock_source / prescaler
```

## dts/bindings/timer/adi,max32-wut-timer.yaml
```yaml
# Copyright (c) 2025 Analog Devices, Inc.
# SPDX-License-Identifier: Apache-2.0

description: |
  ADI MAX32 Wake-Up Timer (WUT) system clock driver.

  The Wake-Up Timer is a 32-bit counter driven by the 32.768 kHz source.
  It can wake the device from all low-power states and is well-suited
  for use as the system timer in low-power applications.

compatible: "adi,max32-wut-timer"

include: [base.yaml]

examples:
  - |
    &wut0 {
        status = "okay";
        prescaler = <1>;

        wut0_timer: timer {
            status = "okay";
        };
    };

    &systick {
        status = "disabled";
    };
```

## dts/bindings/timer/ambiq,ctimer.yaml
```yaml
# Copyright (c) 2025 Ambiq Micro Inc. <www.ambiq.com>
# SPDX-License-Identifier: Apache-2.0

description: Ambiq CTIMER timer

compatible: "ambiq,ctimer"

include: [base.yaml]

properties:
  reg:
    required: true

  interrupts:
    required: true

  clk-source:
    type: string
    required: true
    enum:
      - "CLK_SELECT_CLK_PIN"
      - "CLK_SELECT_HFRC_12MHZ"
      - "CLK_SELECT_HFRC_3MHZ"
      - "CLK_SELECT_HFRC_187_5KHZ"
      - "CLK_SELECT_HFRC_47KHZ"
      - "CLK_SELECT_HFRC_12KHZ"
      - "CLK_SELECT_XT_32_768KHZ"
      - "CLK_SELECT_XT_16_384KHZ"
      - "CLK_SELECT_XT_2_048KHZ"
      - "CLK_SELECT_XT_256HZ"
      - "CLK_SELECT_LFRC_512HZ"
      - "CLK_SELECT_LFRC_32HZ"
      - "CLK_SELECT_LFRC_1HZ"
      - "CLK_SELECT_LFRC_1_16HZ"
      - "CLK_SELECT_RTC_100HZ"
      - "CLK_SELECT_HCLK_DIV4"
      - "CLK_SELECT_XT_DIV4"
      - "CLK_SELECT_XT_DIV8"
      - "CLK_SELECT_XT_DIV32"
      - "CLK_SELECT_RSVD"
    description: |
      Clock source selection: 32 KHz is available in deep sleep.
      - AM_HAL_CTIMER_CLK_PIN               _VAL2FLD(CTIMER_CTRL0_TMRA0CLK, 0x00)
      - AM_HAL_CTIMER_HFRC_12MHZ            _VAL2FLD(CTIMER_CTRL0_TMRA0CLK, 0x01)
      - AM_HAL_CTIMER_HFRC_3MHZ             _VAL2FLD(CTIMER_CTRL0_TMRA0CLK, 0x02)
      - AM_HAL_CTIMER_HFRC_187_5KHZ         _VAL2FLD(CTIMER_CTRL0_TMRA0CLK, 0x03)
      - AM_HAL_CTIMER_HFRC_47KHZ            _VAL2FLD(CTIMER_CTRL0_TMRA0CLK, 0x04)
      - AM_HAL_CTIMER_HFRC_12KHZ            _VAL2FLD(CTIMER_CTRL0_TMRA0CLK, 0x05)
      - AM_HAL_CTIMER_XT_32_768KHZ          _VAL2FLD(CTIMER_CTRL0_TMRA0CLK, 0x06)
      - AM_HAL_CTIMER_XT_16_384KHZ          _VAL2FLD(CTIMER_CTRL0_TMRA0CLK, 0x07)
      - AM_HAL_CTIMER_XT_2_048KHZ           _VAL2FLD(CTIMER_CTRL0_TMRA0CLK, 0x08)
      - AM_HAL_CTIMER_XT_256HZ              _VAL2FLD(CTIMER_CTRL0_TMRA0CLK, 0x09)
      - AM_HAL_CTIMER_LFRC_512HZ            _VAL2FLD(CTIMER_CTRL0_TMRA0CLK, 0x0A)
      - AM_HAL_CTIMER_LFRC_32HZ             _VAL2FLD(CTIMER_CTRL0_TMRA0CLK, 0x0B)
      - AM_HAL_CTIMER_LFRC_1HZ              _VAL2FLD(CTIMER_CTRL0_TMRA0CLK, 0x0C)
      - AM_HAL_CTIMER_LFRC_1_16HZ           _VAL2FLD(CTIMER_CTRL0_TMRA0CLK, 0x0D)
      - AM_HAL_CTIMER_RTC_100HZ             _VAL2FLD(CTIMER_CTRL0_TMRA0CLK, 0x0E)
      - AM_HAL_CTIMER_HCLK_DIV4             _VAL2FLD(CTIMER_CTRL0_TMRA0CLK, 0x0F)
      - AM_HAL_CTIMER_XT_DIV4               _VAL2FLD(CTIMER_CTRL0_TMRA0CLK, 0x10)
      - AM_HAL_CTIMER_XT_DIV8               _VAL2FLD(CTIMER_CTRL0_TMRA0CLK, 0x11)
      - AM_HAL_CTIMER_XT_DIV32              _VAL2FLD(CTIMER_CTRL0_TMRA0CLK, 0x12)
      - AM_HAL_CTIMER_RSVD                  _VAL2FLD(CTIMER_CTRL0_TMRA0CLK, 0x13)
```

## dts/bindings/timer/ambiq,stimer.yaml
```yaml
# Copyright (c) 2023 Antmicro <www.antmicro.com>
# SPDX-License-Identifier: Apache-2.0

description: Ambiq STIMER

compatible: "ambiq,stimer"

include: base.yaml

properties:
  reg:
    required: true

  interrupts:
    required: true

  clk-source:
    type: int
    required: true
    description: |
      clk-source specifies the clock source that used by the system timer.
      For Apollo3:
      0 - NOCLK : No clock enabled.
      1 - HFRC_DIV16 : 3MHz from the HFRC clock divider.
      2 - HFRC_DIV256 : 187.5KHz from the HFRC clock divider.
      3 - XTAL_DIV1 : 32768Hz from the crystal oscillator.
      4 - XTAL_DIV2 : 16384Hz from the crystal oscillator.
      5 - XTAL_DIV32 : 1024Hz from the crystal oscillator.
      6 - LFRC_DIV1 : Approximately 1KHz from the LFRC oscillator (uncalibrated).
      7 - CTIMER0A : Use CTIMER 0 section A as a prescaler.
      8 - CTIMER0B : Use CTIMER 0 section B (or A and B linked together) as a prescaler.
      For Apollo4:
      0 - NOCLK : No clock enabled.
      1 - HFRC_6MHZ : 6MHz from the HFRC clock divider.
      2 - HFRC_375KHZ : 375KHz from the HFRC clock divider.
      3 - XTAL_32KHZ : 32768Hz from the crystal oscillator.
      4 - XTAL_16KHZ : 16384Hz from the crystal oscillator.
      5 - XTAL_1KHZ : 1024Hz from the crystal oscillator.
      6 - LFRC_1KHZ : Approximately 1KHz from the LFRC oscillator (uncalibrated).
      7 - CTIMER0 : Use CTIMER 0 for the clock source (allows prescaling from other system clocks).
      8 - CTIMER1 : Use CTIMER 1 for the clock source (allows prescaling from other system clocks).
```
