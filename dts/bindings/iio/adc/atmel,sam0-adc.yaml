## dts/bindings/iio/adc/atmel,sam0-adc.yaml
```yaml
# Copyright (c) 2019 Derek Hageman <hageman@inthat.cloud>
# SPDX-License-Identifier: Apache-2.0

title: Atmel SAM0 Family ADC

description: |
    This binding gives a base representation of the Atmel SAM0 ADC

compatible: "atmel,sam0-adc"

include: adc-controller.yaml

properties:
    reg:
      required: true

    interrupts:
      required: true

    gclk:
      type: int
      required: true
      description: generic clock generator source

    prescaler:
      type: int
      required: true
      description: clock prescaler divisor applied to the generic clock

    "#io-channel-cells":
      const: 1

io-channel-cells:
    - input
```

## dts/bindings/iio/adc/intel,qmsi-adc.yaml
```yaml
#
# Copyright (c) 2018, Nordic Semiconductor ASA
#
# SPDX-License-Identifier: Apache-2.0
#
---
title: Intel ADC
id: intel,qmsi-adc
version: 0.1

description: >
    This is a representation of the intel ADC node

inherits:
    !include adc.yaml

properties:
    compatible:
      type: string
      category: required
      description: compatible strings
      constraint: "intel,qmsi-adc"

    reg:
      type: array
      description: mmio register space
      generation: define
      category: required

    interrupts:
      type: array
      category: required
      description: required interrupts
      generation: define
...
```

## dts/bindings/iio/adc/intel,quark-d2000-adc.yaml
```yaml
#
# Copyright (c) 2018 Intel Corporation.
#
# SPDX-License-Identifier: Apache-2.0
#
---
title: Intel Quark D2000 ADC
version: 0.1

description: >
    This is a representation of the Intel Quark D2000 ADC Controller

inherits:
    !include adc.yaml

properties:
    compatible:
      constraint: "intel,quark-d2000-adc"

    reg:
      category: required

    interrupts:
      category: required
...
```

## dts/bindings/iio/adc/microchip,xec-adc.yaml
```yaml
#
# Copyright (c) 2019, Intel Corporation
#
# SPDX-License-Identifier: Apache-2.0
#

title: Microchip XEC ADC

description: |
    This binding gives a base representation of the Microchip XEC ADC

compatible: "microchip,xec-adc"

include: adc-controller.yaml

properties:
    reg:
      required: true

    interrupts:
      required: true

    "#io-channel-cells":
      const: 1

io-channel-cells:
    - input
```

## dts/bindings/iio/adc/nordic,nrf-adc.yaml
```yaml
# Copyright (c) 2018, Nordic Semiconductor ASA
# SPDX-License-Identifier: Apache-2.0

description: nRF ADC node

compatible: "nordic,nrf-adc"

include: adc-controller.yaml

properties:
    reg:
      required: true

    interrupts:
      required: true

    "#io-channel-cells":
      const: 1

io-channel-cells:
    - input
```

## dts/bindings/iio/adc/nordic,nrf-saadc.yaml
```yaml
# Copyright (c) 2018, Nordic Semiconductor ASA
# SPDX-License-Identifier: Apache-2.0

description: Nordic Semiconductor nRF family SAADC node

compatible: "nordic,nrf-saadc"

include: adc-controller.yaml

properties:
    reg:
      required: true

    interrupts:
      required: true

    "#io-channel-cells":
      const: 1

io-channel-cells:
    - input
```

## dts/bindings/iio/adc/nuvoton,npcx-adc.yaml
```yaml
# Copyright (c) 2020 Nuvoton Technology Corporation.
# SPDX-License-Identifier: Apache-2.0

description: Nuvoton, NPCX-ADC node

compatible: "nuvoton,npcx-adc"

include: [adc-controller.yaml, pinctrl-device.yaml]

properties:
    reg:
        required: true
    clocks:
        required: true
    label:
        required: true
    pinctrl-0:
        required: true
    pinctrl-names:
        required: true
    channel-count:
        type: int
        required: true
        description: the number of ADC channels
    threshold-reg-offset:
        type: int
        required: true
        description: the offset of threshold detector register address
    threshold-count:
        type: int
        required: true
        description: the number of threshold detectors adc supports

io-channel-cells:
    - input
```

## dts/bindings/iio/adc/nxp,kinetis-adc12.yaml
```yaml
# Copyright (c) 2019 Vestas Wind Systems A/S
# SPDX-License-Identifier: Apache-2.0

title: NXP Kinetis ADC12

description: |
    This binding gives a base representation of the NXP Kinetis ADC12

compatible: "nxp,kinetis-adc12"

include: adc-controller.yaml

properties:
    reg:
      required: true

    interrupts:
      required: true

    clk-source:
      type: int
      required: true
      description: converter clock source

    clk-divider:
      type: int
      required: true
      description: clock divider for the converter

    alternate-voltage-reference:
      type: boolean
      required: false
      description: use alternate voltage reference source

    sample-time:
      type: int
      required: true
      description: sample time in clock cycles

    "#io-channel-cells":
      const: 1

io-channel-cells:
    - input
```

## dts/bindings/iio/adc/nxp,kinetis-adc16.yaml
```yaml
# Copyright (c) 2017, NXP
# SPDX-License-Identifier: Apache-2.0

description: Kinetis ADC16

compatible: "nxp,kinetis-adc16"

include: adc-controller.yaml

properties:
    reg:
      required: true

    interrupts:
      required: true

    "#io-channel-cells":
      const: 1

io-channel-cells:
    - input
```

## dts/bindings/iio/adc/nxp,lpc-lpadc.yaml
```yaml
# Copyright (c) 2020, Toby Firth
# SPDX-License-Identifier: Apache-2.0

description: LPC LPADC

compatible: "nxp,lpc-lpadc"

include: [adc-controller.yaml, pinctrl-device.yaml]

properties:
    reg:
      required: true

    interrupts:
      required: true

    clk-divider:
      type: int
      required: true
      description: clock divider for the converter

    clk-source:
      type: int
      required: true
      description: source to attach the ADC clock to

    voltage-ref:
      type: int
      required: true
      description: reference voltage source

    calibration-average:
      type: int
      required: true
      description: conversion average number for auto-calibration

    power-level:
      type: int
      required: true
      description: power level for the ADC

    offset-value-a:
      type: int
      required: true
      description: Offset value A to use if CONFIG_LPADC_DO_OFFSET_CALIBRATION is false

    offset-value-b:
      type: int
      required: true
      description: Offset value B to use if CONFIG_LPADC_DO_OFFSET_CALIBRATION is false

    "#io-channel-cells":
      const: 1

io-channel-cells:
    - input
```

## dts/bindings/iio/adc/nxp,vf610-adc.yaml
```yaml
# Copyright (c) 2021, Antonio Tessarolo
# SPDX-License-Identifier: Apache-2.0

description: Vf610 Adc

compatible: "nxp,vf610-adc"

include: adc-controller.yaml

properties:
  reg:
    required: true

  interrupts:
    required: true

  clk-source:
    type: int
    required: true
    description: |
      Select adc clock source: 0 clock from IPG, 1 clock from IPG divided 2, 2 async clock

  clk-divider:
    type: int
    required: true
    description: |
      Select clock divider: 0 clock divided by 1, 1 clock divided by 2, 2 clock divided by 4,
      3 clock divided by 8

  "#io-channel-cells":
    const: 1

  rdc:
    type: int
    required: true
    description: |
      Set the RDC permission for this peripheral: the RDC controls which
      processor can access to this peripheral. User can select to assign this
      peripheral to the M4 processor, A9 processor or both with R/W or RW
      permissions. To set wanted permission a user should use the helper
      macro RDC_DOMAIN_PERM(domain,permission) where domain must be one of
      M4_DOMAIN_ID or A9_DOMAIN_ID and permission one among
      RDC_DOMAIN_PERM_NONE, RDC_DOMAIN_PERM_W, RDC_DOMAIN_PERM_R,
      RDC_DOMAIN_PERM_RW. Example to allow both processor to read/write to
      this peripheral a user should put:
      rdc = <(RDC_DOMAIN_PERM(A9_DOMAIN_ID, RDC_DOMAIN_PERM_RW) |
              RDC_DOMAIN_PERM(M4_DOMAIN_ID, RDC_DOMAIN_PERM_RW))>;

io-channel-cells:
  - input
```

## dts/bindings/iio/adc/silabs,gecko-adc.yaml
```yaml
# Copyright (c) 2019 Interay Solutions B.V.
# Copyright (c) Oane Kingma
# SPDX-License-Identifier: Apache-2.0

description: Silicon Labs Gecko Family ADC

compatible: "silabs,gecko-adc"

include: adc-controller.yaml

properties:
    reg:
      required: true

    interrupts:
      required: true

    peripheral-id:
      type: int
      required: true
      description: peripheral ID

    prescaler:
      type: int
      description: clock prescaler divisor applied to the generic clock
      required: true

    "#io-channel-cells":
      const: 1

io-channel-cells:
    - input
```

## dts/bindings/iio/adc/snps,dw-adc.yaml
```yaml
#
# Copyright (c) 2018 Intel Corporation.
#
# SPDX-License-Identifier: Apache-2.0
#

title: DesignWare ADC
version: 0.1

description: >
    This is a representation of the DesignWare ADC node

inherits:
    !include adc.yaml

properties:
    compatible:
      constraint: "snps,dw-adc"

    reg:
      category: required

    interrupts:
      category: required
```

## dts/bindings/iio/adc/st,stm32-adc.yaml
```yaml
# Copyright (c) 2018, Endre Karlson
# Copyright (c) 2018, Song Qiang <songqiang1304521@gmail.com>
# SPDX-License-Identifier: Apache-2.0

title: ST STM32 family ADC

description: |
    This binding gives a base representation of the ST STM32 ADC

compatible: "st,stm32-adc"

include: adc-controller.yaml

properties:
    reg:
      required: true

    clocks:
      required: true

    interrupts:
      required: true

    "#io-channel-cells":
      const: 1

io-channel-cells:
    - input
```

## dts/bindings/iio/adc/ti,lmp90080.yaml
```yaml
description: Texas Instruments LMP90080 AFE binding

compatible: "ti,lmp90080"

include: ti,lmp90xxx-current.yaml
```

## dts/bindings/iio/adc/ti,lmp90100.yaml
```yaml
description: Texas Instruments LMP90100 AFE binding

compatible: "ti,lmp90100"

include: ti,lmp90xxx-current.yaml
```

## dts/bindings/iio/afe/current-sense-amplifier.yaml
```yaml
# Copyright 2023 The ChromiumOS Authors
# SPDX-License-Identifier: Apache-2.0

description: |
  When an io-channel measures the voltage over a current sense amplifier,
  the interesting measurement is almost always the current through the
  sense resistor, not the voltage over it. This binding describes such a current
  sense circuit.

  This is based on Linux, documentation:
    https://www.kernel.org/doc/Documentation/devicetree/bindings/iio/afe/current-sense-amplifier.yaml

compatible: "current-sense-amplifier"

include: base.yaml

properties:
  io-channels:
    required: true
    description: |
      Channels available with this divider configuration.

  sense-resistor-milli-ohms:
    type: int
    required: true
    description: |
      Resistance of the shunt resistor in milli-ohms.

  sense-gain-mult:
    type: int
    default: 1
    description: |
      Amplifier gain multiplier. The default is <1>. The maximum value is <65535>.

  sense-gain-div:
    type: int
    default: 1
    description: |
      Amplifier gain divider. The default is <1>. The maximum value is <65535>.

  zero-current-voltage-mv:
    type: int
    default: 0
    description: |
      The zero-current voltage in millivolts. Defaults to <0>, with a range of <-32768> to <32767>.

      Some current sense amplifiers output a voltage proportional to current, independent of a
      current sense resistor (e.g., Hall-effect current sensors). These sensors often have a
      nonzero offset voltage that corresponds to zero current.

      To use this binding with such sensors, `sense-resistor-milli-ohms` should be set to 1.

  power-gpios:
    type: phandle-array
    description: |
      Control power to the current amplifier.

      If present the corresponding GPIO must be set to an active level
      to enable the current amplifier.

  enable-calibration:
    type: boolean
    description: |
      Enable calibration of the current sense amplifier.
      This is used to calibrate the ADC prior to taking measurements.

  zephyr,noise-threshold:
    type: int
    default: 0
    description: |
     Raw ADC readings below this threshold are treated as noise and
     reported as 0 uA. The default value of 0 disables the threshold.

  gain-extended-range:
    type: string
    description: |
      Alternate gain to use if primary measurement hits limit:
      - ADC_GAIN_1_6: x 1/6
      - ADC_GAIN_1_5: x 1/5
      - ADC_GAIN_1_4: x 1/4
      - ADC_GAIN_1_3: x 1/3
      - ADC_GAIN_2_5: x 2/5
      - ADC_GAIN_1_2: x 1/2
      - ADC_GAIN_2_3: x 2/3
      - ADC_GAIN_4_5: x 4/5
      - ADC_GAIN_1:   x 1
      - ADC_GAIN_2:   x 2
      - ADC_GAIN_3:   x 3
      - ADC_GAIN_4:   x 4
      - ADC_GAIN_6:   x 6
      - ADC_GAIN_8:   x 8
      - ADC_GAIN_12:  x 12
      - ADC_GAIN_16:  x 16
      - ADC_GAIN_24:  x 24
      - ADC_GAIN_32:  x 32
      - ADC_GAIN_64:  x 64
      - ADC_GAIN_128: x 128
    enum:
      - "ADC_GAIN_1_6"
      - "ADC_GAIN_1_5"
      - "ADC_GAIN_1_4"
      - "ADC_GAIN_1_3"
      - "ADC_GAIN_2_5"
      - "ADC_GAIN_1_2"
      - "ADC_GAIN_2_3"
      - "ADC_GAIN_4_5"
      - "ADC_GAIN_1"
      - "ADC_GAIN_2"
      - "ADC_GAIN_3"
      - "ADC_GAIN_4"
      - "ADC_GAIN_6"
      - "ADC_GAIN_8"
      - "ADC_GAIN_12"
      - "ADC_GAIN_16"
      - "ADC_GAIN_24"
      - "ADC_GAIN_32"
      - "ADC_GAIN_64"
      - "ADC_GAIN_128"
```

## dts/bindings/iio/afe/current-sense-shunt.yaml
```yaml
# Copyright 2023 The ChromiumOS Authors
# SPDX-License-Identifier: Apache-2.0

description: |
  When an io-channel measures the voltage over a current sense shunt,
  the interesting measurement is almost always the current through the
  shunt, not the voltage over it. This binding describes such a current
  sense circuit.

  This is based on Linux, documentation:
    https://www.kernel.org/doc/Documentation/devicetree/bindings/iio/afe/current-sense-shunt.yaml

compatible: "current-sense-shunt"

include: base.yaml

properties:
  io-channels:
    required: true
    description: |
      Channels available with this divider configuration.

  shunt-resistor-micro-ohms:
    type: int
    required: true
    description: |
      Resistance of the shunt resistor in micro-ohms
```
