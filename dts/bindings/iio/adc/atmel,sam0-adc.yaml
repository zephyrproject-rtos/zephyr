## dts/bindings/iio/afe/temperature-transducer.yaml
```yaml
# Copyright (C) 2022 Liam Beguin <liambeguin@gmail.com>
# SPDX-License-Identifier: Apache-2.0

description: |
  A temperature transducer is a device that converts a thermal quantity
  into any other physical quantity. This binding applies to temperature to
  voltage (like the LTC2997), and temperature to current (like the AD590)
  linear transducers.
  In both cases these are assumed to be connected to a voltage ADC.

  When an io-channel measures the output voltage of a temperature analog front
  end such as a temperature transducer, the interesting measurement is almost
  always the corresponding temperature, not the voltage output. This binding
  describes such a circuit.

  The general transfer function here is (using SI units)
    V(T) = Rsense * Isense(T)
    T = (Isense(T) / alpha) + offset
    T = 1 / (Rsense * alpha) * (V + offset * Rsense * alpha)

  When using a temperature to voltage transducer, Rsense is set to 1.

  The following circuits show a temperature to current and a temperature to
  voltage transducer that can be used with this binding.

           VCC
          -----
            |
        +---+---+
        | AD590 |                               VCC
        +---+---+                              -----
            |                                    |
            V proportional to T             +----+----+
            |                          D+ --+         |
            +---- Vout                      | LTC2997 +--- Vout
            |                          D- --+         |
        +---+----+                          +---------+
        | Rsense |                               |
        +---+----+                             -----
            |                                   GND
          -----
           GND

  This is based on Linux, documentation:
    https://www.kernel.org/doc/Documentation/devicetree/bindings/iio/afe/temperature-transducer.yaml

compatible: "temperature-transducer"

include: base.yaml

properties:
  io-channels:
    required: true
    description: |
      Channel node of a voltage io-channel.

  sense-offset-millicelsius:
    type: int
    default: 0
    description: |
      Temperature offset in millicelsius.
      This offset is commonly used to convert from Kelvins to degrees Celsius.
      In that case, sense-offset-millicelsius would be set to <(-273150)>.

      When the datasheet specifies an output voltage at a reference temperature
      (e.g., 400 mV at 0°C for the TMP236), the offset must be calculated from
      the transfer function. For a sensor with VOUT = V0 + (alpha × T)

        sense-offset-millicelsius = -(V0_mV × 1,000,000) / alpha-ppm-per-celsius

      Example for TMP236 (V0 = 400 mV at 0°C, alpha = 19.5 mV/°C = 19500 µV/°C)

        sense-offset-millicelsius = -(400 × 1,000,000) / 19500 = -20513

  sense-resistor-ohms:
    type: int
    default: 1
    description: |
      The sense resistor in ohms.
      By default sense-resistor-ohms cancels out the resistor making the
      circuit behave like a temperature transducer.

  alpha-ppm-per-celsius:
    type: int
    required: true
    description: |
      Sometimes referred to as output gain, slope, or temperature coefficient.

      alpha is expressed in parts per million which can be micro-amps per
      degrees Celsius or micro-volts per degrees Celsius. This is the main
      characteristic of a temperature transducer and should be stated in the
      datasheet.

  power-gpios:
    type: phandle-array
    description: |
      GPIO used to control power to the temperature transducer.
      When specified, the driver will automatically enable power during
      sample_fetch() and disable it afterward for power saving.

  power-on-sample-delay-us:
    type: int
    default: 0
    description: |
      Delay in microseconds after enabling power-gpios before sampling.
      This allows the sensor output to stabilize after power-on.
      Consult the sensor datasheet for required startup time.

examples:
  - |
    ad950: temperature-sensor-0 {
        compatible = "temperature-transducer";
        #io-channel-cells = <0>;
        io-channels = <&temp_adc 3>;

        sense-offset-millicelsius = <(-273150)>; /* Kelvin to degrees Celsius */
        sense-resistor-ohms = <8060>;
        alpha-ppm-per-celsius = <1>; /* 1 uA/K */
    };
  - |
    znq_tmp: temperature-sensor-1 {
        compatible = "temperature-transducer";
        #io-channel-cells = <0>;
        io-channels = <&temp_adc 2>;

        sense-offset-millicelsius = <(-273150)>; /* Kelvin to degrees Celsius */
        alpha-ppm-per-celsius = <4000>; /* 4 mV/K */
    };
```

## dts/bindings/iio/io-channel-nexus.yaml
```yaml
# Copyright (c) 2025 TOKITA Hiroshi
# SPDX-License-Identifier: Apache-2.0

# Common fields for io-channel nexus
#
# see 2.5 Nexus Nodes and Specifier Mapping
# https://devicetree-specification.readthedocs.io/en/latest/chapter2-devicetree-basics.html#nexus-nodes-and-specifier-mapping
# in the Devicetree Specification

properties:
  io-channel-map:
    type: compound
    required: true

  io-channel-map-mask:
    type: array

  io-channel-map-pass-thru:
    type: array

  "#io-channel-cells":
    type: int
    required: true
    description: Number of items to expect in the io-channel specifier, such as ADC channels.
```

## dts/bindings/ilc/intel,ilc.yaml
```yaml
description: Interrupt Latency Counter

compatible: "intel,ilc"

include: base.yaml

properties:
  shared-irqs:
    required: true

  shared-irq-count:
    type: int
    required: true
    description: Number of shared interrupt specifier
```

## dts/bindings/input/adafruit,seesaw-gamepad.yaml
```yaml
# Copyright (c) 2026 Charles Dias
# SPDX-License-Identifier: Apache-2.0

description: |
  Adafruit Mini I2C Gamepad with seesaw (product 5743).

  A 2-axis thumbstick + 6-button gamepad communicating over I2C.

  Default I2C address is 0x50. Address can be changed via A0/A1 solder
  jumpers to 0x51, 0x52 or 0x53.

compatible: "adafruit,seesaw-gamepad"

include: i2c-device.yaml

properties:
  polling-interval-ms:
    type: int
    default: 16
    description: |
      Interval between consecutive polls in milliseconds.
      Defaults to 16 ms (~60 Hz).
```

## dts/bindings/input/adc-keys.yaml
```yaml
# Copyright (c) 2024 Chen Xingyu <hi@xingrz.me>
# SPDX-License-Identifier: Apache-2.0

description: |
  Input driver for ADC attached resistor ladder buttons.

  The driver itself does not calculate each possible combination of resistor
  values. Instead, users are required to specify the voltage for each single
  key press or for combinations of key presses.

  Example:

  #include <dt-bindings/input/input-event-codes.h>

  / {
          buttons {
                  compatible = "adc-keys";
                  io-channels = <&adc 2>;
                  keyup-threshold-mv = <0>;

                  key_0 {
                          press-thresholds-mv = <1650>,  /* KEY0 */
                                                <2536>;  /* KEY0 + KEY1 */
                          zephyr,code = <INPUT_KEY_0>;
                  };

                  key_1 {
                          press-thresholds-mv = <2300>,  /* KEY1 */
                                                <2536>;  /* KEY0 + KEY1 */
                          zephyr,code = <INPUT_KEY_1>;
                  };
          };
  };

compatible: "adc-keys"

include: base.yaml

properties:
  io-channels:
    type: phandle-array
    required: true
    description: Phandle to an ADC channel.

  sample-period-ms:
    type: int
    default: 20
    description: |
       Sample period in milliseconds.
       If not specified defaults to 20.

  keyup-threshold-mv:
    type: int
    required: true
    description: |
      Millivolt value to which all the keys are considered up.

child-binding:
  description: ADC KEYS child node.
  properties:
    press-thresholds-mv:
      type: array
      required: true
      description: |
        Array of millivolt values to consider a key pressed.

    zephyr,code:
      type: int
      required: true
      description: Key code to emit.
```

## dts/bindings/input/analog-axis.yaml
```yaml
# Copyright 2023 Google LLC
# SPDX-License-Identifier: Apache-2.0

description: |
  ADC based analog axis input device

  Implement an input device generating absolute axis events by periodically
  reading from some ADC channels.

  Example configuration:

  #include <zephyr/dt-bindings/input/input-event-codes.h>

  analog_axis {
          compatible = "analog-axis";
          poll-period-ms = <15>;
          axis-x {
                  io-channels = <&adc 0>;
                  out-deadzone = <8>;
                  in-min = <100>;
                  in-max = <800>;
                  zephyr,axis = <INPUT_ABS_X>;
          };
  };

compatible: "analog-axis"

include: base.yaml

properties:
  poll-period-ms:
    type: int
    default: 15
    description: |
      How often to get new ADC samples for the various configured axes in
      milliseconds. Defaults to 15ms if unspecified.

child-binding:
  properties:
    io-channels:
      type: phandle-array
      required: true
      description: |
        ADC IO channel to use.

    out-min:
      type: int
      default: 0
      description: |
        Minimum value to output on input events. Defaults to 0 if unspecified.

    out-max:
      type: int
      default: 255
      description: |
        Maximum value to output on input events. Defaults to 255 if
        unspecified.

    out-deadzone:
      type: int
      default: 0
      description: |
        Deadzone for the output center value. If specified output values
        between the center of the range plus or minus this value will be
        reported as center. Defaults to 0, no deadzone.

    in-min:
      type: int
      required: true
      description: |
        Input value that corresponds to the minimum output value.

    in-max:
      type: int
      required: true
      description: |
        Input value that corresponds to the maximum output value.

    zephyr,axis:
      type: int
      required: true
      description: |
        The input code for the axis to report for the device, typically any of
        INPUT_ABS_*.

    invert:
      type: boolean
      description: |
        If set, invert the raw ADC value before processing it. Useful for
        differential channels.
```

## dts/bindings/input/arduino,modulino-buttons.yaml
```yaml
# Copyright (c) 2025 Google, LLC
# SPDX-License-Identifier: Apache-2.0

description: Arduino Modulino buttons

compatible: "arduino,modulino-buttons"

properties:
  zephyr,codes:
    type: array
    required: true
    description: |
      Key codes to emit, the module has three buttons so this must specify
      three key codes.

  poll-period-ms:
    type: int
    default: 50
    description: |
      How often to poll the buttons over the i2c bus, defaults to 50ms.
```
