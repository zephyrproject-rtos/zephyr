## dts/bindings/pcie/host/ptm-root.yaml
```yaml
# Copyright (c) 2021 Intel Corporation
# SPDX-License-Identifier: Apache-2.0

# Common fields for PCIe PTM root

include: base.yaml

properties:
    reg:
      required: true
```

## dts/bindings/peci/ite,it8xxx2-peci.yaml
```yaml
# Copyright (c) 2022 ITE Corporation. All Rights Reserved.
# SPDX-License-Identifier: Apache-2.0

description: ITE it8xxx2 PECI

compatible: "ite,it8xxx2-peci"

include: [peci.yaml, pinctrl-device.yaml]

properties:
  pinctrl-0:
    required: true

  pinctrl-names:
    required: true
```

## dts/bindings/peci/microchip,xec-peci.yaml
```yaml
# Copyright (c) 2020, Intel Corporation
# SPDX-License-Identifier: Apache-2.0

description: Microchip XEC PECI controller

compatible: "microchip,xec-peci"

include: [peci.yaml, pinctrl-device.yaml]

properties:
    reg:
      required: true

    interrupts:
      required: true

    girqs:
      type: array
      required: true
      description: Array of pairs of GIRQ number and bit position

    pcrs:
      type: array
      required: true
      description: ADC PCR register index and bit position

girq-cells:
    - girqnum
    - bitpos

pcr-cells:
    - regidx
    - bitpos
```

## dts/bindings/peci/nuvoton,nct-peci.yaml
```yaml
# Copyright (c) 2022 Nuvoton Technology Corporation.
# SPDX-License-Identifier: Apache-2.0

description: Nuvoton NCT PECI node

compatible: "nuvoton,nct-peci"

include: [peci.yaml, pinctrl-device.yaml]

properties:
  pinctrl-0:
    required: true
```

## dts/bindings/peci/nuvoton,npcx-peci.yaml
```yaml
# Copyright (c) 2022 Nuvoton Technology Corporation.
# SPDX-License-Identifier: Apache-2.0

description: Nuvoton NPCX PECI node

compatible: "nuvoton,npcx-peci"

include: [peci.yaml, pinctrl-device.yaml]

properties:
    pinctrl-0:
      required: true

    pinctrl-names:
      required: true
```

## dts/bindings/pgmc_bpc/nxp,imx-pgmc-bpc.yaml
```yaml
# Copyright (c) 2018, Linaro Limited
# SPDX-License-Identifier: Apache-2.0

description: NXP MCUX power gating and memory control

compatible: "nxp,imx-pgmc-bpc"

include: base.yaml

properties:
    label:
      required: true
```

## dts/bindings/phy/can-transceiver-gpio.yaml
```yaml
# Copyright (c) 2022 Vestas Wind Systems A/S
# SPDX-License-Identifier: Apache-2.0

description: Simple GPIO controlled CAN transceiver

compatible: "can-transceiver-gpio"

include: can-transceiver.yaml

properties:
  enable-gpios:
    type: phandle-array
    description: |
      GPIO to use to enable/disable the CAN transceiver. This GPIO is driven
      active when the CAN transceiver is enabled and inactive when the CAN
      transceiver is disabled.

  standby-gpios:
    type: phandle-array
    description: |
      GPIO to use to put the CAN transceiver into standby. This GPIO is driven
      inactive when the CAN transceiver is enabled and active when the CAN
      transceiver is disabled.
```

## dts/bindings/phy/lin-transceiver-gpio.yaml
```yaml
# Copyright (c) 2025 Renesas Electronics Corporation
# SPDX-License-Identifier: Apache-2.0

description: GPIO-controlled LIN transceiver

compatible: "lin-transceiver-gpio"

include: lin-transceiver.yaml

properties:
  enable-gpios:
    type: phandle-array
    description: |
      GPIO to use to enable/disable the LIN transceiver. This GPIO is driven
      active when the LIN transceiver is enabled and inactive when the LIN
      transceiver is disabled.

  wakeup-gpios:
    type: phandle-array
    description: |
      GPIO to use to wake up the LIN transceiver from standby. This GPIO is driven
      inactive when the LIN transceiver is enabled and active when the LIN
      transceiver is disabled.
```

## dts/bindings/phy/lin-transceiver.yaml
```yaml
# Common fields for LIN transceivers

# Copyright (c) 2025 Renesas Electronics Corporation
# SPDX-License-Identifier: Apache-2.0

include: phy-controller.yaml

properties:
  min-bitrate:
    type: int
    description: |
      The minimum bitrate supported by the CAN transceiver in bits/s.

  max-bitrate:
    type: int
    required: true
    description: |
      The maximum bitrate supported by the CAN transceiver in bits/s.

  "#phy-cells":
    const: 0
```

## dts/bindings/phy/nxp,imx95-dphy-rx.yaml
```yaml
# Copyright 2026 NXP
# SPDX-License-Identifier: Apache-2.0

description: NXP i.MX95 MIPI DPHY Receiver

compatible: "nxp,imx95-dphy-rx"

include: [base.yaml]

properties:
  reg:
    required: true
    description: |
      Register regions for DPHY CSR and CSI-2 interface registers.
      First region is the D-PHY CSR registers.
      Second region is the CSI-2 host registers used for PHY control.

  reg-names:
    required: true

  clocks:
    type: phandle-array
    description: |
      PHY configuration clock. This is typically a 24MHz reference clock.

  clock-names:
    type: string-array
    description: |
      Clock names.

  power-domains:
    type: phandle-array
    description: |
      Power domain for the DPHY.

  "#phy-cells":
    type: int
    const: 0
    description: |
      Number of cells in a PHY specifier.
```

## dts/bindings/phy/phy-controller.yaml
```yaml
# Copyright (c) 2018, Yannis Damigos
# SPDX-License-Identifier: Apache-2.0

# Common fields for PHY providers

include: base.yaml

properties:
  "#phy-cells":
    type: int
    required: true
    description: |
      Number of cells in a PHY provider. The meaning those
      cells is defined by the binding for the phy node.
```

## dts/bindings/phy/phy.yaml
```yaml
#
# Copyright (c) 2018, Yannis Damigos
#
# SPDX-License-Identifier: Apache-2.0
#

title: PHY Base Structure
version: 0.1

description: >
    This binding gives the base structures for all PHY providers

inherits:
    !include base.yaml

properties:
    "#phy-cells":
        type: int
        category: required
        description: Number of cells in a PHY provider. The meaning those
                     cells is defined by the binding for the phy node.
```

## dts/bindings/phy/renesas,ra-usbphyc.yaml
```yaml
# Copyright (c) 2024 Renesas Electronics Corporation
# SPDX-License-Identifier: Apache-2.0

description: Renesas RA USBHS internal PHY controller

compatible: "renesas,ra-usbphyc"

include: phy-controller.yaml

properties:
  clock:
    type: phandle
    description: |
      Clock source for PHY clock in case internal clock is using

  phys-clock-src:
    type: string
    enum:
      - "internal"
      - "xtal"
    description: |
      Select clock source for PHY clock as XTAL or use internal clock

  "#phy-cells":
    const: 0
```

## dts/bindings/phy/st,stm32-embedded-usb-phy.yaml
```yaml
# Copyright (c) 2025 STMicroelectronics
# SPDX-License-Identifier: Apache-2.0

description: STM32 embedded USB PHY

compatible: "st,stm32-embedded-usb-phy"

include: phy-controller.yaml

properties:
  high-speed:
    type: boolean
    description: |
      Set this property to indicate the instance is a High-Speed USB PHY.
      Otherwise, the instance is treated as a Full-Speed USB PHY.

  "#phy-cells":
    const: 0
```

## dts/bindings/phy/st,stm32h5-otghs-phy.yaml
```yaml
# Copyright (c) 2026 Arkadiusz Grzelka
# Copyright (c) 2026 Linumiz GmbH
# SPDX-License-Identifier: Apache-2.0

description: |
    STM32H5 OTG_HS embedded PHY.

    Covers the embedded High-Speed PHY built into STM32H5E5x/STM32H5F5x
    parts. It is the same PHY IP as the one described by
    st,stm32u5-otghs-phy, but on this family the reference-clock selector
    and the PHY enable/reset controls live in RCC (CCIPR4.OTGPHYREFCKSEL,
    AHB2ENR.OTGPHYEN, AHB2RSTR.OTGHSPHYRST) instead of the SYSCFG
    OTGHSPHYCR register, hence a distinct compatible.

compatible: "st,stm32h5-otghs-phy"

include: [phy-controller.yaml, reset-device.yaml]

properties:
  "#phy-cells":
    const: 0

  clocks:
    required: true
    description: |
      First entry gates the PHY block itself (RCC_AHB2ENR.OTGPHYEN).
      Second entry selects the OTG_HS kernel clock (RCC_CCIPR4.OTGHSSEL)
      using the OTGHS_SEL() macro. Supported configurations:

        /* HSE */
        clocks = <&rcc STM32_CLOCK(AHB2, 13)>,
                 <&rcc STM32_SRC_HSE OTGHS_SEL(0)>;

        /* PLL3_Q */
        clocks = <&rcc STM32_CLOCK(AHB2, 13)>,
                 <&rcc STM32_SRC_PLL3_Q OTGHS_SEL(1)>;

        /* HSE/2 */
        clocks = <&rcc STM32_CLOCK(AHB2, 13)>,
                 <&rcc (STM32_SRC_HSE | STM32_CLOCK_DIV(2)) OTGHS_SEL(2)>;

        /* PLL1_Q/2 */
        clocks = <&rcc STM32_CLOCK(AHB2, 13)>,
                 <&rcc (STM32_SRC_PLL1_Q | STM32_CLOCK_DIV(2)) OTGHS_SEL(3)>;

  resets:
    required: true
    description: |
      PHY reset line (RCC_AHB2RSTR.OTGHSPHYRST), deasserted by the driver
      before the PHY clock is turned on.

  clock-reference:
    type: string
    required: true
    enum:
      - "16M"
      - "19_2M"
      - "20M"
      - "24M"
      - "26M"
      - "32M"
    description: |
      Reference clock frequency fed to the PHY PLL, written to
      RCC_CCIPR4.OTGPHYREFCKSEL. This must match the frequency actually
      produced by the kernel clock selected through the second `clocks`
      entry, otherwise the PHY PLL will not lock.
```

## dts/bindings/phy/st,stm32u5-otghs-phy.yaml
```yaml
# Copyright (c) 2024 Marcin Niestroj
# Copyright (c) 2024 Meta
# Copyright (c) 2026 STMicroelectronics
# SPDX-License-Identifier: Apache-2.0

title: STM32 USB HS PHY

description: |
    USB High-Speed PHY as first found in STM32U5 series.

    PHYs described by this binding are configured using registers located
    in a shared IP such as RCC or SYSCFG, unlike `st,stm32-usbphyc` PHYs
    which have dedicated MMIO interfaces.

compatible: "st,stm32u5-otghs-phy"

include: phy-controller.yaml

properties:
  "#phy-cells":
    const: 0

  clocks:
    required: true

  clock-reference:
    type: string
    required: true
    enum:
      - "16M"
      - "19.2M"
      - "20M"
      - "24M"
      - "26M"
      - "32M"
    description: |
      Input frequency of the HS PHY (in MHz: "1M" = 1 MHz)

      The correct value depends on the system's clock configuration,
      including the `clocks` property of this node.

examples:
  - |
    /* Supported clock configurations on STM32U5 */

    /* HSE */
    clocks = <&rcc STM32_CLOCK(AHB2, 15)>,
              <&rcc STM32_SRC_HSE OTGHS_SEL(0)>;

    /* HSE/2 */
    clocks = <&rcc STM32_CLOCK(AHB2, 15)>,
              <&rcc (STM32_SRC_HSE | STM32_CLOCK_DIV(2)) OTGHS_SEL(2)>;

    /* PLL1_P_CK */
    clocks = <&rcc STM32_CLOCK(AHB2, 15)>,
              <&rcc STM32_SRC_PLL1_P OTGHS_SEL(1)>;

    /* PLL1_P_CK/2 */
    clocks = <&rcc STM32_CLOCK(AHB2, 15)>,
              <&rcc (STM32_SRC_PLL1_P | STM32_CLOCK_DIV(2)) OTGHS_SEL(3)>;
```

## dts/bindings/phy/usb-nop-xceiv.yaml
```yaml
# Copyright (c) 2018, Yannis Damigos
# SPDX-License-Identifier: Apache-2.0

description: |
    This binding is to be used by all the usb transceivers which are built-in
    with USB IP

compatible: "usb-nop-xceiv"

include: phy-controller.yaml

properties:
  "#phy-cells":
    const: 0
```

## dts/bindings/phy/usb-ulpi-phy.yaml
```yaml
# Copyright (c) 2022 Meta Platforms
# SPDX-License-Identifier: Apache-2.0

description: |
    This binding is to be used by all the usb transceivers which are an external
    ULPI phy

compatible: "usb-ulpi-phy"

include: phy-controller.yaml

properties:
  "#phy-cells":
    const: 0

  reset-gpios:
    type: phandle-array
    description: |
      GPIO connected to the ulpi RESET pin.
```

## dts/bindings/pinctrl/adi,max32-pinctrl.yaml
```yaml
# Copyright (c) 2023-2024 Analog Devices, Inc.
# SPDX-License-Identifier: Apache-2.0

description: |
  MAX32 Pin Controller

  Based on pincfg-node.yaml binding.
  Note: `bias-disable`  are default pin configurations.

compatible: "adi,max32-pinctrl"

include: base.yaml

properties:
  reg:
    required: true


child-binding:
  description: |
    Base binding configuration for ADI MAX32xxx MCUs

  include:
    - name: pincfg-node.yaml
      property-allowlist:
        - bias-disable
        - bias-pull-down
        - bias-pull-up
        - output-low
        - output-high
        - input-enable
        - output-enable
        - power-source
        - drive-strength

  properties:
    pinmux:
      required: true
      type: int
      description: |
        Integer array, represents gpio pin number and mux setting.
        These defines are calculated as: (pin<<8 | port<<4 | function<<0)
        With:
        - port: The gpio port index (0, 1, ...)
        - pin: The pin offset within the port (0, 1, 2, ...)
        - function: The function number, can be:
        * 0 : GPIO
        * 1 : Alternate Function 1
        * 2 : Alternate Function 2
        * 3 : Alternate Function 3
        * 4 : Alternate Function 4
        In case selected pin function is GPIO, pin is statically configured as
        a plain input/output GPIO. Default configuration is input. Output value
        can be configured by adding 'ouptut-low' or 'output-high' properties
        to the pin configuration.

        To simplify the usage, macro is available to generate "pinmux" field.
        This macro is available here:
          -include/zephyr/dt-bindings/pinctrl/max32-pinctrl.h
        Some examples of macro usage:
        P0.9 set as alernate function 1
        {
          pinmux = <MAX32_PINMUX(0, 9, AF1)>;
        };
        P0.9 set as alernate function 2
        {
          pinmux = <MAX32_PINMUX(0, 9, AF2)>;
        };
        P0.9 set as GPIO output high
        {
          pinmux = <MAX32_PINMUX(0, 9, GPIO)>;
          output-high;
        };
    power-source:
      enum: [0, 1]
      description: |
        GPIO Supply Voltage Select, Selects the voltage rail used for the pin.
        0 or MAX32_VSEL_VDDIO
        1 or MAX32_VSEL_VDDIOH
    drive-strength:
      default: 0
      enum: [0, 1, 2, 3]
      description: |
        There are 4 drive strength mode.
        Mode 0: 1mA
        Mode 1: 2mA
        Mode 2: 4mA
        Mode 3: 8mA
        Default GPIO output drive strength is mode 0 for MAX32 MCUs.
        For more information please take a look device user guide, datasheet.
```

## dts/bindings/pinctrl/aesc,pinctrl.yaml
```yaml
# SPDX-FileCopyrightText: 2026 Aesc Silicon
# SPDX-License-Identifier: Apache-2.0

description: |
  Aesc pin controller.

  The Aesc pin controller is a simple digital multiplexer that selects
  between input sources for each pin. Configuration is defined in child
  nodes, each specifying a pinmux property as a pair of <pin, function>.

  Available mux functions:
    - AESC_PINMUX_MUX0
    - AESC_PINMUX_MUX1

  Example: configuring pins 4 and 5 with different mux selections:

    #include <zephyr/dt-bindings/pinctrl/aesc-pinctrl.h>

    &pinctrl {
      uart0_rx_default: uart0_rx_default {
        pinmux = <4 AESC_PINMUX_MUX0>;
      };
      uart0_tx_default: uart0_tx_default {
        pinmux = <5 AESC_PINMUX_MUX1>;
      };
    };

compatible: "aesc,pinctrl"

include: base.yaml

properties:
  reg:
    required: true

child-binding:
  description: |
    Each child node defines the mux configuration for a single pin.
    The pinmux property takes a pair of <pin_number, mux_function>.

  properties:
    pinmux:
      required: true
      type: array
      description: |
        A pair of <pin, function> where pin is the pin index and
        function is one of the AESC_PINMUX_MUX* constants defined
        in dt-bindings/pinctrl/aesc-pinctrl.h.
```
