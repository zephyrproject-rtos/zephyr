## dts/bindings/pinctrl/alif,pinctrl.yaml
```yaml
# Copyright (c) 2025 Alif Semiconductor
# SPDX-License-Identifier: Apache-2.0

title: Alif Semiconductor pin controller
description: |
  The Alif pin controller manages pin multiplexing and pad configuration for
  Alif SoCs. Each I/O pin can be assigned to one of up to eight alternate
  functions (peripheral signals). Additionally, pad configuration settings
  control electrical properties such as input enable, drive strength, and
  slew rate.

  I/O pins are organized into ports, with each port containing up to 8 pins.
  Pin multiplexing configurations are specified using predefined macros from
  the SoC-specific pinctrl header (e.g., alif-ensemble-pinctrl.h). These macros
  encode the port, pin number, and alternate function.

  For example, PIN_P0_0__UART0_RX_A represents port 0, pin 0, configured for the
  UART0 RX alternate function.

  Pad configuration is specified using standard pinctrl properties.

  Example:

    #include <dt-bindings/pinctrl/alif-ensemble-pinctrl.h>

    &pinctrl {
      uart4_default: uart4_default {
        group0 {
          pinmux = <PIN_P12_1__UART4_RX_B>;
          input-enable;
        };
        group1 {
          pinmux = <PIN_P12_2__UART4_TX_B>;
        };
      };
    };

  In the example above:
  - "&pinctrl" references the pin controller node defined in the SoC devicetree.
  - "uart4_default" is a user-defined state node that groups all pin configurations
    for UART4's default operating state.
  - "group0" and "group1" are pin group nodes. Pins within a group share the same
    pad configuration properties. The RX pin needs input-enable, while the TX pin
    uses default settings, so they are placed in separate groups.
  - "pinmux = <PIN_P12_1__UART4_RX_B>" specifies the pin function. The macro
    PIN_P12_1__UART4_RX_B selects port 12, pin 1, configured for UART4 RX function.
    These macros are defined in alif-ensemble-pinctrl.h.
  - "input-enable" enables the input buffer for the RX pin. Other pad
    configuration properties are supported as defined in the property-allowlist.

  To link the pin configuration to a device:

    &uart4 {
      pinctrl-0 = <&uart4_default>;
      pinctrl-names = "default";
    };

compatible: "alif,pinctrl"

include: base.yaml

properties:
  reg:
    required: true
    description: |
      Pin controller register regions. Two regions are required:
      1. Main pinctrl registers for GPIO ports P0-P14
      2. LPGPIO pinctrl registers for low-power GPIO

  reg-names:
    required: true
    description: |
      Names for the register regions:
      - "pinctrl": Main GPIO pin control registers
      - "lpgpio_pinctrl": Low-power GPIO pin control registers

child-binding:
  description: |
    Pin configuration state node. Each child represents a named pinctrl
    state (e.g., "default", "sleep") containing one or more pin groups.

  child-binding:
    description: |
      Pin group node. Pins within a group share the same pad configuration
      properties. Use multiple groups when pins require different settings.

    include:
      - name: pincfg-node.yaml
        property-allowlist:
          - bias-high-impedance
          - bias-pull-up
          - bias-pull-down
          - bias-bus-hold
          - input-enable
          - input-disable
          - input-schmitt-enable
          - input-schmitt-disable
          - drive-push-pull
          - drive-open-drain
          - drive-strength

    properties:
      pinmux:
        required: true
        type: array
        description: |
          Array of pin function selections. Each element is a 32-bit value
          encoding port, pin, and alternate function using ALIF_PINMUX() or
          predefined macros from alif-ensemble-pinctrl.h (e.g., PIN_P0_0__UART0_RX_A).

      drive-strength:
        type: int
        enum: [2, 4, 8, 12]
        default: 4
        description: |
          Output drive strength in milliamps.
          - 2: 2 mA
          - 4: 4 mA (default)
          - 8: 8 mA
          - 12: 12 mA

      slew-rate:
        type: string
        enum:
          - "slow"
          - "fast"
        default: "slow"
        description: |
          Output slew rate control.
          - slow: Slow slew rate (default)
          - fast: Fast slew rate
```

## dts/bindings/pinctrl/allwinner,sun50i-h618-pinctrl.yaml
```yaml
description: Allwinner H618 Pin Controller

compatible: "allwinner,sun50i-h618-pinctrl"

include: [base.yaml]

properties:
  reg:
    required: true

child-binding:
  description: Pinmux configuration nodes
  include:
    - name: pincfg-node.yaml
      property-allowlist:
        - bias-pull-up
        - bias-pull-down
        - bias-disable
        - drive-strength
  properties:
    pinmux:
      required: true
      type: array
      description: |
        An array of pins sharing the same properties. Each element is an integer
        created by SUNXI_PINMUX macro in dt-bindings/pinctrl/sunxi-pinctrl.h
```

## dts/bindings/pinctrl/ambiq,apollo2-pinctrl.yaml
```yaml
# SPDX-License-Identifier: Apache-2.0
#
# Copyright (c) 2025 Linumiz GmbH
# Author: Sri Surya  <srisurya@linumiz.com>

description: |
  The Ambiq Apollo2 pin controller is responsible for controlling pin
  function selection and pin properties such as routing UART0 TX to a
  specific pin and enabling pull-ups.

  This node uses the 'pinctrl' node label, so you can modify it like:

  &pinctrl {
    /* modifications here */
  };

  Example usage in a board or overlay:

  #include <dt-bindings/pinctrl/ambiq-apollo2-pinctrl.h>

  &pinctrl {
    uart0_default: uart0_default {
      group1 {
        pinmux = <UART0TX_P15>;
      };
      group2 {
        pinmux = <UART0RX_P14>;
        input-enable;
      };
    };
  };

  Each pin group sets common configuration for pins in that group.

compatible: "ambiq,apollo2-pinctrl"

include: base.yaml

child-binding:
  description: |
    Definitions for a pinctrl state on Apollo2.
  child-binding:

    include:
      - name: pincfg-node.yaml
        property-allowlist:
          - input-enable
          - bias-pull-up
          - drive-open-drain

    properties:
      pinmux:
        required: true
        type: array
        description: |
          An array of pins using the same group properties. Each element is
          an encoded integer representing pin number and function.

      drive-strength:
        type: int
        enum:
          - 2
          - 4
          - 8
          - 12
        default: 2
        description: |
          Drive strength for the pin in mA.

      ambiq,pull-up-ohms:
        type: int
        enum:
          - 1500
          - 6000
          - 12000
          - 24000
        default: 1500
        description: |
          Pull-up resistance value in ohms.
```

## dts/bindings/pinctrl/ambiq,apollo3-pinctrl.yaml
```yaml
# Copyright (c) 2023 Ambiq Micro Inc. <www.ambiq.com>
# SPDX-License-Identifier: Apache-2.0

description: |
  The Ambiq Apollo3 pin controller is a node responsible for controlling
  pin function selection and pin properties, such as routing a UART0 TX
  to pin 60 and enabling the pullup resistor on that pin.

  The node has the 'pinctrl' node label set in your SoC's devicetree,
  so you can modify it like this:

  &pinctrl {
    /* your modifications go here */
  };

  All device pin configurations should be placed in child nodes of the
  'pinctrl' node, as shown in this example:

  /* You can put this in places like a board-pinctrl.dtsi file in
   * your board directory, or a devicetree overlay in your application.
  */

  /* include pre-defined combinations for the SoC variant used by the board */
  #include <dt-bindings/pinctrl/ambiq-apollo3-pinctrl.h>

  &pinctrl {
    uart0_default: uart0_default {
      group1 {
        pinmux = <UART0TX_P60>;
      };
      group2 {
        pinmux = <UART0RX_P47>;
        input-enable;
      };
    };
  };

  The 'uart0_default' child node encodes the pin configurations for a
  particular state of a device; in this case, the default (that is, active)
  state.

  As shown, pin configurations are organized in groups within each child node.
  Each group can specify a list of pin function selections in the 'pinmux'
  property.

  A group can also specify shared pin properties common to all the specified
  pins, such as the 'input-enable' property in group 2.

compatible: "ambiq,apollo3-pinctrl"

include: base.yaml

child-binding:
  description: |
    Definitions for a pinctrl state.
  child-binding:

    include:
      - name: pincfg-node.yaml
        property-allowlist:
          - input-enable
          - drive-push-pull
          - drive-open-drain
          - bias-high-impedance
          - bias-pull-up
          - bias-pull-down

    properties:
      pinmux:
        required: true
        type: array
        description: |
          An array of pins sharing the same group properties. Each
          element of the array is an integer constructed from the
          pin number and the alternative function of the pin.
      drive-strength:
        type: string
        enum:
          - "0.1"
          - "0.5"
          - "0.75"
          - "1.0"
        default: "0.1"
        description: |
          The drive strength of a pin, relative to full-driver strength.
          The default value is 0.1, which is the reset value of resigers
          PADREGx.PADnSTRNG and ALTPADCFGx.PADn_DS1.
      ambiq,pull-up-ohms:
        type: int
        enum:
          - 1500
          - 6000
          - 12000
          - 24000
        default: 1500
        description: |
          The 1.5K-24K pullup values are valid for select I2C enabled pads.
          For Apollo3 these pins are 0-1,5-6,8-9,25,27,39-40,42-43,48-49.
          The default value is 1500 ohms, which is the reset value of
          register PADREGx.PADxRSEL.
      ambiq,iom-nce-module:
        type: int
        default: 0
        description: |
          IOM nCE module select, selects the SPI channel (CE) number (0-3).
          The default value is 0, which is the reset value of
          register CFGx.GPIOnOUTCFG. If the pin is not a CE, this
          descriptor will be ignored.
      ambiq,iom-mspi:
        type: int
        default: 0
        description: |
          Indicates the module which uses specific CE pin, 1 if CE is IOM, 0 if MSPI.
          User should check g_ui8NCEtable in am_hal_gpio.c for the mapping
          information and config the pins accordingly, we give a default value
          0 here to make it be consistent with AM_HAL_GPIO_PINCFG_DEFAULT in
          ambiq hal. If the pin is not a CE, this descriptor will be ignored.
      ambiq,iom-num:
        type: int
        default: 0
        description: |
          Indicates the instance which uses specific CE pin.
          IOM number (0-5) or MSPI (0-2).
          User should check g_ui8NCEtable in am_hal_gpio.c for the mapping
          information and config the pins accordingly, we give a default value
          0 here to make it be consistent with AM_HAL_GPIO_PINCFG_DEFAULT in
          ambiq hal. If the pin is not a CE, this descriptor will be ignored.
```

## dts/bindings/pinctrl/ambiq,apollo4-pinctrl.yaml
```yaml
# Copyright (c) 2023 Antmicro <www.antmicro.com>
# SPDX-License-Identifier: Apache-2.0

description: |
    The Ambiq Apollo4 pin controller is a node responsible for controlling
    pin function selection and pin properties, such as routing a UART0 TX
    to pin 60 and enabling the pullup resistor on that pin.

    The node has the 'pinctrl' node label set in your SoC's devicetree,
    so you can modify it like this:

      &pinctrl {
              /* your modifications go here */
      };

    All device pin configurations should be placed in child nodes of the
    'pinctrl' node, as shown in this example:

      /* You can put this in places like a board-pinctrl.dtsi file in
       * your board directory, or a devicetree overlay in your application.
       */

      /* include pre-defined combinations for the SoC variant used by the board */
      #include <dt-bindings/pinctrl/ambiq-apollo4-pinctrl.h>

      &pinctrl {
        uart0_default: uart0_default {
          group1 {
            pinmux = <UART0TX_P60>;
          };
          group2 {
            pinmux = <UART0RX_P47>;
            input-enable;
          };
        };
      };

    The 'uart0_default' child node encodes the pin configurations for a
    particular state of a device; in this case, the default (that is, active)
    state.

    As shown, pin configurations are organized in groups within each child node.
    Each group can specify a list of pin function selections in the 'pinmux'
    property.

    A group can also specify shared pin properties common to all the specified
    pins, such as the 'input-enable' property in group 2.

compatible: "ambiq,apollo4-pinctrl"

include: base.yaml

child-binding:
  description: |
    Definitions for a pinctrl state.
  child-binding:

    include:
      - name: pincfg-node.yaml
        property-allowlist:
          - input-enable
          - drive-push-pull
          - drive-open-drain
          - bias-high-impedance
          - bias-pull-up
          - bias-pull-down

    properties:
      pinmux:
        required: true
        type: array
        description: |
          An array of pins sharing the same group properties. Each
          element of the array is an integer constructed from the
          pin number and the alternative function of the pin.
      drive-strength:
        type: string
        enum:
          - "0.1"
          - "0.5"
          - "0.75"
          - "1.0"
        default: "0.1"
        description: |
          The drive strength of a pin, relative to full-driver strength.
          The default value is 0.1, which is the reset value.
      slew-rate:
        type: string
        enum:
          - "slow"
          - "fast"
        default: "slow"
        description: |
          Select slew rate for a pin. The default is slow, which is the reset value.
      ambiq,pull-up-ohms:
        type: int
        enum:
          - 1500
          - 6000
          - 12000
          - 24000
          - 50000
          - 100000
        default: 1500
        description: |
          The pullup resistor value. The default value is 1500 ohms.
      ambiq,iom-nce-module:
        type: int
        default: 0
        description: |
          IOM nCE module select. The default value is reset value.
```
