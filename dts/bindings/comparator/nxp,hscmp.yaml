## dts/bindings/comparator/nxp,hscmp.yaml
```yaml
# Copyright 2025 NXP
# SPDX-License-Identifier: Apache-2.0

description: |
  NXP High Speed Comparator (HSCMP)

compatible: "nxp,hscmp"

include:
  - base.yaml
  - pinctrl-device.yaml
  - reset-device.yaml

properties:
  reg:
    required: true

  interrupts:
    required: true

  clocks:
    required: true

  resets:
    required: true

  power-mode:
    type: string
    enum:
      - "low_speed"
      - "high_speed"
      - "nano_power"
    description: |
      Select comparator power/speed mode.

  hysteresis-mode:
    type: string
    enum:
      - "LEVEL0"
      - "LEVEL1"
      - "LEVEL2"
      - "LEVEL3"
    description: |
      Comparator hysteresis level.

  enable-stop-mode:
    type: boolean
    description: |
      Allow the comparator to remain enabled in STOP mode.

  invert-output:
    type: boolean
    description: |
      Invert comparator output.

  enable-pin-out:
    type: boolean
    description: |
      Drive comparator output on the associated pin.

  use-unfiltered-output:
    type: boolean
    description: |
      Route unfiltered comparator output to COUT.
      When false, the filtered output is used and filter parameters
      are taken from filter-count and filter-period.

  filter-count:
    type: int
    enum: [0, 1, 2, 3, 4, 5, 6, 7]
    description: |
      Number of consecutive samples that must agree before updating
      the filtered output. Set to 0 to bypass the filter.

  filter-period:
    type: int
    description: |
      Sampling period for the filter in bus clock cycles.
      Valid range: 0 - 255.

  dac-vref-source:
    type: string
    enum:
      - "VREFH0"
      - "VREFH1"
    description: |
      DAC reference high-voltage source selection.

  dac-value:
    type: int
    description: |
      8-bit DAC code used when an input channel is set to DAC output.
      Valid range: 0 - 255.

  positive-mux-input:
    type: string
    enum:
      - "IN0"
      - "IN1"
      - "IN2"
      - "IN3"
      - "IN4"
      - "IN5"
      - "DAC"
    description: |
      Positive input multiplexer selection. "DAC" routes the internal DAC output.

  negative-mux-input:
    type: string
    enum:
      - "IN0"
      - "IN1"
      - "IN2"
      - "IN3"
      - "IN4"
      - "IN5"
      - "DAC"
    description: |
      Negative input multiplexer selection. "DAC" routes the internal DAC output.

  nxp,references:
    type: phandle-array
    description: |
      References to required regulators which must be enabled for HSCMP to function
```

## dts/bindings/comparator/nxp,kinetis-acmp.yaml
```yaml
# Copyright (c) 2020 Vestas Wind Systems A/S
# Copyright (c) 2024 Nordic Semiconductor ASA
# SPDX-License-Identifier: Apache-2.0

description: |
  NXP Kinetis ACMP (Analog CoMParator)

  The following example displays the minimum node layout:

    acmp0: acmp@deadbeef {
            compatible = "nxp,kinetis-acmp";
            reg = <0xdeadbeef 0x1000>;
            interrupts = <0 0>;
            clocks = <&scg KINETIS_SCG_BUS_CLK>;
            status = "disabled";
    };

  Enabling the comparator node requires setting the minimum default
  configuration of the comparator. This includes selecting the
  positive and negative inputs, and routing them using pinctrl:

    &pinctrl {
            acmp0_default: acmp0_default {
                    group0 {
                            ...
                    };
            };
    };

    &acmp0 {
            status = "okay";
            pinctrl-0 = <&acmp0_default>;
            pinctrl-names = "default";

            positive-mux-input = "IN0";
            negative-mux-input = "IN1";
    };

compatible: "nxp,kinetis-acmp"

include:
  - base.yaml
  - pinctrl-device.yaml

properties:
  interrupts:
    required: true

  reg:
    required: true

  nxp,enable-output-pin:
    type: boolean
    deprecated: true
    description: Deprecated. Please use enable-pin-out instead

  nxp,use-unfiltered-output:
    type: boolean
    deprecated: true
    description: Deprecated. Please use use-unfiltered-output instead

  nxp,high-speed-mode:
    type: boolean
    deprecated: true
    description: Deprecated. Please use enable-high-speed-mode instead

  nxp,enable-sample:
    type: boolean
    deprecated: true
    description: Deprecated. Please use filter-enable-sample instead

  nxp,filter-count:
    type: int
    deprecated: true
    description: Deprecated. Please use filter-count instead

  nxp,filter-period:
    type: int
    deprecated: true
    description: Deprecated. Please use filter-period instead

  nxp,window-mode:
    type: boolean
    deprecated: true
    description: Deprecated. Please use enable-window-mode instead

  offset-mode:
    type: string
    enum:
      - "LEVEL0"
      - "LEVEL1"

  hysteresis-mode:
    type: string
    enum:
      - "LEVEL0"
      - "LEVEL1"
      - "LEVEL2"
      - "LEVEL3"

  enable-high-speed-mode:
    type: boolean

  invert-output:
    type: boolean

  use-unfiltered-output:
    type: boolean

  enable-pin-out:
    type: boolean

  enable-window-mode:
    type: boolean

  positive-mux-input:
    type: string
    enum:
      - IN0
      - IN1
      - IN2
      - IN3
      - IN4
      - IN5
      - IN6
      - IN7

  negative-mux-input:
    type: string
    enum:
      - IN0
      - IN1
      - IN2
      - IN3
      - IN4
      - IN5
      - IN6
      - IN7

  positive-port-input:
    type: string
    enum:
      - DAC
      - MUX

  negative-port-input:
    type: string
    enum:
      - DAC
      - MUX

  filter-enable-sample:
    type: boolean

  filter-count:
    type: int
    description: Filter sample count (0 to 7).

  filter-period:
    type: int
    description: Filter sample period in bus clock cycles (0 to 255).

  dac-vref-source:
    type: string
    enum:
      - "VIN1"
      - "VIN2"

  dac-value:
    type: int

  dac-enable:
    type: boolean

  dac-enable-high-speed:
    type: boolean

  discrete-mode-enable-positive-channel:
    type: boolean

  discrete-mode-enable-negative-channel:
    type: boolean

  discrete-mode-enable-resistor-divider:
    type: boolean

  discrete-mode-clock-source:
    type: string
    enum:
      - "SLOW"
      - "FAST"

  discrete-mode-sample-time:
    type: string
    enum:
      - "T1"
      - "T2"
      - "T4"
      - "T8"
      - "T16"
      - "T32"
      - "T64"
      - "T256"

  discrete-mode-phase1-time:
    type: string
    enum:
      - "ALT0"
      - "ALT1"
      - "ALT2"
      - "ALT3"
      - "ALT4"
      - "ALT5"
      - "ALT6"
      - "ALT7"

  discrete-mode-phase2-time:
    type: string
    enum:
      - "ALT0"
      - "ALT1"
      - "ALT2"
      - "ALT3"
      - "ALT4"
      - "ALT5"
      - "ALT6"
      - "ALT7"
```

## dts/bindings/comparator/nxp,lpcmp.yaml
```yaml
# Copyright 2025 NXP
# SPDX-License-Identifier: Apache-2.0

description: |
  NXP Low Power Comparator (LPCMP)

compatible: "nxp,lpcmp"

include:
  - base.yaml
  - pinctrl-device.yaml

properties:
  reg:
    required: true

  interrupts:
    required: true

  power-mode:
    type: string
    enum:
      - "low_speed"
      - "high_speed"
    description: |
      Select comparator power/speed mode.

  hysteresis-mode:
    type: string
    enum:
      - "LEVEL0"
      - "LEVEL1"
      - "LEVEL2"
      - "LEVEL3"
    description: |
      Comparator hysteresis level.

  enable-stop-mode:
    type: boolean
    description: |
      Allow the comparator to remain enabled in STOP/STANDBY mode.
      NOTE: This property is not available on MCXN23x devices.

  invert-output:
    type: boolean
    description: |
      Invert comparator output.

  enable-pin-out:
    type: boolean
    description: |
      Drive comparator output on the associated pin.

  use-unfiltered-output:
    type: boolean
    description: |
      Route unfiltered comparator output (COUTA) to the module output.
      When false, the filtered output (COUT) is used and filter parameters
      are taken from filter-count and filter-period.

  filter-count:
    type: int
    enum: [0, 1, 2, 3, 4, 5, 6, 7]
    description: |
      Number of consecutive samples that must agree before updating
      the filtered output. Set to 0 to bypass the filter.

  filter-period:
    type: int
    description: |
      Sampling period for the filter in bus clock cycles.
      Valid range: 0 - 255.

  dac-vref-source:
    type: string
    enum:
      - "VREFH0"
      - "VREFH1"
    description: |
      DAC reference high-voltage source selection.

  dac-value:
    type: int
    description: |
      8-bit DAC code used when an input is set to DAC output.
      Valid range: 0 - 255.

  positive-mux-input:
    type: string
    enum:
      - "IN0"
      - "IN1"
      - "IN2"
      - "IN3"
      - "IN4"
      - "IN5"
      - "IN6"
      - "IN7"
      - "DAC"
    required: true
    description: |
      Positive input selection. "DAC" routes the internal DAC output.
      NOTE: For MCXN/A devices, IN6 and IN7 are not available, only
      IN0-IN5 and DAC.

  negative-mux-input:
    type: string
    enum:
      - "IN0"
      - "IN1"
      - "IN2"
      - "IN3"
      - "IN4"
      - "IN5"
      - "IN6"
      - "IN7"
      - "DAC"
    required: true
    description: |
      Negative input selection. "DAC" routes the internal DAC output.
      NOTE: For MCXN/A devices, IN6 and IN7 are not available, only
      IN0-IN5 and DAC.

  enable-output-pin:
    type: boolean
    description: |
      Enable the comparator in selected pin.

  enable-output-invert:
    type: boolean
    description: |
      Invert the comparator output.

  hysteresis-level:
    type: int
    enum:
      - 0
      - 1
      - 2
      - 3
    default: 0
    description: |
      LPCMP hysteresis mode.
      The default corresponds to the reset value of the register field.

  power-level:
    type: string
    enum:
      - "low"
      - "high"
      - "nano"
    default: "low"
    description: |
      LPCMP power mode.
      The default corresponds to the reset value of the register field.

  function-clock:
    type: string
    enum:
      - "Reserved"
      - "FRO_16K"
      - "XTAL32K"
      - "CMP_CLOCK"
    default: "Reserved"
    description: |
      LPCMP function clock.
      The default corresponds to the reset value of the register field.

  "#io-channel-cells":
    type: int
    const: 2

io-channel-cells:
  - positive
  - negative
```

## dts/bindings/comparator/renesas,ra-acmphs-global.yaml
```yaml
# Copyright (c) 2025 Renesas Electronics Corporation
# SPDX-License-Identifier: Apache-2.0

description: |
  Renesas RA ACMPHS (High-Speed Analog COMParator) Global

  The following example displays the minimum node layout:

    acmphs_global: acmphs_global@deadbeef {
            compatible = "renesas,ra-acmphs-global";
            reg = <0xdeadbeef 0x200>;
            status = "disabled";

            acmphs0: acmphs0 {
                    ...
            };
    };

  If the pin-output-enable is selected in the comparator controller node,
  this global node needs to define the VCOUT pin to enable output on that pin.

  Note: The VCOUT pinctrl for the comparator global node is already defined
  on each board that supported comparator. Please check the board’s pinctrl
  before defining it.

    acmphs_vcout: acmphs_vcout {
            group1 {
                    /* VCOUT */
                    psels = <RA_PSEL(RA_PSEL_ACMPHS_VCOUT, ..., ...)>;
            };
    };

    &acmphs_global {
            pinctrl-0 = <&acmphs_vcout>;
            pinctrl-names = "default";
            status = "okay";

            acmphs0 {
                    ...
            };
    };

  Note: There is only one VCOUT shared across all comparator controller nodes.
  Therefore, the VCOUT value is the logical OR of the output signals from all
  comparator controllers that have pin-output-enable enabled.

compatible: "renesas,ra-acmphs-global"

include: [base.yaml, pinctrl-device.yaml]
```

## dts/bindings/comparator/renesas,ra-acmphs.yaml
```yaml
# Copyright (c) 2025 Renesas Electronics Corporation
# SPDX-License-Identifier: Apache-2.0

description: |
  Renesas RA ACMPHS (High-Speed Analog COMParator) Controller

  The following example displays the minimum node layout:

    acmphs_global: acmphs_global@deadbeef {
            ...

            acmphs0: acmphs0 {
                    compatible = "renesas,ra-acmphs";
                    channel = <0>;
                    status = "disabled";
            };
    };

  Enabling the comparator controller node requires setting the minimum
  default configuration of the comparator. This includes selecting the
  positive and negative inputs, and routing them using pinctrl:

  Note: A set of pinctrl for the default comparator controller node is
  already defined on each board that supported comparator. Please check
  the board’s pinctrl before defining it.

  &pinctrl {
          acmphs_ivref0: acmphs_ivref0 {
                  group1 {
                          /* IVREF0 */
                          psels = <RA_PSEL(RA_PSEL_ACMPHS, ..., ...)>;
                          renesas,analog-enable;
                  };
          };

          acmphs0_ivcmp0: acmphs0_ivcmp0 {
                  group1 {
                          /* CH0 IVCMP0 */
                          psels = <RA_PSEL(RA_PSEL_ACMPHS, ..., ...)>;
                          renesas,analog-enable;
                  };
          };
  };

  &acmphs_global {
          status = "okay";

          acmphs0 {
                  pinctrl-0 = <&acmphs_ivref0 &acmphs0_ivcmp0>;
                  pinctrl-names = "default";
                  interrupts = <90 12>;
                  interrupt-names = "hs";
                  reference-input-source = "ivref0";
                  compare-input-source = "ivcmp0";
                  status = "okay";
          };
  };

compatible: "renesas,ra-acmphs"

include: [base.yaml, pinctrl-device.yaml]

properties:
  channel:
    type: int
    required: true

  interrupts:
    description: |
      IRQ number and priority to use for interrupt Comparator:
      - "hs": generated on valid edge detection from comparison result
      Note: when this interrupts property is not defined, none of the trigger APIs
            can be used (set_trigger, set_trigger_callback, trigger_is_pending).

  reference-input-source:
    type: string
    required: true
    enum:
      - "ivref0"
      - "ivref1"
      - "ivref2"
      - "ivref3"
    description: |
      Select the Analog reference voltage source.
      Note: ivref2 is connected to Vref
            ivref3 is connected to DA0 (DAC)
            If either of these is selected, there is no need to configure pinsel for pinctrl.

  compare-input-source:
    type: string
    required: true
    enum:
      - "ivcmp0"
      - "ivcmp1"
      - "ivcmp2"
      - "ivcmp3"
    description: |
      Select the Analog compare voltage source.
      Note: ivcmp1 is connected to DA0 (DAC)
            If ivcmp1 is selected, there is no need to configure pinsel for pinctrl.

  noise-filter:
    type: int
    enum: [1, 8, 16, 32]
    default: 32
    description: |
      Select the PCLK divisor for the hardware digital debounce filter.
      Larger divisors provide a longer debounce and take longer for the output to update.

  output-invert-polarity:
    type: boolean
    description: |
      When enabled comparator output is inverted.

  pin-output-enable:
    type: boolean
    description: |
      Turn this on to enable the CMPOUTn signal for this channel.
      The CMPOUTn signal for each channel is OR'd together and the result is output to VCOUT.
```
