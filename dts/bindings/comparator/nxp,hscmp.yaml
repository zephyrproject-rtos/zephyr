## dts/bindings/comparator/renesas,ra-lvd.yaml
```yaml
# Copyright (c) 2025 Renesas Electronics Corporation
# SPDX-License-Identifier: Apache-2.0

description: |
  Renesas RA LVD (Low-voltage detection) Controller

  The following example displays the minimum node layout:

    lvd1: lvd@4001e0e0 {
            compatible = "renesas,ra-lvd";
            reg = <0x4001e0e0 0x02>;
            channel = <1>;
            status = "disabled";
    };

  Enabling the comparator controller node requires setting the minimum
  default configuration of the comparator. This includes selecting the
  positive and negative inputs.
  Note: negative input of this controller is selected through specific
  voltage threshold levels, and positive input is Vcc

    &lvd1 {
          lvd-action = "maskable-interrupt";
          voltage_level = <384>;
          lvd-trigger = "rising";
          reset-negation-timing = <0>;
          status = "okay";
    };

compatible: "renesas,ra-lvd"

include: [base.yaml, pinctrl-device.yaml]

properties:
  reg:
    required: true

  channel:
    type: int
    required: true

  voltage-level:
    required: true
    type: int
    description: |
      Specifies the voltage detection level for each channel.
      This value can be mapped to voltage level that is shown in the HWM.
      Example:
        On RA8P1:
        - To set the voltage detection level to 3.86 V, specify '0x03'.
        - To set the voltage detection level to 1.90 V, specify '0x0C'.
        ...
      Note:
        - Do not set to a value that is prohibited in the HWM.
      For specific voltage detection support levels of each RA MCU series,
      please refer to the HWM.

  noise-filter:
    type: int
    enum: [1, 2, 4, 8, 16]
    default: 16
    description: |
      Select the LOCO divisor for the hardware digital debounce filter.
      Larger divisors provide a longer debounce and take longer for the output to update.
      Set to 1 to disable the filter (or if the filter is not supported).

  lvd-trigger:
    default: "falling"
    type: string
    enum:
      - "rising"
      - "falling"
      - "both"
    description: |
      Specifies the voltage detection conditions and influences interrupt conditions.

  reset-only:
    type: boolean
    description: |
      This property indicate that the channel only support the reset action
      (no interrupt and monitoring).

  lvd-action:
    required: true
    type: string
    enum:
      - "non-maskable-interrupt"
      - "maskable-interrupt"
      - "reset"
      - "no-action"
    description: |
      Choose the action to be taken when the LVD is detected.
      If "reset-only" properties is true, action will always be "reset".

  reset-negation-timing:
    type: int
    default: 0
    enum: [0, 1]
    description: |
      Specifies the time when the system release (negate) from reset
      When action is "reset", trigger is "falling" (system reset when Vcc < Vdet):
        - 0: Reset negation occurs after Vcc > Vdet + stabilization time.
        - 1: Reset negation occurs after assertion of the reset + stabilization time.
      When action is "reset", trigger is "rising" (system reset when Vcc > Vdet):
        - 0: Reset negation occurs after Vcc < Vdet - stabilization time.
        - 1: DO NOT set this value.
      When action is other than "reset", this property is ignored.
```

## dts/bindings/comparator/renesas,rx-lvd.yaml
```yaml
# Copyright (c) 2025 Renesas Electronics Corporation
# SPDX-License-Identifier: Apache-2.0

description: |
  Renesas RX LVD (Low-voltage detection) Controller

  The following example displays the minimum node layout:

    lvd: lvd@800e2 {
            compatible = "renesas,rx-lvd";
            reg = <0x000800e2 0x02>;
            interrupts = <89 1>;
            status = "disabled";
    };

  Enabling the comparator controller node requires setting the minimum
  default configuration of the comparator. This includes selecting the
  positive and negative inputs.
  Note: negative input of this controller is selected through specific
  voltage threshold levels, and positive input can be either Vcc or CMPA pin.
  If CMPA pin is selected as positive input, pinctrl must be defined to
  route CMPA pin to the controller.

      &pinctrl {
                lvd1_cmpa: lvd1_cmpa {
                        group1 {
                                /* CMPA */
                                psels = <RX_PSEL(RX_PSEL_LVD, ..., ...)>;
                                renesas,analog-enable;
                                input-enable;
                        };
                };
        };

      &lvd1 {
            pinctrl-0 = <&lvd1_cmpa>;
            pinctrl-names = "default";
            lvd-action = "maskable-interrupt";
            voltage_level = <384>;
            vdet-target = "cmpa";
            lvd-trigger = "rising";
            lvd-stabilization = <0>;
            status = "okay";
      };

compatible: "renesas,rx-lvd"

include: [base.yaml, pinctrl-device.yaml]

properties:
  reg:
    required: true

  channel:
    type: int
    required: true

  lvd-action:
    required: true
    type: string
    enum:
      - "reset"
      - "non-maskable-interrupt"
      - "maskable-interrupt"
      - "no-action"
    description: |
      Choose the action to be taken when the LVD is detected.

  lvd-support-cmpa:
    type: boolean
    description: |
      Specifies whether the RX LVD supports CMPA pin as target.

  voltage-level:
    required: true
    type: int
    description: |
      Specifies the voltage detection level for each channel, as an integer
      value that represents the voltage in hundredths of a volt.
      Example:
        - To set the voltage detection level to 3.00 V, specify '300'.
        - To set the voltage detection level to 3.84 V, specify '384'.
        - To set the voltage detection level to default value, specify '0xFFFF'
      For specific voltage detection support levels of each RX MCU series,
      please refer to the HWM.

  vdet-target:
    required: true
    type: string
    enum:
      - vcc
      - cmpa
    description: |
      Specifies the target to be monitored for each channel.
      Not all RX LVD channels support CMPA pin as target.
      Please refer to the HWM for details.

  lvd-trigger:
    required: true
    type: string
    enum:
      - "rising"
      - "falling"
      - "both"
    description: |
      Specifies the voltage detection conditions and influences interrupt conditions

  lvd-stabilization:
    type: int
    enum: [0, 1]
    description: |
      Specifies the reset negation timing for each channel, with reset selected as processing.
        - 0: After a LVD reset, negation occurs when a certain period elapses after the
          monitored voltage goes above the voltage detection level.
        - 1: Negation occurs when a certain period elapses after the LVD reset assertion.
      Note: "a certain period" here means a wait time after a voltage monitoring reset.
            Refer to the User's Manual: Hardware for details.

  pinctrl-0:
    description: Pin control for LVD when using CMPA pin as target

  pinctrl-names:
    description: Pin control names for LVD when using CMPA pin as target
```

## dts/bindings/comparator/silabs,acmp.yaml
```yaml
# Copyright (c) 2025 Silicon Laboratories Inc.
# SPDX-License-Identifier: Apache-2.0
description: |
  Silabs ACMP (Analog Comparator)

  The minimal default configuration for the silabs acmp node is as follows:

    #include <zephyr/dt-bindings/comparator/silabs-acmp.h>

    &acmp0 {
           status = "okay";

           input-positive = <ACMP_INPUT_VSENSE01DIV4>;
           input-negative = <ACMP_INPUT_VREFDIVAVDD>;
    };

  Note that there are bindings to retrieve the values for `input-positive` and
  `input-negative` properties. See the included bindings in the example above.

  When using the minimal default configuration in the snippet above, some
  properties will be implicitly configured with default values. An equivalent
  device tree node is therefore as follows:

    #include <zephyr/dt-bindings/comparator/silabs-acmp.h>

    &acmp0 {
            status = "okay";

            bias = <0>;
            hysteresis-mode = "disabled";
            accuracy-mode = "low";
            input-range = "full";
            input-positive = <ACMP_INPUT_VSENSE01DIV4>;
            input-negative = <ACMP_INPUT_VREFDIVAVDD>;
            vref-divider = <63>;
    };

  It is also possible to select a GPIO pin for either/both of the
  `input-positive` or `input-negative` properties. In those cases, the
  `pinctrl` driver must be configured to allocate an analog bus corresponding
  to the port and pin of each GPIO input selected. The following is an example
  of how that can be configured:

    #include <zephyr/dt-bindings/comparator/silabs-acmp.h>
    #include <zephyr/dt-bindings/pinctrl/silabs/xg24-pinctrl.h>

    &pinctrl {
            acmp0_default: acmp0_default {
                    group0 {
                            silabs,analog-bus = <ABUS_CDODD0_ACMP0>;
                    };
            };
    };

    &acmp0 {
            pinctrl-0 = <&acmp0_default>;
            pinctrl-names = "default";
            status = "okay";

            bias = <0>;
            hysteresis-mode = "disabled";
            accuracy-mode = "low";
            input-range = "full";
            input-positive = <ACMP_INPUT_PC3>;
            input-negative = <ACMP_INPUT_VREFDIV1V25>;
            vref-divider = <63>;
    };

  In the above example, note that the device specific bindings for pinctrl
  were included. This header defines the set of analog bus allocations possible
  for xg24 parts, and similar headers exist for other parts.


compatible: "silabs,acmp"

include:
  - base.yaml
  - pinctrl-device.yaml

properties:
  bias:
    type: int
    default: 0

  hysteresis-mode:
    type: string
    enum:
      - "disabled"
      - "sym10mv"
      - "sym20mv"
      - "sym30mv"
      - "pos10mv"
      - "pos20mv"
      - "pos30mv"
      - "neg10mv"
      - "neg20mv"
      - "neg30mv"
    default: "disabled"

  accuracy-mode:
    type: string
    enum:
      - "low"
      - "high"
    default: "low"

  input-range:
    type: string
    enum:
      - "full"
      - "reduced"
    default: "full"

  input-positive:
    type: int
    required: true

  input-negative:
    type: int
    required: true

  vref-divider:
    type: int
    default: 63
```

## dts/bindings/comparator/st,stm32-comp.yaml
```yaml
# Copyright (c) 2025 Alexander Kozhinov <ak.alexander.kozhinov@gmail.com>
# SPDX-License-Identifier: Apache-2.0

description: |
  STM32 Comparator

  The following example displays the minimum node layout:

    comp1: comparator@40010200 {
      reg = <0x40010200 0x4>;
      interrupts = <64 0>;
      clocks = <&rcc STM32_CLOCK(APB2, 0)>;
      st,exti-line = <21>;
      positive-input = "IN0";
      negative-input = "VREFINT";
      status = "okay";
    };

  NOTE: The shown example is for stm32g474re

  Enabling the comparator node requires setting the minimum default
  configuration of the comparator. This includes selecting the
  positive and negative inputs, and routing them using pinctrl:

    &comp1 {
      pinctrl-0 = <&comp1_inp_pa1 &comp1_out_pa6>;
      pinctrl-names = "default";

      positive-input = "IN0";
      negative-input = "VREFINT";
      status = "okay";
    };

  NOTE: Pins used above are an example for stm32g474re

compatible: "st,stm32-comp"

include:
  - base.yaml
  - pinctrl-device.yaml

properties:
  reg:
    required: true
  interrupts:
    required: true
  clocks:
    required: true

  invert-output:
    type: string
    description: |
      Output polarity selection.
    enum:
      - NONINVERTED
      - INVERTED
    default: NONINVERTED

  st,exti-line:
    required: true
    type: int
    description: |
      EXTI interrupt line number connected to the comparator (COMPx) event.

  st,lock-enable:
    type: boolean
    description: |
      The comparator configuration can be locked to prevent any
      modification until the next system reset.
      Once the lock bit is set, it can be cleared only by a system reset.
      This feature allows to protect the comparator configuration against
      unintentional modification.

  positive-input:
    required: true
    type: string
    description: |
      Selects positive input pin provided by the pinmux controller.
      IN0 corresponds to the first pinmux option, IN1 to the second one.
    enum:
      - IN0
      - IN1

  negative-input:
    required: true
    type: string
    description: |
      Selects negative input. May be a package pin (IN0 / IN1) via pinctrl
      or an internal signal (e.g. VREFINT, DAC).
      In case of package pin assignment IN0 will correspond to first pinmux pin
      option and IN1 to the second one.
    enum:
      - 1_4VREFINT
      - 1_2VREFINT
      - 3_4VREFINT
      - VREFINT
      - IN0
      - IN1

  hysteresis:
    type: string
    description: |
      Selects the hysteresis voltage level.
      Hysteresis adds a voltage offset to the comparator threshold to prevent
      unwanted output toggling when the input voltage is noisy or slowly
      varying around the comparator threshold.
    enum:
      - NONE
      - LOW
      - MEDIUM
      - HIGH
    default: NONE

  st,blank-sel:
    type: string
    description: |
      Blanking source to mask short spikes at PWM period start.
      Ref (example): STM32G4 RM0440 Rev 8, 24.3.6.
    enum:
      - NONE
    default: NONE
```

## dts/bindings/comparator/st,stm32g4-comp.yaml
```yaml
# Copyright (c) 2025 Alexander Kozhinov <ak.alexander.kozhinov@gmail.com>
# SPDX-License-Identifier: Apache-2.0

description: |
  STM32G4 series Comparator

include:
  - name: st,stm32-comp.yaml
    property-blocklist:
      - hysteresis
      - st,blank-sel
      - positive-input
      - negative-input

compatible: "st,stm32g4-comp"

properties:
  negative-input:
    required: true
    type: string
    enum:
      - 1_4VREFINT
      - 1_2VREFINT
      - 3_4VREFINT
      - VREFINT
      - DAC1_CH1
      - DAC1_CH2
      - DAC2_CH1
      - DAC3_CH1
      - DAC3_CH2
      - DAC4_CH1
      - DAC4_CH2
      - IN0
      - IN1

  positive-input:
    required: true
    type: string
    enum:
      - IN0
      - IN1
      - DAC2_CH1

  hysteresis:
    type: string
    enum:
      - NONE
      - LOW
      - MEDIUM
      - HIGH
      - 10MV
      - 20MV
      - 30MV
      - 40MV
      - 50MV
      - 60MV
      - 70MV
    default: NONE

  st,blank-sel:
    type: string
    enum:
      - NONE
      - TIM1_OC5_COMP1
      - TIM1_OC5_COMP2
      - TIM1_OC5_COMP3
      - TIM1_OC5_COMP4
      - TIM1_OC5_COMP5
      - TIM1_OC5_COMP6
      - TIM1_OC5_COMP7
      - TIM2_OC3_COMP1
      - TIM2_OC3_COMP2
      - TIM2_OC3_COMP5
      - TIM2_OC4_COMP3
      - TIM2_OC4_COMP6
      - TIM3_OC3_COMP1
      - TIM3_OC3_COMP2
      - TIM3_OC3_COMP3
      - TIM3_OC3_COMP5
      - TIM3_OC3_COMP7
      - TIM3_OC4_COMP4
      - TIM8_OC5_COMP1
      - TIM8_OC5_COMP2
      - TIM8_OC5_COMP3
      - TIM8_OC5_COMP4
      - TIM8_OC5_COMP5
      - TIM8_OC5_COMP6
      - TIM8_OC5_COMP7
      - TIM15_OC1_COMP4
      - TIM15_OC2_COMP6
      - TIM15_OC2_COMP7
      - TIM20_OC5
      - TIM15_OC1
      - TIM4_OC3
    default: NONE

  st,miller-effect-hold-disable:
    type: boolean
    description: |
      Disables an undocumented compare feature (sets COMP_CxCSR bit #1 to 0) which
      holds the comparator output during the duration of the Miller effect.
      NOTE: This setting is supported only by stm32g4x series.
      NOTE: It is recommended to enable the feature unless very fast events are tracked.
      Please refer to following url for details:
      https://community.st.com/t5/stm32-mcus-products/stm32g431-comparator-bug/m-p/679540#M250779
```
