## dts/bindings/comparator/st,stm32h7-comp.yaml
```yaml
# Copyright (c) 2025 Alexander Kozhinov <ak.alexander.kozhinov@gmail.com>
# SPDX-License-Identifier: Apache-2.0

description: |
  STM32H7 series Comparator

include:
  - name: st,stm32-comp.yaml
    property-blocklist:
      - st,blank-sel
      - negative-input

compatible: "st,stm32h7-comp"

properties:
  negative-input:
    required: true
    type: string
    enum:
      - 1_4VREFINT
      - 1_2VREFINT
      - 3_4VREFINT
      - VREFINT
      - DAC1_CH1
      - DAC1_CH2
      - IN0
      - IN1
      - TPSENS_DAC2CH1
      - VBAT_VDDAP

  st,power-mode:
    type: string
    description: |
      Select comparator speed vs power mode.
      Typical modes: fast (higher current), medium, low power, ultra-low power.
      Availability varies by series.
    enum:
      - HIGHSPEED
      - MEDIUMSPEED
      - ULTRALOWPOWER

  st,blank-sel:
    type: string
    enum:
      - NONE
      - TIM1_OC5
      - TIM2_OC3
      - TIM3_OC3
      - TIM3_OC4
      - TIM8_OC5
      - TIM15_OC1
    default: NONE
```

## dts/bindings/comparator/ti,mspm0-comparator.yaml
```yaml
# TI MSPM0 Family

# Copyright (c) 2026, Linumiz
# SPDX-License-Identifier: Apache-2.0

description: |
  Texas Instruments MSPM0 Comparator Module with Reference DAC

compatible: "ti,mspm0-comparator"
include:
  - base.yaml
  - pinctrl-device.yaml

properties:
  reg:
    required: true

  interrupts:
    required: true

  positive-inputs:
    type: int
    default: 0
    description: |
      Positive input channel selection (0-7) and also acts as
      window comparator input in window comparator mode.
      Default is channel 0 which is the hardware reset state.
      Change to match the board pin connection.

  negative-inputs:
    type: int
    default: 0
    description: |
      Negative input channel selection (0-7) and also acts as
      upperthreshold channel input in window comparator mode.
      Default is channel 0 which is the hardware reset state.
      Change to match the board pin connection.

  ti,mode:
    type: string
    default: "fast"
    enum:
      - "fast"
      - "ulp"
    description: |
      Comparator operating mode. Default is fast which is the
      hardware reset state. Use ulp for ultra-low-power
      applications.

  ti,hysteresis:
    type: string
    default: "none"
    enum: ["none", "10", "20", "30"]
    description: |
      Comparator hysteresis in millivolts. Default is none
      which is the hardware reset state. Enable to prevent
      output toggling near the threshold.

  ti,reference-source:
    type: string
    default: "none"
    enum: ["none", "vdda_dac", "vdda", "int_vref_dac", "vref_dac", "int_vref", "vref"]
    description: |
      Reference voltage source selection. Default is none which
      disables the internal reference and uses both external
      input channels.

  ti,reference-terminal:
    type: string
    default: "neg"
    enum: ["pos", "neg"]
    description: |
      Selects which terminal receives the internal reference.
      Default is neg as the common use case is comparing an
      external signal on the positive terminal against an
      internal threshold on the negative terminal.

  ti,reference-dac-code0:
    type: int
    default: 128
    description: |
      8-bit DAC code for reference level 0. Default is 128
      which sets the DAC output to the midpoint of the range.

  ti,reference-dac-code1:
    type: int
    default: 128
    description: |
      8-bit DAC code for reference level 1. Default is 128
      which sets the DAC output to the midpoint of the range.

  ti,reference-dac-control:
    type: string
    default: "comp_out"
    enum: ["comp_out", "sw"]
    description: |
      comp_out automatically chooses the dac reference input
      either code0 or code1 based on output high and low
      respectively and for sw manually select the dac reference
      input. Default is comp_out which is the hardware reset
      state.

  ti,reference-dac-input:
    type: int
    default: 0
    enum: [0, 1]
    description: |
      This is used for selecting the reference dac input either
      code0 or code1 for sw dac control. Default is 0 which
      selects code0. Only applicable when ti,reference-dac-control
      is sw.

  ti,filter-enable:
    type: boolean
    description: Enable analog output filter.

  ti,filter-delay:
    type: int
    default: 70
    enum: [70, 500, 1200, 2700]
    description: |
      Output filter delay in nanoseconds. Default is 70 which
      provides the shortest delay for fastest response. Increase
      for better noise rejection. Only applicable when
      ti,filter-enable is set.

  ti,window-mode-enable:
    type: boolean

  ti,window-lower-threshold:
    type: int
    description: |
      select the channel from 0 to 7.

  ti,window-companion:
    type: phandle

  vref:
    type: phandle
    description: |
      For internal reference selection phandle the vref0 node and enable the
      regulator (vref module in mspm0).
```

## dts/bindings/comparator/zephyr,fake-comp.yaml
```yaml
# Copyright (c) 2024 Nordic Semiconductor ASA
# SPDX-License-Identifier: Apache-2.0

description: Fake comparator device used as stub or mock for testing

compatible: "zephyr,fake-comp"

include: base.yaml
```

## dts/bindings/cordic/st,stm32-cordic.yaml
```yaml
# Copyright (c) 2024 Alexander Kozhinov <ak.alexander.kozhinov@gmail.com>
# SPDX-License-Identifier: Apache-2.0

description: |
  STM32 CORDIC (Coordinate Rotation Digital Computer) coprocessor

  The CORDIC coprocessor is a hardware accelerator for trigonometric,
  hyperbolic, linear, and logarithmic functions. It is available on
  STM32G4, STM32H5, STM32H7, and STM32U5 series.

  Example usage:

    &cordic {
        status = "okay";
    };

compatible: "st,stm32-cordic"

include:
  - name: cordic-controller.yaml
    property-blocklist:
      - pinctrl-0
      - pinctrl-names
```

## dts/bindings/coredump/zephyr,coredump.yaml
```yaml
# Copyright Meta Platforms, Inc. and its affiliates.
# SPDX-License-Identifier: Apache-2.0

include: base.yaml

compatible: "zephyr,coredump"

description: Pseudo-device to help capturing desired data into core dumps

properties:
    memory-regions:
      type: array
      required: false
      description: Start address and size of memory regions to be collected in a core dump

    coredump-type:
      required: true
      type: string
      description: |
        Designate which type of coredump device this will be.
        A device of type COREDUMP_TYPE_MEMCPY can directly memcpy the provided memory-regions
        into the coredump. The memory-regions array can contain 0 or more entries, and more
        regions can be added at runtime through the coredump_device_register_memory API.
        A device of type COREDUMP_TYPE_CALLBACK must specify exactly one entry in the
        memory-regions array with a size of 0 and a desired size. The coredump device will statically
        allocate a block of memory of the desired size and provide a callback with a pointer to
        that memory which will be invoked at the time of a dump. This allows a consumer to add data
        into the coredump that may not be directly accessible through a memcpy and/or provides an
        opportunity to manipulate data for inclusion in the dump. The coredump_device_register_memory
        API is not available for a device of this type.
      enum:
        - "COREDUMP_TYPE_MEMCPY"
        - "COREDUMP_TYPE_CALLBACK"
```

## dts/bindings/counter/adi,max32-counter.yaml
```yaml
# Copyright (c) 2024-2026 Analog Devices, Inc.
# SPDX-License-Identifier: Apache-2.0

description: ADI MAX32 counter

compatible: "adi,max32-counter"

include: [base.yaml, pinctrl-device.yaml]

examples:
  - |
    &timer0 {
            counter0: counter {
                    pinctrl-0 = <&tmr0c_ioa_p0_4>;
                    pinctrl-names = "default";
                    status = "okay";
            };
    };

    &clk_lptmr0 {
            clock-frequency = <32768>;
            status = "okay";
    };

    &lptimer0 {
            clock-source = <ADI_MAX32_PRPH_CLK_SRC_EXTCLK>;
            counter1: counter {
                    status = "okay";
            };
    };
```

## dts/bindings/counter/adi,max32-wut.yaml
```yaml
# Copyright (c) 2025 Analog Devices, Inc.
# SPDX-License-Identifier: Apache-2.0

description: |
  ADI MAX32 Wake-Up Timer is a unique instance of a 32-bit timer that can wake up the
  device from sleep, standby and backup modes.

compatible: "adi,max32-wut"

include: [base.yaml]
```

## dts/bindings/counter/ambiq,counter.yaml
```yaml
# Copyright (c) 2023 Antmicro <www.antmicro.com>
# SPDX-License-Identifier: Apache-2.0

description: Ambiq Timer/Counter

compatible: "ambiq,counter"

include: base.yaml

properties:
  reg:
    required: true

  interrupts:
    required: true

  clock-frequency:
    type: int
    required: true
    description: Counter clock frequency

  clk-source:
    type: int
    required: true
    description: Counter clock source
```

## dts/bindings/counter/arm,crsas-ma2-counter.yaml
```yaml
description: Arm Corstone Reference Systems Architecture Specification MA2 System Counter

compatible: "arm,crsas-ma2-counter"

include: base.yaml

properties:
  reg:
    required: true
    description: |
      CRSAS-MA2 System Counter has two 4KB frames. We only use
      the control frame and don't use the read frame,
      so this should be the base address of the control frame.

  clocks:
    required: true
    description: |
      Specifier for the clock source for the device.

  scaling-factor:
    type: int
    default: 0x01000000
    description: |
      32-bit fixed-point scaling factor (8.24 format).
      Defaults to 1.0 (no scaling) if not specified.

  halt-on-debug:
    type: boolean
    description: |
      Set to enable halt on debug.
```

## dts/bindings/counter/arm,crsas-ma2-timer.yaml
```yaml
description: Arm Corstone Reference Systems Architecture Specification MA2 System Timer

compatible: "arm,crsas-ma2-timer"

include: base.yaml

properties:
  reg:
    required: true
    description: |
      CRSAS-MA2 System Timer register base address.

  interrupts:
    required: true

  clocks:
    required: true
```

## dts/bindings/counter/atmel,sam-rtt.yaml
```yaml
# Copyright 2023 Bjarki Arge Andreasen
# SPDX-License-Identifier: Apache-2.0

description: |
  Atmel SAM series Real-Time Timer (RTT)

  Example using slow clock as source:

    rtt: rtt@400e1a30 {
              compatible = "atmel,sam-rtt";
              reg = <0x400e1a30 0x20>;
              clocks = <&pmc PMC_TYPE_PERIPHERAL 3>;
              interrupts = <3 0>;
              prescaler = <8>;
              source = <ATMEL_SAM_RTT_SOURCE_SCLK>;
              status = "okay";
    };

  Example using RTC clock as source:

    rtt: rtt@400e1a30 {
              compatible = "atmel,sam-rtt";
              reg = <0x400e1a30 0x20>;
              clocks = <&pmc PMC_TYPE_PERIPHERAL 3>;
              interrupts = <3 0>;
              source = <ATMEL_SAM_RTT_SOURCE_RTC>;
              status = "okay";
    };

compatible: "atmel,sam-rtt"

include: base.yaml

properties:
  prescaler:
    type: int
    description: |
      RTT prescaler value used if clock source is SCLK.
        Min prescaler value 3
        Max prescaler value 65536

  source:
    type: int
    enum:
      - 0
      - 1
    required: true
    description: |
      RTT clock source selection
        - 0 (ATMEL_SAM_RTT_SOURCE_SCLK): RTT timer frequency = (SCLK frequency / prescaler)
        - 1 (ATMEL_SAM_RTT_SOURCE_RTC):  RTT timer frequency = 1Hz
```

## dts/bindings/counter/atmel,sam0-tc32.yaml
```yaml
# Copyright (c) 2019 Derek Hageman <hageman@inthat.cloud>
# Copyright (c) 2024 Gerson Fernando Budke <nandojve@gmail.com>
# SPDX-License-Identifier: Apache-2.0

description: Atmel SAM0 basic timer counter (TC) operating in 32-bit wide mode

compatible: "atmel,sam0-tc32"

include:
  - name: base.yaml
  - name: pinctrl-device.yaml
  - name: atmel,assigned-clocks.yaml

properties:
  reg:
    required: true

  interrupts:
    required: true

  clocks:
    required: true

  clock-names:
    required: true

  atmel,assigned-clocks:
    required: true

  atmel,assigned-clock-names:
    required: true

  prescaler:
    type: int
    description: Timer prescaler
    enum:
      - 1
      - 2
      - 4
      - 8
      - 16
      - 64
      - 256
      - 1024
```

## dts/bindings/counter/bflb,rtc.yaml
```yaml
description: Bouffalo Lab RTC Counter (HBN-based)

compatible: "bflb,rtc"

include: base.yaml

properties:
  reg:
    required: true
```

## dts/bindings/counter/bflb,timer-channel.yaml
```yaml
description: |
  Bouffalo Lab Timer Channel (Counter).

  Child of a "bflb,timer" node. The reg property holds the channel index
  (0 or 1).

compatible: "bflb,timer-channel"

include: base.yaml

properties:
  reg:
    required: true
  interrupts:
    required: true
```

## dts/bindings/counter/bflb,timer.yaml
```yaml
description: |
  Bouffalo Lab General Purpose Timer Block.

  Two 32-bit counter channels share this register block. Each channel is
  described by a child node with compatible "bflb,timer-channel".

compatible: "bflb,timer"

include: base.yaml

properties:
  reg:
    required: true
  clocks:
    required: true
  "#address-cells":
    const: 1
  "#size-cells":
    const: 0
```
