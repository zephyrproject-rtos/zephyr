## dts/bindings/can/atmel,sam-can.yaml
```yaml
description: Specialization of Bosch m_can CAN FD controller for Atmel SAM

compatible: "atmel,sam-can"

include:
  - name: bosch,m_can-base.yaml
  - name: pinctrl-device.yaml

properties:
  reg:
    required: true
    description: |
      2 or 3 reg blocks needed;
      - Register block for the MCAN configuration registers
      - Register block for the DMA Base Address (for samx7x SOCs)
      - Register block for the Message RAM (for sama7g5 SOCs)
      - Register block for the MCAN SRAM selection register (for sama7g5 SOCs)

  reg-names:
    type: string-array
    required: true
    description: |
      description of reg blocks: m_can, dma_base, message_ram, sram_sel

  interrupts:
    required: true

  interrupt-names:
    required: true

  clocks:
    required: true

  divider:
    type: int
    enum:
      - 6
      - 12
      - 24
    description: Clock divider for the CAN core clock
      This property is required for samx7x SOCs. It is recommended to use the
      CAN clock at frequencies of 20, 40 or 80 MHz. To achieve these frequencies,
      PMC PCK5 must select the UPLLCK (480 MHz) as source clock and divide by 24,
      12, or 6. PCK5 allows the system bus and processor clock to be modified
      without affecting the bit rate communication.
```

## dts/bindings/can/atmel,sam0-can.yaml
```yaml
# Copyright (c) 2024 Gerson Fernando Budke <nandojve@gmail.com>
# SPDX-License-Identifier: Apache-2.0

description: Specialization of Bosch m_can CAN FD controller for Atmel SAM0

compatible: "atmel,sam0-can"

include:
  - name: bosch,m_can-base.yaml
  - name: pinctrl-device.yaml
  - name: atmel,assigned-clocks.yaml

properties:
  reg:
    required: true

  interrupts:
    required: true

  interrupt-names:
    required: true

  clocks:
    required: true

  clock-names:
    required: true

  atmel,assigned-clocks:
    required: true

  atmel,assigned-clock-names:
    required: true

  divider:
    type: int
    required: true
    description: Clock divider of GLCK7 used by CAN as clock source
```

## dts/bindings/can/bflb,bl61x-can.yaml
```yaml
# SPDX-FileCopyrightText: Copyright The Zephyr Project Contributors
# SPDX-License-Identifier: Apache-2.0

title: Bouffalo Lab BL61x CAN (ISO11898) controller

description: |
  This is an NXP SJA1000 compatible PeliCAN core supporting classic CAN 2.0A/2.0B
  (standard 11-bit and extended 29-bit identifiers). It does not support CAN FD.

  CAN TX/RX are routed to GPIO pads through the UART signal multiplexer. In the
  bflb pinctrl bindings this is the "can0" pin function (UART pad function at
  signal-mux instance 2), which is available on every UART-capable pin.

compatible: "bflb,bl61x-can"

include: [can-controller.yaml, pinctrl-device.yaml]

properties:
  reg:
    required: true

  interrupts:
    required: true

  pinctrl-0:
    required: true

  pinctrl-names:
    required: true

examples:
  - |
    #include <zephyr/dt-bindings/pinctrl/bl618x-pinctrl.h>

    &pinctrl {
        can0_default: can0_default {
            group1 {
                pinmux = <GPIO16_CAN0_TX>,
                         <GPIO17_CAN0_RX>;
                bias-pull-up;
                input-schmitt-enable;
            };
        };
    };

    &can0 {
        status = "okay";

        pinctrl-0 = <&can0_default>;
        pinctrl-names = "default";

        bitrate = <125000>;
    };
```
