## dts/bindings/bluetooth/telink,w91-bt.yaml
```yaml
# Copyright (c) 2024, Telink Semiconductor
# SPDX-License-Identifier: Apache-2.0

description: Telink X91 Bluetooth HCI node

compatible: "telink,w91-bt"

include: bt-hci.yaml

properties:
  bt-hci-name:
    default: "HCI Controller"
  bt-hci-bus:
    default: "BT_HCI_BUS_VIRTUAL"
  bt-hci-quirks:
    default: ["BT_HCI_QUIRK_NO_AUTO_DLE"]
```

## dts/bindings/bluetooth/zephyr,bt-hci-3wire-uart.yaml
```yaml
# UART Bluetooth HCI device

description: Bluetooth HCI behind a 3-Wire UART device (H:5)

compatible: "zephyr,bt-hci-3wire-uart"

include: bt-hci.yaml

properties:
  bt-hci-name:
    default: "H:5"
  bt-hci-bus:
    default: "BT_HCI_BUS_UART"
```

## dts/bindings/bluetooth/zephyr,bt-hci-entropy.yaml
```yaml
# Copyright (c) 2018, I-SENSE group of ICCS
# SPDX-License-Identifier: Apache-2.0

description: |
    Bluetooth module that uses Zephyr's Bluetooth Host Controller Interface as
    an entropy source

compatible: "zephyr,bt-hci-entropy"

include: base.yaml
```

## dts/bindings/bluetooth/zephyr,bt-hci-ipc.yaml
```yaml
description: Bluetooth HCI using the IPC subsystem

compatible: "zephyr,bt-hci-ipc"

include: bt-hci.yaml

properties:
  bt-hci-name:
    default: "IPC"
  bt-hci-bus:
    default: "ipc"
  bt-hci-quirks:
    default: ["no-auto-dle"]
  bt-hci-ipc-name:
    type: string
    default: "nrf_bt_hci"
    description: IPC endpoint name
```

## dts/bindings/bluetooth/zephyr,bt-hci-ll-sw-split.yaml
```yaml
description: Bluetooth HCI provided by the native Zephyr Bluetooth Controller

compatible: "zephyr,bt-hci-ll-sw-split"

include: bt-hci.yaml

properties:
  bt-hci-name:
    default: "Controller"
  bt-hci-bus:
    default: "virtual"
  bt-hci-quirks:
    default: ["no-auto-dle"]
```

## dts/bindings/bluetooth/zephyr,bt-hci-spi-slave.yaml
```yaml
# Copyright (c) 2019 Nordic Semiconductor ASA
# SPDX-License-Identifier: Apache-2.0

description: |
    Configures SPI slave settings for a Bluetooth controller that uses
    Zephyr's Bluetooth Host Controller Interface SPI (HCI SPI) driver.

    A node defined via devicetree overlay should look like this:

       &myspi {
            bt-hci@0 {
                    compatible = "zephyr,bt-hci-spi-slave";
                    reg = <0>;
                    irq-gpios = <&gpio1 2 (GPIO_ACTIVE_HIGH | GPIO_PULL_DOWN)>;
            };
       };

    The bt-hci@0 node configures an HCI SPI slave on SPI slave
    interface myspi.

    The host interrupt GPIO is set to gpio1 pin 2 via irq-gpios. The
    GPIO flags are just for example and may be different depending on
    hardware.

compatible: "zephyr,bt-hci-spi-slave"

include: base.yaml

on-bus: spi

properties:
  irq-gpios:
    type: phandle-array
    required: true
```

## dts/bindings/bluetooth/zephyr,bt-hci-spi.yaml
```yaml
# Copyright (c) 2018, I-SENSE group of ICCS
# SPDX-License-Identifier: Apache-2.0

description: |
    Bluetooth module that uses Zephyr's Bluetooth Host Controller Interface SPI
    driver (e.g. nRF51822)

compatible: "zephyr,bt-hci-spi"

include: [spi-device.yaml, bt-hci.yaml]

properties:
  irq-gpios:
    type: phandle-array
    required: true

  reset-gpios:
    type: phandle-array
    required: true

  reset-assert-duration-ms:
    type: int
    description:
      Minimum duration to hold the reset-gpios pin low for.
      If not specified no delay beyond the code path execution time is guaranteed.

  controller-data-delay-us:
    type: int
    default: 20
    description:
      Duration to delay between reading a valid header and transceiving the data
      associated with that header. This delay gives the controller time to configure
      the SPI data transaction after finishing the header transaction. Without this
      delay the host can attempt to read/write before the controller is ready,
      resulting in an ignored transaction that then needs to be performed a second time.
      The default of 20uS was chosen as the lowest delay that reliably eliminated double
      transactions between a nRF9160 host and a nRF52832 controller.

  bt-hci-name:
    default: "SPI"

  bt-hci-bus:
    default: "BT_HCI_BUS_SPI"
```

## dts/bindings/bluetooth/zephyr,bt-hci-uart.yaml
```yaml
# UART Bluetooth HCI device

description: Bluetooth HCI behind a UART device (H:4)

compatible: "zephyr,bt-hci-uart"

include: bt-hci.yaml

properties:
  bt-hci-name:
    default: "H:4"
  bt-hci-bus:
    default: "uart"
  reset-gpios:
    type: phandle-array
  reset-assert-duration-ms:
    type: int
    description:
      Minimum duration to hold the reset-gpios pin low for.
      If not specified no delay beyond the code path execution time is guaranteed.
```

## dts/bindings/bluetooth/zephyr,bt-hci-userchan.yaml
```yaml
description: Bluetooth HCI provided by a Linux HCI user channel socket

compatible: "zephyr,bt-hci-userchan"

include: bt-hci.yaml

properties:
  bt-hci-name:
    default: "HCI User Channel"
  bt-hci-bus:
    default: "BT_HCI_BUS_UART"
```

## dts/bindings/bus/bus.yaml
```yaml
# Common fields for platforms interface

include: [acpi.yaml, pcie-device.yaml]

properties:
  io-mapped:
    type: boolean
    description: specify registers are IO mapped or memory mapped
```

## dts/bindings/buzzer/gpio-buzzer.yaml
```yaml
# Copyright (c) 2026 Carlo Caione <ccaione@baylibre.com>
# SPDX-License-Identifier: Apache-2.0

title: GPIO-driven active buzzer

description: |
    Active buzzers contain their own oscillator and produce a fixed tone whenever they are
    powered. The Zephyr driver toggles a single GPIO line; the buzzer API's frequency argument is
    interpreted as on/off only (zero = stop, non-zero = sound). The actual tone is determined by
    the buzzer part itself.

compatible: "gpio-buzzer"

include: base.yaml

properties:
  gpios:
    type: phandle-array
    required: true
    description: |
      GPIO line driving the buzzer. Typically wired with the active level corresponding to
      "buzzer on".
```

## dts/bindings/buzzer/pwm-buzzer.yaml
```yaml
# Copyright (c) 2026 Carlo Caione <ccaione@baylibre.com>
# SPDX-License-Identifier: Apache-2.0

title: PWM-driven passive piezo buzzer

description: |
    The PWM channel's period sets the audio frequency; the duty cycle sets the perceived volume
    (50% is loudest for piezos, 0% and 100% are silent). Applications drive the buzzer through the
    generic buzzer API in <zephyr/drivers/buzzer.h>.

compatible: "pwm-buzzer"

include: base.yaml

properties:
  pwms:
    required: true
    type: phandle-array
    description: |
      PWM specifier for the channel wired to the buzzer. The period cell conventionally encodes
      the buzzer's natural operating frequency (typically the piezo element's mechanical
      resonance, e.g. ``PWM_HZ(2700)``); the driver overrides the period at runtime as the
      application requests specific tones, so the DT value acts as a documentary default rather
      than as a hard configuration. Polarity flags are forwarded to the PWM controller verbatim.
```

## dts/bindings/cache/andestech,l2c.yaml
```yaml
#
# Copyright (c) 2024, Andes Technology Corporation.
#
# SPDX-License-Identifier: Apache-2.0
#

description: AndesTech L2 cache

compatible: "andestech,l2c"

include: base.yaml

properties:
  reg:
    required: true
```

## dts/bindings/cache/arm,ahb-cache.yaml
```yaml
#
# SPDX-FileCopyrightText: Copyright (c) 2026 Synaptics Incorporated
#
# SPDX-License-Identifier: Apache-2.0
#

description: |
  ARM CoreLink AHB Cache.

compatible: "arm,ahb-cache"

include: base.yaml
```

## dts/bindings/cache/bflb,l1c.yaml
```yaml
#
# Copyright (c) 2025 MASSDRIVER EI <massdriver.space>
#
# SPDX-License-Identifier: Apache-2.0
#

description: |
  Bouffalo Lab L1C cache control.

  The node should be added in the soc group and be provided disabled ways, the
  cache configuration is specific to the platform.

compatible: "bflb,l1c"

include: base.yaml

properties:
  dcache-ways-disabled:
    type: int
    required: true
    description: How many data cache lines are disabled and used as instruction cache lines.
    enum:
      - 0
      - 1
      - 2
      - 3
      - 4

examples:
  - |
    soc {
        cache {
          compatible = "bflb,l1c";
          dcache-ways-disabled = <0>;
        };
    };
```

## dts/bindings/cache/nxp,cache64.yaml
```yaml
description: NXP CACHE64 controller and policy selector for FlexSPI/XSPI AHB windows
compatible: nxp,cache64

include: base.yaml

properties:
  reg:
    description: >
      Single MMIO region used as the base for both CACHE64_CTRL
      and CACHE64_POLSEL registers.
    required: true

  windows:
    type: array
    description: >
      Array of memory window configurations. Each window is encoded as:
      <base_addr size [remap_base]>
      - base_addr: Window base address in system memory map
      - size: Window size in bytes
      - remap_base: Optional remapped base address (use 0 if not remapped)

      Some SoCs expose the same physical memory through multiple address
      aliases (e.g., 0x18000000 and 0x38000000 for secure/non-secure access).
      The remap_base is used on platforms with CACHE64_CTRL_ALIAS_REMAPPED_BASE_ADDR
      feature to provide unified/contiguous address mapping.

      Examples:
        Single window, no remap:
          windows = <0x18000000 0x08000000 0>;

        Two windows, second one remapped:
          windows = <0x18000000 0x08000000 0>,
                    <0x38000000 0x04000000 0x10000000>;

        Three windows with continuous remap:
          windows = <0x60000000 0x02000000 0x00000000>,
                    <0x70000000 0x02000000 0x02000000>,
                    <0x80000000 0x04000000 0x04000000>;

  enable-write-buffer:
    type: boolean
    description: Enable cache write buffer if supported

  regions:
    type: array
    description: >
      Array of region configurations in ascending order. Each entry encodes:
      <boundary_addr policy>
        - boundary_addr: End address (exclusive) of this region, in bytes
          (converted to device units). Boundaries must be strictly increasing
          within the FlexSPI/XSPI physical address domain.
        - policy: 0=Non-cacheable, 1=Write-through, 2=Write-back

      Up to 3 regions are supported (CACHE64 hardware limit).

      Regions are defined between 0 and the first boundary, between consecutive
      boundaries, and from the last boundary to the end of the address space.
      Thus, N boundary entries normally define N+1 regions.

      To explicitly set the policy of the last region, add a final “sentinel”
      entry whose boundary_addr equals the end of the address space. The driver
      uses that entry policy for the last region, and does not program the
      sentinel boundary to hardware.

      Examples:
        Example 1: One boundary (2 regions), last region uses default policy
          regions = <0x01000000 2>;
          - Region 0: 0x00000000-0x00FFFFFF -> Write-back (16MB)
          - Region 1: 0x01000000-end        -> Non-cacheable (default)

        Example 2: Two boundaries (3 regions), last region uses default policy
          regions = <0x01000000 2>, <0x08000000 1>;
          - Region 0: 0x00000000-0x00FFFFFF -> Write-back (16MB)
          - Region 1: 0x01000000-0x07FFFFFF -> Write-through (112MB)
          - Region 2: 0x08000000-end        -> Non-cacheable (default)

        Example 3: Explicitly set last region policy via sentinel
          regions = <0x01000000 2>, <0x08000000 1>, <0x10000000 2>;
          - Region 0: 0x00000000-0x00FFFFFF -> Write-back (16MB)
          - Region 1: 0x01000000-0x07FFFFFF -> Write-through (112MB)
          - Region 2: 0x08000000-0x0FFFFFFF -> Write-back (128MB)
          (0x10000000 marks end-of-space; its boundary value is not programmed)

    default: []
```

## dts/bindings/cache/xuantie,xtheadcmo.yaml
```yaml
#
# Copyright (c) 2025 MASSDRIVER EI <massdriver.space>
#
# SPDX-License-Identifier: Apache-2.0
#

description: |
  Xuantie T-HEAD xtheadcmo extension cache control.

  xtheadcmo is documented at: https://github.com/XUANTIE-RV/thead-extension-spec
  It is a RISC-V extension that manages the CPU cache on T-HEAD cores.
  The node should be added in the CPU group and provide cache line sizes:

  cpus {

    ...

    cpu0: cpu@0 {

      ...

      cache {
        compatible = "xuantie,xtheadcmo";
        dcache-line-size = <32>;
        icache-line-size = <32>;
      };
    }
  };

  The cache configuration is specific to the platform, this only provides controls for it.

compatible: "xuantie,xtheadcmo"

include: base.yaml

properties:
  dcache-line-size:
    type: int
    description: Size of data cache line in bytes

  icache-line-size:
    type: int
    description: Size of data cache line in bytes
```

## dts/bindings/camera/camera.yaml
```yaml
#
# Copyright (c) 2019, NXP
#
# SPDX-License-Identifier: Apache-2.0
#
---
title: camera module
version: 0.1

description: >
    This binding specifies the camera module.
    If there are two cameras present, one is primary
    camera and the other is secondary camera.

inherits:
    !include base.yaml

properties:
    compatible:
      category: required

    clocks:
      type: array
      category: optional
      description: Clock gate information
      generation: define

    label:
      category: optional
      description: Primary camera("primary") or Secondary camera("secondary").
...
```

## dts/bindings/camera/image-sensor.yaml
```yaml
#
# Copyright (c) 2019, NXP
#
# SPDX-License-Identifier: Apache-2.0
#
---
title: CMOS Image Sensor
version: 0.1

description: >
    This is a representation of the CMOS Sensor nodes.

inherits:
    !include i2c-device.yaml

properties:
    compatible:
      constraint: "zephyr,image-sensor"

    pwr-gpios:
      type: compound
      category: optional
      description: power control
      generation: define
...
```

## dts/bindings/camera/nxp,imx-csi.yaml
```yaml
#
# Copyright (c) 2019, NXP
#
# SPDX-License-Identifier: Apache-2.0
#
---
title: NXP CMOS SENSOR INTERFACE
version: 0.1

description: >
    This binding gives a base representation of the NXP i.MX RT CSI nodes.

inherits:
    !include camera.yaml

properties:
    compatible:
      constraint: "nxp,imx-csi"

    clocks:
      category: required
...
```

## dts/bindings/can/adi,max32-can.yaml
```yaml
# Copyright (c) 2024 Analog Devices, Inc.
# SPDX-License-Identifier: Apache-2.0

description: ADI MAX32 CAN Node

compatible: "adi,max32-can"

include: ["can-controller.yaml", "pinctrl-device.yaml"]

properties:
  reg:
    required: true

  interrupts:
    required: true

  clocks:
    required: true
```

## dts/bindings/can/atmel,mcan.yaml
```yaml
description: Bosch m_can CAN-FD controller

compatible: "atmel,mcan"

include: bosch-mcan.yaml

properties:
    peripheral-id:
      type: int
      required: true
      description: peripheral ID

    pinctrl-0:
      type: phandles
      required: true
      description: |
        PIO pin configuration for CAN_RX & CAN_TX signals.  We expect that
        the phandles will reference pinctrl nodes.  These nodes will
        have a nodelabel that matches the Atmel SoC HAL defines and
        be of the form p<port><pin><periph>_<inst>_<signal>.
```
