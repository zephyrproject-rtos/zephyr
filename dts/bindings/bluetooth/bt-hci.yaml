## dts/bindings/bluetooth/bt-hci.yaml
```yaml
# Common fields for Bluetooth HCI devices

include: base.yaml

properties:
  bt-hci-name:
    type: string
    description: Name of the HCI transport
  bt-hci-bus:
    type: string
    description: Bus of the transport
    enum:
      - "bus_virtual"
      - "bus_usb"
      - "bus_pccard"
      - "bus_uart"
      - "bus_rs232"
      - "bus_pci"
      - "bus_sdio"
      - "bus_spi"
      - "bus_i2c"
      - "bus_smd"
      - "bus_virtio"
      - "bus_ipm"    # Deprecated. "ipc" should be used instead.
      - "bus_ipc"
  bt-hci-quirks:
    type: string-array
    description: HCI device quirks
    enum:
      - "no-reset"
      - "no-auto-dle"
  bt-hci-vs-ext:
    type: boolean
    description: Zephyr HCI vendor extensions are supported
```

## dts/bindings/bluetooth/espressif,bt-hci-esp-hosted-mcu.yaml
```yaml
# Copyright (c) 2026 Espressif Systems (Shanghai) CO LTD
# SPDX-License-Identifier: Apache-2.0

description: |
  Bluetooth HCI controller reached over the esp-hosted-mcu transport core. The
  controller runs on an external Espressif coprocessor (for example an
  ESP32-C6) and its HCI H4 traffic is multiplexed onto the same SPI or SDIO
  link as Wi-Fi by the esp-hosted-mcu core.

compatible: "espressif,bt-hci-esp-hosted-mcu"

include: bt-hci.yaml

properties:
  bt-hci-name:
    default: "ESP Hosted"
  bt-hci-bus:
    default: "virtual"

examples:
  - |
    esp_hosted_mcu_hci: esp-hosted-mcu-hci {
            compatible = "espressif,bt-hci-esp-hosted-mcu";
            status = "okay";
    };
```

## dts/bindings/bluetooth/espressif,esp32-bt-hci.yaml
```yaml
description: Bluetooth HCI for Espressif ESP32

compatible: "espressif,esp32-bt-hci"

include: bt-hci.yaml

properties:
  bt-hci-name:
    default: "BT ESP32"
  bt-hci-bus:
    default: "ipc"
  bt-hci-quirks:
    default: ["no-auto-dle"]
```

## dts/bindings/bluetooth/infineon,bt-hci-uart.yaml
```yaml
# Copyright (c) 2023 Cypress Semiconductor Corporation (an Infineon company) or
# an affiliate of Cypress Semiconductor Corporation
#
# SPDX-License-Identifier: Apache-2.0

description: |
    Connectivity chip that uses Infineon Bluetooth Host Controller Interface UART
    driver.

    Example of enabling device:

      &uart2 {
        status = "okay";
        current-speed = <115200>;

        /* HCI-UART pins*/
        pinctrl-0 = <&p3_1_scb2_uart_tx &p3_0_scb2_uart_rx
                     &p3_2_scb2_uart_rts &p3_3_scb2_uart_cts>;
        pinctrl-names = "default";

        /* HW Flow control must be enabled for HCI H4 */
        hw-flow-control;

        bt_hci_uart: bt_hci_uart {
          compatible = "zephyr,bt-hci-uart";
          status = "okay";

          bt-hci {
            status = "okay";
            compatible = "infineon,bt-hci-uart";
            bt-reg-on-gpios = <&gpio_prt3 4 GPIO_ACTIVE_HIGH>;

            fw-download-speed = <3000000>;
          };
        };
      };

    NOTE1: The UART bus speed (current_speed) for bt_hci_uart should be the same
           as the default baudrate defined in controller firmware (default 115200).

    NOTE2: Use fw-download-speed and hci-operation-speed properties to configure UART
           speeds for firmware download (fw-download-speed) and HCI operation
           (hci-operation-speed).
           If hci-operation-speed or fw-download-speed are not defined in bt-hci node,
           bt-hci driver will use bus/current-speed as default speed.

    NOTE3: Requires fetch binary files of BT controller. To fetch binary blobs:
           west blobs fetch hal_infineon

compatible: "infineon,bt-hci-uart"

include: base.yaml

properties:
  bt-reg-on-gpios:
    description: |
      Power-up/down gpio to control the internal regulators used
      by the Bluetooth section of the device.
    type: phandle-array

  bt-dev-wake-gpios:
    description: |
      Bluetooth device wake-up gpio. Signal from the host to the
      device indicating that the host requires attention.
    type: phandle-array

  bt-host-wake-gpios:
    description: |
      Host wake-up gpio. Signal from the device to the host
      indicating that the device requires attention.
    type: phandle-array

  hci-operation-speed:
    type: int
    description: |
      HCI UART baudrate for feature operation. If not defined
      bus/current-speed will be used as default.

  fw-download-speed:
    type: int
    description: |
      HCI UART baudrate for FW download operation. If not defined
      bus/current-speed will be used as default.
```

## dts/bindings/bluetooth/infineon,cat1-bless-hci.yaml
```yaml
# Copyright (c) 2023 Cypress Semiconductor Corporation (an Infineon company) or
# an affiliate of Cypress Semiconductor Corporation
#
# SPDX-License-Identifier: Apache-2.0

description: |
    Bluetooth module that uses Infineon's Host Controller Interface

compatible: "infineon,cat1-bless-hci"

include: bt-hci.yaml

properties:
  bt-hci-name:
    default: "PSOC 6 BLESS"
  bt-hci-bus:
    default: "virtual"
  bt-hci-quirks:
    default: ["no-reset"]
  interrupts:
    required: true
```

## dts/bindings/bluetooth/infineon,cyw208xx-hci.yaml
```yaml
# Copyright (c) 2024 Cypress Semiconductor Corporation (an Infineon company) or
# an affiliate of Cypress Semiconductor Corporation
#
# SPDX-License-Identifier: Apache-2.0

description: |
    Bluetooth module that uses Infineon CYW208XX HCI bluetooth interface

    NOTE:
      cyw920829 requires fetch binary files of Bluetooth controller firmware.
      To fetch Binary Blobs:  west blobs fetch hal_infineon

compatible: "infineon,cyw208xx-hci"

include: bt-hci.yaml

properties:
  bt-hci-name:
    default: "CYW208XX"
  bt-hci-bus:
    default: "BT_HCI_BUS_VIRTUAL"
```

## dts/bindings/bluetooth/infineon,cyw43xxx-bt-hci.yaml
```yaml
# Copyright (c) 2023 Cypress Semiconductor Corporation (an Infineon company) or
# an affiliate of Cypress Semiconductor Corporation
#
# SPDX-License-Identifier: Apache-2.0

description: |
    CYW43xxx Connectivity that uses Zephyr's Bluetooth Host Controller Interface UART
    driver.

    Example of enabling CYW43xxx device:

      &uart2 {
        status = "okay";
        current-speed = <115200>;

        /* HCI-UART pins*/
        pinctrl-0 = <&p3_1_scb2_uart_tx &p3_0_scb2_uart_rx
                     &p3_2_scb2_uart_rts &p3_3_scb2_uart_cts>;
        pinctrl-names = "default";

        /* HW Flow control must be enabled for HCI H4 */
        hw-flow-control;

        bt-hci {
          status = "okay";
          compatible = "infineon,cyw43xxx-bt-hci";
          bt-reg-on-gpios = <&gpio_prt3 4 (GPIO_ACTIVE_HIGH)>;

          fw-download-speed = <3000000>;
        };
      };

    NOTE1: The UART bus speed (current_speed) for zephyr_bt_uart should be the same
           as the default baudrate defined in CYW43xx firmware (default 115200).

    NOTE2: Use fw-download-speed and hci-operation-speed properties to configure UART
           speeds for firmware download (fw-download-speed) and HCI operation
           (hci-operation-speed).
           If hci-operation-speed or fw-download-speed are not defined in bt-hci node,
           cyw43xx driver will use bus/current-speed as default speed.

    NOTE3: CYW43xxx requires fetch binary files of BT controller. To fetch binary blobs:
           west blobs fetch hal_infineon

compatible: "infineon,cyw43xxx-bt-hci"

include: base.yaml

properties:
  bt-reg-on-gpios:
    description: |
      Power-up/down gpio to control the internal regulators used
      by the Bluetooth section of CYW43xx device.
    type: phandle-array

  bt-dev-wake-gpios:
    description: |
      Bluetooth device wake-up gpio. Signal from the host to the
      CYW43xx indicating that the host requires attention.
    type: phandle-array

  bt-host-wake-gpios:
    description: |
      Host wake-up gpio. Signal from the CYW43xx to the host
      indicating that the CYW43xx requires attention.
    type: phandle-array

  hci-operation-speed:
    type: int
    description: |
      HCI UART boudrate for feature operation. If not defined
      bus/current-speed will be used as default.

  fw-download-speed:
    type: int
    description: |
      HCI UART boudrate for FW download operation. If not defined
      bus/current-speed will be used as default.
```

## dts/bindings/bluetooth/nxp,bt-hci-uart.yaml
```yaml
# Copyright 2024,2026 NXP
# SPDX-License-Identifier: Apache-2.0

description: |
    Bluetooth module that uses NXP's Bluetooth Module (e.g. Murata 2EL)

compatible: "nxp,bt-hci-uart"

include: base.yaml

properties:
  sdio-reset-gpios:
    type: phandle-array
    required: true

  w-disable-gpios:
    type: phandle-array
    required: true

  hci-operation-speed:
    type: int
    description: |
      HCI UART baudrate for feature operation. If not defined
      bus/current-speed will be used as default.

  hw-flow-control:
    type: boolean
    description: Set to enable RTS/CTS flow control for HCI.

  fw-download-primary-speed:
    type: int
    description: |
      HCI UART primary baudrate for FW download operation.
      If not defined bus/current-speed will be used as default.

  fw-download-primary-flowcontrol:
    type: boolean
    description: |
      Flow control setting for primary speed.

  fw-download-secondary-speed:
    type: int
    description: |
      HCI UART secondary baudrate for FW download operation.
      If not defined bus/current-speed will be used as default.

  fw-download-secondary-flowcontrol:
    type: boolean
    description: |
      Flow control setting for secondary speed.

  wakeup-bt-gpios:
    type: phandle-array
    description: |
      BT wakeup host pin
      This pin defaults to active low when consumed by the SDK card. The
      property value should ensure the flags properly describe the signal
      that is presented to the driver.
```

## dts/bindings/bluetooth/realtek,ameba-bt-hci.yaml
```yaml
# Copyright (c) 2026 Realtek Semiconductor Corp.
# SPDX-License-Identifier: Apache-2.0

description: Bluetooth HCI for REALTEK AMEBA

compatible: "realtek,ameba-bt-hci"

include: bt-hci.yaml

properties:
  bt-hci-name:
    default: "BT AMEBA"
```

## dts/bindings/bluetooth/realtek,bee-bt-hci.yaml
```yaml
# Copyright (c) 2026, Realtek Semiconductor Corporation
# SPDX-License-Identifier: Apache-2.0

description: Bluetooth HCI for Realtek Bee SoCs

compatible: "realtek,bee-bt-hci"

include: bt-hci.yaml

properties:
  bt-hci-name:
    default: "BT BEE"
  bt-hci-bus:
    default: "virtual"
```

## dts/bindings/bluetooth/renesas,bt-hci-da1453x.yaml
```yaml
# Copyright 2024 Ian Morris
# SPDX-License-Identifier: Apache-2.0

description: |
  Extension of the Bluetooth H:4 HCI driver for a Renesas DA1453x based
  controller, allowing control of the GPIO used to reset the DA1453x.

compatible: "renesas,bt-hci-da1453x"

include: base.yaml

properties:
  reset-gpios:
    type: phandle-array
    description: |
      This gpio is used to reset the DA1453x.

  reset-assert-duration-ms:
    type: int
    description: |
      Minimum duration to activate the reset-gpios pin.
      If not specified no delay beyond the code path execution time is guaranteed.

  boot-duration-ms:
    type: int
    default: 200
    description: |
      Minimum time to wait for the DA1453x to boot following a hardware reset.
```

## dts/bindings/bluetooth/renesas,bt-hci-da1469x.yaml
```yaml
description: Bluetooth HCI for Renesas DA1469x

compatible: "renesas,bt-hci-da1469x"

include: bt-hci.yaml

properties:
  bt-hci-name:
    default: "BT DA1469x"
  bt-hci-bus:
    default: "ipc"
```

## dts/bindings/bluetooth/sifli,bt-mbox.yaml
```yaml
# Mailbox Bluetooth HCI device

description: Bluetooth HCI behind a mailbox IPC device (H:4)

compatible: "sifli,bt-mbox"

include: bt-hci.yaml

properties:
  bt-hci-name:
    default: "mbox"
  bt-hci-bus:
    default: "virtual"
        
mbox-cells:
  - channel    
```

## dts/bindings/bluetooth/sifli,sf32lb-mailbox.yaml
```yaml
# Mailbox Bluetooth HCI device

description: |
    Mailbox device to exchange Bluetooth HCI traffic between
    application CPU and bluetooth LCPU. The traffic is encoding
    in Bluetooth UART H:4 format.

compatible: "sifli,sf32lb-mailbox"

include: bt-hci.yaml

properties:
  bt-hci-name:
    default: "mailbox"
  bt-hci-bus:
    default: "virtual"
```

## dts/bindings/bluetooth/silabs,bt-hci-efr32.yaml
```yaml
title: Silicon Labs Series 2 Bluetooth HCI (Host-Controller Interface)

description: |
  Bluetooth Host-Controller Interface for Silicon Labs Series 2 SoCs.

compatible: "silabs,bt-hci-efr32"

include: bt-hci.yaml

properties:
  bt-hci-name:
    default: "efr32"
  bt-hci-bus:
    default: "virtual"
  bt-hci-quirks:
    default: ["no-reset"]
```

## dts/bindings/bluetooth/silabs,bt-hci.yaml
```yaml
description: Bluetooth HCI on Silabs boards

compatible: "silabs,bt-hci"

include: bt-hci.yaml

properties:
  bt-hci-name:
    default: "sl:bt"
  bt-hci-bus:
    default: "BT_HCI_BUS_VIRTUAL"
  bt-hci-quirks:
    default: ["BT_HCI_QUIRK_NO_RESET"]
```

## dts/bindings/bluetooth/silabs,siwx91x-bt-hci.yaml
```yaml
description: Bluetooth HCI on Silabs boards

compatible: "silabs,siwx91x-bt-hci"

include: bt-hci.yaml

properties:
  bt-hci-name:
    default: "sl:bt:siwx91x"
  bt-hci-bus:
    default: "virtual"
  bt-hci-quirks:
    default: ["no-reset"]
```

## dts/bindings/bluetooth/st,bluenrg2-uart.yaml
```yaml
# Copyright (C) 2022 Marek Matej
# SPDX-License-Identifier: Apache-2.0

description: ST BlueNRG2 chip with DTM firmware connected by uart

compatible: "st,bluenrg2-uart"

include: uart-device.yaml

properties:
  label:
    required: true

  reset-gpios:
    type: phandle-array
    required: true

  wake-gpios:
    type: phandle-array
    required: false
```

## dts/bindings/bluetooth/st,hci-spi-v1.yaml
```yaml
# Copyright (c) 2023, STMicroelectronics
# SPDX-License-Identifier: Apache-2.0

description: STMicroelectronics SPI protocol V1 compatible with BlueNRG-MS devices

compatible: "st,hci-spi-v1"

include: zephyr,bt-hci-spi.yaml

properties:
  bt-hci-quirks:
    default: ["no-reset"]

  reset-event:
    type: boolean
    description:
      It indicates whether a proprietary event is generated after reset to inform the host
      that the controller is ready to receive commands.

  req-ll-only:
    type: boolean
    description:
      It indicates that the host needs to send a vendor-specific command to put the BlueNRG
      into controller-only mode.
```

## dts/bindings/bluetooth/st,hci-spi-v2.yaml
```yaml
# Copyright (c) 2023, STMicroelectronics
# SPDX-License-Identifier: Apache-2.0

description: STMicroelectronics SPI protocol V2 compatible with BlueNRG-1 and successor devices

compatible: "st,hci-spi-v2"

include: st,hci-spi-v1.yaml

properties:
  reset-delay-ms:
    type: int
    description:
      Duration to wait after reset, in ms. This allows the system to be up and running after reset
      if the controller does not generate a proprietary event.

  wait-irq-low:
    type: boolean
    description:
      It indicates whether the host needs to wait for the IRQ pin to go low
      after sending the header.
```

## dts/bindings/bluetooth/st,hci-stm32wb0.yaml
```yaml
description: Bluetooth HCI driver for ST STM32WB0 series

compatible: "st,hci-stm32wb0"

include: bt-hci.yaml

properties:
  bt-hci-name:
    default: "HCI over RAM"
  bt-hci-bus:
    default: "virtual"
  bt-hci-quirks:
    default: ["no-reset"]
```

## dts/bindings/bluetooth/st,hci-stm32wba.yaml
```yaml
description: Bluetooth HCI driver for ST STM32WBA

compatible: "st,hci-stm32wba"

include: bt-hci.yaml

properties:
  bt-hci-name:
    default: "BT IPM"
  bt-hci-bus:
    default: "BT_HCI_BUS_IPM"
```
