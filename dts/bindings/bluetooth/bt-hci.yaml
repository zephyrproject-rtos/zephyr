## dts/bindings/bluetooth/st,spbtle-rf.yaml
```yaml
#
# Copyright (c) 2018, I-SENSE group of ICCS
#
# SPDX-License-Identifier: Apache-2.0
#
---
title: STMicroelectronics SPBTLE-RF bluetooth module
id: st,spbtle-rf
version: 0.1

description: >
    This binding gives the base representation of SPBTLE-RF bluetooth module

inherits:
    !include spi-device.yaml

properties:
    compatible:
      constraint: "st,spbtle-rf"

    irq-gpios:
      type: compound
      category: required
      generation: define, use-prop-name

    reset-gpios:
      type: compound
      category: required
      generation: define, use-prop-name
...
```

## dts/bindings/bluetooth/st,stm32wb-ble-rf.yaml
```yaml
# Copyright (c) 2022, Linaro Limited
# SPDX-License-Identifier: Apache-2.0

description: |
    STM32WB Radio device

compatible: "st,stm32wb-rf"

include: bt-hci.yaml

properties:
  clocks:
    required: true
  bt-hci-name:
    default: "BT IPM"
  bt-hci-bus:
    default: "ipm"
```

## dts/bindings/bluetooth/telink,tlx-bt.yaml
```yaml
# Copyright (c) 2024, Telink Semiconductor
# SPDX-License-Identifier: Apache-2.0

description: Telink TLx Bluetooth HCI node

compatible: "telink,tlx-bt"

include: bt-hci.yaml

properties:
  bt-hci-name:
    default: "HCI Controller"
  bt-hci-bus:
    default: "BT_HCI_BUS_VIRTUAL"
  bt-hci-quirks:
    default: ["BT_HCI_QUIRK_NO_AUTO_DLE"]
```
