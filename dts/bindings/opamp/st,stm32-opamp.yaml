## dts/bindings/pcie/host/pcie-device.yaml
```yaml
# Copyright (c) 2022 Intel Corporation
# SPDX-License-Identifier: Apache-2.0

# Common fields for PCIe devices

properties:
  pcie-controller:
    type: phandle
    description: |
      Owning PCIe host controller. Nodes on a pcie bus use their bus controller
      when this property is absent; other nodes default to the
      zephyr,pcie-controller chosen node unless this property is specified.
  vendor-id:
    type: int
    description: Vendor ID of the device
  device-id:
    type: int
    description: Device ID of the device
  class-rev:
    type: int
    description: Optional class/revision register filter
  class-rev-mask:
    type: int
    description: Class/revision register mask
```

## dts/bindings/phy/rockchip,rk3588-usb2phy.yaml
```yaml
# SPDX-FileCopyrightText: Copyright The Zephyr Project Contributors
# SPDX-License-Identifier: Apache-2.0

title: Rockchip RK3588 USB 2.0 PHY

description: |
  Innosilicon USB 2.0 PHY of the RK3588, controlled through the GRF syscon
  whose child the node is. The properties follow the Linux
  rockchip,inno-usb2phy binding; the USB controller refers to a port of the
  PHY in its phys property.

  Example:

    usb2phy0_grf: syscon@fd5d0000 {
      compatible = "rockchip,rk3588-usb2phy-grf", "syscon", "simple-mfd";
      reg = <0xfd5d0000 0x4000>;
      #address-cells = <1>;
      #size-cells = <1>;

      u2phy0: usb2phy@0 {
        compatible = "rockchip,rk3588-usb2phy";
        reg = <0x0 0x10>;
        #clock-cells = <0>;
        clocks = <&cru_clk CLK_USB2PHY_HDPTXRXPHY_REF>;
        clock-names = "phyclk";
        clock-output-names = "usb480m_phy0";
        resets = <&cru_rst SRST_OTGPHY_U3_0>, <&cru_rst SRST_P_USB2PHY_U3_0_GRF0>;
        reset-names = "phy", "apb";

        u2phy0_otg: otg-port {
          #phy-cells = <0>;
        };
      };
    };

compatible: "rockchip,rk3588-usb2phy"

include: [base.yaml, reset-device.yaml]

properties:
  reg:
    required: true
    description: |
      Address of the PHY registers in the GRF, which identifies the PHY:
      0x0 and 0x4000 for the PHYs of the USB 3.0 OTG controllers.

  clock-output-names:
    type: string-array
    description: Name of the 480 MHz clock the PHY provides.

  rockchip,usbgrf:
    type: phandle
    description: USB GRF syscon, on SoCs that need it.

  extcon:
    type: phandle
    description: External connector reference.

  wakeup-source:
    type: boolean
    description: The PHY can wake the system up.

child-binding:
  description: Host or OTG port of the PHY, without a compatible as in Linux.

  properties:
    "#phy-cells":
      type: int
      required: true
      const: 0

    phy-supply:
      type: phandle
      description: Regulator of the port VBUS.
```

## dts/bindings/pinctrl/microchip,pio-g1-pinctrl.yaml
```yaml
# SPDX-FileCopyrightText: Copyright The Zephyr Project Contributors
# SPDX-License-Identifier: Apache-2.0

title: Microchip PIO pin controller (group g1)

description: |
  Microchip PIO pin controller (group g1).

  The pin controller is a singleton node, labeled 'pinctrl', that contains the
  PIO GPIO controllers as child nodes and the pin configurations used by
  devices. Pins are selected with the MCHP_PINMUX macros of the SoC pinctrl
  header, for example:

    #include <dt-bindings/pic32c/pic32cz_ca/pic32cz_ca70/pic32cz2051ca70144-pinctrl.h>

    &pinctrl {
      uart1_default: uart1_default {
        group1 {
          pinmux = <PA5C_UART1_URXD1>, <PA6C_UART1_UTXD1>;
          bias-pull-up;
        };
      };
    };

  Peripheral functions A to D are routed through PIO_ABCDSR. GPIO entries hand
  the pin to the PIO. Extra functions (analog inputs, wake-up inputs, crystal
  and debug pins) are left to the peripheral that owns them; for PB4 to PB7
  and PB12 they also restore the system function selected by CCFG_SYSIO.

  Group g1 PIO PINCTRL driver supports following hardware peripherals:
    - module name="PIO" id="11004" version="V"

compatible: "microchip,pio-g1-pinctrl"

include: base.yaml

properties:
  "#address-cells":
    required: true
    const: 1
  "#size-cells":
    required: true
    const: 1

child-binding:
  description: |
    Each child node defines the configuration for a particular state.
  child-binding:
    description: |
      The grandchild nodes group pins that share the same pin configuration.

    include:
      - name: pincfg-node.yaml
        property-allowlist:
          - bias-pull-up
          - bias-pull-down
          - drive-open-drain
          - input-enable
          - output-enable

    properties:
      pinmux:
        required: true
        type: array
        description: |
          An array of pins sharing the same group properties, defined with the
          macros of the SoC pinctrl header.

      slew-rate:
        type: string
        default: "fast"
        enum:
          - "fast"
        description: |
          The PIO has no slew rate control. This property exists for the
          shared PIC32CZ CA pin configuration encoding and only accepts its
          default value.
```

## dts/bindings/pinctrl/renesas,rza-pinctrl.yaml
```yaml
# Copyright (c) 2025 Renesas Electronics Corporation
# SPDX-License-Identifier: Apache-2.0

description: |
  The pin definitions are provided by a header per SoC, which includes the
  helpers common to the RZ/A SoCs from pinctrl-rza-common.h:
    - pinctrl-rza3ul.h for RZ/A3UL
    - pinctrl-rza3m.h for RZ/A3M

  Below generic example shows of supported pinctrl definitions:

    #include <zephyr/dt-bindings/pinctrl/renesas/pinctrl-rza3ul.h>
    example_pins: device_pin {
        device-pinmux {
          pinmux = <RZA_PINMUX(PORT_08, 1, 5)>,
                   <RZA_PINMUX(PORT_08, 2, 5)>;
          bias_pull_up;
          renesas,filter = RZA_FILTER_SET(RZA_FILNUM_8_STAGE,RZA_FILCLKSEL_DIV_18000);
          drive-strength = <1>;
          slew-rate = "fast";
        };

        device-spins {
          pins = <BSP_IO_XSPI_IO0>, <BSP_IO_XSPI_IO4>;
          input-enable;
          renesas,filter = RZA_FILTER_SET(RZA_FILNUM_8_STAGE,RZA_FILCLKSEL_DIV_18000);
          drive-strength = <2>;
          slew-rate = "fast";
        };
      };


compatible: "renesas,rza-pinctrl"

include: base.yaml

child-binding:
  description: |
    This RZA pins mux/cfg nodes description.

  child-binding:
    description: |
      The RZA pinmux/pincfg configuration nodes description.

    include:
    - name: pincfg-node.yaml
      property-allowlist:
      - bias-disable
      - bias-high-impedance
      - bias-pull-down
      - bias-pull-up
      - bias-pull-pin-default
      - drive-strength
      - input-enable
      - input-disable
      - output-enable
      - power-source
      - low-power-enable
      - low-power-disable

    properties:
      pinmux:
        type: array
        description: |
          Pinmux configuration node.
          Values are constructed from GPIO port number, pin number, and
          alternate function configuration number using the RZA_PINMUX()
          helper macro in the header of the SoC

      pins:
        type: array
        description: |
          Special Purpose pins configuration node.
          Values are defined in the header of the SoC.
          Ex: BSP_IO_XSPI_IO0,BSP_IO_I3C_SCL,...

      drive-strength:
        type: int
        default: 0
        description: |
          Maximum sink or source current in mA for pin which shall be selected
          depending on device and pin group.

      renesas,filter:
        type: int
        description: |
          Digital Noise Filter configuration for a pin which shall be defined
          using RZA_FILTER_SET() helper macro in pinctrl-rza-common.h to specify
          FILNUM and FILCLKSEL. With 24Mhz external clock:
          - min debounce time will be 166.666ns for FILNUM=0 and FILCLKSEL=0
          - max debounce time will be 24ms for FILNUM=3 and FILCLKSEL=3.
          This property intentionally redefined to avoid unnecessary conversation from usec to
          FILNUM and FILCLKSEL values depending on external clock value as this configuration
          is static.

      slew-rate:
        type: string
        default: "fast"
        enum:
        - "slow"
        - "fast"
        description: |
          Select slew rate for pin.
```

## dts/bindings/pinctrl/rockchip,rk3588-pinctrl.yaml
```yaml
# SPDX-FileCopyrightText: Copyright (c) 2026 Process Mission
# SPDX-License-Identifier: Apache-2.0

description: |
  Rockchip RK3588 IOC pin controller.

  The controller exposes pin multiplexing and pad configuration through one
  64 KiB IOC window. Device tree pinctrl states use Zephyr's standard state
  and group model.

title: Rockchip RK3588 IOC pin controller

compatible: "rockchip,rk3588-pinctrl"

include: base.yaml

properties:
  reg:
    required: true

child-binding:
  description: RK3588 pinctrl state.

  child-binding:
    description: Pins sharing the same configuration.

    include:
      - name: pincfg-node.yaml
        property-allowlist:
          - bias-disable
          - bias-pull-down
          - bias-pull-up
          - input-enable
          - input-disable
          - input-schmitt-enable
          - input-schmitt-disable

    properties:
      pinmux:
        type: array
        required: true
        description: |
          Encoded bank, bank-local pin, and mux function values created with
          RK3588_PINMUX() from rockchip-rk3588.h.

      rockchip,drive-strength-ohms:
        type: int
        enum: [25, 33, 40, 50, 66, 100]
        description: |
          Output driver impedance. RK3588 uses two distinct, non-linear
          hardware encodings; only values defined by the TRM for the selected
          pins are accepted.
```

## dts/bindings/pinctrl/wch,ch582m-pinctrl.yaml
```yaml
# Copyright (c) 2026 Zephyr Project Contributors
# SPDX-License-Identifier: Apache-2.0

description: WCH CH582M pin controller

compatible: "wch,ch582m-pinctrl"

include: base.yaml

properties:
  reg:
    required: true
  "#address-cells":
    required: true
    const: 1
  "#size-cells":
    required: true
    const: 1

child-binding:
  description: |
    Each child node defines the configuration for a particular state.
  child-binding:
    description: |
      The grandchild nodes group pins that share the same pin configuration.

    include:
      - name: pincfg-node.yaml
        property-allowlist:
          - bias-high-impedance
          - bias-pull-up
          - bias-pull-down
          - drive-push-pull
          - output-high
          - output-low

    properties:
      output-capacity:
        type: string
        default: "5mA-level"
        enum:
          - "5mA-level"
          - "20mA-level"
        description: |
          Configures the output pin drive strength (5 mA or 20 mA current
          drive capability).

      pinmux:
        required: true
        type: array
        description: |
          An array of pins sharing the same group properties. The pins should
          be defined using the CH582M_PINMUX_DEFINE() macro.
```

## dts/bindings/pinctrl/wch,x03x-afio.yaml
```yaml
# Copyright (c) 2026 Chen Ren
# SPDX-License-Identifier: Apache-2.0

description: WCH CH32X035 Alternate Function (AFIO)

compatible: "wch,x03x-afio"

include: base.yaml

properties:
  reg:
    required: true
  "#address-cells":
    required: true
    const: 1
  "#size-cells":
    required: true
    const: 1

child-binding:
  description: |
    Each child node defines the configuration for a particular state.
  child-binding:
    description: |
      The grandchild nodes group pins that share the same pin configuration.

    include:
      - name: pincfg-node.yaml
        property-allowlist:
          - bias-high-impedance
          - bias-pull-up
          - bias-pull-down
          - drive-open-drain
          - drive-push-pull
          - output-high
          - output-low

    properties:
      slew-rate:
        type: string
        default: "max-speed"
        enum:
          - "max-speed"

      pinmux:
        required: true
        type: array
        description: |
          An array of pins sharing the same group properties. The pins should
          be defined using pre-defined macros.
```

## dts/bindings/pwm/st,stm32-lptim-pwm.yaml
```yaml
description: |
  STM32 LPTIM PWM

  PWM output of an STM32 low-power timer. The node is a child of an "st,stm32-lptim" node, which
  gives the registers, the reset line, the clocks and the counter prescaler (st,prescaler). The
  second clock of the parent selects the kernel clock. With LSI or LSE the output keeps running
  in the Stop modes where the timer is functional.

  A constant level, 0 % or 100 % duty cycle, is exact while no channel of the timer generates a
  waveform, since the counter is then stopped. On an instance with two channels, while the other
  channel generates a waveform, 0 % becomes one high cycle per period and 100 % one low cycle
  per period, since an exact level would disturb the other channel. A channel with a GPIO in
  channel-gpios holds exact levels in all cases.

  Example for STM32U5, LPTIM3 clocked by LSI, channel 1 on PD14:

    &lptim3 {
      clocks = <&rcc STM32_CLOCK(APB3, 12)>,
               <&rcc STM32_SRC_LSI LPTIM34_SEL(1)>;
      status = "okay";

      lptim3_pwm: pwm {
        pinctrl-0 = <&lptim3_ch1_pd14>;
        pinctrl-names = "default";
        status = "okay";
      };
    };

compatible: "st,stm32-lptim-pwm"

include: [pwm-controller.yaml, base.yaml, pinctrl-device.yaml]

properties:
  pinctrl-0:
    required: true

  pinctrl-names:
    required: true

  channel-gpios:
    type: phandle-array
    description: |
      GPIO of the output pin of each channel, in channel order, with <0> for a channel without
      one. For 0 % and 100 % duty cycle the pin of a channel with a GPIO is driven as GPIO
      output, which gives exact levels also while the other channel generates a waveform. For a
      waveform the pin goes back to the timer. Each GPIO must be the pin of its channel in
      pinctrl-0. The level is the physical one that the PWM flags select, so GPIO_ACTIVE_LOW has
      no effect. On an instance with a single output, a GPIO also avoids a short low pulse when a
      pulse of a waveform with the regular polarity switches to a high level.

      Example for channel 2 of LPTIM2 on PC7:

        channel-gpios = <0>, <&gpioc 7 GPIO_ACTIVE_HIGH>;

  "#pwm-cells":
    const: 3
    description: |
      Number of items to expect in a PWM
      - channel of the timer used for PWM
      - period to set in ns
      - flags : combination of standard flags like PWM_POLARITY_NORMAL

pwm-cells:
  - channel
  - period
  - flags
```

## dts/bindings/rc/pwm-ir-transmitter.yaml
```yaml
# SPDX-FileCopyrightText: Copyright (c) 2026 Linumiz
# SPDX-License-Identifier: Apache-2.0

description: |
  Infrared LED driven by a PWM output. The PWM generates the carrier and
  a counter alarm switches it on and off at each pulse and space edge.

compatible: "pwm-ir-transmitter"

include:
  - name: rc-device.yaml
    property-blocklist:
      - protocols
      - rx-timeout-us

properties:
  pwms:
    type: phandle-array
    required: true
    description: |
      PWM output driving the LED, one entry. The period in the
      specifier is not used: the carrier comes from carrier-hz and
      duty-cycle-percent, or from the protocol.

  counter:
    type: phandle
    required: true
    description: |
      Counter timing the edges. Its frequency sets the edge resolution,
      1 MHz or more is recommended.

  counter-channel:
    type: int
    default: 0
    description: Counter alarm channel used for the edges.
```
