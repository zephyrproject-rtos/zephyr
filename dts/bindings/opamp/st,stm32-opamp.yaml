## dts/bindings/opamp/st,stm32-opamp.yaml
```yaml
# Copyright (c) 2025 Alexander Kozhinov <ak.alexander.kozhinov@gmail.com>
# Copyright (c) 2026 Witekio
# SPDX-License-Identifier: Apache-2.0

description: STM32 OPAMP (Operational Amplifier)

include:
  - opamp-controller.yaml

compatible: st,stm32-opamp

properties:
  reg:
    required: true
  clocks:
    required: true
  clock-names:
    required: true
  pinctrl-0:
    required: true
  pinctrl-names:
    required: true

  st,opamp-offset-trimming-time-ms:
    type: int
    required: true
    description: |
      Offset trim time: during calibration, minimum time needed between
      two steps to have 1 mV accuracy

  st,enable-self-calibration:
    type: boolean
    description: |
      Run the offset self-calibration of the NMOS and PMOS differential pairs
      at OPAMP initialization.

  st,pmos-trimming-value:
    type: int
    description: |
      Offset trimming value of the PMOS differential pair.
      If present together with st,enable-self-calibration, this value
      overrides the one found by self-calibration.
    min: 0
    max: 0x1f

  st,nmos-trimming-value:
    type: int
    description: |
      Offset trimming value of the NMOS differential pair.
      If present together with st,enable-self-calibration, this value
      overrides the one found by self-calibration.
    min: 0
    max: 0x1f

  st,opamp-has-secondary-inputs:
    type: boolean
    description: |
      If present, the OPAMP has secondary inputs selected by a timer controlled
      multiplexer.

  st,opamp-has-lock:
    type: boolean
    description: |
      If present, the OPAMP configuration can be locked until the next system reset.

  st,opamp-has-internal-output:
    type: boolean
    description: |
      If present, the OPAMP output can be internally connected to an ADC input.

  st,opamp-has-vdda-isolation:
    type: boolean
    description: |
      If present, the analog peripherals are isolated from VDDA after reset and
      their supply has to be enabled in the PWR peripheral.

  st,opamp-has-common-power-range:
    type: boolean
    description: |
      If present, the power supply range (OPA_RANGE) is common to all OPAMP
      instances and has to be set before the first one is enabled.
```

## dts/bindings/opamp/st,stm32u5-opamp.yaml
~~~~yaml
# Copyright (c) 2026 Witekio
# SPDX-License-Identifier: Apache-2.0

title: STM32U5 OPAMP (Operational Amplifier)

description: |
  One OPAMP has two inputs and one output. The three I/Os can be connected
  to external pins, enabling any type of external interconnection.
  An OPAMP can be configured internally:
    - standalone amplifier (external gain setting mode)
    - follower
    - non-inverting amplifier with gains of 2, 4, 8 or 16

  The non-inverting input can be connected to an internal DAC channel.

  Minimal DTS examples:

    - Standalone amplifier (external gain):
      ```
      &opamp2 {
        pinctrl-0 = <&opamp2_vinm_pa7 &opamp2_vinp_pa6 &opamp2_vout_pb0>;
        pinctrl-names = "default";
        functional-mode = "standalone";
        inp = "VINP0";
        inm = "VINM0";
        status = "okay";
      };
      ```

    - Follower (voltage buffer) of the DAC output:
      ```
      &opamp2 {
        pinctrl-0 = <&opamp2_vout_pb0>;
        pinctrl-names = "default";
        functional-mode = "follower";
        inp = "DAC";
        status = "okay";
      };
      ```

    - Non-inverting PGA (gain 2..16):
      ```
      &opamp2 {
        pinctrl-0 = <&opamp2_vinp_pa6 &opamp2_vout_pb0>;
        pinctrl-names = "default";
        functional-mode = "non_inverting";
        inp = "VINP0";
        status = "okay";
      };
      ```

include:
  - st,stm32-opamp.yaml

compatible: st,stm32u5-opamp

properties:
  st,power-mode:
    type: string
    description: |
      OPAMP power mode, selected by the OPALPM and OPAHSM bits of OPAMPx_CSR:
        - NORMALPOWER_NORMALSPEED: normal mode, standard slew rate.
        - LOWPOWER_NORMALSPEED: low-power mode, standard slew rate.
        - NORMALPOWER_HIGHSPEED: normal mode, increased consumption to
          improve the slew rate.
        - LOWPOWER_HIGHSPEED: low-power mode, increased consumption to
          improve the slew rate.
      Normal and low-power modes use separate trimming values (OPAMPx_OTR
      and OPAMPx_LPOTR). Refer to the device datasheet for the slew rate,
      bandwidth and consumption of each mode.
    enum:
      - NORMALPOWER_NORMALSPEED
      - LOWPOWER_NORMALSPEED
      - NORMALPOWER_HIGHSPEED
      - LOWPOWER_HIGHSPEED
    default: NORMALPOWER_NORMALSPEED

  inp:
    required: true
    type: string
    description: |
      Non-inverting input selection (VP_SEL bit of OPAMPx_CSR):
        - VINP0: GPIO pin
        - DAC: internal DAC channel
    enum:
      - VINP0
      - DAC

  inm:
    type: string
    description: |
      Inverting input selection (VM_SEL bits of OPAMPx_CSR):
        - VINM0: GPIO pin
        - VINM1: dedicated low-leakage input
      Required in standalone mode. In non_inverting (PGA) mode it is optional
      and connects the selected pin to the internal feedback node for
      low-pass filtering. Leave unset to keep the inverting input not
      externally connected. Ignored in follower mode.
    enum:
      - VINM0
      - VINM1
~~~~

## dts/bindings/opamp/ti,am13-pga.yaml
```yaml
# Copyright (c) 2026 Texas Instruments Incorporated
# SPDX-License-Identifier: Apache-2.0

description: |
  Texas Instruments AM13E Programmable Gain Amplifier (PGA).

  Register and field names (PGACTL, MUXSEL, PWREN_SYSPERIPH, ...) are those of
  the AM13E230x Technical Reference Manual (SPRUJF2), chapter "Programmable
  Gain Amplifier (PGA)" and section "Peripheral Power Control".

  An op-amp with an internal resistor ladder. Mux topology, filter resistor
  and output routing are set in devicetree; only gain changes at runtime via
  opamp_set_gain().

  functional-mode must match the mux connections:
    non_inverting: nmux rtap, mmux non-inverting. Gain x1, x2, x4 ... x64.
    inverting: nmux rtap, mmux inm0..inm3 or shared. Gain -1, -3, -7 ... -63,
      selected by magnitude.
    differential: as inverting; gain selects G in G * INP - (G - 1) * INM.
    follower: nmux rtop, mmux standalone. Fixed gain x1.
    standalone: nmux inm0..inm3, mmux standalone. Gain set externally;
      opamp_set_gain() has no effect.

  The amplifier starts at the lowest gain of its mode.

compatible: "ti,am13-pga"

include: opamp-controller.yaml

properties:
  reg:
    required: true

  sysctl:
    type: phandle
    required: true
    description: SYSCTL syscon containing the peripheral power control register.

  ti,power-bit:
    type: int
    required: true
    enum: [1, 2, 3]
    description: PGA instance bit in SYSCTL PWREN_SYSPERIPH.

  ti,pmux-input:
    type: string
    default: "inp0"
    enum:
      - "inp0"
      - "inp1"
      - "inp2"
      - "inp3"
      - "inp4"
      - "inp5"
      - "inp6"
      - "inp7"
      - "inp8"
    description: |
      Positive input mux selection (MUXSEL.PMUXSEL[3:0]).
      Selects which PGA_INPx package pin is routed to the non-inverting op-amp input.

  ti,nmux-input:
    type: string
    default: "rtap"
    enum:
      - "rtop"
      - "rtap"
      - "inm0"
      - "inm1"
      - "inm2"
      - "inm3"
    description: |
      Negative input mux selection (MUXSEL.NMUXSEL[2:0]).
      rtop: direct output feedback for follower mode.
      rtap: internal feedback resistor tap for programmable-gain modes.
      inm0..inm3: PGA_INMx package pin.

  ti,mmux-input:
    type: string
    default: "non-inverting"
    enum:
      - "standalone"
      - "non-inverting"
      - "inm0"
      - "inm1"
      - "inm2"
      - "inm3"
      - "neg-shared-a"
      - "neg-shared-b"
    description: |
      M-mux selection (MUXSEL.MMUXSEL[2:0]). Controls the bottom node of the
      internal feedback resistor ladder (Ria bottom).
      standalone: naked op-amp / G=1, no internal gain (MMUXSEL=0).
      non-inverting: feedback to VSSA, non-inverting gain x1..x64 (MMUXSEL=1).
      inm0..inm3: inverting gain via local PGA_INMx pin (MMUXSEL=2..5).
      neg-shared-a/b: select shared inputs from another PGA instance
        (MMUXSEL=6,7).

  ti,filter-resistor-ohms:
    type: int
    default: 0
    enum:
      - 0
      - 50
      - 100
      - 200
      - 400
      - 800
    description: |
      On-chip series filter resistor at PGA_OUT pin (PGACTL.FILT_RES_SEL).
      0 disables the filtered output path; it does not select a zero-ohm bypass.
      Connect an external capacitor to PGA_OUT for an RC low-pass filter with
      cutoff 1 / (2 * pi * R * C), so the value depends on the application.
      Minimum values per gain setting (from TRM Table 23-6):
        G=1..4: 50 ohm, G=8..16: 100 ohm, G=32: 200 ohm, G=64: 400 ohm.
      Gain changes that require a higher resistance are rejected.

  ti,output-to-pin:
    type: boolean
    description: |
      Route the PGA output to the PGA_OUT package pin (PGACTL.PGA_OUTENABLE),
      through the filter resistor selected by ti,filter-resistor-ohms. Without
      a filter resistor the driver also closes the internal feedback path
      (PGACTL.PGA_OUTEN_INTGAIN), so the gain is kept. The unfiltered
      PGA_OUT_INT signal for the ADC and CMPSS is always available.

  ti,chop-mode:
    type: string
    default: "disabled"
    enum:
      - "disabled"
      - "adc-soc"
    description: |
      Chopping mode (MUXSEL.PGA_CHOP[1:0]).
      disabled: no chopping (default).
      adc-soc: select ADC-assisted chopping when using the corresponding ADC.
        The acquisition sequence must account for the alternating chop phases.

  ti,feedback-on-pin:
    type: boolean
    description: |
      Connect PGA_INM0 and the inverting input together (MUXSEL.PGA_FBONPIN=1).
      Used in non-inverting mode for single-pole low-pass filtering via an
      external capacitor across the feedback loop.
```

## dts/bindings/opamp/ti,mspm0-gpamp.yaml
```yaml
# SPDX-FileCopyrightText: Copyright (c) 2026 Texas Instruments
# SPDX-License-Identifier: Apache-2.0

description: |
  Texas Instruments MSPM0 General Purpose Amplifier (GPAMP).

  The GPAMP has no register block of its own. It is controlled by the
  PMUOPAMP register inside SYSCTL, so the node has no reg property and is
  declared as a child of the SYSCTL syscon node.

  The amplifier has no gain stage. The gain is set by the external network
  connected to the GPAMP_IN-/GPAMP_OUT pins. The input routing is derived
  from functional-mode:

    follower   - the output is fed back to the inverting input, gain is x1.
                 With ti,outpin-enable the output is on the GPAMP_OUT pin
                 (unity gain mode). Without it the output is internal only,
                 for example as an ADC input buffer.
    standalone - inverting input is on the GPAMP_IN- pin, all feedback
                 is external. Needs ti,outpin-enable.

  Other functional-mode values are not supported.

  Register and field names (PMUOPAMP) are those of the MSPM0 G-Series TRM
  (SLAU846F), chapter "GPAMP", and the MSPM0G350x data sheet (SLASEX6C),
  section "GPAMP".

  The GPAMP pins are analog functions, they are not selected in the IOMUX and
  need no pinctrl. The VBOOST circuit supplying the GPAMP needs MCLK and ULPCLK
  not sourced from LFCLK while it starts up.

compatible: "ti,mspm0-gpamp"

include: opamp-controller.yaml

properties:
  ti,outpin-enable:
    type: boolean
    description: |
      Connect the amplifier output to the GPAMP_OUT package pin.

  ti,chop-mode:
    type: string
    default: "disabled"
    enum: ["disabled", "standard", "adc-assisted"]
    description: |
      Selects the chopping mode.
      standard: needs an external output filter, refer to the device data
        sheet for recommended values.
      adc-assisted: for an output feeding an ADC channel that uses hardware
        averaging with an even sample count. No external filter is needed,
        the ADC toggles the chopping state between samples.

  ti,chop-freq-hz:
    type: int
    default: 16000
    enum: [16000, 8000, 4000, 2000]
    description: |
      Chopping clock frequency in Hz. Lower the frequency as the external
      gain increases, refer to the chopping section of the device TRM.

  ti,rri-mode:
    type: string
    default: "rail-to-rail"
    enum: ["pmos", "nmos", "rail-to-rail"]
    description: |
      Selects the input stage, PMOS pair, NMOS pair or rail-to-rail input.
```

## dts/bindings/otp/aspeed,ast2700-otp.yaml
```yaml
# Copyright (c) 2026 ASPEED Technology Inc.
# SPDX-License-Identifier: Apache-2.0

description: ASPEED AST27x0 series OTP controller

compatible: "aspeed,ast2700-otp"

include: base.yaml

properties:
  reg:
    required: true

  aspeed,word-size:
    type: int
    required: true
    enum: [2, 4]
    description: |
      Size in bytes of one OTP word, the unit the controller reads at a
      time. The AST27x0 series has 16-bit words.
```

## dts/bindings/otp/microchip,otpc-g1-otp.yaml
```yaml
# Copyright (c) 2026 Microchip Technology Inc.
# SPDX-License-Identifier: Apache-2.0

title: Microchip OTPC G1 Driver

description: |
  Binding for the Microchip OTPC driver supporting Group G1 peripherals.

  Group G1 OTPC driver supports the following hardware peripheral:
    - module name="OTPC" id="44105" version="150"

examples:
  - |
    Example devicetree configuration at SoC level:
      otpc: efuse@e8c00000 {
        compatible = "microchip,otpc-g1-otp";
        reg = <0xe8c00000 0x100>;
        interrupt-parent = <&gic>;
        interrupts = <GIC_SPI 67 IRQ_TYPE_LEVEL IRQ_DEFAULT_PRIORITY>;
        otp-memory-size = <DT_SIZE_K(11)>;
        emul-sram-size = <DT_SIZE_K(4)>;
        #address-cells = <1>;
        #size-cells = <1>;
        status = "disabled";

        /* Temp calib data packet TAG */
        temperature_calib: calib@41435354 {
          reg = <0x41435354 0x48>;
        };
      };

    Example devicetree configuration at board level:
      &otpc {
        status = "okay";
      };

compatible: "microchip,otpc-g1-otp"

include: base.yaml

properties:
  reg:
    required: true
    description: |
      Register base address and size for the OTPC peripheral.

  interrupts:
    required: true
    description: |
      Interrupt specifier for the OTPC peripheral.

  otp-memory-size:
    type: int
    required: true
    description: |
      OTP user area memory size of OTPC, in bytes.

  emul-sram-size:
    type: int
    required: true
    description: |
      Emulation mode sram size of OTPC, in bytes.
```

## dts/bindings/otp/rockchip,rk3588-otp.yaml
```yaml
# SPDX-FileCopyrightText: Copyright The Zephyr Project Contributors
# SPDX-License-Identifier: Apache-2.0

title: Rockchip RK3588 OTP

description: |
  Rockchip RK3588 One-Time Programmable memory controller.

  This binding represents the OTP peripheral found on Rockchip RK3588 SoCs.
  The OTP module provides access to on-chip fuse memory used to store
  device-specific information such as CPU ID, calibration data, etc.

  Fuse values can be exposed through nvmem-layout child nodes. The OTP API is
  byte addressed while the controller reads 32-bit words; the driver handles
  unaligned nvmem-layout child 'reg' offsets and read offsets/lengths
  internally.

compatible: "rockchip,rk3588-otp"

include: base.yaml

properties:
  reg:
    required: true

examples:
  - |
    rk3588_otp: otp@fecc0000 {
            compatible = "rockchip,rk3588-otp";
            reg = <0xfecc0000 0x400>;
            status = "okay";

            nvmem-layout {
                    compatible = "fixed-layout";
                    #address-cells = <1>;
                    #size-cells = <1>;

                    otp_id: id@7 {
                            reg = <0x07 0x10>;
                            #nvmem-cell-cells = <0>;
                            read-only;
                    };
            };
    };
```
