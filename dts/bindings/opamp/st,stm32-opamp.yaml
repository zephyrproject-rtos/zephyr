## dts/bindings/regulator/alif,ensemble-phy-regulator.yaml
```yaml
# Copyright (c) 2026 Analog Devices, Inc.
# SPDX-License-Identifier: Apache-2.0

title: Alif Ensemble PHY power switches

description: |
  PHY power switches controlled by the PWR_CTRL register in the Alif
  Ensemble VBAT register block. Each child node describes one switch,
  controlled by the two PWR_CTRL bits starting at its en-offset.

  The driver recognizes children by node name:

  - mipi-tx-dphy, mipi-rx-dphy, mipi-pll-dphy and usb-phy: the bit at
    en-offset masks the PHY power and the bit at en-offset + 1 enables
    isolation. Enabling clears both bits, disabling sets the isolation
    bit.
  - ldo-phy: the MIPI D-PHY 1.8 V supply. The bit at en-offset is the
    bypass enable and the bit at en-offset + 1 is the bypass value.
    Enabling clears both bits, so the supply follows the PD-6 power
    state. Disabling enables bypass with a value of 0, which forces the
    supply off.

compatible: "alif,ensemble-phy-regulator"

include: base.yaml

properties:
  reg:
    required: true

child-binding:
  include:
    - name: regulator.yaml
      property-allowlist:
        - regulator-name
        - regulator-always-on
        - regulator-boot-on
        - regulator-boot-off

  properties:
    en-offset:
      type: int
      required: true
      description: |
        Bit offset within PWR_CTRL of the first of the two control bits
        for this power switch.

examples:
  - |
    regulator@1a609008 {
      compatible = "alif,ensemble-phy-regulator";
      reg = <0x1a609008 0x4>;

      mipi-rx-dphy {
        en-offset = <4>;
      };

      ldo-phy {
        en-offset = <12>;
      };
    };
```

## dts/bindings/regulator/nxp,pmc-bandgap-buffer.yaml
```yaml
# SPDX-FileCopyrightText: Copyright 2026 NXP
# SPDX-License-Identifier: Apache-2.0

description: |
  NXP PMC buffered bandgap output (PMC_REGSC[BGBE]).
  Must be a child of the PMC node, whose reg is the PMC base address.

compatible: "nxp,pmc-bandgap-buffer"

include:
  - name: regulator.yaml
    property-allowlist:
      - regulator-always-on
      - regulator-boot-on
```

## dts/bindings/regulator/ti,tps6521x-regulator.yaml
```yaml
# SPDX-FileCopyrightText: Copyright The Zephyr Project Contributors
# SPDX-License-Identifier: Apache-2.0

title: TI TPS65214/TPS65215 PMIC regulators

description: |
  TI TPS65214/TPS65215 PMIC regulators

  The node is a child of a "ti,tps65214" or "ti,tps65215" node, which
  selects the register map. The regulators are child nodes named BUCK1,
  BUCK2, BUCK3, LDO1 and LDO2.

  Voltage ranges:
    - BUCK1-3: 0.6 V to 3.4 V
    - LDO1, LDO2 (TPS65214): 0.6 V to 3.3 V
    - LDO1 (TPS65215): 0.6 V to 3.4 V
    - LDO2 (TPS65215): 1.2 V to 3.3 V

  An LDO the PMIC NVM configures as a load switch has no voltage control.

compatible: "ti,tps6521x-regulator"

include: base.yaml

child-binding:
  include:
    - name: regulator.yaml
      property-allowlist:
        - regulator-always-on
        - regulator-boot-on
        - regulator-min-microvolt
        - regulator-max-microvolt
        - regulator-init-microvolt

examples:
  - |
    pmic@30 {
      compatible = "ti,tps65214";
      reg = <0x30>;

      regulators {
        compatible = "ti,tps6521x-regulator";

        BUCK1 {
          regulator-always-on;
        };
      };
    };
```

## dts/bindings/rng/aspeed,hwrng.yaml
```yaml
# Copyright (c) 2026 ASPEED Technology Inc.
# SPDX-License-Identifier: Apache-2.0

description: |
  ASPEED hardware random number generator, a control register followed by a
  data register in the SCU register space.

compatible: "aspeed,hwrng"

include: base.yaml

properties:
  reg:
    required: true
```

## dts/bindings/rng/inside-secure,safexcel-eip76.yaml
```yaml
# SPDX-FileCopyrightText: Copyright The Zephyr Project Contributors
# SPDX-License-Identifier: Apache-2.0

description: |
  Inside Secure SafeXcel EIP-76 true random number generator.

  Found on TI AM62L as TRNG_DRBG_EIP76D_WRAP0.

compatible: "inside-secure,safexcel-eip76"

include: base.yaml

properties:
  reg:
    required: true
```

## dts/bindings/sdhc/brcm,bcm2712-sdhci.yaml
```yaml
# SPDX-FileCopyrightText: Copyright (c) 2026 Process Mission
# SPDX-License-Identifier: Apache-2.0

title: Broadcom BCM2712 SD host controller.

description: |
  Main-bank SDIO pins may be configured through pinctrl. Dedicated EMMC
  pads used by the SD card slot are not covered by the BCM2712 pinctrl
  driver and must retain the boot firmware configuration.

compatible: "brcm,bcm2712-sdhci"

include: [sdhc.yaml, pinctrl-device.yaml]

properties:
  no-1-8-v:
    type: boolean
    description: |
      Disable 1.8 V signalling on this slot, even when supported by the host.

  bus-width:
    required: true

  reg:
    required: true

  reg-names:
    required: true
    description: SDHCI host registers followed by the Broadcom cfg registers.

  clocks:
    required: true

  non-removable:
    type: boolean
    description: Permanently connected device; no card-detect GPIO is needed.

  cd-gpios:
    type: phandle-array
    description: Card detect GPIO. Without it, a removable slot assumes a card is present.

  vmmc-supply:
    type: phandle
    required: true
    description: Card power regulator.

  vqmmc-supply:
    type: phandle
    description: |
      SD signalling voltage regulator; absent for fixed 3.3 V signalling.
      When provided, this supply must remain enabled independently, for example
      through regulator-always-on. The driver sets its voltage but does not
      enable or disable it.
```

## dts/bindings/sdhc/microchip,sdhc-g1.yaml
```yaml
# Copyright (c) 2026 Microchip Technology Inc.
# SPDX-License-Identifier: Apache-2.0

title: Microchip SDHC controller

description: |
  Microchip SDHC controller

  Microchip G1 SDHC controller supports the following hardware peripheral:
    - module name="SDHC" compatible="microchip,sdhc-g1"

compatible: "microchip,sdhc-g1"

include:
  - name: sdhc.yaml
  - name: pinctrl-device.yaml

properties:
  reg:
    required: true

  clocks:
    required: true

  clock-names:
    required: true
    description: |
      Names of the clock sources listed in "clocks", in the same order.
      Must be "mclk" (main clock), "gclk" (generic clock) and "gclk-slow"
      (slow generic clock).

  interrupts:
    required: true

  auto-cmd12:
    type: boolean
    description: |
      Enable Auto CMD12 for multi-block transfers. The host controller
      automatically issues CMD12 (stop transmission) after the last block.
      Use this for cards that do not support CMD23.

  auto-cmd23:
    type: boolean
    description: |
      Enable Auto CMD23 for multi-block transfers. The host controller
      automatically issues CMD23 (set block count) before the transfer.
      Requires ADMA and card CMD23 support (SCR bit 33). Takes precedence
      over auto-cmd12 if both are set.

  pinctrl-0:
    required: true

  pinctrl-names:
    required: true
    description: |
      Names of the pinctrl states defined for this controller. Must include
      "default" matching pinctrl-0.

  bus-width:
    default: 4
    description: |
      SD bus width in bits. 1 for 1-bit, 4 for 4-bit. No 8-bit support in hardware.
      By default 4-bit data line is enabled and can be adjusted based on the SDMMC
      instance or hardware board design.

examples:
  - |
    #Example devicetree configuration for Microchip G1 SDHC controller:

    sdhc0: sdhc@46000000 {
            compatible = "microchip,sdhc-g1";
            reg = <0x46000000 0x234>;
            interrupts = <136 0>;
            clocks = <&mclkperiph CLOCK_MCHP_MCLKPERIPH_ID_AHB_SDHC1>,
                     <&gclkperiph CLOCK_MCHP_GCLKPERIPH_ID_SDHC1>,
                     <&gclkperiph CLOCK_MCHP_GCLKPERIPH_ID_SDHC1_SLOW>;
            clock-names = "mclk", "gclk", "gclk-slow";
            min-bus-freq = <400000>;
            max-bus-freq = <50000000>;
            auto-cmd23;
            pinctrl-0 = <&sdhc0_default>;
            pinctrl-names = "default";
            status = "okay";
    };
```

## dts/bindings/sdhc/rockchip,rk3568-dw-mshc.yaml
```yaml
# SPDX-FileCopyrightText: 2026 Seunghoon Park
# SPDX-License-Identifier: Apache-2.0

description: |
  Rockchip RK3568 (and RK3566) SD/MMC host controller, a Synopsys
  DesignWare Mobile Storage Host Controller.

  The compatible string is the same as in the Linux binding. A node is
  expected to also list the generic fallbacks used there, for example:

    compatible = "rockchip,rk3568-dw-mshc", "rockchip,rk3288-dw-mshc";

  The driver programs the controller registers and the card clock source
  select in the CRU. It does not configure pin muxing, the card power
  supply, the controller bus clock gate or the card clock phase: those must
  already have been set up by the boot loader.

  Only SD cards at 3.3 V (default and high speed, up to 50 MHz) on a 1-bit
  or 4-bit bus are supported.

compatible: "rockchip,rk3568-dw-mshc"

include: [sdhc.yaml]

properties:
  reg:
    required: true

  interrupts:
    description: |
      Controller interrupt. The driver currently polls and does not use it.

  fifo-depth:
    type: int
    required: true
    description: |
      Depth of the controller data FIFO in 32-bit words, as in the Linux
      binding. The RK3568 value is 256.

  rockchip,cru:
    type: phandle
    required: true
    description: |
      Phandle of the CRU node, which must be a "syscon" node. It provides the
      card clock source select register (CRU_CLKSEL_CON30), as there is no
      clock controller driver for this SoC yet.

  bus-width:
    description: |
      Number of card data lines wired on the board: 1 or 4. The driver
      assumes 4 when the property is absent. 8 is not supported.

examples:
  - |
    cru: syscon@fdd20000 {
            compatible = "syscon";
            reg = <0xfdd20000 0x1000>;
    };

    sdmmc0: mmc@fe2b0000 {
            compatible = "rockchip,rk3568-dw-mshc", "rockchip,rk3288-dw-mshc";
            reg = <0xfe2b0000 0x4000>;
            interrupts = <GIC_SPI 98 IRQ_TYPE_LEVEL IRQ_DEFAULT_PRIORITY>;
            fifo-depth = <256>;
            rockchip,cru = <&cru>;
            bus-width = <4>;
            max-bus-freq = <50000000>;
            min-bus-freq = <375000>;
            power-delay-ms = <10>;

            sdmmc {
                    compatible = "zephyr,sdmmc-disk";
                    disk-name = "SD";
            };
    };
```
