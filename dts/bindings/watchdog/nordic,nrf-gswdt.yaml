## dts/bindings/watchdog/nordic,nrf-gswdt.yaml
```yaml
# Copyright (c) 2026 Nordic Semiconductor ASA
# SPDX-License-Identifier: Apache-2.0

description: Nordic nRF global software watchdog timer (GSWDT) binding

compatible: "nordic,nrf-gswdt"

include: base.yaml

properties:
  mbox:
    type: phandle
    required: true
    description: phandle to the MBOX controller (TX)
```

## dts/bindings/watchdog/nordic,nrf-watchdog.yaml
```yaml
# Copyright (c) 2018, Nordic Semiconductor ASA
# SPDX-License-Identifier: Apache-2.0

description: Nordic Semiconductor nRF watchdog

compatible: "nordic,nrf-watchdog"

include: base.yaml

properties:
    reg:
      required: true

    label:
      required: true

    interrupts:
      required: true
```

## dts/bindings/watchdog/nordic,nrf-wdt-v2.yaml
```yaml
# Copyright (c) 2018-2025, Nordic Semiconductor ASA
# SPDX-License-Identifier: Apache-2.0

description: Nordic nRF family WDT (Watchdog Timer version 2)

compatible: "nordic,nrf-wdt-v2"

include: base.yaml

properties:
  reg:
    required: true

  interrupts:
    required: true

  enable-at-boot:
    type: boolean
    description: |
      When enabled this property will configure the UICR to start the watchdog at device boot,
      before the application has been booted.
```

## dts/bindings/watchdog/nordic,nrf-wdt.yaml
```yaml
# Copyright (c) 2018, Nordic Semiconductor ASA
# SPDX-License-Identifier: Apache-2.0

description: Nordic nRF family WDT (Watchdog Timer)

compatible: "nordic,nrf-wdt"

interrupt-source: true

include: base.yaml

properties:
  reg:
    required: true
```

## dts/bindings/watchdog/nuvoton,nct-watchdog.yaml
```yaml
# Copyright (c) 2025 Nuvoton Technology Corporation.
# SPDX-License-Identifier: Apache-2.0

description: Nuvoton, NCT-TWD node

compatible: "nuvoton,nct-watchdog"

include: [base.yaml]

properties:
  reg:
    required: true
  t0-out:
    type: phandle
    required: true
    description: |
        Mapping table between Wake-Up Input (WUI) and t0-out timer expired signal.
        For example, the WUI mapping on NCT6 t0-out timer would be
           t0-out = <&wui_t0out>;
```

## dts/bindings/watchdog/nuvoton,npcx-watchdog-npckn-v1.yaml
```yaml
# Copyright (c) 2025 Nuvoton Technology Corporation.
# SPDX-License-Identifier: Apache-2.0

description: Nuvoton, NPCX-TWD

compatible: "nuvoton,npcx-watchdog-npckn-v1"

include: nuvoton,npcx-watchdog.yaml
```

## dts/bindings/watchdog/nuvoton,npcx-watchdog.yaml
```yaml
# Copyright (c) 2021 Nuvoton Technology Corporation.
# SPDX-License-Identifier: Apache-2.0

description: Nuvoton, NPCX-TWD node

compatible: "nuvoton,npcx-watchdog"

include: [base.yaml]

properties:
    reg:
        required: true
    label:
        required: true
    t0_out:
        type: phandle
        required: true
        description: |
            Mapping table between Wake-Up Input (WUI) and t0-out timer expired signal.
            For example, the WUI mapping on NPCX7 t0-out timer would be
               t0_out = <&wui_t0out>;
```

## dts/bindings/watchdog/nuvoton,numaker-wdt.yaml
```yaml
# Copyright (c) 2026 Nuvoton Technology Corporation.
# SPDX-License-Identifier: Apache-2.0

description: Nuvoton, NuMaker watchdog timer

compatible: "nuvoton,numaker-wdt"

include: base.yaml

properties:
  reg:
    required: true

  interrupts:
    required: true

  clocks:
    required: true
```

## dts/bindings/watchdog/nuvoton,numaker-wwdt.yaml
```yaml
# Copyright (c) 2024 Nuvoton Technology Corporation.
# SPDX-License-Identifier: Apache-2.0

description: Nuvoton, NuMaker window watchdog timer

compatible: "nuvoton,numaker-wwdt"

include: base.yaml

properties:
  reg:
    required: true

  interrupts:
    required: true

  clocks:
    required: true
```

## dts/bindings/watchdog/nxp,cop.yaml
```yaml
# Copyright (c) 2025 Alexandre Rey
# SPDX-License-Identifier: Apache-2.0

description: NXP COP watchdog

compatible: "nxp,cop"

include: base.yaml

properties:
  reg:
    required: true

  clk-source:
    type: int
    required: true
    description: |
      Watchdog counter clock source.
      - 0: LPO clock (1 kHz)
      - 1: MCGIRCLK
      - 2: OSCERCLK
      - 3: Bus clock

  timeout-cycles:
    type: int
    required: true
    description: Watchdog timeout cycles
    enum:
      - 32
      - 256
      - 1024
      - 8192
      - 65536
      - 262144

  windowed-mode:
    type: boolean
    description: |
      Watchdog timeout mode. Allowed only when timeout-cycles is 8192, 65526 or
      262144 cycles. If enabled, the COP window opens during the last 3 quarters
      of the timeout period.
```

## dts/bindings/watchdog/nxp,ewm.yaml
```yaml
# Copyright 2025 NXP
# SPDX-License-Identifier: Apache-2.0

description: NXP External Watchdog Monitor

compatible: "nxp,ewm"

include: base.yaml

properties:
  reg:
    required: true

  interrupts:
    required: true

  clk-sel:
    type: string
    description: |
      Watchdog clock select
      (See the chip-specific information for clock sources used.)
    enum:
      - "lpo_clk[0]"
      - "lpo_clk[1]"
      - "lpo_clk[2]"
      - "lpo_clk[3]"

  clk-divider:
    type: int
    description: Watchdog clock divider

  input-trigger-en:
    type: boolean
    description: |
      When enabled the ewm_in signal can be used
      to assert the ewm.

  input-trigger-active-high:
    type: boolean
    description: |
      When enabled the ewm_in signal is active high.
      The ewm_in signal is active low otherwise.
```

## dts/bindings/watchdog/nxp,fs26-wdog.yaml
```yaml
# Copyright 2023 NXP
# SPDX-License-Identifier: Apache-2.0

description: |
  FS26 System Basis Chip (SBC) watchdog driver.

  The FS26 features multiple voltage regulators to supply the microcontroller,
  peripheral ICs and communication interfaces. The FS26 also offers various
  functionalities for system control and monitoring, including a configurable
  watchdog counter to ensure the microcontroller is able to communicate with the
  FS26, which can react to any failure condition and place the system in a safe
  state. This driver covers only the watchdog functionality of FS26. The rest
  of the functionalities are not implemented.

  The FS26 uses a 32-bit SPI interface. The MCU is the primary driving MOSI and
  FS26 is the secondary driving MISO. Therefore the FS26 devicetree node must be
  in a SPI bus. For example, if FS26 is connected to spi3 bus, on Chip Select 0:

    &spi3 {
      // here there should be spi3 properties as needed
      status = "okay";

      fs26_wdt: watchdog@0 {
        compatible = "nxp,fs26-wdog";
        reg = <0>;
        spi-max-frequency = <DT_FREQ_M(5)>;
        type = "challenger";
        int-gpios = <&gpioa_h 3 GPIO_ACTIVE_LOW>;
        status = "okay";
      };
    };

  When an FS26 internal interrupt occurs, the INTB pin generates a pulse to
  inform the microcontroller. The driver masks all interrupt sources except for
  bad watchdog refresh (BAD_WD_M). The GPIO pin where the interrupt signal is
  received must be configured from devicetree. In the example above, this is
  indicated through int-gpios property. It is also required to configure the
  external interrupt controller to receive interrupts on this pin.

compatible: "nxp,fs26-wdog"

include: spi-device.yaml

properties:
  type:
    required: true
    type: string
    enum:
      - simple
      - challenger
    description: |
      Watchdog type enabled on this device.

      The Challenger watchdog monitoring feature is enabled for ASIL D devices.
      This mode is based on a question/answer process with the microcontroller.

      The Simple watchdog monitoring feature is enabled for ASIL B devices. This
      mode uses a unique seed.

  int-gpios:
    type: phandle-array
    required: true
    description: |
      GPIO to use to receive external interrupts from INTB signal.
```

## dts/bindings/watchdog/nxp,imx-rtwdog.yaml
```yaml
# Copyright (c) 2018, NXP
# SPDX-License-Identifier: Apache-2.0

description: imxRT watchdog

compatible: "nxp,imx-rtwdog"

include: [base.yaml, pinctrl-device.yaml]

properties:
  reg:
    required: true

  interrupts:
    required: true

  clocks:
    required: true

  clk-source:
    type: int
    required: true
    description: Watchdog counter clock source

  clk-divider:
    type: int
    description: Watchdog counter clock divider
    required: true
```

## dts/bindings/watchdog/nxp,imx-wdog.yaml
```yaml
# Copyright (c) 2018, NXP
# SPDX-License-Identifier: Apache-2.0

description: imxRT watchdog

compatible: "nxp,imx-wdog"

include: base.yaml

properties:
    reg:
      required: true

    label:
      required: true

    interrupts:
      required: true
```

## dts/bindings/watchdog/nxp,kinetis-wdog.yaml
```yaml
# Copyright (c) 2018, NXP
# SPDX-License-Identifier: Apache-2.0

description: Kinetis watchdog

compatible: "nxp,kinetis-wdog"

include: base.yaml

properties:
    reg:
      required: true

    interrupts:
      required: true

    clocks:
      required: true
```

## dts/bindings/watchdog/nxp,kinetis-wdog32.yaml
```yaml
# Copyright (c) 2019 Vestas Wind Systems A/S
# SPDX-License-Identifier: Apache-2.0

description: Kinetis watchdog (WDOG32)

compatible: "nxp,kinetis-wdog32"

include: base.yaml

properties:
    reg:
      required: true

    interrupts:
      required: true

    clocks:
      required: true

    clk-source:
      type: int
      required: true
      description: Watchdog counter clock source

    clk-divider:
      type: int
      description: Watchdog counter clock divider
      required: true
```

## dts/bindings/watchdog/nxp,lpc-wwdt.yaml
```yaml
# Copyright (c) 2020 Jiri Kerestes
# SPDX-License-Identifier: Apache-2.0

description: LPC Windowed Watchdog Timer

compatible: "nxp,lpc-wwdt"

include: base.yaml

properties:
    reg:
      required: true

    label:
      required: true

    interrupts:
      required: true

    clk-divider:
      type: int
      description: Watchdog clock divider
      required: true
```

## dts/bindings/watchdog/nxp,rtwdog.yaml
```yaml
# Copyright 2024, NXP
# SPDX-License-Identifier: Apache-2.0

description: NXP RT watchdog

compatible: "nxp,rtwdog"

include: base.yaml

properties:
  reg:
    required: true

  interrupts:
    required: true

  clocks:
    required: true

  clk-source:
    type: int
    required: true
    description: Watchdog counter clock source

  clk-divider:
    type: int
    description: Watchdog counter clock divider
    required: true
```

## dts/bindings/watchdog/nxp,s32-swt.yaml
```yaml
# Copyright 2022-2024 NXP
# SPDX-License-Identifier: Apache-2.0

description: Software Watchdog Timer (SWT)

compatible: "nxp,s32-swt"

include: base.yaml

properties:
  reg:
    required: true

  interrupts:
    required: true

  clocks:
    required: true

  master-access-mask:
    type: int
    default: 0xff
    description: |
      Each bit set on this mask enables access to this watchdog for the platform
      bus master corresponding to the bit. The platform bus master assignments
      are chip-specific.
      Defaults to access enabled for all masters (hardware reset value).

  reset-on-invalid-access:
    type: boolean
    description: |
      Set this flag to generate a reset on respond to an invalid access.

  service-mode:
    type: string
    default: "fixed"
    enum:
      - "fixed"
      - "keyed"
    description: |
      Watchdog service mode:
        - fixed: writes a fixed sequence as defined by hardware.
        - keyed: writes two pseudo-random key values based on an initial key.
      Defaults to "fixed" (hardware reset value).

  initial-key:
    type: int
    default: 0
    description: |
      Overrides the initial key when using keyed service mode.
      Defaults to 0 (hardware reset value).

  lock-mode:
    type: string
    default: "unlocked"
    enum:
      - "unlocked"
      - "soft-lock"
      - "hard-lock"
    description: |
      Lock mechanism that provides write access protection to the configuration
      and service registers:
        - unlocked: registers are always writable.
        - soft: unlocked by writing an unlock sequence to the service register.
        - hard: unlocked only after a reset.
      Defaults to unlocked (hardware reset value).
```

## dts/bindings/watchdog/nxp,swt.yaml
```yaml
# Copyright 2025 NXP
# SPDX-License-Identifier: Apache-2.0

description: NXP software watchdog timer (SWT)

compatible: "nxp,swt"

include: base.yaml

properties:
  reg:
    required: true

  interrupts:
    required: true
```

## dts/bindings/watchdog/raspberrypi,pico-watchdog.yaml
```yaml
# Copyright (c) 2022, Jamie McCrae
# SPDX-License-Identifier: Apache-2.0

description: Raspberry Pi Pico Watchdog

compatible: "raspberrypi,pico-watchdog"

include: base.yaml

properties:
    reg:
      required: true

    label:
      required: true

    clocks:
      required: true
      description: Crystal oscillator source clock
```

## dts/bindings/watchdog/realtek,ameba-watchdog.yaml
```yaml
# Copyright (c) 2026 Realtek Semiconductor Corp.
# SPDX-License-Identifier: Apache-2.0

description: Ameba watchdog

compatible: "realtek,ameba-watchdog"

include: base.yaml

properties:
  reg:
    required: true

  interrupts:
    required: true

  early-int-cnt-ms:
    type: int
    default: 500
    min: 1
    max: 65535
    description: |
      Watchdog early interrupt trigger threshold in milliseconds.
      The early interrupt fires this many milliseconds before the watchdog
      reset, giving firmware time to perform recovery or logging.

  realtek,auto-enabled:
    type: boolean
    description: |
      Watchdog is automatically enabled by hardware at power-on (IWDT).
      When set, the driver marks the watchdog as already running during
      initialization, so wdt_feed() works before wdt_setup() is called.
      Useful for bootloader contexts where the IWDT is hardware-enabled.
```

## dts/bindings/watchdog/realtek,bee-core-wdt.yaml
```yaml
description: Realtek Bee Core Watchdog Timer

compatible: "realtek,bee-core-wdt"

include: base.yaml

properties:
  reg:
    required: true

  initial-timeout-ms:
    type: int
    default: 4000
    description: |
      Set timeout value in milliseconds.
```

## dts/bindings/watchdog/realtek,rts5817-watchdog.yaml
```yaml
# Copyright (c) 2024 Realtek Semiconductor, Inc.
# SPDX-License-Identifier: Apache-2.0

description: |
  Realtek RTS5817 Watchdog driver

compatible: "realtek,rts5817-watchdog"

include: base.yaml

properties:
  reg:
    required: true
```

## dts/bindings/watchdog/realtek,rts5912-watchdog.yaml
```yaml
# Copyright (c) 2025 Realtek, SIBG-SD7
# SPDX-License-Identifier: Apache-2.0

description: Realtek RTS5912 watchdog timer

include: base.yaml

compatible: "realtek,rts5912-watchdog"

properties:
  reg:
    required: true

  interrupts:
    required: true

  clk-divider:
    type: int
    description: Watchdog clock divider
    required: true
```
