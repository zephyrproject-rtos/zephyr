## dts/bindings/watchdog/atmel,sam4l-watchdog.yaml
```yaml
# Copyright (c) 2024-2025, Gerson Fernando Budke <nandojve@gmail.com>
# SPDX-License-Identifier: Apache-2.0

description: ATMEL SAM4L watchdog

compatible: "atmel,sam4l-watchdog"

include: base.yaml

properties:
  reg:
    required: true

  interrupts:
    required: true

  clocks:
    required: true

  clk-source:
    type: string
    default: "rcsys"
    enum:
      - "rcsys"
      - "osc32k"
    description: |
      Watchdog counter clock source:
        - rcsys:  115kHz internal System RC oscillator
        - osc32k: 32kHz clock source
      Defaults to "rcsys" (hardware reset value) and always enabled source

  lock-mode:
    type: boolean
    description: |
      Lock the watchdog when setup is executed. This provides a write protection
      to the control register. This mechanism can only be released when a hardware
      reset happens.
```

## dts/bindings/watchdog/bflb,wdt.yaml
```yaml
# SPDX-FileCopyrightText: Copyright The Zephyr Project Contributors
# SPDX-License-Identifier: Apache-2.0

description: Bouffalo Lab Watchdog Timer

compatible: "bflb,wdt"

include: base.yaml

properties:
  reg:
    required: true
  interrupts:
    required: true
```

## dts/bindings/watchdog/ene,kb106x-watchdog.yaml
```yaml
# Copyright (c) 2025 ENE Technology Inc.
# SPDX-License-Identifier: Apache-2.0

description: ENE watchdog timer

include: [base.yaml]

compatible: "ene,kb106x-watchdog"

properties:
  reg:
    required: true

  interrupts:
    required: true
```

## dts/bindings/watchdog/ene,kb1200-watchdog.yaml
```yaml
# Copyright (c) 2024 ENE Technology Inc.
# SPDX-License-Identifier: Apache-2.0

description: ENE watchdog timer

include: [base.yaml]

compatible: "ene,kb1200-watchdog"

properties:
  reg:
    required: true

  interrupts:
    required: true
```

## dts/bindings/watchdog/espressif,esp32-xt-wdt.yaml
```yaml
# Copyright (c) 2024 Espressif Systems (Shanghai) Co., Ltd.
# SPDX-License-Identifier: Apache-2.0

description: |
    ESP32 XT Watchdog Timer.

    This watchdog timer can detect oscillation failure of the RTC_SLOW_CLK_SRC_XTAL32K.
    When such a failure is detected the hardware automatically switch to
    ESP32_RTC_SLOW_CLK_SRC_RC_SLOW.

    This feature is only available for ESP32S2,ESP32C3 and ESP32S3.

compatible: "espressif,esp32-xt-wdt"

include: base.yaml

properties:
  reg:
    required: true
```

## dts/bindings/watchdog/gd,gd32-fwdgt.yaml
```yaml
# Copyright (c) 2021, TOKITA Hiroshi
# SPDX-License-Identifier: Apache-2.0

description: GD32 free watchdog timer

compatible: "gd,gd32-fwdgt"

include: base.yaml

properties:
    reg:
      required: true

    initial-timeout-ms:
      type: int
      default: 250
      description: |
        Set timeout value in milliseconds.
        The following equation gives the maximum timeout value

          timeout = (reload + 1) / (peripheral_freqency / prescaler).

        where the maximum prescaler = 256 and the maximum reload = 4096.
        The peripheral_frequency uses GD32_LOW_SPEED_IRC_FREQUENCY
        that defined in modules/hal_gigadevice/Kconfig.
        Validate the value is within a capable range at the compile time.

        The default value defined is close to the register reset value
        from values that don't cause calculation errors in both cases of
        the low-speed internal RC oscillator frequency is 32kHz or 40kHz.

        0.25 [timeout in sec] = (1999 [reload] + 1) / (32000 [freq] / 4 [prescaler])
        0.25 [timeout in sec] = (2499 [reload] + 1) / (40000 [freq] / 4 [prescaler])
```

## dts/bindings/watchdog/gd,gd32-wwdgt.yaml
```yaml
# Copyright (c) 2021 TOKITA Hiroshi
# SPDX-License-Identifier: Apache-2.0

description: GD32 window watchdog timer

compatible: "gd,gd32-wwdgt"

include: [base.yaml, reset-device.yaml]

properties:
    reg:
      required: true

    clocks:
      required: true

    resets:
      required: true
```

## dts/bindings/watchdog/infineon,cat1-watchdog.yaml
```yaml
# Copyright (c) 2023 Cypress Semiconductor Corporation (an Infineon company) or
# an affiliate of Cypress Semiconductor Corporation
#
# SPDX-License-Identifier: Apache-2.0

description: Infineon CAT1 Watchdog

compatible: "infineon,cat1-watchdog"

include: base.yaml

properties:
  reg:
    required: true
```

## dts/bindings/watchdog/infineon,watchdog.yaml
```yaml
# Copyright (c) 2023 Cypress Semiconductor Corporation (an Infineon company) or
# an affiliate of Cypress Semiconductor Corporation
#
# SPDX-License-Identifier: Apache-2.0

description: Infineon CAT1 Watchdog

compatible: "infineon,watchdog"

include: [base.yaml, "infineon,system-interrupts.yaml"]

properties:
  reg:
    required: true

  interrupts:
    description: Required for non-cat1c devices

  system-interrupts:
    description: Required for cat1c devices

  infineon,wdt-lock:
    type: boolean
    description: |
      The watchdog has lock/unlock protection registers. When set, the driver
      unlocks the configuration registers before each update and locks them
      afterwards to guard against unintended writes.
```

## dts/bindings/watchdog/infineon,xmc4xxx-watchdog.yaml
```yaml
# Copyright (c) 2023, SLB
# SPDX-License-Identifier: Apache-2.0

description: Infineon XMC4xxx watchdog

compatible: "infineon,xmc4xxx-watchdog"

include: base.yaml

properties:
  reg:
    required: true

  interrupts:
    required: true
```

## dts/bindings/watchdog/intel,adsp-watchdog.yaml
```yaml
description: Intel ADSP Watchdog

compatible: "intel,adsp-watchdog"

include: base.yaml

properties:
  # This properties is also supported:
  # interrupts:
  # clocks:

  reg:
    required: true

  clock-frequency:
    type: int
    description: |
      Clock frequency used by counter in Hz. You can specify a frequency here or specify a clock
      using the clocks propertie.

  reset-pulse-length:
    type: int
    enum:
      - 2
      - 4
      - 8
      - 16
      - 32
      - 64
      - 128
      - 256
    description: Duration of the reset pulse in clock cycles
```

## dts/bindings/watchdog/intel,qmsi-watchdog.yaml
```yaml
# Copyright (c) 2018, Intel
# SPDX-License-Identifier: Apache-2.0

title: QMSI watchdog driver

description: >
    This is a representation of the QMSI watchdog

compatible: "intel,qmsi-watchdog"

include: base.yaml

properties:
    reg:
      required: true

    label:
      required: true

    interrupts:
      required: true
```

## dts/bindings/watchdog/intel,tco-wdt.yaml
```yaml
# Copyright (c) 2022 Intel Corporation
# SPDX-License-Identifier: Apache-2.0

description: Intel TCO Watchdog

compatible: "intel,tco-wdt"

include: base.yaml
```

## dts/bindings/watchdog/ite,it51xxx-watchdog.yaml
```yaml
# Copyright (c) 2025 ITE Corporation. All Rights Reserved.
# SPDX-License-Identifier: Apache-2.0

description: ITE watchdog timer

include: base.yaml

compatible: "ite,it51xxx-watchdog"

properties:
  reg:
    required: true

  interrupts:
    required: true
```

## dts/bindings/watchdog/ite,it8xxx2-watchdog.yaml
```yaml
# Copyright (c) 2021 ITE Corporation. All Rights Reserved.
# SPDX-License-Identifier: Apache-2.0

description: ITE watchdog timer

include: base.yaml

compatible: "ite,it8xxx2-watchdog"

properties:
    reg:
      required: true

    label:
      required: true

    interrupts:
      required: true
```

## dts/bindings/watchdog/litex,watchdog.yaml
```yaml
# Copyright (c) 2024 Vogl Electronic GmbH
# SPDX-License-Identifier: Apache-2.0

description: LiteX watchdog.

compatible: "litex,watchdog"

include: base.yaml

properties:
  reg:
    required: true

  interrupts:
    required: true
```

## dts/bindings/watchdog/m5stack,m5pm1-wdt.yaml
```yaml
# Copyright (c) 2026 The Zephyr Project Contributors
# SPDX-License-Identifier: Apache-2.0

description: M5Stack M5PM1 watchdog

compatible: "m5stack,m5pm1-wdt"

include: base.yaml

on-bus: m5pm1
```

## dts/bindings/watchdog/microchip,pic32cxsg-watchdog.yaml
```yaml
description: Microchip PIC32CXSG watchdog

compatible: "atmel,sam0-watchdog"

include: base.yaml

properties:
  reg:
    required: true

  interrupts:
    required: true
```

## dts/bindings/watchdog/microchip,xec-watchdog.yaml
```yaml
# Copyright (c) 2019, Intel Corporation
# SPDX-License-Identifier: Apache-2.0

description: Microchip XEC watchdog timer

include:
  - name: base.yaml
  - name: microchip,dmec-ecia-girq.yaml

compatible: "microchip,xec-watchdog"

properties:
  reg:
    required: true

  interrupts:
    required: true

  pcr-scr:
    type: int
    required: true
    description: |
      WDT Power Clock Reset(PCR) peripheral index and bit position.
```

## dts/bindings/watchdog/neorv32-wdt.yaml
```yaml
# Copyright (c) 2024, Calian
# SPDX-License-Identifier: Apache-2.0

description: NEORV32 Watchdog Timer

compatible: "neorv32-wdt"

include: base.yaml

properties:
  reg:
    required: true

  syscon:
    type: phandle
    required: true
    description: |
      phandle to syscon (NEORV32 SYSINFO) node.
```

## dts/bindings/watchdog/nordic,npm10xx-wdt.yaml
```yaml
# Copyright (c) 2026 Nordic Semiconductor ASA
# SPDX-License-Identifier: Apache-2.0

title: Nordic nPM10 Series PMIC's Watchdog driver

description: |
  Nordic's nPM10 Series PMICs feature a Watchdog that can either issue a pin reset through one of
  PMIC's GPIOs or power cycle the system by turning off all voltage supplies and internally
  resetting the PMIC. It can also be used as a general purpose timer without any reset
  functionality. In addition to that, it can issue a pre-warning 32ms before timer expiration
  either through interrupt configured using the nPM10xx MFD driver or through a dedicated GPIO.

compatible: "nordic,npm10xx-wdt"

include: base.yaml

properties:
  reset-gpio-config:
    type: array
    description: PMIC pin used as reset output <idx flags>.

  prewarn-gpio-config:
    type: array
    description: PMIC pin used as pre-warning output <idx flags>.

  timeout-gpio-config:
    type: array
    description: PMIC pin used as timeout output <idx flags>.

examples:
  - |
    npm1012: pmic@6b {
      /* ... */

      wdt {
        compatible = "nordic,npm10xx-wdt";
        reset-gpio-config = <0 (GPIO_ACTIVE_LOW | GPIO_OPEN_DRAIN)>;
        prewarn-gpio-config = <1 GPIO_ACTIVE_HIGH>;
      };

      /* ... */
    };
```

## dts/bindings/watchdog/nordic,npm1300-wdt.yaml
```yaml
# Copyright (c) 2023 Nordic Semiconductor ASA
# SPDX-License-Identifier: Apache-2.0

description: nPM1300 Watchdog

compatible: "nordic,npm1300-wdt"

include: base.yaml

properties:
  reset-gpios:
    type: phandle-array
    description: nPM1300 pin used as NRESETOUT
```

## dts/bindings/watchdog/nordic,npm1304-wdt.yaml
```yaml
# Copyright (c) 2025 Nordic Semiconductor ASA
# SPDX-License-Identifier: Apache-2.0

description: nPM1304 Watchdog

compatible: "nordic,npm1304-wdt"

include: base.yaml

properties:
  reset-gpios:
    type: phandle-array
    description: nPM1304 pin used as NRESETOUT
```

## dts/bindings/watchdog/nordic,npm2100-wdt.yaml
```yaml
# Copyright (c) 2024 Nordic Semiconductor ASA
# SPDX-License-Identifier: Apache-2.0

description: nPM2100 Watchdog

compatible: "nordic,npm2100-wdt"

include: base.yaml
```

## dts/bindings/watchdog/nordic,npm6001-wdt.yaml
```yaml
# Copyright (c) 2022 Nordic Semiconductor ASA
# SPDX-License-Identifier: Apache-2.0

description: nPM6001 Watchdog

compatible: "nordic,npm6001-wdt"
```
