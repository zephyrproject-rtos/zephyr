## dts/bindings/wifi/infineon,airoc-wifi.yaml
```yaml
# Copyright (c) 2023 Cypress Semiconductor Corporation (an Infineon company) or
# an affiliate of Cypress Semiconductor Corporation
#
# SPDX-License-Identifier: Apache-2.0

description: |
    AIROC Wi-Fi Connectivity.

    Example of enabling AIROC Wi-Fi device (for SDIO):
      &sdhc0 {
        status = "okay";

        /* SDIO pins */
        pinctrl-0 = <&p2_4_sdio_cmd &p2_5_sdio_clk &p2_0_sdio_data0
              &p2_1_sdio_data1 &p2_2_sdio_data2 &p2_3_sdio_data3>;
        pinctrl-names = "default";

        /* Wifi configuration */
        airoc-wifi {
          status = "okay";
          compatible = "infineon,airoc-wifi-sdio";

          /* Wi-Fi control gpios */
          wifi-reg-on-gpios    = <&gpio_prt2 6 GPIO_ACTIVE_HIGH>;
          wifi-host-wake-gpios = <&gpio_prt0 4 GPIO_ACTIVE_HIGH>;
        };
      };

compatible: "infineon,airoc-wifi"

include: [base.yaml, pinctrl-device.yaml]

properties:
  wifi-reg-on-gpios:
    description: |
      Power-up/down gpio to control the internal regulators used
      by the WiFi section of AIROC Wi-Fi device.
    type: phandle-array

  wifi-host-wake-gpios:
    description: |
      Host wake-up gpio. Signal from the AIROC Wi-Fi device
      to the host indicating that the device requires attention.
    type: phandle-array

  wifi-dev-wake-gpios:
    description: |
      WiFi device wake-up gpio. Signal from the host to the
      AIROC Wi-Fi device indicating that the host requires attention.
    type: phandle-array
```

## dts/bindings/wifi/infineon,cyw43xxx-wifi-sdio.yaml
```yaml
# Copyright (c) 2023 Cypress Semiconductor Corporation (an Infineon company) or
# an affiliate of Cypress Semiconductor Corporation
#
# SPDX-License-Identifier: Apache-2.0

description: |
    CYW43xxx WIFI Connectivity.

    Example of enabling CYW43xxx device:
      wifi-sdio {
        status = "okay";
        compatible = "infineon,cyw43xxx-wifi-sdio";

        /* SDIO pins */
        sdio-cmd-gpios  = <&gpio_prt2 4 0>;
        sdio-clk-gpios  = <&gpio_prt2 5 0>;
        sdio-data-gpios = <&gpio_prt2 0 0>,
                          <&gpio_prt2 1 0>,
                          <&gpio_prt2 2 0>,
                          <&gpio_prt2 3 0>;

        /* WIFI control gpios */
        wifi-reg-on-gpios    = <&gpio_prt2 6 0>;
        wifi-host-wake-gpios = <&gpio_prt0 4 0>;
      };


compatible: "infineon,cyw43xxx-wifi-sdio"

include: [base.yaml, pinctrl-device.yaml]

properties:
  wifi-reg-on-gpios:
    description: |
      Power-up/down gpio to control the internal regulators used
      by the WiFi section of CYW43xx device.
    type: phandle-array

  wifi-host-wake-gpios:
    description: |
      Host wake-up gpio. Signal from the CYW43xx to the host
      indicating that the CYW43xx requires attention.
    type: phandle-array

  wifi-dev-wake-gpios:
    description: |
      WiFi device wake-up gpio. Signal from the host to the
      CYW43xx indicating that the host requires attention.
    type: phandle-array

  sdio-cmd-gpios:
    description: WiFi SDIO command gpio.
    type: phandle-array
    required: true

  sdio-clk-gpios:
    description: WiFi SDIO clock gpio.
    type: phandle-array
    required: true

  sdio-data-gpios:
    description: Array of WiFi SDIO data gpios (D0, D1, D2, D3).
    type: phandle-array
    required: true
```

## dts/bindings/wifi/inventek,eswifi-uart.yaml
```yaml
# Copyright (c) 2018, Linaro Limited
# Copyright (c) 2020, ATL Electronics
# SPDX-License-Identifier: Apache-2.0

description: es-WiFi module (uart firmware interface)

compatible: "inventek,eswifi-uart"

include: uart-device.yaml

properties:
    resetn-gpios:
      type: phandle-array
      required: true

    wakeup-gpios:
      type: phandle-array
      required: false
```

## dts/bindings/wifi/inventek,eswifi.yaml
```yaml
# Copyright (c) 2018, Linaro Limited
# SPDX-License-Identifier: Apache-2.0

description: es-WiFi module

compatible: "inventek,eswifi"

include: spi-device.yaml

properties:
  resetn-gpios:
    type: phandle-array
    required: true

  data-gpios:
    type: phandle-array
    required: true

  wakeup-gpios:
    type: phandle-array

  boot0-gpios:
    type: phandle-array
```

## dts/bindings/wifi/nordic,nrf70-coex.yaml
```yaml
# Copyright (c) 2024 Nordic Semiconductor ASA
# SPDX-License-Identifier: Apache-2.0

description: |
  This is a representation of an external radio coexistence setup for coexistence
  with nRF70 WiFi chips.

properties:
  req-gpios:
    type: phandle-array
    description: |
      GPIO of the SOC connected to the PTA's REQUEST pin.

  status0-gpios:
    type: phandle-array
    description: |
      GPIO of the SOC connected to the PTA's PRIORITY pin.
      This GPIO is also used to indicate direction (TX/RX).

  grant-gpios:
    type: phandle-array
    description: |
      GPIO of the SOC connected to the PTA's GRANT pin.

  swctrl1-gpios:
    type: phandle-array
    description: |
      GPIO of the SOC controlling the Priority (STATUS1) pin (in 4-wire
      coex case) of the nRF7002
```

## dts/bindings/wifi/nordic,nrf70-mspi.yaml
```yaml
# Copyright (c) 2026 Embeint Inc
# SPDX-License-Identifier: Apache-2.0

description: nRF70 Wi-Fi chip with MSPI interface.

include: ["nordic,nrf70.yaml", "mspi-device.yaml"]
```

## dts/bindings/wifi/nordic,nrf70-qspi.yaml
```yaml
# Copyright (c) 2024 Nordic Semiconductor ASA
# SPDX-License-Identifier: Apache-2.0

description: This is a representation of the nRF70 Wi-Fi chip.

include: ["nordic,nrf70.yaml", "base.yaml"]

on-bus: qspi

properties:
  qspi-frequency:
    type: int
    required: true
    description: |
      Maximum clock speed (in Hz) supported by the device.

  reg:
    required: true

  qspi-quad-mode:
    type: boolean
    description: |
      If specified, Use QSPI in quad mode (4 IO lines) otherwise in
      SPI mode (2 IO lines - MOSI & MISO).

  qspi-rx-delay:
    type: int
    default: 0
    description: |
      Number of clock cycles from the rising edge of the SPI clock
      until the input serial data is sampled.

  qspi-cpha:
    type: boolean
    description: |
      Set to indicate phase starts with asserted half-phase (CPHA=1).
      The driver using this property must also use `cpol`.

  qspi-cpol:
    type: boolean
    description: |
      Set to indicate that the clock leading edge is falling (CPOL=1).
      The driver using this property requires also use `cpha`.
```

## dts/bindings/wifi/nordic,nrf70-spi.yaml
```yaml
# Copyright (c) 2024 Nordic Semiconductor ASA
# SPDX-License-Identifier: Apache-2.0

description: nRF70 Wi-Fi chip with SPI interface.

include: ["nordic,nrf70.yaml", "spi-device.yaml"]
```

## dts/bindings/wifi/nordic,nrf7000-coex.yaml
```yaml
# Copyright (c) 2024 Nordic Semiconductor ASA
# SPDX-License-Identifier: Apache-2.0

description: nRF7000 Wi-Fi chip with COEX interface.

compatible: nordic,nrf7000-coex

include:
  - "nordic,nrf70-coex.yaml"
```

## dts/bindings/wifi/nordic,nrf7001-coex.yaml
```yaml
# Copyright (c) 2024 Nordic Semiconductor ASA
# SPDX-License-Identifier: Apache-2.0

description: This is a representation of the nRF7001 Wi-Fi chip with COEX interface.

compatible: nordic,nrf7001-coex

include:
  - "nordic,nrf70-coex.yaml"
```
