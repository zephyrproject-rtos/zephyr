## dts/bindings/watchdog/wch,iwdg.yaml
```yaml
# Copyright (c) 2025 Michael Hope <michaelh@juju.nz>
# SPDX-License-Identifier: Apache-2.0

description: WCH Independent Watchdog (IWDG)

compatible: "wch,iwdg"

include: base.yaml

properties:
  reg:
    required: true
```

## dts/bindings/watchdog/wdt-gpio.yaml
```yaml
#
# Copyright (c) 2018 qianfan Zhao
#
# SPDX-License-Identifier: Apache-2.0
#
---
title: GPIO based watchdog driver
version: 0.1

description: >
    This is a representation of the gpio-wdt.

properties:
    compatible:
      type: string
      category: required
      description: compatible strings
      constraint: "wdt-gpio"

    label:
      type: string
      category: required
      description: Human readable string describing the device (used by Zephyr for API name)
      generation: define

    gpios:
      type: compound
      category: required
      generation: define

    hw-margin-ms:
      type: int
      category: required
      description: Maximum time to reset watchdog circuit (milliseconds).
      generation: define
...
```

## dts/bindings/watchdog/xlnx,xps-timebase-wdt-1.00.a.yaml
```yaml
# Copyright (c) 2023, Calian
# SPDX-License-Identifier: Apache-2.0

description: Xilinx AXI timebase WDT core

compatible: "xlnx,xps-timebase-wdt-1.00.a"

include: base.yaml

properties:
  reg:
    required: true

  clocks:
    description: Reference to AXI clock for watchdog core
    required: true

  xlnx,wdt-interval:
    description:
      Configured bit width of watchdog counter in core, controls watchdog expiry duration.
    required: true
    type: int

  xlnx,wdt-enable-once:
    description: Indicates whether WDT can only be enabled once and not disabled
    required: true
    type: int
    enum:
      - 0
      - 1
```

## dts/bindings/watchdog/zephyr,counter-watchdog.yaml
```yaml
# Copyright (c) 2021 Nordic Semiconductor ASA
# SPDX-License-Identifier: Apache-2.0

description: |
    Counter based watchdog

compatible: "zephyr,counter-watchdog"

include: base.yaml

properties:
    counter:
      type: phandle
      required: true
      description: |
        Counter device used for watchdog.
```

## dts/bindings/wifi/atmel,winc1500.yaml
```yaml
# Copyright (c) 2018, Linaro Limited
# SPDX-License-Identifier: Apache-2.0

description: Atmel WINC1500 WiFi module

compatible: "atmel,winc1500"

include: spi-device.yaml

properties:
  irq-gpios:
    type: phandle-array
    required: true

  reset-gpios:
    type: phandle-array
    required: true

  enable-gpios:
    type: phandle-array
    required: true
```

## dts/bindings/wifi/bflb,bl60x-wifi.yaml
```yaml
# SPDX-FileCopyrightText: Copyright The Zephyr Project Contributors
#
# SPDX-License-Identifier: Apache-2.0

description: Bouffalo Lab BL60x WiFi MAC

compatible: "bflb,bl60x-wifi"

include: base.yaml

properties:
  interrupts:
    required: true
    description: |
      WiFi MAC, IPC and RF interrupts.
      Four entries required: "wifi" (MAC), "wifi-ipc" (IPC mailbox),
      "rf-top0" and "rf-top1" (RF calibration).

  interrupt-names:
    required: true

  pwr-table-11b:
    type: array
    description: |
      TX power targets for 802.11b rates (1, 2, 5.5, 11 Mbps).
      4 entries, units are quarter-dBm.

  pwr-table-11g:
    type: array
    description: |
      TX power targets for 802.11g rates (6..54 Mbps).
      8 entries, units are quarter-dBm.

  pwr-table-11n:
    type: array
    description: |
      TX power targets for 802.11n HT20 (MCS 0-7).
      8 entries, units are quarter-dBm.
```

## dts/bindings/wifi/bflb,bl61x-wifi.yaml
```yaml
# SPDX-FileCopyrightText: Copyright The Zephyr Project Contributors
#
# SPDX-License-Identifier: Apache-2.0

description: Bouffalo Lab BL61x WiFi MAC

compatible: "bflb,bl61x-wifi"

include: base.yaml

properties:
  interrupts:
    required: true
    description: |
      WiFi MAC and IPC interrupts.
      Two entries required: "wifi" (MAC) and "wifi-ipc" (IPC).

  interrupt-names:
    required: true

  pwr-table-11b:
    type: array
    description: |
      TX power targets for 802.11b rates (1, 2, 5.5, 11 Mbps).
      4 entries, units are quarter-dBm.

  pwr-table-11g:
    type: array
    description: |
      TX power targets for 802.11g rates (6..54 Mbps).
      8 entries.

  pwr-table-11n-ht20:
    type: array
    description: |
      TX power targets for 802.11n HT20 (MCS 0-7).
      8 entries.

  pwr-table-11n-ht40:
    type: array
    description: |
      TX power targets for 802.11n HT40 (MCS 0-7).
      8 entries.

  pwr-table-11ac-vht20:
    type: array
    description: |
      TX power targets for 802.11ac VHT20 (MCS 0-9).
      10 entries.

  pwr-table-11ac-vht40:
    type: array
    description: |
      TX power targets for 802.11ac VHT40 (MCS 0-9).
      10 entries.

  pwr-table-11ax-he20:
    type: array
    description: |
      TX power targets for 802.11ax HE20 (MCS 0-11).
      12 entries.

  pwr-table-11ax-he40:
    type: array
    description: |
      TX power targets for 802.11ax HE40 (MCS 0-11).
      12 entries.

  pwr-table-11ac-vht80:
    type: array
    description: |
      TX power targets for 802.11ac VHT80 (MCS 0-9).
      10 entries.

  pwr-table-11ax-he80:
    type: array
    description: |
      TX power targets for 802.11ax HE80 (MCS 0-11).
      12 entries.

  pwr-table-11ax-he160:
    type: array
    description: |
      TX power targets for 802.11ax HE160 (MCS 0-11).
      12 entries.

  pwr-offset:
    type: array
    description: |
      Per-channel TX power offset for channels 1-14.
      Raw TLV encoding: value 16 = 0 dBm offset, each step = 0.25 dBm.
      14 entries.

  pwr-offset-lp:
    type: array
    description: |
      Per-channel low-power TX power offset for channels 1-14.
      Same encoding as pwr-offset.
      14 entries.

  xtal-capcode-in:
    type: int
    description: Crystal load capacitor code for input pin (0-63).
    min: 0
    max: 63

  xtal-capcode-out:
    type: int
    description: Crystal load capacitor code for output pin (0-63).
    min: 0
    max: 63

  tcal-enable:
    type: boolean
    description: Enable temperature calibration.

  tcal-linear-or-follow:
    type: int
    description: Temperature calibration mode (0=linear, 1=follow).
    min: 0
    max: 1

  tcal-channels:
    type: array
    description: |
      Temperature calibration channel frequencies in MHz.
      5 entries.

  tcal-channel-os:
    type: array
    description: |
      Temperature calibration channel offsets.
      5 entries, signed (encoded as uint16).

  tcal-channel-os-low:
    type: array
    description: |
      Temperature calibration channel offsets for low power.
      5 entries, signed (encoded as uint16).

  tcal-troom-os:
    type: int
    description: |
      Temperature calibration room offset.
      Encoded: 256 = 0, 255 = -1, 257 = +1.
    min: 0
    max: 512

  tcap-enable:
    type: boolean
    description: Enable capcode temperature compensation.

  tcap-tsen:
    type: array
    description: |
      Capcode temperature compensation sensor values.
      10 entries.

  tcap-capcode:
    type: array
    description: |
      Capcode temperature compensation capcode values.
      11 entries.
```

## dts/bindings/wifi/brcm,bcm43xxx-sdio.yaml
```yaml
# Copyright (c) 2026 Jonathan Elliot Peace <jep@alphabetiq.com>
# SPDX-License-Identifier: Apache-2.0

description: |
  Broadcom BCM43xxx SDIO Wi-Fi (brcmfmac protocol).

  Covers SDIO-attached Broadcom/Cypress combo chips speaking the
  brcmfmac SDPCM+BCDC protocol (BCM43430A1 / CYW43439 / BCM4334x).
  Chip identity is read at runtime from chipcommon[0] on the AXI/SB
  backplane.

  The node is a child of an SDHC controller. The driver reaches the
  SDHC parent via DT_INST_PARENT(0). Firmware and per-board NVRAM
  files are selected by Kconfig (CONFIG_WIFI_BRCMFMAC_FIRMWARE_FILE
  / CONFIG_WIFI_BRCMFMAC_NVRAM_FILE) and resolved against the
  hal_broadcom blob directory at build time.

compatible: "brcm,bcm43xxx-sdio"

include: base.yaml

properties:
  wifi-reg-on-gpios:
    description: |
      Power / regulator-enable GPIO ("WL_REG_ON" on Cypress modules).
      Optional: on boards where the SoC firmware asserts this before
      Zephyr starts, the driver leaves it alone.
    type: phandle-array

  wifi-host-wake-gpios:
    description: |
      Optional host-wake GPIO. When the chip wants attention it
      drives this line; the driver wakes its RX thread from the IRQ.
      Not used on platforms where the SDHC driver delivers in-band
      SDIO interrupts on DAT1.
    type: phandle-array
```

## dts/bindings/wifi/espressif,esp-at.yaml
```yaml
# Copyright (c) 2019 Tobias Svehagen
# SPDX-License-Identifier: Apache-2.0

description: Espressif ESP8266/ESP32 WiFi modem (AT Commands)

compatible: "espressif,esp-at"

include: uart-device.yaml

properties:
  power-gpios:
    type: phandle-array

  reset-gpios:
    type: phandle-array

  external-reset:
    type: boolean
    description:
      Modem is reset by an external source. In most situations this will
      be the microcontroller and the ESP modem on a common reset line.

  target-speed:
    type: int
    description:
      UART baudrate which will be requested using AT commands and to which
      UART interface will be reconfigured during initialization phase.
```

## dts/bindings/wifi/espressif,esp-hosted-mcu-sdio.yaml
```yaml
# Copyright (c) 2026 Espressif Systems (Shanghai) CO LTD
# SPDX-License-Identifier: Apache-2.0

description: |
  Espressif ESP-Hosted-MCU Wi-Fi co-processor over SDIO.

  An Espressif SoC running esp-hosted-mcu coprocessor firmware, attached to the
  host over the SDIO bus. The node is a child of an SDHC slot and drives
  the coprocessor reset line over a host GPIO. Data-ready is signalled by the
  coprocessor through an SDIO interrupt register, so no data-ready GPIO is used.

  The coprocessor firmware version the host expects is a Kconfig option, not a
  devicetree property: the firmware is flashed to a separate chip and the driver
  queries it at init.

compatible: "espressif,esp-hosted-mcu-sdio"

include: [sd-device.yaml]

properties:
  reset-gpios:
    type: phandle-array
    required: true
    description: Coprocessor reset line, driven by the host.

examples:
  - |
    &sdhc1 {
            #address-cells = <1>;
            #size-cells = <0>;

            esp_hosted_mcu: esp-hosted-mcu@0 {
                    compatible = "espressif,esp-hosted-mcu-sdio";
                    reg = <0>;
                    reset-gpios = <&gpio1 22 GPIO_ACTIVE_HIGH>;
                    status = "okay";
            };
    };
```

## dts/bindings/wifi/espressif,esp-hosted-mcu.yaml
```yaml
# Copyright (c) 2026 Espressif Systems (Shanghai) CO LTD
# SPDX-License-Identifier: Apache-2.0

description: |
  Espressif ESP-Hosted-MCU Wi-Fi co-processor over SPI.

  An Espressif SoC running esp-hosted-mcu coprocessor firmware, attached to the
  host over SPI with three handshake GPIOs: reset drives the coprocessor reset
  line, handshake is asserted by the coprocessor when it is ready for a
  transaction, and dataready is asserted when the coprocessor has a frame to send.

  The coprocessor firmware version the host expects is a Kconfig option, not a
  devicetree property: the firmware is flashed to a separate chip and the driver
  queries it at init.

compatible: "espressif,esp-hosted-mcu"

include: spi-device.yaml

properties:
  reset-gpios:
    type: phandle-array
    required: true
    description: Coprocessor reset line, driven by the host.

  handshake-gpios:
    type: phandle-array
    required: true
    description: Coprocessor-driven handshake line, asserted when ready.

  dataready-gpios:
    type: phandle-array
    required: true
    description: Coprocessor-driven data-ready line, asserted when TX pending.

examples:
  - |
    &spi2 {
            cs-gpios = <&gpio0 10 GPIO_ACTIVE_LOW>;

            esp_hosted_mcu: esp-hosted-mcu@0 {
                    compatible = "espressif,esp-hosted-mcu";
                    reg = <0>;
                    spi-max-frequency = <20000000>;
                    reset-gpios = <&gpio0 5 GPIO_ACTIVE_HIGH>;
                    handshake-gpios = <&gpio0 6 GPIO_ACTIVE_HIGH>;
                    dataready-gpios = <&gpio0 7 GPIO_ACTIVE_HIGH>;
                    status = "okay";
            };
    };
```

## dts/bindings/wifi/espressif,esp-hosted.yaml
```yaml
# Copyright (c) 2025 Arduino SA
# SPDX-License-Identifier: Apache-2.0

description: Espressif ESP-Hosted WiFi

compatible: "espressif,esp-hosted"

include: spi-device.yaml

properties:
  reset-gpios:
    type: phandle-array
    required: true

  dataready-gpios:
    type: phandle-array
    required: true

  handshake-gpios:
    type: phandle-array
    required: true
```

## dts/bindings/wifi/espressif,esp.yaml
```yaml
# Copyright (c) 2019 Tobias Svehagen
# SPDX-License-Identifier: Apache-2.0

description: Espressif ESP8266/ESP32 WiFi modem (AT Commands)

compatible: "espressif,esp"

include: uart-device.yaml

properties:
    label:
      required: true

    power-gpios:
      type: phandle-array
      required: false

    reset-gpios:
      type: phandle-array
      required: false

    target-speed:
      type: int
      required: false
      description:
        UART baudrate which will be requested using AT commands and to which
        UART interface will be reconfigured during initialization phase.
```

## dts/bindings/wifi/espressif,esp32-wifi.yaml
```yaml
# Copyright (c) 2022 Espressif Systems (Shanghai) Co., Ltd.
# SPDX-License-Identifier: Apache-2.0

description: ESP32 SoC Wi-Fi

compatible: "espressif,esp32-wifi"
```

## dts/bindings/wifi/infineon,airoc-wifi-spi.yaml
```yaml
# ==================================================================================================
# Copyright (c) 2025 Cypress Semiconductor Corporation (an Infineon company) or
# an affiliate of Cypress Semiconductor Corporation
#
# SPDX-License-Identifier: Apache-2.0
# ==================================================================================================

description: |
  AIROC Wi-Fi Connectivity over SPI.

compatible: "infineon,airoc-wifi"

include: [spi-device.yaml, "infineon,airoc-wifi.yaml"]

properties:
  wifi-host-wake-gpios:
    required: true

  bus-select-gpios:
    required: true
    description: |
      Select bus mode.  This gpio must be held low before
      wifi-reg-on-gpios goes high to select SPI bus mode.
    type: phandle-array

  spi-half-duplex:
    description:
      Use half-duplex communication;  if not present, full-
      duplex operation is assumed.
    type: boolean

  spi-word-size:
    description:
      SPI word size in bits.  Since 8-bit word size is the
      most common, that is selected as the default.
    type: int
    enum:
      - 8
      - 16
      - 32
    default: 8

  spi-data-irq-shared:
    description:
      SPI data and IRQ share the same GPIO.
    type: boolean
```
