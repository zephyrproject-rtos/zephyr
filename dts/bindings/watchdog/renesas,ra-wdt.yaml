## dts/bindings/watchdog/renesas,ra-wdt.yaml
```yaml
# Copyright (c) 2025 Renesas Electronics Corporation
# SPDX-License-Identifier: Apache-2.0

description: Renesas RA Watchdog (wdt)

compatible: "renesas,ra-wdt"

include: base.yaml

properties:
  reg:
    required: true

  clocks:
    required: true
```

## dts/bindings/watchdog/renesas,rx-iwdt.yaml
```yaml
# Copyright (c) 2025 Renesas Electronics Corporation and/or its affiliates
# SPDX-License-Identifier: Apache-2.0

description: Renesas RX Independent Watchdog

compatible: "renesas,rx-iwdt"

include: base.yaml

properties:
  reg:
    required: true

  clocks:
    required: true

  window-start:
    required: true
    type: int
    enum: [0, 0x1000, 0x2000, 0x3000]
    description: |
      The start of the window in clock cycles. The watchdog will reset the system
      if the watchdog is not refreshed within the window.
      - 0: 25%
      - 0x1000: 50%
      - 0x2000: 75%
      - 0x3000: 100% (window end position is not specified.)

  window-end:
    required: true
    type: int
    enum: [0, 0x100, 0x200, 0x300]
    description: |
      The end of the window in clock cycles. The watchdog will reset the system
      if the watchdog is not refreshed within the window.
      - 0: 75%
      - 0x200: 50%
      - 0x200: 25%
      - 0x300: 0% (window start position is not specified.)
```

## dts/bindings/watchdog/renesas,rz-wdt.yaml
```yaml
# Copyright (c) 2025 Renesas Electronics Corporation
# SPDX-License-Identifier: Apache-2.0

description: Renesas RZ Watchdog (wdt)

compatible: "renesas,rz-wdt"

include: base.yaml

properties:
  reg:
    required: true

  clock-freq:
    required: true
    type: int
```

## dts/bindings/watchdog/renesas,smartbond-watchdog.yaml
```yaml
# Copyright (c) 2022 Renesas Electronics Corporation and/or its affiliates
# SPDX-License-Identifier: Apache-2.0

description: Smartbond watchdog

compatible: "renesas,smartbond-watchdog"

include: base.yaml

properties:
  reg:
    required: true
```

## dts/bindings/watchdog/sf32lb.wdt.yaml
```yaml
# Copyright (c) 2025 Qingsong Gou <gouqs@hotmail.com>
# SPDX-License-Identifier: Apache-2.0

description: |
  This binding describes the Sifli SF32LB watchdog timer (WDT).

compatible: "sifli,sf32lb-watchdog"

include: base.yaml

properties:
  reg:
    required: true
    description: Register address and size of the WDT peripheral.

  interrupts:
    required: true
    description: Interrupt specifier for the WDT.
```

## dts/bindings/watchdog/shakti,wdt.yaml
```yaml
# Copyright (c) 2018, SiFive Inc.
# SPDX-License-Identifier: Apache-2.0

description: |
  shakti Watchdog timer.

  Note: First instance of the Sifive SPI controller (spi0) must be kept
  disabled if used to access SPI Flash ROM. Failing to do so could result in
  crashes during boot time.

compatible: "shakti,wdt"

properties:
  reg:
    type: array
    required: true
  
  rcycles:
    type: int
    required: true
    
  wcycles:
    type: int
    required: true
  
```

## dts/bindings/watchdog/sifive,wdt.yaml
```yaml
# Copyright (c) 2021 Katsuhiro Suzuki
# SPDX-License-Identifier: Apache-2.0

description: SiFive FE310 Watchdog driver

compatible: "sifive,wdt"

include: base.yaml

properties:
    reg:
      required: true

    interrupts:
      required: true
```

## dts/bindings/watchdog/sifli,sf32lb-wdt.yaml
```yaml
# Copyright (c) 2025 Qingsong Gou <gouqs@hotmail.com>
# SPDX-License-Identifier: Apache-2.0

description: |
  This binding describes the Sifli SF32LB watchdog timer (WDT).

compatible: "sifli,sf32lb-wdt"

include: [base.yaml, sifli-sf32lb-pmuc.yaml, sifli-sf32lb-cfg.yaml]

properties:
  reg:
    required: true

  interrupts:
    required: true

  sifli,pmuc:
    required: true

  sifli,cfg:
    required: true

  sifli,reset-all:
    type: boolean
    description: |
      If set, the watchdog will be configured to reset the whole chip, including
      LCPU. Otherwise, it will only reset HCPU.
```

## dts/bindings/watchdog/silabs,gecko-wdog.yaml
```yaml
# Copyright (c) 2019 Interay Solutions B.V.
# Copyright (c) Oane Kingma
# SPDX-License-Identifier: Apache-2.0

title: Silicon Labs Series 1-2 WDOG (Watchdog)

description: Watchdog timer for Silicon Labs Series 1-2 SoCs.

compatible: "silabs,gecko-wdog"

include: base.yaml

properties:
  reg:
    required: true

  interrupts:
    required: true

  peripheral-id:
    type: int
    description: peripheral ID
    required: true
```

## dts/bindings/watchdog/silabs,siwx91x-wdt.yaml
```yaml
description: Silabs SiWx91x Watchdog

compatible: "silabs,siwx91x-wdt"

include: base.yaml

properties:
  reg:
    required: true

  interrupts:
    required: true
```

## dts/bindings/watchdog/snps,designware-watchdog.yaml
```yaml
description: Synopsys Designware Watchdog

compatible: "snps,designware-watchdog"

include: [base.yaml, reset-device.yaml]

properties:
  # This properties is also supported:
  # interrupts:
  # clocks:

  reg:
    required: true

  clock-frequency:
    type: int
    description: |
      Clock frequency used by counter in Hz. You can specify a frequency here or specify a clock
      using the clocks properties.

  reset-pulse-length:
    type: int
    enum:
      - 2
      - 4
      - 8
      - 16
      - 32
      - 64
      - 128
      - 256
    description: Duration of the reset pulse in clock cycles
```

## dts/bindings/watchdog/st,stm32-watchdog.yaml
```yaml
# Copyright (c) 2019, Linaro Limited
# SPDX-License-Identifier: Apache-2.0

description: STM32 watchdog

compatible: "st,stm32-watchdog"

include: base.yaml

properties:
    reg:
      required: true

    label:
      required: true
```

## dts/bindings/watchdog/st,stm32-window-watchdog.yaml
```yaml
# Copyright (c) 2019 Centaur Analytics, Inc
# SPDX-License-Identifier: Apache-2.0

description: STM32 system window watchdog

compatible: "st,stm32-window-watchdog"

include: base.yaml

properties:
    reg:
      required: true

    label:
      required: true

    clocks:
      required: true
```

## dts/bindings/watchdog/syna,watchdog.yaml
```yaml
# Copyright (c) 2025 Synaptics, Inc.
# SPDX-License-Identifier: Apache-2.0

description: Synaptics Watchdog, based on the ARM SSE system timer

compatible: "syna,watchdog"

include: base.yaml

properties:
  reg:
    required: true

  clock-frequency:
    type: int
    required: true

  interrupts:
    required: true
```

## dts/bindings/watchdog/synopsys,sdw-watchdog.yaml
```yaml
description: SYNOPSYS Designware apb watchdog

compatible: "synopsys,sdw-watchdog"

include: base.yaml

properties:
    reg:
      required: true

    clocks:
      required: true

    utops:
      type: array
      required: false
```

## dts/bindings/watchdog/telink,b91-watchdog.yaml
```yaml
# Copyright (c) 2023, Telink Semiconductor
# SPDX-License-Identifier: Apache-2.0

description: Telink B91 watchdog node

compatible: "telink,b91-watchdog"

include: base.yaml

properties:
  reg:
    required: true
```

## dts/bindings/watchdog/telink,b9x-watchdog.yaml
```yaml
# Copyright (c) 2023, Telink Semiconductor
# SPDX-License-Identifier: Apache-2.0

description: Telink B9X watchdog node

compatible: "telink,b9x-watchdog"

include: base.yaml

properties:
  reg:
    required: true
```

## dts/bindings/watchdog/telink,tlx-watchdog.yaml
```yaml
# Copyright (c) 2024, Telink Semiconductor
# SPDX-License-Identifier: Apache-2.0

description: Telink TLX watchdog node

compatible: "telink,tlx-watchdog"

include: base.yaml

properties:
  reg:
    required: true
```

## dts/bindings/watchdog/telink,w91-watchdog.yaml
```yaml
# Copyright (c) 2024, Telink Semiconductor
# SPDX-License-Identifier: Apache-2.0

description: Telink W91 watchdog node

compatible: "telink,w91-watchdog"

include: base.yaml
```

## dts/bindings/watchdog/ti,cc13xx-cc26xx-watchdog.yaml
```yaml
# Copyright (c) 2022 Florin Stancu <niflostancu@gmail.com>
# SPDX-License-Identifier: Apache-2.0

description: TI CC13xx/CC26xx watchdog

compatible: "ti,cc13xx-cc26xx-watchdog"

include: base.yaml

properties:
  reg:
    required: true

  interrupts:
    required: true

  interrupt-nmi:
    type: boolean
    description: |
      Whether the watchdog triggers a Non-Maskable Interrupt or a standard one
```

## dts/bindings/watchdog/ti,cc23x0-wdt.yaml
```yaml
# Copyright (c) 2024 BayLibre, SAS
# SPDX-License-Identifier: Apache-2.0

description: TI CC23x0 watchdog

compatible: "ti,cc23x0-wdt"

include: base.yaml

properties:
  reg:
    required: true
```

## dts/bindings/watchdog/ti,cc32xx-watchdog.yaml
```yaml
# Copyright (c) 2021 Pavlo Hamov <pasha.gamov@gmail.com>
# SPDX-License-Identifier: Apache-2.0

description: cc32xx watchdog

compatible: "ti,cc32xx-watchdog"

include: base.yaml

properties:
    reg:
      required: true

    label:
      required: true
```

## dts/bindings/watchdog/ti,j7-rti-wdt.yaml
```yaml
# Copyright (c) 2025, Ayush Singh BeagleBoard.org Foundation
# SPDX-License-Identifier: Apache-2.0

description: K3 Watchdog timer (RTI module) available in the K3 generation of processors.

compatible: "ti,j7-rti-wdt"

include: base.yaml

properties:
  reg:
    required: true

  clock-frequency:
    type: int
    required: true

  interrupts:
    description:
      Watchdog interrupt line, if present NMI mode is supported.

  reset-capable:
    type: boolean
    description:
      Indicates reset mode is supported by hardware.
      If set, watchdog timeout will trigger a reset.
      The SoC can only be configured for either NMI
      or Reset mode at a time. Support for NMI or Reset is SoC
      specific.
```

## dts/bindings/watchdog/ti,tps382x.yaml
```yaml
# Copyright (c) 2023, Prevas A/S

description: Watchdog driver for external IC (TPS382x)

compatible: "ti,tps382x"

include: base.yaml

properties:
  wdi-gpios:
    type: phandle-array
    required: true
    description:
      WDI gpio. If WDI remains high or low longer than the timeout period,
      then reset is triggered. The reset has a typical delay time of 200 ms for
      TPS3823/4/8, TPS3823A. The timer clears when reset is asserted or
      when WDI sees a rising edge or a falling edge. If unused, the WDI
      connection must be high impedance to prevent it from causing a reset
      event.

  timeout-period:
    type: int
    default: 1600
    description:
      Time-out period in milliseconds. Typical for TPS3823/4/8 and TPS3823A is
      1.6 seconds but minimum is 0.9. To avoid false positive watchdog reset
      the watchdog should be kicked within the minimum timeout period. The kick
      interval also needs to compensate for MCU clock tolerances which means it
      should be kicked with an interval less than 0.9 seconds. If this device
      is used as fallback for the task watchdog this can be achieved by setting
      e.g. TASK_WDT_MIN_TIMEOUT to 850 and TASK_WDT_HW_FALLBACK_DELAY to 750.
```

## dts/bindings/watchdog/ti,tps3851.yaml
```yaml
# Copyright (c) 2025, Alex Fabre
# SPDX-License-Identifier: Apache-2.0

description: |
  Watchdog driver for external IC (TPS3851).

  The TPS3851 combines a precision voltage
  supervisor with a programmable watchdog timer.

  This driver targets the watchdog timer functionality, as the voltage
  supervisor part is a simple gpio read/write that does not necessarily
  require a dedicated driver.

  Key features:

  - The watchdog timer has a dedicated watchdog output signal.
  - The watchdog timeouts can be programmed either by an external
  capacitor, or by factory-programmed default delay settings.
  - Finally, the watchdog can also be enabled/disabled via a dedicated
  logic pin.

  Example:

  ext_watchdog: ext_watchdog {
    compatible = "ti,tps3851";
    wdo-gpios = <&gpioi 11 GPIO_ACTIVE_LOW>;
    wdi-gpios = <&gpioh 5 GPIO_ACTIVE_LOW>;
    set1-gpios = <&gpioh 4 GPIO_ACTIVE_HIGH>;
    timeout-period = <220>;
  };

compatible: "ti,tps3851"

include: base.yaml

properties:
  wdo-gpios:
    type: phandle-array
    description: |
      Optional GPIO used to catch watchdog output signal (timeout).
      Goes low (asserts) when a watchdog timeout occurs.
      This GPIO is optional because it may be routed to some hardware
      logic directly.
      When set, this GPIO calls the watchdog callback on falling-edge event.
      This GPIO is considered to be configured ACTIVE_LOW in the dts.

  wdi-gpios:
    type: phandle-array
    required: true
    description: |
      Watchdog input (feed). A falling edge must occur at
      WDI before the timeout expires.
      This GPIO is considered to be configured ACTIVE_LOW in the dts.

  set1-gpios:
    type: phandle-array
    description: |
      Optional GPIO used to enable (High) or disable (Low) the watchdog timer.
      This GPIO is optional because it may be routed to HIGH by hardware
      design directly.
      This GPIO is considered to be configured ACTIVE_HIGH in the dts.

  timeout-period:
    type: int
    required: true
    description: |
      The TPS3851 features three options for setting the watchdog timer.
      1. Connecting a capacitor to the CWD pin: A formula
         gives the timings according to the capacitor value.
      2. Connecting a pullup resistor to VDD.
      3. Leaving the CWD pin unconnected.

      PS: Beware that two version of the IC exist: TPS3851xxxS with standard
      timings formula and TPS3851xxxE with extended timings formula.
```
