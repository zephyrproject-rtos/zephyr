## dts/bindings/watchdog/nuvoton,npcm-watchdog.yaml
```yaml
# Copyright (c) 2026 Nuvoton Technology Corporation.
# SPDX-License-Identifier: Apache-2.0

description: Nuvoton NPCM Timer and Watchdog (TWD)

compatible: "nuvoton,npcm-watchdog"

include: base.yaml

properties:
  reg:
    required: true

  nuvoton,scfg:
    type: phandle
    required: true
    description: |
      System configuration (SCFG) node, used to control the debug freeze
      of the watchdog counter.
```

## dts/bindings/watchdog/renesas,ra-iwdt.yaml
```yaml
description: Renesas RA Independent Watchdog

compatible: "renesas,ra-iwdt"

include: base.yaml

properties:
  reg:
    required: true


  window-start:
    type: int
    enum: [100, 75, 50, 25]
    description: |
      The start of the window, as a percentage of the timeout period. The watchdog
      will reset the system if it is not refreshed within the window.
      - 100: window opens at 100%
      - 75: window opens at 75%
      - 50: window opens at 50%
      - 25: window opens at 25%

  window-end:
    type: int
    enum: [0, 25, 50, 75]
    description: |
      The end of the window, as a percentage of the timeout period. The watchdog
      will reset the system if it is not refreshed within the window.
      - 0: window closes at 0%
      - 25: window closes at 25%
      - 50: window closes at 50%
      - 75: window closes at 75%

  timeout-period:
    type: int
    enum: [128, 512, 1024, 2048]
    description: |
      The IWDT timeout period, in IWDTCLK cycles.
      - 128: 128 cycles
      - 512: 512 cycles
      - 1024: 1024 cycles
      - 2048: 2048 cycles

  clock-division:
    type: int
    enum: [1, 16, 32, 64, 128, 256]
    description: |
      The divisor applied to IWDTCLK to produce the IWDT count source.
      - 1: IWDTCLK / 1
      - 16: IWDTCLK / 16
      - 32: IWDTCLK / 32
      - 64: IWDTCLK / 64
      - 128: IWDTCLK / 128
      - 256: IWDTCLK / 256
```

## dts/bindings/watchdog/silabs,wdog.yaml
```yaml
# Copyright (c) 2016 Silicon Laboratories Inc.
# SPDX-License-Identifier: Apache-2.0

title: Silicon Labs Series 3 WDOG (Watchdog)

description: Watchdog timer for Silicon Labs Series 3 SoCs.

compatible: "silabs,wdog"

include: base.yaml

properties:
  reg:
    required: true

  clocks:
    required: true
```

## dts/bindings/watchdog/ti,cc35xx-watchdog.yaml
```yaml
# Copyright (c) 2025 Conclusive Engineering Sp. z o.o.
# SPDX-License-Identifier: Apache-2.0

description: cc35xx watchdog

compatible: "ti,cc35xx-watchdog"

include: base.yaml

properties:
  reg:
    required: true
```

## dts/bindings/watchdog/ti,lpf3-wdt.yaml
```yaml
# Copyright (c) 2025 Texas Instruments Incorporated
# SPDX-License-Identifier: Apache-2.0


description: TI LPF3 watchdog controller

compatible: "ti,lpf3-wdt"

include: base.yaml

properties:
  reg:
    required: true

  label:
    type: string
    description: |
      Human readable string describing the device (used by Zephyr for API name)
```

## dts/bindings/watchdog/ti,mspm0-iwdt.yaml
```yaml
# Copyright (c) 2026 Texas Instruments Inc.
# SPDX-License-Identifier: Apache-2.0

description: |
  Texas Instruments MSPM0 Independent Watchdog Timer (IWDT)

  A free-running watchdog counter clocked by LFOSC, independent of the
  main system clock. No windowing, no interrupt, no callback - feed it
  any time before it expires or it resets the device. Only present on
  LFSS-equipped MSPM0 families.

compatible: "ti,mspm0-iwdt"

include: base.yaml

properties:
  reg:
    required: true
```

## dts/bindings/watchdog/ti,mspm0-watchdog.yaml
```yaml
# Copyright (c) 2024 Texas Instruments Incorporated
# Copyright (c) 2026 Linumiz
# SPDX-License-Identifier: Apache-2.0

description: MSPM0 Windowed Watchdog Timer

compatible: "ti,mspm0-watchdog"

include: base.yaml

properties:
  reg:
    required: true

  ti,watchdog-reset-action:
    type: int
    required: true
    description: |
      Reset type delivered by this WWDT instance on a violation.
      1 = SYSRST (WDT_FLAG_RESET_SOC), 0 = BOOTRST (WDT_FLAG_RESET_CPU_CORE).
      Note: the hardware always generates SYSRST regardless of this value;
      it is used only to validate the flags passed to wdt_install_timeout().

  closed-window:
    type: int
    required: true
    description: Watchdog has two closed windows. 0 is WINDOW0, 1 is WINDOW1

  clocks:
    required: true
    description: |
      Reference to the clock controller providing LFCLK.
      Typically <&ckm MSPM0_CLOCK_LFCLK>.

  interrupts:
    description: |
      INTTIM interrupt line. Only fires in interval-timer mode
      (WDT_FLAG_RESET_NONE). Not used in window-watchdog mode.
```

## dts/bindings/watchdog/xen,watchdog.yaml
```yaml
# SPDX-FileCopyrightText: Copyright (c) 2026 EPAM Systems
# SPDX-License-Identifier: Apache-2.0

description: Xen domain watchdog

compatible: "xen,watchdog"

include: base.yaml

properties:
  num-channels:
    type: int
    default: 1
    enum:
      - 1
      - 2
    description: Number of Xen watchdog timer slots exposed as watchdog channels.
```

## dts/bindings/watchdog/xlnx,versal-wwdt.yaml
```yaml
# Copyright (c) 2025-2026 Advanced Micro Devices, Inc.
# SPDX-License-Identifier: Apache-2.0

description: |
  Xilinx Versal watchdog
  The versal_wwdt IP supports two watchdog engines: the window watchdog
  (WWDT) and the generic watchdog (GWDT).
  The WWDT implements a two-window (closed + open) watchdog. It must be
  fed only during the open window. A feed in the closed window, or a
  missed feed by the end of the open window, is treated as a watchdog
  failure.
  The action taken on a failure (no reset, CPU/subsystem reset, or SoC
  reset) is routed through the platform Error Aggregation Module and
  configured by firmware (PLM) via the boot-time CDO. Zephyr running on
  the APU/RPU cannot observe or change this routing, so the driver does
  not honor the WDT_FLAG_RESET_* flags (including WDT_FLAG_RESET_NONE)
  passed to wdt_install_timeout(); the reset behavior is defined entirely
  by platform firmware.
  The GWDT is a two-stage timer whose stage-1 timeout raises an interrupt
  and, if the watchdog is not refreshed, firmware issues the stage-2 reset.
  The two engines are separate counters with their own enable bits and
  interrupt lines.

compatible: "xlnx,versal-wwdt"

include: base.yaml

properties:
  reg:
    required: true

  clocks:
    required: true
    description: Reference to the clock that drives the watchdog counters.

  interrupts:
    description: |
      Watchdog interrupt lines. The node may expose more than one interrupt.
      The window interrupt (WINT) is asserted when the second (open) window
      is entered, i.e. as soon as the watchdog may be serviced, so the
      timeout can be handled from the installed callback. The generic
      watchdog also provides a stage-1 timeout interrupt. This property is
      optional; the names required for each line are documented under
      interrupt-names.

  interrupt-names:
    description: |
      Names for the interrupts specified in the "interrupts" property. The
      window watchdog interrupt (WINT) must be named "wdt" and the generic
      watchdog stage-1 interrupt must be named "gwdt".
```

## dts/bindings/wifi/bflb,wifi4.yaml
```yaml
# SPDX-FileCopyrightText: Copyright The Zephyr Project Contributors
#
# SPDX-License-Identifier: Apache-2.0

title: Bouffalo Lab 'WiFi4' WiFi MAC

description: |
  Bouffalo Lab 'WiFi4' WiFi MAC. This is an 802.11b/g/n blob-HW pair
  present on earlier BFLB chips.

compatible: "bflb,wifi4"

include: base.yaml

properties:
  interrupts:
    required: true
    description: |
      WiFi MAC, IPC and RF interrupts.
      Four entries required: "wifi" (MAC), "wifi-ipc" (IPC mailbox),
      "rf-top0" and "rf-top1" (RF calibration).

  interrupt-names:
    required: true

  pwr-table-11b:
    type: array
    description: |
      TX power targets for 802.11b rates (1, 2, 5.5, 11 Mbps).
      4 entries, units are dBm.

  pwr-table-11g:
    type: array
    description: |
      TX power targets for 802.11g rates (6..54 Mbps).
      8 entries, units are dBm.

  pwr-table-11n:
    type: array
    description: |
      TX power targets for 802.11n HT20 (MCS 0-7).
      8 entries, units are dBm.
```

## dts/bindings/wifi/espressif,esp-hosted-mcu-sd.yaml
```yaml
# Copyright (c) 2026 Espressif Systems (Shanghai) CO LTD
# SPDX-License-Identifier: Apache-2.0

description: |
  Espressif ESP-Hosted-MCU Wi-Fi co-processor over SDIO.

  An Espressif SoC running esp-hosted-mcu coprocessor firmware, attached to the
  host over the SDIO bus. The node is a child of an SDHC slot. Data-ready is
  signalled by the coprocessor through an SDIO interrupt register, so no
  data-ready GPIO is used.

  The coprocessor is normally restarted through a dedicated reset line wired to
  a host GPIO, which is the recommended configuration. Where no such line
  exists, reset-gpios may be omitted and the coprocessor is left to the power
  cycle the SD subsystem performs when it enumerates the card.

  That fallback only restarts the coprocessor when both of the following hold,
  so check them before relying on it. The host controller driver must act on
  SDHC_POWER_OFF and SDHC_POWER_ON, which many do not: a driver that ignores the
  power mode still reports success, so an ineffective cycle is indistinguishable
  from a real one. The board must also route the coprocessor supply through
  whatever the controller switches, and describe it in devicetree; on an
  espressif,esp32-sdhc-slot that means giving the slot node a pwr-gpios
  property, without which the power mode only gates the card clock and leaves
  the coprocessor running.

  Where either does not hold, the coprocessor is never actually restarted and
  enumeration only succeeds if it happens to be cold-booting already.

  The coprocessor firmware version the host expects is a Kconfig option, not a
  devicetree property: the firmware is flashed to a separate chip and the driver
  queries it at init.

compatible: "espressif,esp-hosted-mcu"

include: [sd-device.yaml]

properties:
  reset-gpios:
    type: phandle-array
    description: |
      Coprocessor reset line, driven by the host. Recommended, and the only
      mechanism that restarts the coprocessor on its own. When absent the
      coprocessor falls back to the SD power cycle, which is only effective
      under the two conditions described above.

examples:
  - |
    &sdhc1 {
            #address-cells = <1>;
            #size-cells = <0>;

            esp_hosted_mcu: esp-hosted-mcu@0 {
                    compatible = "espressif,esp-hosted-mcu";
                    reg = <0>;
                    reset-gpios = <&gpio1 22 GPIO_ACTIVE_HIGH>;
                    status = "okay";
            };
    };
```

## dts/bindings/wifi/espressif,esp-hosted-mcu-uart.yaml
```yaml
# Copyright (c) 2026 Espressif Systems (Shanghai) CO LTD
# SPDX-License-Identifier: Apache-2.0

description: |
  Espressif ESP-Hosted-MCU Wi-Fi co-processor over UART.

  An Espressif SoC running esp-hosted-mcu coprocessor firmware, attached to the
  host over UART. The protocol is length-prefixed framing with no handshake or
  data-ready GPIOs: the host reads the fixed 12-byte header, parses the
  little-endian len field, and reads exactly that many payload bytes.

  The coprocessor is restarted through a dedicated reset line wired to a host
  GPIO.

  The coprocessor firmware version the host expects is a Kconfig option, not a
  devicetree property: the firmware is flashed to a separate chip and the driver
  queries it at init.

compatible: "espressif,esp-hosted-mcu"

include: uart-device.yaml

properties:
  reset-gpios:
    type: phandle-array
    required: true
    description: Coprocessor reset line, driven by the host. Active low.

examples:
  - |
    &uart2 {
            esp_hosted_mcu: esp-hosted-mcu {
                    compatible = "espressif,esp-hosted-mcu";
                    reset-gpios = <&gpio0 5 GPIO_ACTIVE_LOW>;
                    status = "okay";
            };
    };
```

## dts/bindings/wifi/espressif,esp-hosted-mcu-wifi.yaml
```yaml
# Copyright (c) 2026 Espressif Systems (Shanghai) CO LTD
# SPDX-License-Identifier: Apache-2.0

description: |
  Wi-Fi network interfaces provided by an esp-hosted-mcu coprocessor.

  This node names the Wi-Fi interfaces the coprocessor exposes. It carries no
  registers of its own: the transport is the parent esp-hosted-mcu node, which
  the driver reaches through it.

compatible: "espressif,esp-hosted-mcu-wifi"

include: ethernet-controller.yaml
```

## dts/bindings/wifi/mxchip,emw3080.yaml
```yaml
# Copyright (c) 2026 Witekio
# SPDX-License-Identifier: Apache-2.0

description: |
  MXCHIP EMW3080 Wi-Fi module connected over SPI.

  The EMW3080 uses a custom SPI protocol with flow control and
  interrupt (notify) signaling. The host communicates using an IPC
  request/response protocol over this SPI link.

compatible: "mxchip,emw3080"

include: spi-device.yaml

properties:
  resetn-gpios:
    type: phandle-array
    required: true
    description: |
      GPIO connected to the module RESET pin (active low).

  nss-gpios:
    type: phandle-array
    required: true
    description: |
      GPIO connected to the module SPI chip select (active low).
      Driven by the driver instead of the SPI controller because it
      must stay asserted across the FLOW handshakes of a transaction.

  notify-gpios:
    type: phandle-array
    required: true
    description: |
      GPIO connected to the module NOTIFY (IRQ) pin.
      The module asserts this pin when it has data ready to send.

  flow-gpios:
    type: phandle-array
    required: true
    description: |
      GPIO connected to the module FLOW control pin.
      The host must wait for this pin to be high before transferring
      data on SPI.
```

## dts/bindings/wifi/nordic,nrf70.yaml
```yaml
# Copyright (c) 2024 Nordic Semiconductor ASA
# SPDX-License-Identifier: Apache-2.0

# power.yaml provides supply-gpios and vin-supply, which control the
# VBAT/BUCKVBAT/AFEVBAT supply of the nRF70.
include: power.yaml

properties:
  iovdd-ctrl-gpios:
    type: phandle-array
    description: |
      GPIO of the SoC controlling IO_VDD Control pin of the nRF70, either this
      or iovdd-regulator needs to be set.

  iovdd-regulator:
    type: phandle
    description: |
      Regulator controlling IO_VDD of the nRF70, either this or iovdd-ctrl-gpios
      needs to be set.

  bucken-gpios:
    type: phandle-array
    required: true
    description: GPIO of the SoC controlling BUCK_EN pin of the nRF70

  host-irq-gpios:
    type: phandle-array
    required: true
    description: GPIO of the SoC controlling the HOST_IRQ pin of the nRF70

  srrf-switch-gpios:
    type: phandle-array
    description: |
      GPIO of the RF Switch to control SR RF output to either SR Antenna
      or shared Antenna with Wi-Fi

  iovdd-power-up-delay-ms:
    type: int
    default: 1
    description: |
      Duration to wait after enabling IOVDD before attempting communications.
      Default value of 1 comes from the nRF7002 DK/EK switch (TCK106AG): ~600us

  supply-power-up-delay-ms:
    type: int
    default: 6
    description: |
      Duration to wait after enabling the supply (supply-gpios and/or vin-supply)
      before asserting BUCKEN.
      Default value of 6 comes from the nRF7002 datasheet section 14.3.5 Supply
      sequencing requirements which states Wait >= 6 ms
```

## dts/bindings/wifi/nordic,nrf7002-mspi.yaml
```yaml
# Copyright (c) 2026 Kickmaker
# SPDX-License-Identifier: Apache-2.0

description: nRF7002 Wi-Fi chip with MSPI interface.

compatible: "nordic,nrf7002"

include:
  - "nordic,nrf70-mspi.yaml"
  - "wifi-tx-power-2g.yaml"
  - "wifi-tx-power-5g.yaml"
```
