## dts/bindings/wifi/nxp,wifi.yaml
```yaml
# Copyright 2023-2025 NXP
#
# SPDX-License-Identifier: Apache-2.0

description: |
    NXP Wi-Fi Module

compatible: "nxp,wifi"

include: [base.yaml, pinctrl-device.yaml]

properties:
  wakeup-gpios:
    type: phandle-array
    description: |
      WLAN wakeup host pin
      This pin defaults to active low when consumed by the SDK card. The
      property value should ensure the flags properly describe the signal
      that is presendted to the driver.
  pwr-gpios:
    type: phandle-array
    description: |
      Power pin
      This pin defaults to active high when consumed by the wlan cpu power.
      The property value should ensure the flags properly describe the signal
      that is presented to the driver.
  ext1-pwren-gpios:
    type: phandle-array
    description: |
      External power enable pin - controls an external power supply to the
      wireless module. When present, this pin is asserted before the module
      is powered on and deasserted during power off.
      The property value should ensure the flags properly describe the signal
      that is presented to the driver.

  sd-gpios:
    type: phandle-array
    description: |
      SDIO Reset pin
      This pin defaults to active high when consumed by the SD card. The
      property value should ensure the flags properly describe the signal
      that is presented to the driver.

child-binding:
  description: WiFi antenna information
  properties:
    antenna-gain-2ghz:
      type: int
      default: 0
      description: |
        Net antenna gain in the 2.4 GHz band, in 0.25 dBi units.
        Defaults to 0 (isotropic / unknown antenna, no derating applied),
        the safe assumption when a board does not characterize its antenna.

    antenna-gain-5ghz-sb1:
      type: int
      default: 0
      description: |
        Net antenna gain in 5 GHz sub-band 1 5180 MHz, in 0.25 dBi units.
        Defaults to 0 (no derating), see antenna-gain-2g4hz.

    antenna-gain-5ghz-sb2:
      type: int
      default: 0
      description: |
        Net antenna gain in 5 GHz sub-band 2 5600 MHz, in 0.25 dBi units.
        Defaults to 0 (no derating), see antenna-gain-2g4hz.

    antenna-gain-5ghz-sb3:
      type: int
      default: 0
      description: |
        Net antenna gain in 5 GHz sub-band 3 5825 MHz, in 0.25 dBi units.
        Defaults to 0 (no derating), see antenna-gain-2g4hz.
```

## dts/bindings/wifi/raspberrypi,cyw43-wifi.yaml
```yaml
# SPDX-License-Identifier: Apache-2.0

description: Infineon CYW43 module

compatible: "raspberrypi,cyw43-wifi"

include: [base.yaml, pinctrl-device.yaml, spi-device.yaml]

properties:
  spi-max-frequency:
    type: int
    required: true

  wl-on-gpios:
    type: phandle-array

  host-wake-gpios:
    description: |
      "interrupt" gpio. Signal from the Infineon module to the host
      that an event has occurred.
    type: phandle-array

  bus-select-gpios:
    required: true
    description: |
      Select bus mode.  This gpio must be held low before
      wifi-reg-on-gpios goes high to select SPI bus mode.
    type: phandle-array
```

## dts/bindings/wifi/silabs,ncp-wifi.yaml
```yaml
# Copyright (c) 2026 Silicon Laboratories Inc.
# SPDX-License-Identifier: Apache-2.0

description: |
  Wi-Fi station running on a Silicon Labs network co-processor. The
  node is a child of the "silabs,ncp" device. Two CPC endpoints carry the
  traffic: Ethernet frames on the data endpoint, commands and events of the
  network processor on the management endpoint. The 802.11 association and
  the key exchange are driven by the Zephyr supplicant.

  Example:

    &ncp {
        ncp_wifi: wifi {
            compatible = "silabs,ncp-wifi";
        };
    };

compatible: "silabs,ncp-wifi"

include: ethernet-controller.yaml
```

## dts/bindings/wifi/ti,cc35xx-wlan.yaml
```yaml
# Copyright (c) 2025 Conclusive Engineering sp. z o. o.
# SPDX-License-Identifier: Apache-2.0

description: Texas Instruments CC35XX Wi-Fi controller

compatible: "ti,cc35xx-wlan"
```

## dts/bindings/wifi/wifi-tx-power-2g.yaml
```yaml
# Copyright (c) 2024 Nordic Semiconductor ASA
# SPDX-License-Identifier: Apache-2.0

description: |
  Wi-Fi transmit power ceilings
  i.e., maximum transmit power allowed for 2.4GHz band. Based on the
  RF performance of the device, the transmit power can be limited
  for different data rates and sub-bands to get the best performance.
  Resolution is 1 dBm

  The defaults are the conservative values currently used for the Sheliak DK,
  so a board that has not been characterised errs on the side of transmitting
  too little rather than exceeding a regulatory limit. Every board should set
  the values measured for its own RF front-end.

properties:
  wifi-max-tx-pwr-2g-dsss:
    type: int
    default: 18
    description: Maximum transmit power allowed in 2.4GHz band for DSSS/CCK rates
  wifi-max-tx-pwr-2g-mcs0:
    type: int
    default: 14
    description: Maximum transmit power allowed in 2.4GHz band for MCS0
  wifi-max-tx-pwr-2g-mcs7:
    type: int
    default: 14
    description: Maximum transmit power allowed in 2.4GHz band for MCS7
```

## dts/bindings/wifi/wifi-tx-power-5g.yaml
```yaml
# Copyright (c) 2024 Nordic Semiconductor ASA
# SPDX-License-Identifier: Apache-2.0

description: |
  Wi-Fi transmit power ceilings
  i.e., maximum transmit power allowed for 5GHz band. Based on the
  RF performance of the device, the transmit power can be limited
  for different data rates and sub-bands to get the best performance.

  low sub-band: Channels 36-64
  mid sub-band: Channels 96-132
  high sub-band: Channels 136-177

  Resolution is 1 dBm

  The defaults are the conservative values currently used for the Sheliak DK,
  so a board that has not been characterised errs on the side of transmitting
  too little rather than exceeding a regulatory limit. Every board should set
  the values measured for its own RF front-end.

properties:
  wifi-max-tx-pwr-5g-low-mcs0:
    type: int
    default: 10
    description: Maximum transmit power allowed in 5GHz band MCS0 low sub-band
  wifi-max-tx-pwr-5g-low-mcs7:
    type: int
    default: 10
    description: Maximum transmit power allowed in 5GHz band MCS7 low sub-band
  wifi-max-tx-pwr-5g-mid-mcs0:
    type: int
    default: 10
    description: Maximum transmit power allowed in 5GHz band MCS0 mid sub-band
  wifi-max-tx-pwr-5g-mid-mcs7:
    type: int
    default: 10
    description: Maximum transmit power allowed in 5GHz band MCS7 mid sub-band
  wifi-max-tx-pwr-5g-high-mcs0:
    type: int
    default: 10
    description: Maximum transmit power allowed in 5GHz band MCS0 high sub-band
  wifi-max-tx-pwr-5g-high-mcs7:
    type: int
    default: 10
    description: Maximum transmit power allowed in 5GHz band MCS7 high sub-band
```

## dts/bindings/wifi/wifi-tx-power-6g.yaml
```yaml
# Copyright (c) 2026 Nordic Semiconductor ASA
# SPDX-License-Identifier: Apache-2.0

description: |
  Wi-Fi transmit power ceilings
  i.e., maximum transmit power allowed for the 6GHz band. Based on the
  RF performance of the device, the transmit power can be limited
  for different data rates and sub-bands to get the best performance.

  The 6GHz band is split into six sub-bands:

  band1: 5935 MHz - 6015 MHz
  band2: 6035 MHz - 6115 MHz
  band3: 6135 MHz - 6215 MHz
  band4: 6235 MHz - 6315 MHz
  band5: 6335 MHz - 6415 MHz
  band6: 6435 MHz - 6475 MHz

  Resolution is 1 dBm

  The defaults are conservative values pending characterisation of the DK,
  so a board that has not been characterised errs on the side of transmitting
  too little rather than exceeding a regulatory limit. Every board should set
  the values measured for its own RF front-end.

properties:
  wifi-max-tx-pwr-6g-band1-mcs0:
    type: int
    default: 10
    description: Maximum transmit power allowed in 6GHz band1 for MCS0
  wifi-max-tx-pwr-6g-band1-mcs7:
    type: int
    default: 10
    description: Maximum transmit power allowed in 6GHz band1 for MCS7
  wifi-max-tx-pwr-6g-band2-mcs0:
    type: int
    default: 10
    description: Maximum transmit power allowed in 6GHz band2 for MCS0
  wifi-max-tx-pwr-6g-band2-mcs7:
    type: int
    default: 10
    description: Maximum transmit power allowed in 6GHz band2 for MCS7
  wifi-max-tx-pwr-6g-band3-mcs0:
    type: int
    default: 10
    description: Maximum transmit power allowed in 6GHz band3 for MCS0
  wifi-max-tx-pwr-6g-band3-mcs7:
    type: int
    default: 10
    description: Maximum transmit power allowed in 6GHz band3 for MCS7
  wifi-max-tx-pwr-6g-band4-mcs0:
    type: int
    default: 10
    description: Maximum transmit power allowed in 6GHz band4 for MCS0
  wifi-max-tx-pwr-6g-band4-mcs7:
    type: int
    default: 10
    description: Maximum transmit power allowed in 6GHz band4 for MCS7
  wifi-max-tx-pwr-6g-band5-mcs0:
    type: int
    default: 10
    description: Maximum transmit power allowed in 6GHz band5 for MCS0
  wifi-max-tx-pwr-6g-band5-mcs7:
    type: int
    default: 10
    description: Maximum transmit power allowed in 6GHz band5 for MCS7
  wifi-max-tx-pwr-6g-band6-mcs0:
    type: int
    default: 10
    description: Maximum transmit power allowed in 6GHz band6 for MCS0
  wifi-max-tx-pwr-6g-band6-mcs7:
    type: int
    default: 10
    description: Maximum transmit power allowed in 6GHz band6 for MCS7
```
