## dts/bindings/biometrics/dfrobot,sen0359.yaml
```yaml
# SPDX-FileCopyrightText: Copyright The Zephyr Project Contributors
# SPDX-License-Identifier: Apache-2.0

title: DFRobot SEN0359 Gravity capacitive fingerprint sensor

description: |
  Fingerprint module built around the ID809 fingerprint processor.
  Templates are enrolled, stored (80 or 200 slots depending on the
  firmware) and matched on the module itself. The host talks to it over
  I2C, default address 0x1f.

compatible: "dfrobot,sen0359"

include: i2c-device.yaml

examples:
  - |
    i2c {
        #address-cells = <1>;
        #size-cells = <0>;

        fingerprint@1f {
            compatible = "dfrobot,sen0359";
            reg = <0x1f>;
        };
    };
```

## dts/bindings/biometrics/hilink,ai10.yaml
```yaml
# SPDX-License-Identifier: Apache-2.0
# Copyright (c) 2026 Siratul Islam <siratul.islam@linux.dev>

description: |
  Hi-Link AI-10 face and palm recognition module, using the binary
  UART protocol at 115200 baud. Face IDs are 1 through 1000 and palm IDs
  are 1001 through 2000.

  Also rebranded as the DFRobot SEN0677.

compatible: "hilink,ai10"

include: [uart-device.yaml]

properties:
  startup-delay-ms:
    type: int
    default: 2500
    description: |
      Time from driver initialization until the module can receive its first
      command. The default covers the documented maximum startup time when
      the module and host are powered together.

examples:
  - |
    &uart1 {
      status = "okay";
      current-speed = <115200>;

      ai10: biometrics {
        compatible = "hilink,ai10";
      };
    };
```

## dts/bindings/bluetooth/espressif,esp-hosted-mcu-bt-hci.yaml
```yaml
# Copyright (c) 2026 Espressif Systems (Shanghai) CO LTD
# SPDX-License-Identifier: Apache-2.0

description: |
  Bluetooth HCI controller reached over the esp-hosted-mcu transport core. The
  controller runs on an external Espressif coprocessor (for example an
  ESP32-C6) and its HCI H4 traffic is multiplexed onto the same SPI or SDIO
  link as Wi-Fi by the esp-hosted-mcu core.

compatible: "espressif,esp-hosted-mcu-bt-hci"

include: bt-hci.yaml

properties:
  bt-hci-name:
    default: "ESP Hosted"
  bt-hci-bus:
    default: "virtual"
  bt-hci-quirks:
    # The coprocessor firmware advertises the controller to host flow
    # control commands but rejects them.
    default: ["no-flow-control"]

examples:
  - |
    esp-hosted-mcu@0 {
            compatible = "espressif,esp-hosted-mcu";
            reg = <0>;

            esp_hosted_mcu_hci: bt-hci {
                    compatible = "espressif,esp-hosted-mcu-bt-hci";
                    status = "okay";
            };
    };
```

## dts/bindings/bluetooth/nxp,hci-ble.yaml
```yaml
# Copyright 2023, 2026 NXP
# SPDX-License-Identifier: Apache-2.0

description: NXP BLE HCI information

compatible: "nxp,hci-ble"

include: [bt-hci.yaml, nvmem-consumer.yaml]

properties:
  bt-hci-name:
    default: "BT NXP"
  bt-hci-bus:
    default: "ipc"

  nvmem-cells:
    description: |
      Optional list of NVMEM cells holding a Bluetooth device address (6 bytes,
      most significant byte first). Cells are tried in the order listed and the
      first one that is readable and provisioned (neither all 0x00 nor all
      0xff) is used as public address. If none is usable, the address is
      derived from the unique ID of the device. Only used when no public
      address is set by the application (CONFIG_BT_HCI_SET_PUBLIC_ADDR).
```

## dts/bindings/bluetooth/silabs,ncp-hci.yaml
```yaml
# Copyright (c) 2026 Silicon Laboratories Inc.
# SPDX-License-Identifier: Apache-2.0

description: |
  Bluetooth HCI controller running on a Silicon Labs network
  co-processor. The node is a child of the "silabs,ncp" device, the HCI
  packets (H4 framing) are carried by a dedicated CPC endpoint.

  Example:

    &ncp {
        ncp_hci: bt-hci {
            compatible = "silabs,ncp-hci";
        };
    };

compatible: "silabs,ncp-hci"

include: bt-hci.yaml

properties:
  bt-hci-name:
    default: "ncp"
  bt-hci-bus:
    default: "virtual"
```

## dts/bindings/bluetooth/ti,cc35xx-bt-hci.yaml
```yaml
# Copyright (c) 2025-2026 Conclusive Engineering sp. z o. o.
# SPDX-License-Identifier: Apache-2.0

include: bt-hci.yaml

description: Bluetooth HCI for Texas Instruments CC35xx SoC

compatible: "ti,cc35xx-bt-hci"

properties:
  bt-hci-name:
    default: "TI CC35XX BT HCI"
  bt-hci-bus:
    default: "virtual"
```

## dts/bindings/bluetooth/zephyr,bsim-2g4-radio.yaml
```yaml
# Copyright The Zephyr Project Contributors
# SPDX-License-Identifier: Apache-2.0

description: |
  Packet level 2.4GHz radio model of BabbleSim based boards.

  The BabbleSim boards only have vendor radio models, so Bluetooth LE Link
  Layer code written for one of them does not run on another. This model does
  not depend on any vendor radio: it talks to the BabbleSim 2G4 Phy, and
  signals the end of each packet Tx or Rx, and the matches of its free running
  1MHz counter, through the interrupts given here.

compatible: "zephyr,bsim-2g4-radio"

include: base.yaml

properties:
  interrupts:
    required: true

  interrupt-names:
    required: true
    description: |
      Must contain "radio" (end of a radio operation), "cntr" (counter
      compare), "swi-lll" and "swi-ull-low". The last two are software
      interrupts of the Bluetooth LE Controller, given here so that it takes
      all its interrupt lines from this node.
```

## dts/bindings/board_id/zephyr,board-id-gpio.yaml
```yaml
# SPDX-License-Identifier: Apache-2.0
# Copyright (c) 2026 The Zephyr Project Contributors
# Copyright (c) 2026 Dev It Wise

description: |
  GPIO strap board-id device.

  Reads a raw board identity value from a set of GPIO pins wired as straps.
  The value is the concatenation of the pin levels, bit N taken from the
  gpios entry at index N (least significant bit first). Active-low straps
  are handled by GPIO_ACTIVE_LOW in the phandle cell; no separate polarity
  property is needed.

  Example, three straps encoding an identity in the range 0-7:

    board_id: board-id {
            compatible = "zephyr,board-id-gpio";
            gpios = <&gpio0 3 (GPIO_ACTIVE_HIGH | GPIO_PULL_UP)>,
                    <&gpio0 4 (GPIO_ACTIVE_HIGH | GPIO_PULL_UP)>,
                    <&gpio0 5 (GPIO_ACTIVE_HIGH | GPIO_PULL_UP)>;
    };

compatible: "zephyr,board-id-gpio"

include: base.yaml

properties:
  gpios:
    type: phandle-array
    required: true
    description: |
      Strap pins, least significant bit first. The read value is the
      concatenation of the pin levels, bit N taken from gpios index N.
      Between 1 and 32 pins are accepted.
```

## dts/bindings/cache/arm,pl310-cache.yaml
```yaml
# Copyright (c) 2026 Analog Devices, Inc.
# SPDX-License-Identifier: Apache-2.0

description: |
  ARM L2C-310 (PL310) outer (L2) cache controller.

  Generic ARM IP found on multiple platforms (Zynq-7000, i.MX6, ST-Ericsson
  Ux500, Renesas RZA2M, ...). It sits below the CPU-integrated L1 cache and is
  not snooped by device-side DMA, so on a Cortex-A/R core its maintenance
  operations must be paired with the L1 ones. The driver provides the
  z_arm_outer_cache_* hooks called by the arch cache layer when CONFIG_OUTER_CACHE
  is set; it does not implement the cache_data_* API (L1 keeps owning that).

  SoC-specific values (aux control straps, RAM latencies) are supplied as
  properties.

compatible: "arm,pl310-cache"

include: base.yaml

properties:
  reg:
    required: true

  cache-unified:
    type: boolean
    description: |
      Standard cache-controller binding property; the PL310 is a unified
      (not split I/D) cache. Always present on this node.

  cache-level:
    type: int
    default: 2
    description: |
      Standard cache-controller binding property; the PL310 is always an L2
      (outer) cache.

  arm,data-latency:
    type: array
    description: |
      <read-latency write-latency setup-latency> cycle counts for the Data RAM
      Latency Control register (offset 0x10C), matching the ARM/Linux
      l2c2x0.yaml binding. Each cycle count N is packed as (N - 1) into the
      corresponding field; the driver does the packing.

  arm,tag-latency:
    type: array
    description: |
      <read-latency write-latency setup-latency> cycle counts for the Tag RAM
      Latency Control register (offset 0x108), matching the ARM/Linux
      l2c2x0.yaml binding. Each cycle count N is packed as (N - 1) into the
      corresponding field; the driver does the packing.

  arm,shared-override:
    type: boolean
    description: |
      Set the Shared Attribute Override Enable bit (aux control bit 22). Without
      it the PL310 treats Normal Shareable Cacheable transactions as
      non-cacheable, which hangs at MMU enable on Zynq-7000.

  arm,num-ways:
    type: int
    description: |
      Number of cache ways. Used to build the way mask for the invalidate-by-way
      reset sequence. If omitted the driver derives it from the associativity
      strap in the aux control register.
```

## dts/bindings/cache/nxp,llc.yaml
```yaml
# SPDX-FileCopyrightText: Copyright 2026 NXP
#
# SPDX-License-Identifier: Apache-2.0

description: |
  NXP CodaCache last-level cache (LLC) controller.

  The LLC sits in front of one or more external-memory controllers. Each of
  those controllers exposes its AHB window to the CPU twice: a direct window
  that bypasses the LLC, and a cached alias at a fixed offset above it. Only
  the cached alias is in the LLC address map, so maintenance by address takes
  the cached-alias address even for a buffer the application reaches through
  the direct window.

  reg is the controller register block. nxp,cached-memories names the memory
  controllers whose window this LLC caches: reg index 1 of each of those nodes
  is its direct window, and the cached alias of that window is its base plus
  nxp,cached-alias-offset.

compatible: "nxp,llc"

include: base.yaml

properties:
  reg:
    required: true

  cache-line-size:
    type: int
    required: true
    description: |
      LLC cache line size in bytes. Maintenance by address operates on whole
      lines of this size, which is independent of the CPU L1 line size.

  nxp,cached-memories:
    type: phandles
    required: true
    description: |
      Memory controllers whose AHB window is cached by this LLC. Index 1 of
      each referenced node's reg is taken as that memory's direct
      (LLC-bypassing) window base and size.

  nxp,cached-alias-offset:
    type: int
    required: true
    description: |
      Offset from a direct window base to the LLC-cached alias of the same
      memory, applied to every nxp,cached-memories window.
```

## dts/bindings/can/infineon,aurix-mcmcan-node.yaml
```yaml
# SPDX-FileCopyrightText: Copyright (c) 2024 Infineon Technologies AG,
# SPDX-FileCopyrightText: or an affiliate of Infineon Technologies AG. All rights reserved.
# SPDX-FileCopyrightText: Copyright (c) 2026 Linumiz
#
# SPDX-License-Identifier: Apache-2.0

description: |
  Infineon AURIX MCMCAN node, a Bosch M_CAN controller and a child of
  infineon,aurix-mcmcan. The pinctrl-0 pin without output-enable is the
  receive pin.

compatible: "infineon,aurix-mcmcan-node"

include: ["bosch,m_can-base.yaml", "pinctrl-device.yaml"]

properties:
  reg:
    required: true

  reg-names:
    required: true
    description: Must be "m_can" and "message_ram".

  interrupts:
    required: true
    description: Service requests of the "line0" and "line1" interrupt lines.

  interrupt-names:
    required: true

  pinctrl-0:
    required: true

  pinctrl-names:
    required: true
```

## dts/bindings/can/infineon,aurix-mcmcan.yaml
```yaml
# SPDX-FileCopyrightText: Copyright (c) 2024 Infineon Technologies AG,
# SPDX-FileCopyrightText: or an affiliate of Infineon Technologies AG. All rights reserved.
# SPDX-FileCopyrightText: Copyright (c) 2026 Linumiz
#
# SPDX-License-Identifier: Apache-2.0

description: |
  Infineon AURIX MCMCAN module, with up to four infineon,aurix-mcmcan-node
  child nodes sharing one message RAM.

compatible: "infineon,aurix-mcmcan"

include: base.yaml

properties:
  reg:
    required: true

  clocks:
    required: true
    description: fMCAN (CAN clock) and fMCANH (host clock).

  clock-names:
    required: true
    description: Must be "mcan" and "mcanh".
```

## dts/bindings/can/microchip,mcan-g1.yaml
```yaml
# SPDX-FileCopyrightText: Copyright The Zephyr Project Contributors
# SPDX-License-Identifier: Apache-2.0

title: Microchip M_CAN G1 CAN FD controller

description: |
  Microchip M_CAN G1.

  A Bosch M_CAN core inside a Microchip wrapper. The wrapper registers occupy
  the first 0x100 bytes of the peripheral and hold CTRLA, CTRLB, the bus error
  and debug interrupt registers and SYNCBUSY; the M_CAN core starts at 0x100.
  The two reg entries name that split.

  Supported families: PIC32CM SG/GC.

  Group g1 CAN driver supports following hardware peripherals:
    - module name="CAN" id="05010" name2="can_fd_apb_v1" version="1a0"

compatible: "microchip,mcan-g1"

include:
  - name: bosch,m_can-base.yaml
  - name: pinctrl-device.yaml

properties:
  reg:
    required: true

  reg-names:
    required: true
    description: |
      Two entries: "wrapper", the Microchip wrapper registers, and "m_can",
      the Bosch M_CAN core.

  interrupts:
    required: true

  interrupt-names:
    required: true
    description: |
      Three entries: "int0" and "int1", the two M_CAN interrupt lines, and
      "berr", the Microchip AHB bus error and debug interrupt that sits
      outside the core.

  clocks:
    required: true

  clock-names:
    required: true
    description: |
      Two entries: "mclk", the peripheral bus clock, and "gclk", the generic
      clock feeding the M_CAN core.

  pinctrl-0:
    required: true

  pinctrl-names:
    required: true
```
