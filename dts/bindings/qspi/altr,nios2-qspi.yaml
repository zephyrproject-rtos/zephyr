## dts/bindings/qspi/raspberrypi,pico-spi-pio-qspi.yaml
```yaml
# Copyright (c) 2026 WIZnet Co., Ltd.
# SPDX-License-Identifier: Apache-2.0

description: Raspberry Pi Pico QSPI (Quad SPI) via PIO

compatible: "raspberrypi,pico-spi-pio-qspi"

include: ["spi-controller.yaml", "raspberrypi,pico-pio-device.yaml", "reset-device.yaml"]

properties:
  clk-gpios:
    type: phandle-array
    required: true
    description: |
      Output pin for QSPI clock

  io0-gpios:
    type: phandle-array
    required: true
    description: |
      Bidirectional data pin IO0 (base pin).
      IO0 through IO3 must be consecutive GPIO pins.

  io1-gpios:
    type: phandle-array
    required: true
    description: |
      Bidirectional data pin IO1 (must be IO0 + 1)

  io2-gpios:
    type: phandle-array
    required: true
    description: |
      Bidirectional data pin IO2 (must be IO0 + 2)

  io3-gpios:
    type: phandle-array
    required: true
    description: |
      Bidirectional data pin IO3 (must be IO0 + 3)

  clocks:
    required: true
```

## dts/bindings/qspi/renesas,ra-qspi.yaml
```yaml
# Copyright (c) 2024 Renesas Electronics Corporation
# SPDX-License-Identifier: Apache-2.0

description: Renesas RA QSPI

compatible: "renesas,ra-qspi"

include: [base.yaml, pinctrl-device.yaml]

bus: qspi

properties:
  reg:
    required: true

  pinctrl-0:
    required: true

  pinctrl-names:
    required: true
```

## dts/bindings/qspi/renesas,rz-spibsc.yaml
```yaml
# Copyright (c) 2025 Renesas Electronics Corporation
# SPDX-License-Identifier: Apache-2.0

description: Renesas RZ SPIBSC

compatible: "renesas,rz-spibsc"

include: [base.yaml, pinctrl-device.yaml]

bus: qspi

properties:
  reg:
    required: true
```

## dts/bindings/qspi/renesas,rz-xspi.yaml
```yaml
# Copyright (c) 2025 Renesas Electronics Corporation
# SPDX-License-Identifier: Apache-2.0

description: Renesas RZ XSPI

compatible: "renesas,rz-xspi"

include: [base.yaml, pinctrl-device.yaml]

bus: qspi

properties:
  reg:
    required: true

  unit:
    type: int
    required: true
    description: XSPI unit number

  pinctrl-0:
    required: true

  pinctrl-names:
    required: true
```

## dts/bindings/qspi/st,stm32-qspi.yaml
```yaml
# Copyright (c) 2020, Linaro limited
# SPDX-License-Identifier: Apache-2.0

description: |
    STM32 QSPI Controller.

    An stm32 quadspi node would typically look like this:

        &quadspi {
            pinctrl-0 = <&quadspi_clk_pe10 &quadspi_ncs_pe11
                         &quadspi_bk1_io0_pe12 &quadspi_bk1_io1_pe13
                         &quadspi_bk1_io2_pe14 &quadspi_bk1_io3_pe15>;

            dmas = <&dma1 5 5 0x0000 0x03>;
            dma-names = "tx_rx";

            status = "okay";
        };

compatible: "st,stm32-qspi"

include: [base.yaml, pinctrl-device.yaml]

bus: qspi

properties:
  reg:
    required: true

  interrupts:
    required: true

  pinctrl-0:
    required: true

  pinctrl-names:
    required: true

  dmas:
    description: |
      Optional DMA channel specifier. If DMA should be used, specifier should
      hold a phandle reference to the dma controller (not the DMAMUX even if present),
      the channel number, the slot number, channel configuration and finally features.
      (depending on the type of DMA: 'features' is optional)

      When a DMAMUX is present and enabled, the channel is the dma one
      (not dmamux channel). The request is given by the DMAMUX (no 'features' required).

      For example with DMA 2 for TX/RX on QSPI like stm32l496 (no 'features')
         /* select DMA2 channel 7 request 3 for QUADSPI */
         dmas = <&dma2 7 3 (STM32_DMA_PERIPH_TX | STM32_DMA_PRIORITY_HIGH)>;
      For example with a DMAMUX for TX/RX on QSPI like stm32wb55  (no 'features')
         /* select DMA2 channel 0, request 20 for QUADSPI */
         dmas = <&dma2 0 20 (STM32_DMA_PERIPH_TX | STM32_DMA_PRIORITY_HIGH)>;

  dma-names:
    description: |
      DMA channel name. If DMA should be used, expected value is "tx_rx".

      For example
         dma-names = "tx_rx";

  dual-flash:
    type: boolean
    description: |
      configuration to enable the dual flash mode of the QSPI peripheral
      where two external quad SPI Flash memories (FLASH 1 and FLASH 2) are used
      in order to send/receive 8 bits (or 16 bits in DDR mode) every cycle,
      effectively doubling the throughput as well as the capacity.
      When true, the Flash ID number <flash-id> is useless.

  flash-id:
    type: int
    description: |
      Flash ID number. This number, if defined, helps to select the right
      QSPI GPIO banks (defined as 'quadspi_bk[1/2]' in pinctrl property)
      to communicate with flash memory.
      Valid only if the <dual-flash> is not set.

      For example
         flash-id = <2>;
```

## dts/bindings/radio/nordic,nrf52840-radio.yaml
```yaml
---
title: Nordic Radio
id: nordic,nrf52840-radio
version: 0.1

description: >
    This binding gives a base representation of the Nordic Radio

properties:
    compatible:
      type: string
      category: required
      description: compatible strings
      constraint: "nordic,nrf52840-radio"

    reg:
      type: array
      description: mmio register space
      generation: define
      category: required

    interrupts:
      type: array
      category: optional
      description: optional interrupts
      generation: define

    interrupt-names:
      type: stringlist
      category: optional
      description: names of optinal interrupts
      generation: define

    iee802154_drv_label:
      type: string
      category: required
      description: Human readable string describing the device (used by Zephyr for API name)
      generation: define
...
```

## dts/bindings/regulator/adi,adp5360-regulator.yaml
```yaml
# Copyright (c) 2023 Nordic Semiconductor ASA
# Copyright (c) 2026 Analog Devices, Inc.
# SPDX-License-Identifier: Apache-2.0

description: |
  Analog Devices ADP5360 PMIC

  The PMIC has one buck converter and one buck-boost converter. Both need to be
  defined as children nodes, strictly following the BUCK and BUCKBOOST node
  names.

  The regulators are modeled in DT as a child device of "adi,adp5360" compatible node.

compatible: "adi,adp5360-regulator"

include: base.yaml

child-binding:
  include:
    - name: regulator.yaml
      property-allowlist:
        - regulator-always-on
        - regulator-boot-on
        - regulator-boot-off
        - regulator-init-microvolt
        - regulator-min-microvolt
        - regulator-max-microvolt
        - regulator-allowed-modes
        - regulator-initial-mode
        - regulator-active-discharge

  properties:
    regulator-init-microvolt:
      type: int
      required: true

    adi,switch-delay-us:
      type: int
      enum:
        - 0
        - 5
        - 10
        - 20
      default: 0
      description: Switch delay time in hysteresis. The device default for this setting is 0us.

    adi,soft-start-ms:
      type: int
      enum:
        - 1
        - 8
        - 64
        - 512
      default: 1
      description: Soft start time in milliseconds. The device default for this setting is 1ms.

    adi,ilim-milliamp:
      type: int
      enum:
        - 100
        - 200
        - 300
        - 400
        - 500
        - 600
        - 700
        - 800
      default: 400
      description: |
        Peak current limit, in milliamperes. Values above 400mA are only
        applicable to buck boost.
        The device default for this setting is 400mA.

    adi,enable-stop-pulse:
      type: boolean
      description: |
        With this option selected and the buck/boost enabled, the buck/boost
        regulator can be stopped using the STP pin.

    adi,enable-output-discharge:
      type: boolean
      description: Enable output discharge functionality

    adi,enable-gpios:
      type: phandle-array
      description: |
        Enable pin for the Buck/Buckboost regulator.
        Note that the Buck regulator enable pin is logically AND-ed to its enable bit.
        If the enable-gpios pin is not found on the Buck converter, it is assumed
        that the EN1 pin is latched to high via hardware configuration.

        The Buckboost regulator is logically OR-ed to its enable bit,
        thus it is optional to use alongside the enable bit in the buckboost config register.

examples:
  - |
    pmic@46 {
      compatible = "adi,adp5360";
      reg = <0x46>;
      /* ... */
      regulators {
        compatible = "adi,adp5360-regulator";

        BUCK {
          /* all properties for BUCK */
        };
        BUCKBOOST {
          /* all properties for BUCKBOOST */
        };
      };
    };
```

## dts/bindings/regulator/arduino,modulino-latch-relay.yaml
```yaml
# Copyright (c) 2026 Silicon Labs
#
# SPDX-License-Identifier: Apache-2.0

title: Arduino Modulino Latch Relay

description: |
  The Arduino Modulino Latch Relay module features a bistable latching relay
  that maintains its state without continuous power, capable of switching
  high-current DC loads up to 30V.
  See: https://docs.arduino.cc/hardware/modulino-latch/

compatible: "arduino,modulino-latch-relay"

include: i2c-device.yaml

properties:
  reg:
    required: true
```

## dts/bindings/regulator/bflb,aon-regulator.yaml
```yaml
# Copyright (c), 2026 MASSDRIVER EI (massdriver.space)
# SPDX-License-Identifier: Apache-2.0

description: |
  Bouffalolab HBN AON (Always ON section) voltage regulator
  It is a LDO with a canonical voltage of 1.10v
  It has two modes, but they are only switched between when going into sleep mode and do not share
  settings areas.

compatible: "bflb,aon-regulator"

include: "bflb,regulators-common.yaml"
```

## dts/bindings/regulator/bflb,regulators-common.yaml
```yaml
# Copyright (c), 2026 MASSDRIVER EI (massdriver.space)
# SPDX-License-Identifier: Apache-2.0

include:
  - name: base.yaml
  - name: regulator.yaml
    property-allowlist:
      - regulator-init-microvolt
      - regulator-always-on
      - regulator-boot-on
      - regulator-min-microvolt
      - regulator-max-microvolt

properties:
  regulator-init-microvolt:
    default: 1100000

  sleep-microvolt:
    type: int
    default: 1100000
    enum:
      - 600000
      - 650000
      - 700000
      - 750000
      - 800000
      - 850000
      - 900000
      - 950000
      - 1000000
      - 1050000
      - 1100000
      - 1150000
      - 1200000
      - 1250000
      - 1300000
      - 1350000
    description:
      Regulator's voltage when system is in sleep mode.
```

## dts/bindings/regulator/cirrus,cp9314.yaml
```yaml
# Copyright (c) 2024 Cirrus Logic, Inc.
# SPDX-License-Identifier: Apache-2.0

description: |
  Cirrus CP9314 Buck Switched Cap DC/DC Converter

  converter@72 {
    compatible = "cirrus,cp9314";
    reg = <0x72>;

    cirrus,initial-switched-capacitor-mode = "2:1";
  };

compatible: "cirrus,cp9314"

include:
  - name: i2c-device.yaml
  - name: regulator.yaml
    property-allowlist:
      - regulator-boot-on

properties:
  reg:
    required: true

  cirrus,en-gpios:
    type: phandle-array
    description: GPIO tied to EN pin

  cirrus,pgood-gpios:
    type: phandle-array
    description: GPIO tied to PGOOD pin

  cirrus,initial-switched-capacitor-mode:
    type: string
    enum:
      - "2:1"
      - "3:1"
    description: |
      Desired switched capacitor ratio set at initialization. This entry will overwrite
      the selection set by the PROG resistor.
```

## dts/bindings/regulator/espressif,esp32-regulator.yaml
```yaml
# Copyright (c) 2026 Espressif Systems (Shanghai) Co., Ltd.
# SPDX-License-Identifier: Apache-2.0

description: |
  Espressif ESP32 on-chip LDO voltage regulators.

  Some Espressif SoCs include internal general-purpose LDO channels
  that can supply power to internal and external peripherals such as
  SPI flash and PSRAM.

  Supported voltage range: 500mV to 2700mV (continuously adjustable),
  or 3300mV (rail bypass mode). Some channels have eFuse-calibrated
  output for precise voltage regulation.

compatible: "espressif,esp32-regulator"

include: base.yaml

properties:
  "#address-cells":
    const: 1

  "#size-cells":
    const: 0

child-binding:
  include:
    - name: regulator.yaml
      property-allowlist:
        - regulator-name
        - regulator-always-on
        - regulator-boot-on
        - regulator-init-microvolt
        - regulator-min-microvolt
        - regulator-max-microvolt

  properties:
    reg:
      type: int
      required: true
      description: |
        LDO output channel number (1-4), corresponding to VO1-VO4.

    regulator-min-microvolt:
      default: 500000

    regulator-max-microvolt:
      default: 3300000

examples:
  - |
    ldo {
      compatible = "espressif,esp32-regulator";
      #address-cells = <1>;
      #size-cells = <0>;

      ldo1@1 {
        reg = <1>;
        regulator-name = "ldo1";
        regulator-boot-on;
        regulator-always-on;
        regulator-init-microvolt = <3300000>;
      };

      ldo2@2 {
        reg = <2>;
        regulator-name = "ldo2";
        regulator-init-microvolt = <1800000>;
      };
    };
```

## dts/bindings/regulator/gd,gd32-bldo.yaml
```yaml
# Copyright (c) 2026 Aleksandr Senin <al@meshium.net>
#
# SPDX-License-Identifier: Apache-2.0

description: GD32 Backup SRAM LDO (BLDO) regulator

include:
  - name: base.yaml
  - name: regulator.yaml
    property-allowlist:
      - regulator-name
      - regulator-boot-on
      - regulator-boot-off
      - regulator-always-on
      - startup-delay-us
      - off-on-delay-us

compatible: "gd,gd32-bldo"

properties:
  regulator-name:
    required: true

  clocks:
    required: true
    description: Reference to PMU clock gate
```
