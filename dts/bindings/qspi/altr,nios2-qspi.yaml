## dts/bindings/regulator/infineon,autanalog-prb-vref.yaml
```yaml
# Copyright (c) 2026 Infineon Technologies AG,
# or an affiliate of Infineon Technologies AG.
#
# SPDX-License-Identifier: Apache-2.0

description: |
  Infineon AutAnalog PRB voltage reference regulator.

  Each node represents one of the two programmable voltage references (Vref0 or
  Vref1) within a PRB block.  The PRB derives the output voltage from a source
  (VBGR at 0.9 V or VDDA at up to 1.8 V) through a 16-position resistive tap
  divider.  The output voltage is:

    Vref = fraction * Vsrc

  where fraction depends on the tap setting:
    Tap  0 → 0.0625  (1/16)
    Tap  1 → 0.125   (2/16)
    ...
    Tap 15 → 1.0     (16/16)

  Available voltages (microvolts) depend on the source property:
    source = 0 (VBGR, Vsrc = 0.9 V): 56250, 112500, ..., 900000
    source = 1 (VDDA, Vsrc = 1.8 V): 112500, 225000, ..., 1800000

  The parent node must have compatible "infineon,autanalog-prb".

compatible: "infineon,autanalog-prb-vref"

include: [base.yaml, regulator.yaml]

properties:
  reg:
    required: true
    description: |
      Vref index within the PRB block (0 or 1).

  source:
    type: int
    required: true
    description: |
      Source voltage selector.
      Use IFX_AUTANALOG_PRB_SRC_* constants from
      <dt-bindings/regulator/infineon-autanalog-prb.h>.
        IFX_AUTANALOG_PRB_SRC_VBGR (0) = VBGR (0.9 V nominal)
        IFX_AUTANALOG_PRB_SRC_VDDA (1) = VDDA (1.8 V max)
    enum:
      - 0
      - 1

  tap:
    type: int
    required: true
    description: |
      Initial tap position (0-15).  The output voltage is
      ((tap + 1) / 16) * Vsrc.
      Use IFX_AUTANALOG_PRB_TAP_* constants from
      <dt-bindings/regulator/infineon-autanalog-prb.h>.
    enum:
      - 0
      - 1
      - 2
      - 3
      - 4
      - 5
      - 6
      - 7
      - 8
      - 9
      - 10
      - 11
      - 12
      - 13
      - 14
      - 15

examples:
  - |
    /*
     * Use constants from <dt-bindings/regulator/infineon-autanalog-prb.h>.
     */
    prb0: prb@0 {
        compatible = "infineon,autanalog-prb";
        status = "okay";

        vref0: vref@0 {
            compatible = "infineon,autanalog-prb-vref";
            reg = <0>;
            source = <IFX_AUTANALOG_PRB_SRC_VDDA>;
            tap = <IFX_AUTANALOG_PRB_TAP_7>;
        };
    };
```

## dts/bindings/regulator/m5stack,m5pm1-regulator.yaml
```yaml
# Copyright (c) 2026 The Zephyr Project Contributors
# SPDX-License-Identifier: Apache-2.0

description: M5Stack M5PM1 fixed-voltage regulators

compatible: "m5stack,m5pm1-regulator"

on-bus: m5pm1

include: base.yaml

child-binding:
  include:
    - name: regulator.yaml
      property-allowlist:
        - regulator-min-microvolt
        - regulator-max-microvolt
        - regulator-boot-on
        - regulator-boot-off
        - regulator-always-on

examples:
  - |
    i2c {
      pmic@6e {
        compatible = "m5stack,m5pm1";
        reg = <0x6e>;

        regulators {
          compatible = "m5stack,m5pm1-regulator";

          DCDC_3V3 {
          };

          LDO_3V3 {
          };

          BOOST_5V {
          };
        };
      };
    };
```

## dts/bindings/regulator/maxim,max20335-regulator.yaml
```yaml
# Copyright (c), 2023 Grinn
# SPDX-License-Identifier: Apache-2.0

description: |
  Maxim MAX20335 PMIC

  The PMIC has two buck converters and three LDOs. All need to be defined as
  children nodes, strictly following the BUCK1..2, LDO1..3 node names. For
  example:

  pmic@28 {
    reg = <0x28>;
    ...
    regulators {
      compatible = maxim,max20335-regulator";

      BUCK1 {
        /* all properties for BUCK1 */
      };
      BUCK2 {
        /* all properties for BUCK2 */
      };
      LDO1 {
        /* all properties for LDO1 */
      };
      LDO2 {
        /* all properties for LDO2 */
      };
      LDO3 {
        /* all properties for LDO3 */
      };
    };
  };

compatible: "maxim,max20335-regulator"

include: base.yaml

child-binding:
  include:
    - name: regulator.yaml
      property-allowlist:
        - regulator-init-microvolt
        - regulator-min-microvolt
        - regulator-max-microvolt
        - regulator-init-microamp
        - regulator-max-microamp
        - regulator-always-on
        - regulator-boot-on
        - regulator-initial-mode
        - regulator-allowed-modes
```

## dts/bindings/regulator/mps,mpm54304.yaml
```yaml
# Copyright (c) 2024 Vogl Electronic GmbH
#
# SPDX-License-Identifier: Apache-2.0

description: |
  Monolithic Power Systems MPM54304 quad-output DC/DC step-down power module.
  See https://www.monolithicpower.com/en/mpm54304.html.

  The MPM54304 has four buck regulators. All need to be defined as
  children nodes, strictly following the BUCK1..4 node names. For
  example:

  mpm54304@68 {
    reg = <0x68>;
    ...

    BUCK1 {
      /* all properties for BUCK1 */
    };
    BUCK2 {
      /* all properties for BUCK2 */
    };
    BUCK3 {
      /* all properties for BUCK3 */
    };
    BUCK4 {
      /* all properties for BUCK4 */
    };
  };

compatible: "mps,mpm54304"

include: i2c-device.yaml
```

## dts/bindings/regulator/nordic,hvdcdc-regulator.yaml
```yaml
# Copyright 2019-2020 Peter Bigot Consulting, LLC
# Copyright 2023 EPAM Systems
# SPDX-License-Identifier: Apache-2.0

description: Nordic high voltage DC/DC regulator

include:
  - name: base.yaml
  - name: regulator.yaml
    property-allowlist:
      - regulator-name
      - regulator-boot-on
      - regulator-init-microvolt
      - regulator-min-microvolt
      - regulator-max-microvolt

compatible: "nordic,hvdcdc-regulator"

properties:
  regulator-name:
    required: true
```
