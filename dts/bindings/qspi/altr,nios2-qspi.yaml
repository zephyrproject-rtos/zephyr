## dts/bindings/qspi/altr,nios2-qspi.yaml
```yaml
# Copyright (c) 2022, Kumar Gala <galak@kernel.org>
# SPDX-License-Identifier: Apache-2.0

description: Altera NIOS2 QSPI

compatible: "altr,nios2-qspi"

include: [base.yaml]

bus: qspi

properties:
  reg:
    required: true
```

## dts/bindings/qspi/atmel,sam-qspi.yaml
```yaml
# Copyright (c) 2026 Eve Redero
# SPDX-License-Identifier: Apache-2.0

description: |
  Atmel SAM QSPI Controller

  The Atmel SAM QSPI peripheral can work in two modes, the first is a QSPI flash driver
  mode able to work in several parallel configuration such as mono, dual or quad SPI.
  The second mode is a generic SPI driver.
  The current driver handles the QSPI flash mode only.

  This is the peripheral controller node. The flash behaviour is described in the
  atmel,sam-flash-qspi child node.

compatible: "atmel,sam-qspi"

include:
  - name: "base.yaml"
  - name: "pinctrl-device.yaml"

bus: qspi

properties:
  reg:
    required: true

  interrupts:
    required: true

  pinctrl-0:
    required: true

  pinctrl-names:
    required: true

examples:
  - |
    qspi: qspi@4007c000 {
        compatible = "atmel,sam-qspi";
        #address-cells = <1>;
        #size-cells = <0>;
        reg = <0x4007c000 0x4000>;
        interrupts = <43 0>;
        clocks = <&pmc PMC_TYPE_PERIPHERAL 43>;
        pinctrl-0 = <&qspi_default>;
        pinctrl-names = "default";
        status = "okay";
    };
```

## dts/bindings/qspi/nxp,qspi.yaml
```yaml
# Copyright 2026 NXP
# SPDX-License-Identifier: Apache-2.0

description: NXP QSPI controller

compatible: "nxp,qspi"

include: [base.yaml, pinctrl-device.yaml]

properties:
  reg:
    required: true
    description: |
      Register base address and size for QSPI controller and AHB memory region.
      First region is the QSPI controller registers.
      Second region is the AHB memory mapped region for flash access.

  clocks:
    required: true

  tx-watermark:
    type: int
    default: 8
    description: QSPI transmit watermark value (1-16)

  rx-watermark:
    type: int
    default: 8
    description: QSPI receive watermark value (1-16)

  dqs-config:
    type: array
    description: |
      DQS configuration array with following elements:
      [0] - portADelayTapNum: Delay chain tap number for port A (0-127)
      [1] - shift: DQS phase shift (0-3)
            0: No phase shift
            1: 45 degree phase shift
            2: 90 degree phase shift
            3: 135 degree phase shift
      [2] - rxSampleClock: Read sample clock selection (0-2)
            0: Internal loopback
            1: Loopback from DQS pad
            2: External input from DQS pad
      [3] - enableDQSClkInverse: Enable DQS clock inverse (0 or 1)
      Only applicable if FSL_FEATURE_QSPI_HAS_NO_SOCCR_REG is not defined.
```

## dts/bindings/qspi/nxp,s32-qspi-port.yaml
```yaml
# Copyright 2024 NXP
# SPDX-License-Identifier: Apache-2.0

description: NXP S32 Quad Serial Peripheral Interface (QSPI) Port

compatible: "nxp,s32-qspi-port"

include: base.yaml

properties:
  memory-sizes:
    required: true
    type: array
    description: |
      Size of flash memories devices, in bits, connected to this port. The
      number of elements must match the number of CS lines available on this
      port.
      The sizes of the flash memory devices are mapped with the system memory
      space based on the memory sizes configuration of all available ports,
      starting from QSPI AHB base address. The corresponding CS line is asserted
      based on this configuration.
      Example configurations for 'memory-sizes' property:

                                   port_a        port_b (if available)
        single mode, single-die    <A1>, <0>     <0>,  <0>
        single mode, dual-die      <A1>, <A2>    <0>,  <0>
        serial mode, single-die    <A1>, <0>     <B1>, <0>
        serial mode, dual-die      <A1>, <A2>    <B1>, <B2>

  rx-clock-source:
    type: string
    enum:
      - LOOPBACK
      - LOOPBACK DQS
      - INTERNAL DQS
      - EXTERNAL DQS
    description: |
      Selects DQS clock source for sampling read data at side A:
      - LOOPBACK: use loopback clock from dummy internal PAD as strobe signal.
      - LOOPBACK DQS: use loopback clock from PAD as strobe signal.
      - INTERNAL DQS: use internally generated strobe signal.
      - EXTERNAL DQS: use external strobe signal.

  io2-idle-high:
    type: boolean
    description: |
      Set if the logic level of IO2 signal output of this port must be driven
      high in the inactive state.

  io3-idle-high:
    type: boolean
    description: |
      Set if the logic level of IO3 signal output of this port must be driven
      high in the inactive state.

  dll-mode:
    type: string
    enum:
      - BYPASSED
      - MANUAL UPDATE
      - AUTO UPDATE
    description: |
      DLL mode. The supported modes depends on the SoC.

  dll-freq-enable:
    type: boolean
    description: |
      Selects delay-chain for high frequency of operation.

  dll-ref-counter:
    type: int
    enum: [0, 1, 2, 3, 4, 5, 6, 7, 8, 9, 10, 11, 12, 13, 14, 15]
    description: |
      Select the "n+1" interval of DLL phase detection and reference delay
      updating interval.
      Minimum recommended value is 1.

  dll-resolution:
    type: int
    enum: [2, 3, 4, 5, 6, 7, 8, 9, 10, 11, 12, 13, 14, 15]
    description: |
      Minimum resolution for DLL phase detector to remain locked/unlocked based
      on flash memory clock jitter.
      The minimum value is 2.

  dll-coarse-delay:
    type: int
    enum: [0, 1, 2, 3, 4, 5, 6, 7, 8, 9, 10, 11, 12, 13, 14, 15]
    description: |
      This field sets the number of delay elements in each delay tap. The field
      is used to overwrite DLL-generated delay values.

  dll-fine-delay:
    type: int
    enum: [0, 1, 2, 3, 4, 5, 6, 7, 8, 9, 10, 11, 12, 13, 14, 15]
    description: |
      This field sets the number of fine offset delay elements up to 16 in
      incoming DQS.

  dll-tap-select:
    type: int
    enum: [0, 1, 2, 3, 4, 5, 6, 7]
    description: |
      Selects the Nth tap provided by the slave delay-chain.
```

## dts/bindings/qspi/nxp,s32-qspi-sfp-frad.yaml
```yaml
# Copyright 2024 NXP
# SPDX-License-Identifier: Apache-2.0

description: NXP S32 Quad Serial Peripheral Interface (QSPI) Secure Flash Protection SFP FRAD.

  The SFP FRAD performs second-level checks on input flash write and erase transactions,
  based on the address range of each transaction.

compatible: "nxp,s32-qspi-sfp-frad"

child-binding:

  properties:
    reg:
      type: array
      required: true

    master-domain-acp-policy:
      type: int
      required: true
      description: |
        Selects the master domain access control policy, defined in dt-bindings/qspi/nxp-s32-qspi.h:
        - NXP_S32_QSPI_NON_SECURE: Selects the non-secure access control policy.
        - NXP_S32_QSPI_SECURE: Selects the secure access control policy.
        - NXP_S32_QSPI_PRIVILEGE: Selects the privilege access control policy.
        Allowed combinations:
        - NXP_S32_QSPI_SECURE
        - NXP_S32_QSPI_SECURE | NXP_S32_QSPI_PRIVILEGE
        - NXP_S32_QSPI_NON_SECURE | NXP_S32_QSPI_PRIVILEGE
        - NXP_S32_QSPI_NON_SECURE | NXP_S32_QSPI_SECURE | NXP_S32_QSPI_PRIVILEGE

    exclusive-access-lock:
      type: string
      enum:
        - DISABLED
        - OWNER
        - NONE
      default: DISABLED
      description: |
        Selects the exclusive access lock:
        - DISABLED: The exclusive access lock disabled, granting write permissions for all masters
        - ENABLED: The exclusive access lock enabled, granting write permissions only to the
          exclusive access owner master and disabling write permissions for other masters.
        - NONE: This configuration should not be used
        The default corresponds to the reset value of the register field.

    exclusive-access-owner:
      type: int
      default: 0
      description: |
        The domain master ID that owns the exclusive access lock.
        Valid range: 0 - 63. The default corresponds to the reset
        value of the register field.
```

## dts/bindings/qspi/nxp,s32-qspi-sfp-mdad.yaml
```yaml
# Copyright 2024 NXP
# SPDX-License-Identifier: Apache-2.0

description: NXP S32 Quad Serial Peripheral Interface (QSPI) Secure Flash Protection SFP MDAD.

  The SFP MDAD performs first-level checks on input transactions, based on the secure attribute
  and MGID associated with each transaction.

compatible: "nxp,s32-qspi-sfp-mdad"

child-binding:

  properties:
    secure-attribute:
      type: int
      required: true
      description: |
        Selects the secure attribute, defined in dt-bindings/qspi/nxp-s32-qspi.h:
        - NXP_S32_QSPI_NON_SECURE: Allow the bus attribute for this master to non-secure
        - NXP_S32_QSPI_SECURE: Allow the bus attribute for this master to secure
        Allowed combinations:
        - NXP_S32_QSPI_NON_SECURE
        - NXP_S32_QSPI_SECURE
        - NXP_S32_QSPI_NON_SECURE | NXP_S32_QSPI_SECURE

    mask-type:
      type: string
      enum:
        - AND
        - OR
      default: AND
      description: |
        Selects the mask type:
        - AND: AND-ed mask
        - OR: OR-ed mask
        The default corresponds to the reset value of the register field.

    mask:
      type: int
      default: 0
      description: |
        Defines the mask value for the ID-Match comparison.
        Valid range: 0 - 63. The default corresponds to the
        reset value of the register field.

    domain-id:
      type: int
      required: true
      description: |
        Domain ID Reference value of the Domain-ID (MID) for MID-comparison.
        Valid range: 0 - 63.
```

## dts/bindings/qspi/nxp,s32-qspi.yaml
```yaml
# Copyright 2023-2024 NXP
# SPDX-License-Identifier: Apache-2.0

description: |
  NXP S32 Quad Serial Peripheral Interface (QSPI) Controller.

  QSPI acts as an interface to up to two serial flash memory devices, each with
  up to eight bidirectional data lines, depending on the platform.

compatible: "nxp,s32-qspi"

include: [base.yaml, pinctrl-device.yaml]

bus: qspi

properties:
  reg:
    required: true

  reg-names:
    required: true

  "#address-cells":
    const: 1

  "#size-cells":
    const: 0

  data-rate:
    required: true
    type: string
    enum:
      - SDR
      - DDR
    description: |
      Selects the read mode:
      - Single Data Rate (SDR): sampling of incoming data occurs on single edges.
      - Double Data Rate (DDR): sampling of incoming data occurs on both edges.

  hold-time-2x:
    type: boolean
    description: |
      Set to align incoming data with 2x serial flash half clock, when in DDR
      mode. Otherwise, data will be aligned to the posedge of the controller's
      internal reference clock.

  sample-delay-half-cycle:
    type: boolean
    description: |
      Set to use half-cycle early DQS delay when sampling received data.

  sample-phase-inverted:
    type: boolean
    description: |
      Set to sample received data at inverted clock.

  cs-setup-time:
    type: int
    enum: [2, 3, 4, 5, 6, 7, 8, 9, 10, 11, 12, 13, 14, 15]
    default: 3
    description: |
      Chip select setup time, in serial clock cycles. A bigger value will pull
      the CS signal earlier before the transaction starts.
      The default corresponds to the reset value of the register field.

  cs-hold-time:
    type: int
    enum: [2, 3, 4, 5, 6, 7, 8, 9, 10, 11, 12, 13, 14, 15]
    default: 3
    description: |
      Chip select hold time, in serial clock cycles. A bigger value will release
      the CS signal later after the transaction ends.
      The default corresponds to the reset value of the register field.

  column-space:
    type: int
    default: 0
    enum: [0, 1, 2, 3, 4, 5, 6, 7, 8, 9, 10, 11, 12, 13, 14, 15]
    description: |
      Column Address Space bit width. For example, if the column address is
      [2:0] of QSPI_SFAR/AHB address, then the column address space bit width
      must be 3. If there is no column address separation in any serial flash
      device connected to this controller, this value must be programmed to 0.
      The default corresponds to the reset value of the register field.

  word-addressable:
    type: boolean
    description: |
      Set if the serial flash device connected to this controller is word
      (2 bytes) addressable.

  byte-swapping:
    type: boolean
    description: |
      In case of Octal DDR mode, specifies whether a word unit composed of two
      bytes from posedge and negedge of a single DQS cycle needs to be swapped.

  ahb-buffers:
    type: array
    required: true
    description: |
      AHB receive buffer configuration as in an array of tuples in the form
      <master-id buffer-size>. The master ID of every incoming request is
      checked and the data is returned or fetched into the corresponding
      associated buffer.
      The maximum buffer size and maximum number of buffers is SoC specific.

  ahb-buffers-all-masters:
    type: boolean
    description: |
      Any access from a master not associated with any other buffer is routed to
      the last buffer.

  lut-size:
    type: int
    required: true
    description: |
      Number of look-up table registers.

  tx-fifo-size:
    type: int
    required: true
    description: |
      Transmit FIFO size in bytes.

  rx-fifo-size:
    type: int
    required: true
    description: |
      Receive FIFO size in bytes.

  chip-options:
    type: int
    description: |
      Value to write to QSPI SOC configuration register (SOCCFG), if available.
      For details, see chip-specific QSPI information in the device reference
      manual.

  has-ddr:
    type: boolean
    description: |
      Set if the device supports Double Data Rate (DDR) mode.

  has-dqs-clock:
    type: boolean
    description: |
      Set if the device supports internal DQS clock.

  has-dll:
    type: boolean
    description: |
      Set if the device supports DLL.

  has-dllcr-en:
    type: boolean
    description: |
      Set if the device supports DLL enable (bitfield DLLCR[DLLEN]).

  has-dllcr-loop-control:
    type: boolean
    description: |
      Set if the device supports DLL loop control configuration (bitfields
      DLLCR[DLL_REFCNTR] and DLLCR[DLLRES]).

  has-dllcr-slave-auto-updt:
    type: boolean
    description: |
      Set if the device supports DLL slave chain auto-update
      (bitfield DLLCR[SLAVE_AUTO_UPDT]).

  has-sfacr-cas:
    type: boolean
    description: |
      Set if the device supports column address space (bitfield SFACR[CAS]).

  has-sfacr-byte-swap:
    type: boolean
    description: |
      Set if the device supports byte swapping (bitfield SFACR[BYTE_SWAP]).

  has-rbct-rxbrd:
    type: boolean
    description: |
      Set if the device supports receive buffer readout (bitfield RBCT[RXBRD]).

  has-sptrclr-abrt-clr:
    type: boolean
    description: |
      Set if the device supports flash memory abort/AHB buffer clear
      (bifield SPTRCLR[ABRT_CLR]).

  has-mcr-isd:
    type: boolean
    description: |
      Set if the device supports configuration if idle lines (bitfield MCR[ISDx]).

child-binding:
  description: NXP S32 QuadSPI memory device

  include: nxp,s32-qspi-device.yaml
```
