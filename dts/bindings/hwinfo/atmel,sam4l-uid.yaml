## dts/bindings/hwinfo/atmel,sam4l-uid.yaml
```yaml
# Copyright (c) 2020 Gerson Fernando Budke <nandojve@gmail.com>
# SPDX-License-Identifier: Apache-2.0

description: ATMEL SAM4L Unique 120-bit Serial Number

compatible: "atmel,sam4l-uid"

include: base.yaml

properties:
    reg:
        required: true
```

## dts/bindings/hwinfo/cypress,psoc6-uid.yaml
```yaml
# Copyright (c) 2020 ATL Electronics
# SPDX-License-Identifier: Apache-2.0

description: Cypress PSoC-6 Unique 88-bit Serial Number

compatible: "cypress,psoc6-uid"

include: base.yaml

properties:
    reg:
        required: true
```

## dts/bindings/hwinfo/litex,dna0.yaml
```yaml
# Copyright (c)  2019 Antmicro <www.antmicro.com>
# SPDX-License-Identifier: Apache-2.0

description: LiteX DNA ID reader

compatible: "litex,dna0"

include: base.yaml

properties:
    reg:
        required: true
```

## dts/bindings/hwinfo/microchip,hwinfo-g1.yaml
```yaml
# Copyright (c) 2025 Microchip Technology Inc.
# SPDX-License-Identifier: Apache-2.0

title: Microchip G1 hwinfo driver

description: |
  Microchip Hardware information driver bindings.

compatible: "microchip,hwinfo-g1"

include: base.yaml

properties:
  reg:
    required: true
```

## dts/bindings/hwinfo/microchip,pic32cxsg-rstc.yaml
```yaml
# Copyright (c) 2024 Microchip
# SPDX-License-Identifier: Apache-2.0

description: Microchip PIC32CXSG Reset controller

compatible: "microchip,pic32cxsg-rstc"

include: base.yaml

properties:
  reg:
    required: true

  clocks:
    required: true

  user-nrst:
    type: boolean
    description: Allow user reset on external NRST assert.
```

## dts/bindings/hwinfo/nxp,cmc-reset-cause.yaml
```yaml
# Copyright 2025 NXP
# SPDX-License-Identifier: Apache-2.0

description: CMC reset causes

compatible: "nxp,cmc-reset-cause"
```

## dts/bindings/hwinfo/nxp,imx-src-rev2.yaml
```yaml
# Copyright 2025 NXP
# SPDX-License-Identifier: Apache-2.0

description: NXP SRC REV2 get reset cause flags

compatible: "nxp,imx-src-rev2"

include: base.yaml

properties:
  reg:
    required: true
```

## dts/bindings/hwinfo/nxp,lpc-uid.yaml
```yaml
# Copyright (c) 2021 NXP
# SPDX-License-Identifier: Apache-2.0

description: NXP LPC 128-bit Unique identifier

compatible: "nxp,lpc-uid"

include: base.yaml

properties:
    reg:
        required: true
```

## dts/bindings/hwinfo/nxp,mc-rgm.yaml
```yaml
# Copyright 2026 NXP
# SPDX-License-Identifier: Apache-2.0

description: |
  NXP MC_RGM (Reset Generation Module).

  Found on NXP MCUs with the MC_RGM module (e.g. the MCXE family). The
  hwinfo reset-cause backend uses this node to decode the MC_RGM DES
  (Destructive Event Status) and FES (Functional/External Reset Status)
  registers.

compatible: "nxp,mc-rgm"

include: base.yaml

properties:
  reg:
    required: true
```

## dts/bindings/hwinfo/nxp,otp-uid.yaml
```yaml
# Copyright 2026 NXP
# SPDX-License-Identifier: Apache-2.0

description: |
  NXP OTP unique chip identifier (UID).

  Describes the read-only unique chip identifier that some NXP MCUs store in a
  one-time-programmable (OTP) flash memory area. The hwinfo device-id backend
  reads the identifier directly from the address given by reg. The identifier is
  programmed by NXP during manufacturing and can be read by any core.

compatible: "nxp,otp-uid"

include: base.yaml

properties:
  reg:
    required: true
```

## dts/bindings/hwinfo/nxp,rcm-hwinfo.yaml
```yaml
# Copyright 2026 NXP
# SPDX-License-Identifier: Apache-2.0

description: NXP RCM get reset cause flags

compatible: "nxp,rcm-hwinfo"

include: base.yaml

properties:
  reg:
    required: true
```

## dts/bindings/hwinfo/nxp,rstctl-hwinfo.yaml
```yaml
# Copyright 2025 NXP
# SPDX-License-Identifier: Apache-2.0

description: NXP RSTCTL get reset cause flags

compatible: "nxp,rstctl-hwinfo"

include: base.yaml

properties:
  reg:
    required: true
```

## dts/bindings/hwinfo/nxp,sim-uuid.yaml
```yaml
# Copyright 2026 NXP
# SPDX-License-Identifier: Apache-2.0

description: NXP SIM 128-bit Unique identifier

compatible: "nxp,sim-uuid"

include: base.yaml

properties:
  reg:
    required: true
```

## dts/bindings/hwspinlock/hwspinlock-controller.yaml
```yaml
# Copyright (c) 2025 Sequans Communications
# SPDX-License-Identifier: Apache-2.0

description: Common fields for HW spinlock controllers

properties:
  "#hwlock-cells":
    type: int
    required: true
    description: Number of items to expect in a HW spinlock specifier
```

## dts/bindings/hwspinlock/nxp,sema42.yaml
```yaml
# Copyright 2025 NXP
# SPDX-License-Identifier: Apache-2.0

description: |
  NXP SEMA42 hardware semaphore controller.

compatible: "nxp,sema42"

include:
  - name: base.yaml
  - name: hwspinlock-controller.yaml

properties:
  reg:
    required: true

  clocks:
    type: phandle-array
    description: |
      Clock controller specifier for the SEMA42 peripheral clock gate.

  domain-id:
    type: int
    required: true
    description: |
      Domain ID used by this CPU/domain when locking/unlocking a SEMA42 gate.

  num-locks:
    type: int
    required: true
    description: |
      Number of available gates.

hwlock-cells:
  - id
```

## dts/bindings/hwspinlock/sqn,hwspinlock.yaml
```yaml
# Copyright (c) 2025 Sequans Communications
# SPDX-License-Identifier: Apache-2.0

description: SQN Hardware spinlocks

compatible: "sqn,hwspinlock"

include: [base.yaml, hwspinlock-controller.yaml]

properties:
  reg:
    required: true

  num-locks:
    type: int
    required: true

  reg-width:
    type: int
    enum:
      - 1
      - 2
      - 4
    required: true
    description: |
      Register width for a single spinlock in bytes.
      Depending on the platform, the register used to write the cluster identifier
      may vary in size.
        - 1: cluster id register fit in a single byte
        - 2: cluster id register span across 2 bytes
        - 4: cluster id register span across 4 bytes

hwlock-cells:
  - id
```

## dts/bindings/hwtrig/st,stm32-timer-trigger.yaml
```yaml
# SPDX-License-Identifier: Apache-2.0

description: STM32 TIMER TRIGGER

compatible: "st,stm32-timer-trigger"

include: [base.yaml]

properties:
    label:
      required: true

    st,prescaler:
      type: int
      required: true
      description: Clock prescaler at the input of the timer
```

## dts/bindings/i2c/adi,max32-i2c.yaml
```yaml
# Copyright (c) 2024 Analog Devices, Inc.
# SPDX-License-Identifier: Apache-2.0

description: ADI MAX32 I2C

compatible: "adi,max32-i2c"

include: [i2c-controller.yaml, pinctrl-device.yaml]

properties:
  reg:
    required: true

  clocks:
    required: true

  interrupts:
    required: true
```

## dts/bindings/i2c/ambiq,i2c.yaml
```yaml
# Copyright (c) 2023 Antmicro <www.antmicro.com>
# SPDX-License-Identifier: Apache-2.0

description: Ambiq I2C

compatible: "ambiq,i2c"

include: [i2c-controller.yaml, pinctrl-device.yaml]

properties:
  scl-gpios:
    type: phandle-array
    description: |
      GPIO to which the I2C SCL signal is routed. This is only needed for I2C bus recovery
      support.

  sda-gpios:
    type: phandle-array
    description: |
      GPIO to which the I2C SDA signal is routed. This is only needed for I2C bus recovery
      support.
```

## dts/bindings/i2c/ambiq,ios-i2c.yaml
```yaml
# Copyright (c) 2025 Ambiq Micro Inc.
# SPDX-License-Identifier: Apache-2.0

description: Ambiq IOS I2C target (slave) peripheral

compatible: "ambiq,ios-i2c"

include: [i2c-controller.yaml, pinctrl-device.yaml]

properties:
  fifo-threshold:
    type: int
    default: 16
    description: |
        Set the FIFO threshold to the middle by default

  fifo-base:
    type: int
    default: 32
    description: |
        Set the FIFO base address in LRAM (default 0x20 = 32).
```

## dts/bindings/i2c/andestech,atciic100.yaml
```yaml
#
# Copyright (c) 2022, Andes Technology Corporation.
#
# SPDX-License-Identifier: Apache-2.0
#

description: AndesTech ATCIIC100 I2C

compatible: "andestech,atciic100"

include: i2c-controller.yaml

properties:
  reg:
    required: true

  interrupts:
    required: true
```

## dts/bindings/i2c/arm,versatile-i2c.yaml
```yaml
# Copyright (c) 2018, Linaro Limited
# Copyright 2025 Arm Limited and/or its affiliates <open-source-office@arm.com>
# SPDX-License-Identifier: Apache-2.0

description: ARM SBCon two-wire serial bus interface

compatible: "arm,versatile-i2c"

include: [i2c-controller.yaml, pinctrl-device.yaml]

properties:
  reg:
    required: true
```

## dts/bindings/i2c/asmedia,asm2364.yaml
```yaml
# Copyright (c) 2020 Seagate Technology LLC
# SPDX-License-Identifier: Apache-2.0

description: ASMedia ASM2364 USB-to-PCIe bridge controller

compatible: "asmedia,asm2364"

include: base.yaml

on-bus: i2c

properties:
  int-gpios:
    type: phandle-array
    required: true
    description: Interrupt GPIO for read requests
```

## dts/bindings/i2c/atmel,sam-i2c-twi.yaml
```yaml
# Copyright (c) 2017 Piotr Mienkowski
# SPDX-License-Identifier: Apache-2.0

description: Atmel SAM Family I2C (TWI) node

compatible: "atmel,sam-i2c-twi"

include:
  - name: i2c-controller.yaml
  - name: pinctrl-device.yaml

properties:
  reg:
    required: true

  interrupts:
    required: true

  clocks:
    required: true
```

## dts/bindings/i2c/atmel,sam-i2c-twihs.yaml
```yaml
# Copyright (c) 2017 Piotr Mienkowski
# SPDX-License-Identifier: Apache-2.0

description: Atmel SAM Family I2C (TWIHS)

compatible: "atmel,sam-i2c-twihs"

include:
  - name: i2c-controller.yaml
  - name: pinctrl-device.yaml

properties:
  reg:
    required: true

  interrupts:
    required: true

  clocks:
    required: true
```
