## dts/bindings/ieee802154/bflb,ieee802154.yaml
```yaml
# Copyright The Zephyr Project Contributors
# SPDX-License-Identifier: Apache-2.0

description: Bouffalo Lab IEEE 802.15.4 node

compatible: "bflb,ieee802154"

include: base.yaml

properties:
  interrupts:
    required: true
    description: |
      IEEE 802.15.4 MAC interrupts.
      Three entries required: "m154" (MAC), "m154-req-ack" (ACK request)
      and "m154-aes" (AES engine).

  interrupt-names:
    required: true

  pwr-table-zigbee:
    type: int
    description: Zigbee TX power target in dBm (0-15 dBm range).

  pwr-offset-bz:
    type: array
    description: |
      Per-channel BLE/Zigbee TX power offset.
      Encoding: 16 = 0 dBm, step 0.25 dBm.
      5 entries.
```

## dts/bindings/ieee802154/decawave,dw1000.yaml
```yaml
# Copyright (c) 2019, Phytec Messtechnik GmbH
# SPDX-License-Identifier: Apache-2.0

description: Decawave DW1000 802.15.4 UWB transceiver

compatible: "decawave,dw1000"

include: spi-device.yaml

properties:
    int-gpios:
      type: phandle-array
      required: true
      description: Interrupt pin.

        The interrupt pin IRQ of DW1000 is active high output.
        If connected directly the MCU pin should be configured
        as active high.

    reset-gpios:
      type: phandle-array
      required: true
      description: RESET pin.

        The RESET pin of DW1000 is active low.
        If connected directly the MCU pin should be configured
        as active low.

    tx-ant-delay:
      type: int
      required: false
      description: Transmitter antenna delay.

    rx-ant-delay:
      type: int
      required: false
      description: Receiver antenna delay.
```

## dts/bindings/ieee802154/espressif,esp32-ieee802154.yaml
```yaml
# Copyright (c) 2024 A Labs GmbH
# SPDX-License-Identifier: Apache-2.0

description: Espressif ESP32 IEEE 802.15.4 node

compatible: "espressif,esp32-ieee802154"

include: base.yaml
```

## dts/bindings/ieee802154/nordic,nrf-ieee802154.yaml
```yaml
# Copyright (c) 2022 Nordic Semiconductor ASA
# SPDX-License-Identifier: Apache-2.0

description: Nordic nRF IEEE 802.15.4 node

compatible: "nordic,nrf-ieee802154"

include: base.yaml
```

## dts/bindings/ieee802154/nxp,kw41z-ieee802154.yaml
```yaml
# Copyright (c) 2022 Nordic Semiconductor ASA
# SPDX-License-Identifier: Apache-2.0

description: NXP KW41Z IEEE 802.15.4 node

compatible: "nxp,kw41z-ieee802154"

include: base.yaml

properties:
  reg:
    required: true
```

## dts/bindings/ieee802154/nxp,mcr20a.yaml
```yaml
# Copyright (c) 2018, NXP
# SPDX-License-Identifier: Apache-2.0

description: NXP MCR20A 802.15.4 wireless transceiver

compatible: "nxp,mcr20a"

include: spi-device.yaml

properties:
  irqb-gpios:
    type: phandle-array
    required: true
    description: Interrupt pin.

      The interrupt pin of MCR20A is open-drain, active low.
      If connected directly the MCU pin should be configured
      as pull-up, active low.

  reset-gpios:
    type: phandle-array
    required: true
    description: RESET pin.

      The RESET pin of MCR20A is active low.
      If connected directly the MCU pin should be configured
      as active low.
```

## dts/bindings/ieee802154/nxp,mcxw-ieee802154.yaml
```yaml
# Copyright (c) 2025, NXP
# SPDX-License-Identifier: Apache-2.0

description: NXP MCXW71 IEEE 802.15.4 node

compatible: "nxp,mcxw-ieee802154"

include: base.yaml

properties:
  counter:
    type: phandle
    description: Dedicated counter device used as the radio timestamp source.
```

## dts/bindings/ieee802154/nxp,mcxw71-ieee802154.yaml
```yaml
# Copyright (c) 2022 Nordic Semiconductor ASA
# SPDX-License-Identifier: Apache-2.0

description: NXP MCXW71 IEEE 802.15.4 node

compatible: "nxp,mcxw-ieee802154"

include: base.yaml
```

## dts/bindings/ieee802154/qorvo,dw3001c.yaml
```yaml
# Copyright (c) 2023, Sahas Chitlange, Zephyr Project
# SPDX-License-Identifier: Apache-2.0

description: Qorvo DW3001C 802.15.4 UWB transceiver

compatible: "qorvo,dw3001c"

include: spi-device.yaml

properties:
  int-gpios:
    type: phandle-array
    required: true
    description: Interrupt pin.

      The interrupt pin IRQ of DW3001C is active high output.
      If connected directly the MCU pin should be configured
      as active high.

  reset-gpios:
    type: phandle-array
    required: true
    description: RESET pin.

      The RESET pin of DW3001C is active low.
      If connected directly the MCU pin should be configured
      as active low.

  # TODO The antenna tx/rx properties should be moved to the qorvo ieee802154 driver in the future where they belong.
  tx-ant-delay:
    type: int
    description: Transmitter antenna delay.

  rx-ant-delay:
    type: int
    description: Receiver antenna delay.
```

## dts/bindings/ieee802154/silabs,efr32-ieee802154.yaml
```yaml
# SPDX-FileCopyrightText: Copyright (c) 2026 Silicon Laboratories Inc.
# SPDX-License-Identifier: Apache-2.0

description: Silicon Labs EFR32 IEEE 802.15.4 radio

compatible: "silabs,efr32-ieee802154"

include: base.yaml

properties:
  hfxo:
    type: phandle
    description: |
      Optional phandle to the HFXO (high-frequency crystal oscillator) node.
      The driver reads the referenced node's "precision" property (ppm) and
      always includes it in get_sch_acc, because the radio's awake-time
      timing reference (RAIL/protimer) is derived from the HFXO.

      When omitted, get_sch_acc uses a 250 ppm fallback for the HFXO term.

      Boards typically set this in the same dtsi where they configure
      &hfxo, e.g. hfxo = <&hfxo>;.

  sleep-clock:
    type: phandle
    description: |
      Optional phandle to the low-frequency oscillator that keeps time
      while the SoC is sleeping (typically &lfxo). The referenced node
      must have a "precision" property (ppm). When
      CONFIG_OPENTHREAD_MTD_SED is enabled, the driver adds this value
      to the scheduling accuracy to account for sleep-clock drift.

      When omitted, 0 ppm is assumed for the sleep-clock term.
```

## dts/bindings/ieee802154/st,s2lp.yaml
```yaml
# Copyright (c) 2021 Nikos Oikonomou <nikoikonomou92@gmail.com>
# SPDX-License-Identifier: Apache-2.0

description: ST S2LP 802.15.4 Wireless Transceiver.

compatible: "st,s2lp"

include: spi-device.yaml

properties:
    sdn-gpios:
      type: phandle-array
      required: true
      description: Shutdown pin.

        The shutdown pin of the S2LP is active low.
        If connected directly the MCU pin should be configured
        as active low.

    rx-rdy-irq-gpios:
      type: phandle-array
      required: true
      description: RX RDY Interrupt pin.

        The interrupt pin of the S2LP is open-drain, active low.
        If connected directly the MCU pin should be configured
        as pull-up, active low.
```

## dts/bindings/ieee802154/st,stm32wba-ieee802154.yaml
```yaml
# Copyright (c) 2025 STMicroelectronics
# SPDX-License-Identifier: Apache-2.0

description: ST STM32WBA IEEE 802.15.4

compatible: "st,stm32wba-ieee802154"

include: base.yaml
```

## dts/bindings/ieee802154/telink,b91-zb.yaml
```yaml
# Copyright (c) 2021, Telink Semiconductor
# SPDX-License-Identifier: Apache-2.0

description: Telink B91 IEEE802154 node

compatible: "telink,b91-zb"

include: base.yaml

properties:
  reg:
    required: true

  interrupts:
    required: true
```

## dts/bindings/ieee802154/telink,b9x-zb.yaml
```yaml
# Copyright (c) 2021-2024, Telink Semiconductor
# SPDX-License-Identifier: Apache-2.0

description: Telink B9x IEEE802154 node

compatible: "telink,b9x-zb"

include: base.yaml

properties:
  reg:
    required: true

  interrupts:
    required: true
```

## dts/bindings/ieee802154/telink,tlx-zb.yaml
```yaml
# Copyright (c) 2021, Telink Semiconductor
# SPDX-License-Identifier: Apache-2.0

description: Telink TLx IEEE802154 node

compatible: "telink,tlx-zb"

include: base.yaml

properties:
  reg:
    required: true

  interrupts:
    required: true
```

## dts/bindings/ieee802154/telink,w91-zb.yaml
```yaml
# Copyright (c) 2025, Telink Semiconductor
# SPDX-License-Identifier: Apache-2.0

description: Telink W91 IEEE802154 node

compatible: "telink,w91-zb"

include: base.yaml

properties:
  serial:
    type: phandle
    required: true
    description: serial port for RCP connection
```

## dts/bindings/ieee802154/ti,cc1200.yaml
```yaml
# Copyright (c) 2018, Linaro Limited
# SPDX-License-Identifier: Apache-2.0

description: Texas Instruments CC1200 802.15.4 wireless transceiver

compatible: "ti,cc1200"

include: spi-device.yaml

properties:
    int-gpios:
      type: phandle-array
      required: true
```

## dts/bindings/ieee802154/ti,cc13xx-cc26xx-ieee802154-subghz.yaml
```yaml
# Copyright (c) 2022 Nordic Semiconductor ASA
# SPDX-License-Identifier: Apache-2.0

description: TI SimpleLink CC13xx / CC26xx IEEE 802.15.4 node (sub-GHz)

compatible: "ti,cc13xx-cc26xx-ieee802154-subghz"

include: base.yaml
```

## dts/bindings/ieee802154/ti,cc13xx-cc26xx-ieee802154.yaml
```yaml
# Copyright (c) 2022 Nordic Semiconductor ASA
# SPDX-License-Identifier: Apache-2.0

description: TI SimpleLink CC13xx / CC26xx IEEE 802.15.4 node

compatible: "ti,cc13xx-cc26xx-ieee802154"

include: base.yaml
```

## dts/bindings/ieee802154/ti,cc2520.yaml
```yaml
# Copyright (c) 2018, Intel Corporation
# SPDX-License-Identifier: Apache-2.0

description: Texas Instruments CC2520 802.15.4 wireless transceiver

compatible: "ti,cc2520"

include: spi-device.yaml

properties:
    vreg-en-gpios:
      type: phandle-array
      required: true

    reset-gpios:
      type: phandle-array
      required: true

    fifo-gpios:
      type: phandle-array
      required: true

    cca-gpios:
      type: phandle-array
      required: true

    sfd-gpios:
      type: phandle-array
      required: true

    fifop-gpios:
      type: phandle-array
      required: true
```

## dts/bindings/ieee802154/zephyr,ieee802154-uart-pipe.yaml
```yaml
# Copyright (c) 2022 Nordic Semiconductor ASA
# SPDX-License-Identifier: Apache-2.0

description: UART PIPE fake radio device (used in QEMU)

compatible: "zephyr,ieee802154-uart-pipe"

include: base.yaml
```

## dts/bindings/iio/adc/adc-controller.yaml
```yaml
# Copyright (c) 2017, NXP
# SPDX-License-Identifier: Apache-2.0

# Common fields for ADC controllers

properties:
    label:
      required: true

    "#io-channel-cells":
      type: int
      required: true
```

## dts/bindings/iio/adc/adc.yaml
```yaml
#
# Copyright (c) 2017, NXP
#
# SPDX-License-Identifier: Apache-2.0
#

# Common fields for ADC devices

inherits:
    !include base.yaml

properties:
    label:
      category: required
```

## dts/bindings/iio/adc/arduino,uno-adc.yaml
```yaml
# Copyright (C) 2019 Peter Bigot Consulting, LLC
# SPDX-License-Identifier: Apache-2.0

description: |
    ADC channels exposed on Arduino Uno (R3) headers.

    The Arduino Uno layout provides a 6-pin Analog Input header.  This
    has analog input signals labeled from A0 at the top through A5 at
    the bottom.

    This binding provides a nexus mapping for these pins where parent
    pins 0 through 5 correspond to A0 through A5.

compatible: "arduino,uno-adc"

include: base.yaml

properties:
    io-channel-map:
      type: compound
      required: true

    io-channel-map-mask:
      type: compound
      required: false

    io-channel-map-pass-thru:
      type: compound
      required: false

    "#io-channel-cells":
      type: int
      required: true
      description: Number of items to expect in an ADC specifier
```

## dts/bindings/iio/adc/atmel,sam-afec.yaml
```yaml
description: Atmel SAM family AFEC

compatible: "atmel,sam-afec"

include: adc-controller.yaml

properties:
    reg:
      required: true

    interrupts:
      required: true

    peripheral-id:
      type: int
      description: peripheral ID
      required: true

    "#io-channel-cells":
      const: 1

io-channel-cells:
    - input
```
