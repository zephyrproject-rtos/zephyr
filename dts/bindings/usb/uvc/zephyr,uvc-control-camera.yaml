## dts/bindings/usb/zephyr,hid-device.yaml
```yaml
# Copyright (c) 2023 Nordic Semiconductor ASA
# SPDX-License-Identifier: Apache-2.0

description: Bindings for HID device

compatible: "zephyr,hid-device"

include: base.yaml

properties:
  interface-name:
    type: string
    description: |
      HID device name. When this property is present, a USB device will use it
      as the string descriptor of the interface.

  protocol-code:
    type: string
    description: |
      This property corresponds to the protocol codes defined in Chapter 4.3
      of the HID specification. Only boot devices are required to set one of
      the protocols, keyboard or mouse. For non-boot devices, this property is
      not required or can be set to none.
      - none:     Device does not support the boot interface
      - keyboard: Device supports boot interface and keyboard protocol
      - mouse:    Device supports boot interface and mouse protocol
    enum:
      - none
      - keyboard
      - mouse

  in-report-size:
    type: int
    required: true
    description: |
      The size of the longest input report that the HID device can generate.
      This property is used to determine the buffer length used for transfers.

  in-polling-period-us:
    type: int
    required: true
    description: |
      Input or output type reports polling period in microseconds. For USB full
      speed this could be clamped to 1ms or 255ms depending on the value.

  out-report-size:
    type: int
    description: |
      The size of the longest output report that the HID device can generate.
      When this property is present, a USB device will use out pipe for output
      reports, otherwise control pipe will be used for output reports.

  out-polling-period-us:
    type: int
    description: |
      Output type reports polling period in microseconds. For USB full
      speed this could be clamped to 1ms or 255ms depending on the value.
      This option is only effective if the out-report-size property is defined.
```

## dts/bindings/usb/zephyr,midi2-device.yaml
```yaml
# Copyright (c) 2024 Titouan Christophe
# SPDX-License-Identifier: Apache-2.0

description: MIDI2 device

compatible: "zephyr,midi2-device"

properties:
  "#address-cells":
    type: int
    const: 1

  "#size-cells":
    type: int
    const: 1

  label:
    type: string
    description: Name of the UMP (MIDI 2.0) endpoint

child-binding:
  description: |
    MIDI2 Group terminal block.
    This represent a set of contiguous MIDI2 groups through which the
    device exchange Universal MIDI Packets with the host.

  properties:
    label:
      type: string
      description: Name of the corresponding UMP Function block

    reg:
      type: array
      required: true
      description: |
        First MIDI2 Group number (address) and number of Group Terminals (size)
        in this MIDI2 Group Terminal Block.
        The MIDI2 Groups 1 to 16 corresponds to address 0x0 to 0xf. There are
        at most 16 addressable groups (of 16 chans each) per MIDI2 interface.

    protocol:
      type: string
      enum:
      - "use-midi-ci"
      - "midi1-up-to-64b"
      - "midi1-up-to-128b"
      - "midi2"
      description: |
        Default MIDI protocol of the Group Terminals in this Block.

    terminal-type:
      type: string
      default: "bidirectional"
      enum:
      - "bidirectional"
      - "input-only"
      - "output-only"
      description: |
        Type (data direction) of Group Terminals in this Block.

    serial-31250bps:
      type: boolean
      description: |
        This represent a physical MIDI1 serial port, which is limited
        to a transmission speed of 31.25kb/s.
```

## dts/bindings/usb/zephyr,native-posix-udc.yaml
```yaml
# Copyright (c) 2021 Nordic Semiconductor ASA
# SPDX-License-Identifier: Apache-2.0

description: Native POSIX USB device controller

compatible: "zephyr,native-posix-udc"

include: usb-controller.yaml
```

## dts/bindings/usb/zephyr,udc-skeleton.yaml
```yaml
# Copyright (c) 2023 Nordic Semiconductor ASA
# SPDX-License-Identifier: Apache-2.0

description: Skeleton for USB device controller driver

compatible: "zephyr,udc-skeleton"

include: usb-ep.yaml
```

## dts/bindings/usb/zephyr,udc-virtual.yaml
```yaml
# Copyright (c) 2022 Nordic Semiconductor ASA
# SPDX-License-Identifier: Apache-2.0

description: Virtual USB device controller

compatible: "zephyr,udc-virtual"

include: usb-ep.yaml
```
