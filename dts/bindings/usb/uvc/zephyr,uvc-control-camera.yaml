## dts/bindings/usb/uvc/zephyr,uvc-control-camera.yaml
```yaml
# Copyright (c) 2024 tinyVision.ai Inc.
# SPDX-License-Identifier: Apache-2.0

description: UVC Input Terminal for controlling image sensors

compatible: "zephyr,uvc-control-camera"

include: "zephyr,uvc-control.yaml"
```

## dts/bindings/usb/uvc/zephyr,uvc-control-ct.yaml
```yaml
# Copyright (c) 2024 tinyVision.ai Inc.
# SPDX-License-Identifier: Apache-2.0

description: UVC Input Terminal for controlling image sensors

compatible: "zephyr,uvc-control-ct"

include: "base.yaml"

properties:

  control-target:
    type: phandle
    description: |
      Video device that will receive the camera control requests from the host
      as set_ctrl() and get_ctrl() API calls.

  control-scanning-mode:
    type: boolean

  control-ae-mode:
    type: boolean

  control-ae-priority:
    type: boolean

  control-exposure-time-absolute:
    type: boolean
    description: |
      Enable controls for the camera exposure time.
      Sent to control-target as VIDEO_CID_CAMERA_EXPOSURE

  control-exposure-time-relative:
    type: boolean

  control-focus-absolute:
    type: boolean

  control-focus-relative:
    type: boolean

  control-focus-auto:
    type: boolean

  control-focus-simple:
    type: boolean

  control-iris-absolute:
    type: boolean

  control-iris-relative:
    type: boolean

  control-zoom-absolute:
    type: boolean
    description: |
      Enable controls for the camera zoom, assuming a zoom motor present.
      Sent to control-target as VIDEO_CID_CAMERA_ZOOM

  control-zoom-relative:
    type: boolean

  control-pantilt-absolute:
    type: boolean

  control-pantilt-relative:
    type: boolean

  control-roll-absolute:
    type: boolean

  control-roll-relative:
    type: boolean

  control-privacy:
    type: boolean

  control-window:
    type: boolean

  control-region-of-interest:
    type: boolean
```

## dts/bindings/usb/uvc/zephyr,uvc-control-encoding.yaml
```yaml
# Copyright (c) 2024 tinyVision.ai Inc.
# SPDX-License-Identifier: Apache-2.0

description: UVC Encoding Unit controls for the compression engine

compatible: "zephyr,uvc-control-encoding"

include: "zephyr,uvc-control.yaml"

properties:

  source-entity:
    type: phandle
    required: true
    description: |
      Entity connected as input to the Encoder.
```

## dts/bindings/usb/uvc/zephyr,uvc-control-eu.yaml
```yaml
# Copyright (c) 2024 tinyVision.ai Inc.
# SPDX-License-Identifier: Apache-2.0

description: UVC Encoding Unit controls for the compression engine

compatible: "zephyr,uvc-control-eu"

include: "zephyr,uvc-control.yaml"

properties:

  control-select-layer:
    type: boolean

  control-profile-toolset:
    type: boolean

  control-video-resolution:
    type: boolean

  control-min-frame-interval:
    type: boolean

  control-slice-mode:
    type: boolean

  control-rate-control-mode:
    type: boolean

  control-average-bitrate:
    type: boolean

  control-cpb-size:
    type: boolean

  control-peak-bit-rate:
    type: boolean

  control-quantization-params:
    type: boolean

  control-sync-ref-frame:
    type: boolean

  control-ltr-buffer:
    type: boolean

  control-ltr-picture:
    type: boolean

  control-ltr-validation:
    type: boolean

  control-level-idc-limit:
    type: boolean

  control-sei-payloadtype:
    type: boolean

  control-qp-range:
    type: boolean

  control-priority:
    type: boolean

  control-start-or-stop-layer:
    type: boolean

  control-error-resiliency:
    type: boolean
```

## dts/bindings/usb/uvc/zephyr,uvc-control-extension.yaml
```yaml
# Copyright (c) 2024 tinyVision.ai Inc.
# SPDX-License-Identifier: Apache-2.0

description: UVC Extension Unit for custom vendor-specific controls

compatible: "zephyr,uvc-control-extension"

include: "zephyr,uvc-control.yaml"

properties:

  source-entities:
    type: phandle-array
    required: true
    description: |
      Entities connected as input to the Extension Unit.
      The relation between controls and the source(s) is implementation-specific.
```

## dts/bindings/usb/uvc/zephyr,uvc-control-input.yaml
```yaml
# Copyright (c) 2024 tinyVision.ai Inc.
# SPDX-License-Identifier: Apache-2.0

description: UVC Input Terminal controls for a custom video input

compatible: "zephyr,uvc-control-input"
```

## dts/bindings/usb/uvc/zephyr,uvc-control-ot.yaml
```yaml
# Copyright (c) 2024 tinyVision.ai Inc.
# SPDX-License-Identifier: Apache-2.0

description: UVC Output Terminal representing the data going out of the device.

compatible: "zephyr,uvc-control-ot"

include: "zephyr,uvc-control.yaml"
```

## dts/bindings/usb/uvc/zephyr,uvc-control-output.yaml
```yaml
# Copyright (c) 2024 tinyVision.ai Inc.
# SPDX-License-Identifier: Apache-2.0

description: UVC Output Terminal representing the data going out of the device.

compatible: "zephyr,uvc-control-output"

include: base.yaml

properties:

  control-target:
    type: phandle
    description: |
      Device that will receive the start/stop signals from the host, and
      receives the format negotiated from the host.

  source-entity:
    type: phandle
    required: true
    description: |
      Last entity of the chain before the output of the device.
```

## dts/bindings/usb/uvc/zephyr,uvc-control-processing.yaml
```yaml
# Copyright (c) 2024 tinyVision.ai Inc.
# SPDX-License-Identifier: Apache-2.0

description: UVC Processing Unit controls for the Image Signal Processor (ISP)

compatible: "zephyr,uvc-control-processing"

include: "zephyr,uvc-control.yaml"

properties:

  source-entity:
    type: phandle
    required: true
    description: |
      Entity connected as input to the ISP.
```

## dts/bindings/usb/uvc/zephyr,uvc-control-pu.yaml
```yaml
# Copyright (c) 2024 tinyVision.ai Inc.
# SPDX-License-Identifier: Apache-2.0

description: UVC Processing Unit controls for the Image Signal Processor (ISP)

compatible: "zephyr,uvc-control-pu"

include: "zephyr,uvc-control.yaml"

properties:

  control-backlight-compensation:
    type: boolean

  control-brightness:
    type: boolean
    description: |
      Enable controls for image brightness level tuning.
      Sent to control-target as VIDEO_CID_CAMERA_BRIGHTNESS

  control-contrast:
    type: boolean
    description: |
      Enable controls for image contrast tuning.
      Sent to control-target as VIDEO_CID_CAMERA_CONTRAST

  control-gain:
    type: boolean
    description: |
      Enable controls for overall gain tuning, combined digital and analog.
      Sent to control-target as VIDEO_CID_CAMERA_GAIN

  control-power-line-frequency:
    type: boolean

  control-hue:
    type: boolean

  control-saturation:
    type: boolean
    description: |
      Enable controls for the image color saturation tuning.
      Sent to control-target as VIDEO_CID_CAMERA_SATURATION

  control-sharpness:
    type: boolean

  control-gamma:
    type: boolean

  control-white-balance-temperature:
    type: boolean
    description: |
      Enable controls for .
      Sent to control-target as VIDEO_CID_CAMERA_WHITE_BAL

  control-white-balance-component:
    type: boolean

  control-digital-multiplier:
    type: boolean

  control-digital-multiplier-limit:
    type: boolean

  control-analog-video-standard:
    type: boolean

  control-analog-lock-status:
    type: boolean
```

## dts/bindings/usb/uvc/zephyr,uvc-control-selector.yaml
```yaml
# Copyright (c) 2024 tinyVision.ai Inc.
# SPDX-License-Identifier: Apache-2.0

description: UVC Selector Unit controls for choosing one of several sources

compatible: "zephyr,uvc-control-selector"

include: "base.yaml"

properties:

  control-target:
    type: phandle
    required: true
    description: |
      Reference to a video device which controls the source selection.

  source-entities:
    type: phandle-array
    required: true
    description: |
      Entities connected as input to the Selector Unit.
      The target video device will receive the host's source switch requests.
```

## dts/bindings/usb/uvc/zephyr,uvc-control-su.yaml
```yaml
# Copyright (c) 2024 tinyVision.ai Inc.
# SPDX-License-Identifier: Apache-2.0

description: UVC Selector Unit controls for choosing one of several sources

compatible: "zephyr,uvc-control-su"

include: "zephyr,uvc-control.yaml"
```

## dts/bindings/usb/uvc/zephyr,uvc-control-xu.yaml
```yaml
# Copyright (c) 2024 tinyVision.ai Inc.
# SPDX-License-Identifier: Apache-2.0

description: |
  UVC Extension Unit for custom vendor-specific controls

  Extension units can have any number of input pins specified by
  "source-entity", and the control-target device is going to receive
  controls IDs such as VIDEO_CTRL_CLASS_VENDOR + N where N is the
  UVC control selector number.

compatible: "zephyr,uvc-control-xu"

include: "zephyr,uvc-control.yaml"

properties:

  control-num:
    type: int
    required: true
    description: |
      Number of controls enabled, with control codes 0x00, 0x01, 0x02, 0x03...

  guid:
    type: uint8-array
    required: true
    description: |
      GUID that identifies the control block and let the host know what
      kind of extension this is about.
```

## dts/bindings/usb/uvc/zephyr,uvc-control.yaml
```yaml
# Copyright (c) 2024 tinyVision.ai Inc.
# SPDX-License-Identifier: Apache-2.0

# USB Video Class control common properties.

include: base.yaml

properties:

  control-target:
    type: phandle
    description: |
      Reference to a video device which these controls affect.

  source-entity:
    type: phandle
    required: true
    description: |
      Points to the entity that controls the data source to the current control.
```

## dts/bindings/usb/uvc/zephyr,uvc-format-mjpeg.yaml
```yaml
# Copyright (c) 2024 tinyVision.ai Inc.
# SPDX-License-Identifier: Apache-2.0

description: |
  USB Video Class list of supported Motion JPEG (MJPEG) formats.

include: zephyr,uvc-format.yaml

compatible: "zephyr,uvc-format-mjpeg"
```

## dts/bindings/usb/uvc/zephyr,uvc-format-uncompressed.yaml
```yaml
# Copyright (c) 2024 tinyVision.ai Inc.
# SPDX-License-Identifier: Apache-2.0

description: |
  USB Video Class list of supported uncompressed frame formats.

compatible: "zephyr,uvc-format-uncompressed"

include: zephyr,uvc-format.yaml

properties:

  guid:
    type: uint8-array
    description: |
      A GUID identifier that identifies the frame format. A list of GUIDs can
      be found in "include/zephyr/dt-bindings/usb/video.h" already encoded.
    required: true

  bits-per-pixel:
    type: int
    description: |
      Number of bit for one pixel. This must match the pixel format specified
      by the GUID.
    required: true
```

## dts/bindings/usb/uvc/zephyr,uvc-format.yaml
```yaml
# Copyright (c) 2024 tinyVision.ai Inc.
# SPDX-License-Identifier: Apache-2.0

# USB Video Class format common properties.

include: base.yaml

properties:
  fourcc:
    type: string
    description: |
      The four-character string that uniquely identifies a pixel format.
      This must be matching the definition on "include/zephyr/drivers/video.h".
    required: true

child-binding:
  description: |
    Enumeration of all frame dimensions supported for this format.

  properties:

    size:
      type: array
      description: |
        Frame width and size in pixel, from which can be deduced the
        frame size since this is an uncompressed format.
      required: true

    max-fps:
      type: int
      description: |
        Maximum FPS that can be sustained by theh device for this frame format.
        The actual FPS might be lower if the host throttles the transfer, or if
        it desires to receive frames less fast.
      required: true
```

## dts/bindings/usb/uvc/zephyr,uvc.yaml
```yaml
# Copyright (c) 2024 tinyVision.ai Inc.
# SPDX-License-Identifier: Apache-2.0

description: |
  USB Video Class instance

  Child nodes of "zephyr,uvc" compatibles are supposed to be:
  - First, Video Control entities, with a compatible = "zephry,uvc-control-...";
  - Then, Video Streaming entities, with a compatible = "zephyr,uvc-format-...";

  The position of the Video Control entities determines their ID on the USB
  descriptors. The last UVC Control entity must be an Output Terminal with a
  compatible = "zephyr,uvc-control-ot";

  Example: USB UVC Control allowing tuning of the exposure at the image sensor
  level, and tuning of the gain with an Image Signal Processor (ISP) core.
  There are two format types, each declaring their own frame sizes.

  #include <zephyr/dt-bindings/usb/video.h>

  uvc0 {
    compatible = "zephyr,uvc";

    uvc0ct: camera_terminal {
      compatible = "zephyr,uvc-control-ct";
      control-ae-mode;
      control-exposure-time-absolute;
      control-target = <&imx219>;
    };

    uvc0pu: processing_unit {
      compatible = "zephyr,uvc-control-pu";
      control-gain;
      control-target = <&isp0>;
      source-entity = <&uvc0ct>;
    };

    uvc0ot: output_terminal {
      compatible = "zephyr,uvc-control-ot";
      control-target = <&uvcmanager>;
      source-entity = <&uvc0pu>;
    };

    format_uncompressed {
      compatible = "zephyr,uvc-format-uncompressed";
      fourcc = "YUYV";
      guid = [UVC_GUID_YUY2];
      bits-per-pixel = <16>;

      FHD {
        size = <1920 1080>;
        max-fps = <87>;
      };

      VGA {
        size = <640 480>;
        max-fps = <589>;
      };

      QVGA {
        size = <320 240>;
        max-fps = <2347>;
      };
    };

    format_mjpeg {
      compatible = "zephyr,uvc-format-mjpeg";
      fourcc = "JPEG";

      4K {
        size = <3840 2160>;
        max-fps = <22>;
      };

      FHD {
        size = <1920 1080>;
        max-fps = <87>;
      };
    };
  };

compatible: "zephyr,uvc"

on-bus: usb
```

## dts/bindings/usb/wch,usbfs.yaml
```yaml
# Copyright (c) 2023 Nordic Semiconductor ASA
# SPDX-License-Identifier: Apache-2.0

description: WCH USB device controller driver

compatible: "wch,usbfs"

include: usb-ep.yaml
```

## dts/bindings/usb/zephyr,cdc-ecm-host.yaml
```yaml
# Copyright (c) 2025 - 2026 NXP
# SPDX-License-Identifier: Apache-2.0

description: |
  USB CDC Ethernet Control Model (CDC-ECM) host instance.
  Each CDC-ECM instance added to the USB Host Controller (UHC) node
  will be visible as a new ethernet interface from Zephyr point of
  view.
  As soon as a ethernet interface is connected to USB this device will
  be usable by the application as a ethernet interface device,
  following the networking API.

compatible: "zephyr,cdc-ecm-host"

include: base.yaml
```
