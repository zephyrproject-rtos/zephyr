## dts/bindings/video/galaxycore,gc0308.yaml
```yaml
# SPDX-FileCopyrightText: Copyright The Zephyr Project Contributors
# SPDX-FileCopyrightText: Copyright (c) 2024 Felipe Neves
# SPDX-FileCopyrightText: Copyright (c) 2026 Victor Hogeweij
#
# SPDX-License-Identifier: Apache-2.0

description: Galaxy Core GC0308 CMOS video sensor

compatible: "galaxycore,gc0308"

include: i2c-device.yaml

properties:
  clock-frequency:
    type: int
    required: true
    description: |
      Frequency in Hz of the clock the board drives the sensor XCLK pin with.
      The sensor derives all of its timing from it, so the driver needs it to
      report and select frame intervals.
  pclk-drive-strength:
    type: int
    enum: [2, 4, 8, 10]
    description: |
      Drive strength in mA of the PCLK output pad. Left out, the sensor keeps
      the 2 mA the vendor register sequence selects. Raise it for a receiver
      that needs faster edges, at the cost of more radiated emissions.
  data-drive-strength:
    type: int
    enum: [4, 6, 10, 12]
    description: |
      Drive strength in mA of the pixel data output pads, 4 mA when left out.
      See pclk-drive-strength.
  sync-drive-strength:
    type: int
    enum: [4, 8, 12, 16]
    description: |
      Drive strength in mA of the HSYNC and VSYNC output pads, 4 mA when left
      out. See pclk-drive-strength.
  reset-gpios:
    type: phandle-array
    description: |
      The RESETn pin is asserted to disable the sensor causing a hard
      reset.  The sensor receives this as an active-low signal.
  pwdn-gpios:
    type: phandle-array
    description: |
      The PWDN pin is asserted to power down the sensor. The sensor
      receives this as an active high signal

child-binding:
  child-binding:
    include: video-interfaces.yaml
```

## dts/bindings/video/galaxycore,gc2145.yaml
```yaml
# Copyright (c) 2024 Felipe Neves
# SPDX-License-Identifier: Apache-2.0

description: |
  Galaxy Core GC2145 CMOS video sensor

  The frame interval is set by dividing the sensor clock, which divides the
  pixel clock by the same factor. On the parallel bus the receiver selects
  the fastest pixel clock it can sample as the link frequency. Both need the
  rate of the input clock, which is read from the clock controller referenced
  by clocks.

compatible: "galaxycore,gc2145"

include: i2c-device.yaml

properties:
  reset-gpios:
    type: phandle-array
    description: |
      The RESETn pin is asserted to disable the sensor causing a hard
      reset.  The sensor receives this as an active-low signal.
  pwdn-gpios:
    type: phandle-array
    description: |
      The PWDN pin is asserted to power down the sensor. The sensor
      receives this as an active high signal
  clocks:
    description: |
      Input clock of the sensor (MCLK). It is enabled before the sensor is
      probed, and its rate is read from the clock controller to compute the
      frame intervals.

child-binding:
  child-binding:
    include: video-interfaces.yaml
```

## dts/bindings/video/heimann,htpa-120x84-camera.yaml
```yaml
# Copyright (c) 2026 sensry.io
# SPDX-License-Identifier: Apache-2.0

compatible: "heimann,htpa-120x84-camera"

include:
  - name: heimann,htpa-common-camera.yaml
```

## dts/bindings/video/heimann,htpa-160x120-camera.yaml
```yaml
# Copyright (c) 2026 sensry.io
# SPDX-License-Identifier: Apache-2.0

compatible: "heimann,htpa-160x120-camera"

include:
  - name: heimann,htpa-common-camera.yaml
```

## dts/bindings/video/heimann,htpa-processor.yaml
```yaml
# SPDX-FileCopyrightText: Copyright The Zephyr Project Contributors
# SPDX-License-Identifier: Apache-2.0

description: |
  HTPA electrical offset correction and pixel ordering video device. The processor
  provides signed 16-bit samples and 8-bit grayscale output. Grayscale values are
  scaled per frame using histogram percentile clipping.

compatible: "heimann,htpa-processor"

include: base.yaml

properties:
  source:
    type: phandle
    required: true
    description: Video device providing HTPA raw frames
```

## dts/bindings/video/microchip,sama7g5-csi2dc.yaml
```yaml
# Copyright (C) 2025 Microchip Technology Inc. and its subsidiaries
#
# SPDX-License-Identifier: Apache-2.0
#

title: Microchip SAMA7G5 CSI-2 Demux Controller (CSI2DC)

description: |
  The CSI-2 Demux Controller receives the CSI-2 packet stream from the MIPI
  CSI-2 host controller on its IDI input and converts one virtual channel and
  data type into an unpacked parallel video stream for the Image Sensor
  Controller (ISC), through its internal video pipeline.

  The sink port (port@0) describes the link to the CSI-2 host controller, the
  source port (port@1) the parallel link to the ISC. Both are described by the
  SoC devicetree.

  Since the pipeline unpacks the CSI-2 payload, the format on the parallel side
  differs from the one on the CSI-2 side: a packed 10-bit Bayer stream such as
  SBGGR10P is presented to the ISC as one 10-bit sample per pixel (SBGGR10).

compatible: "microchip,sama7g5-csi2dc"

include: [base.yaml]

properties:
  reg:
    required: true

  clocks:
    required: true

  microchip,virtual-channel:
    type: int
    default: 0
    enum: [0, 1, 2, 3]
    description: |
      CSI-2 virtual channel identifier demultiplexed into the video pipeline.

  microchip,non-continuous-clock:
    type: boolean
    description: |
      Set when the image sensor stops its CSI-2 clock lane between transmissions.
      When absent, the clock lane is assumed to keep running, which is the case
      for most sensors, and the MIPIFRN bit is set accordingly.

child-binding:
  child-binding:
    child-binding:
      include: video-interfaces.yaml

examples:
  - |
    &csi2dc {
      status = "okay";
    };
```

## dts/bindings/video/microchip,sama7g5-csi2host.yaml
```yaml
# Copyright (C) 2025 Microchip Technology Inc. and its subsidiaries
#
# SPDX-License-Identifier: Apache-2.0
#

title: Microchip SAMA7G5 MIPI CSI-2 host controller

description: |
  MIPI CSI-2 host controller with an integrated MIPI D-PHY receiver, found on
  the SAMA7G5 family. It receives up to two CSI-2 D-PHY data lanes from an image
  sensor and forwards the packets on its internal IDI output to the CSI-2 Demux
  Controller (CSI2DC).

  The sink port (port@1) describes the CSI-2 link to the image sensor, the source
  port (port@0) the internal link to the CSI2DC.

    &csi2host {
      status = "okay";

      ports {
        port@1 {
          reg = <1>;

          csi2host_ep_in: endpoint {
            remote-endpoint-label = "imx219_ep_out";
            bus-type = <VIDEO_BUS_TYPE_CSI2_DPHY>;
            data-lanes = <1 2>;
          };
        };
      };
    };

compatible: "microchip,sama7g5-csi2host"

include: [base.yaml]

properties:
  reg:
    required: true

  interrupts:
    required: true

  clocks:
    required: true

  clock-names:
    required: true
    description: |
      Must be "pclk" (peripheral clock) and "phyclk" (generated clock feeding the
      D-PHY configuration clock input).

  microchip,dphy-frequency:
    type: int
    description: |
      Lane data rate in kbit/s to tune the D-PHY receiver for, selecting the
      frequency range it locks to. When absent the driver uses the rate the source
      reports through VIDEO_CID_LINK_FREQ, which is normally what is wanted. Pin it
      here for a source whose reported rate sits on a range boundary; Linux, whose
      D-PHY driver cannot reach the sensor, always takes it from devicetree instead
      (snps,dphy-frequency on the dphy node of sama7g5.dtsi, set to 900000).

  microchip,dphy-bitrate-code:
    type: int
    description: |
      High-speed bit rate code written to the analog configuration of the D-PHY
      receiver, bypassing the frequency range lookup. Taken from the D-PHY bit
      rate table of the datasheet. Only needed when microchip,dphy-frequency
      cannot express the wanted range.

  assigned-clock-rates:
    type: int
    default: 26600000
    description: |
      Rate in Hz programmed for the "phyclk" generated clock. The D-PHY
      configuration clock must be in the 17 MHz to 27 MHz range.

child-binding:
  child-binding:
    child-binding:
      include: video-interfaces.yaml
```

## dts/bindings/video/microchip,sama7g5-isc.yaml
```yaml
# Copyright (C) 2025 Microchip Technology Inc. and its subsidiaries
#
# SPDX-License-Identifier: Apache-2.0
#

title: Microchip SAMA7G5 Image Sensor Controller (XISC)

description: |
  The eXtended Image Sensor Controller samples a parallel video stream, either
  from the CSI-2 Demux Controller (CSI2DC) or from the parallel camera pins, runs
  it through its image processing pipeline and writes the frames to memory with
  its own DMA master.

  Raw Bayer input can either be written to memory unmodified, or converted by the
  pipeline (white balance, Bayer interpolation, color correction, color space
  conversion) into RGB or YUV frames.

  The single input port describes the parallel link feeding the parallel front end.

compatible: "microchip,sama7g5-isc"

include: [base.yaml]

properties:
  reg:
    required: true

  interrupts:
    required: true

  clocks:
    required: true

  microchip,mipi-mode:
    type: boolean
    description: |
      Set when the parallel front end is fed by the CSI2DC video pipeline instead
      of the parallel camera pins. The front end then handles the data and clock
      lines differently.

  microchip,black-level-offset:
    type: int
    default: 0
    description: |
      Black level pedestal the sensor adds to its samples, in counts at a 10-bit
      sample width, which the pipeline subtracts before interpolating the Bayer
      pattern. The value is scaled to the width actually sampled, and the
      hardware saturates it at 511.

      The pedestal is a property of the sensor and of how it is configured, so
      the default of zero leaves the samples untouched. Subtracting more than the
      sensor actually adds darkens the image and clips the low end.

  microchip,srgb-gamma:
    type: boolean
    description: |
      Encode the frames the pipeline converts with the sRGB transfer function,
      instead of leaving them linear.

      Displays expect encoded input, so the frames of a board that leaves this
      out look dark in the shadows and washed out elsewhere. Set it unless the
      frames feed something that wants linear light, such as a further
      processing stage of its own.

      The property has no effect on raw Bayer output, which the pipeline writes
      to memory untouched.

  microchip,sensor-clock-div:
    type: int
    default: 0
    description: |
      Divider applied to the ISC peripheral clock to generate the camera sensor
      reference clock (ISC_MCK), which also clocks the CSI2DC video pipeline.
      The resulting rate is the peripheral clock divided by (div + 1).

child-binding:
  child-binding:
    include: video-interfaces.yaml
```

## dts/bindings/video/ovti,ov2640.yaml
```yaml
# Copyright (c) 2021 Antmicro <www.antmicro.com>
# SPDX-License-Identifier: Apache-2.0

title: OV2640 CMOS video sensor

description: |
  The COM10 register expected to set the polarity active-high or active-low of VSYNC does not seem
  to have any effect. Instead, it depends on whether the DSP core is enabled or not.

  To access the bayer format, SBGGR8, it is required to turn off the DSP core on the sensor.

  The desired VSYNC polarity therefore selects which formats are available, as the driver will
  follow the devicetree configuration first, and deduce the formats that can be accessed in this
  VSYNC configuration.

  By default, the color formats are exposed. To access bayer, tuning the devicetree is needed.

  Mind to update both side of the link so that the video receiver also updates its expected
  format.

compatible: "ovti,ov2640"

properties:
  reset-gpios:
    type: phandle-array
    description: |
      The RESETn pin is asserted to disable the sensor causing a hard
      reset.  The sensor receives this as an active-low signal.

  pwdn-gpios:
    type: phandle-array
    description: |
      The PWDN pin is asserted to disable the sensor. The sensor
      receives this as an active-high signal.

  clock-multiplier:
    type: int
    default: 2
    min: 1
    max: 2
    description: |
      Select the multiplier applied to XVCLK (input clock pin), clocking the sensor internal
      elements, also affecting the maximal pixel rate and frame rate.

  drive-strength:
    type: int
    default: 1
    min: 1
    max: 4
    description: |
      Select the signal drive strength, particularly useful for PCLK which reaches above 150 MHz
      for 16-bit per pixel formats at 1600x1200 at 30 FPS.

  jpeg-hsync:
    type: boolean
    description: |
      Mimicks an uncompressed frame transfer, with the JPEG buffer segmented in lines of as many
      bytes as an uncompressed frame would have, leading to fewer lines (early VSYNC) and the last
      line shorter (early HSYNC).

      Set if the video receiver does not support JPEG input explicitly, in which case, the HSYNC
      signal will be the same as VSYNC, effectively sending a single line with JPEG encoded data.

      The pixel clock will be active only when data is to be sent, pausing and resuming.


child-binding:
  child-binding:
    include: video-interfaces.yaml

    properties:
      vsync-active:
        required: true


include: i2c-device.yaml
```

## dts/bindings/video/ovti,ov5647.yaml
```yaml
# SPDX-FileCopyrightText: Copyright The Zephyr Project Contributors
# SPDX-License-Identifier: Apache-2.0

description: |
  OV5647 raw image sensor

  The OV5647 is a 5 Mpx raw Bayer image sensor with a MIPI CSI-2 image data
  interface and a CCI (I2C compatible) control bus.

compatible: "ovti,ov5647"

include: i2c-device.yaml

properties:
  clocks:
    description: Reference to the XVCLK clock, which must be 6 to 27 MHz.
    required: true

  pwdn-gpios:
    type: phandle-array
    description: |
      Reference to the GPIO connected to the PWDN pin. The sensor receives
      this as an active-high signal.

child-binding:
  child-binding:
    include: video-interfaces.yaml
```
