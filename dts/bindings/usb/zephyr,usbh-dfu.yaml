## dts/bindings/usb/zephyr,usbh-dfu.yaml
```yaml
# Copyright (c) 2026 Renesas Electronics Corporation
# SPDX-License-Identifier: Apache-2.0

description: Bindings for DFU Host driver

compatible: "zephyr,usbh-dfu"

include: base.yaml

properties:
  "#address-cells":
    required: true
    const: 1

  "#size-cells":
    required: true
    const: 0
```

## dts/bindings/usb/zephyr,usbh-hid-device.yaml
```yaml
# Copyright (c) 2026 Renesas Electronics Corporation
# SPDX-License-Identifier: Apache-2.0

description: Bindings for HID Host driver device

compatible: "zephyr,usbh-hid-device"

include: base.yaml

properties:
  reg:
    required: true
    description: USB device vendor + device IDs (0xFFFFFFFF acts as wildcard)

  start-with-boot-protocol:
    type: boolean
    description: Most USB HID devices will implement a common report descriptor
      known as "boot protocol". It is meant to let host machines interact
      with the device even without loading a fully fledged HID driver,
      usually in the context of a bootloader. It works well by itself,
      so it may be used as a more lightweight alternative to the full report parsing.

  match-class:
    type: boolean
    description: Whether to use the VID-DID combination or just match this to
      any HID device.

  in-idle-rate-ms:
    type: array
    default: [0, 0]
    description: List of idle rates to be applied to report IDs. Odd entries
      represent report IDs, even entries are the corresponding period in
      milliseconds (must be a multiple of 4).
```

## dts/bindings/usb/zephyr,usbh-hid.yaml
```yaml
# Copyright (c) 2026 Renesas Electronics Corporation
# SPDX-License-Identifier: Apache-2.0

description: Bindings for HID Host driver

compatible: "zephyr,usbh-hid"

include: base.yaml

properties:
  "#address-cells":
    required: true
    const: 1

  "#size-cells":
    required: true
    const: 0
```

## dts/bindings/usb/zephyr,usbh-vendor.yaml
```yaml
# Copyright (c) 2026 Renesas Electronics Corporation
# SPDX-License-Identifier: Apache-2.0

description: Bindings for Vendor Host driver

compatible: "zephyr,usbh-vendor"

include: base.yaml

properties:
  "#address-cells":
    required: true
    const: 1

  "#size-cells":
    required: true
    const: 0
```

## dts/bindings/usb/zephyr,usbtmc-device.yaml
```yaml
# SPDX-FileCopyrightText: Copyright The Zephyr Project Contributors
# SPDX-License-Identifier: Apache-2.0

title: USBTMC (USB Test and Measurement Class) device

description: |
  USB Test and Measurement Class (USBTMC) device instance. The node is a
  child of a USB device controller and provides the transport for test and
  measurement instruments, interpretation of the device dependent messages,
  typically IEEE 488.2 or SCPI commands, is left to the application.

compatible: "zephyr,usbtmc-device"

include: base.yaml

on-bus: usb

properties:
  label:
    description: |
      The string defined by the label property is also used for the USB
      device interface string descriptor.

examples:
  - |
    &zephyr_udc0 {
        usbtmc0: usbtmc0 {
            compatible = "zephyr,usbtmc-device";
            label = "USBTMC instrument";
        };
    };
```

## dts/bindings/uwb/nxp,uwb-device.yaml
```yaml
#
# Copyright NXP 2026
#
# SPDX-License-Identifier: Apache-2.0
#

description: NXP UWB Module Support

compatible: "nxp,uwb-device"

include: [uwb-uci.yaml, spi-device.yaml]

properties:
  reg:
    type: array
    required: true

  uwb-dev-name:
    default: "UWB NXP"

  bt-hci-bus:
    default: "spi"

  uwb,irq-gpios:
    type: phandle-array
    required: true
    description: |
      This irq gpio is used to indicate there is packet ready to receive from UWB device

  uwb,rstn-gpios:
    type: phandle-array
    required: true
    description: |
      Configures pin routing and optionally pin electrical features of RW61X_PDn signal.
```

## dts/bindings/uwb/zephyr,native-uwb-device.yaml
```yaml
#
# Copyright NXP 2026
#
# SPDX-License-Identifier: Apache-2.0
#

description: Native simulator UWB Module Support

compatible: "zephyr,native-uwb-device"

include: [uwb-uci.yaml]

properties:
  uwb-uci-name:
    default: "UWB Native Sim"

  uwb-uci-bus:
    default: "virtual"
```

## dts/bindings/uwb/zephyr,uwb-emul.yaml
```yaml
#
# Copyright NXP 2026
#
# SPDX-License-Identifier: Apache-2.0
#

description: Emulation UWB Module driver

compatible: "zephyr,uwb-emul"

include: [uwb-uci.yaml]

properties:
  uwb-uci-name:
    default: "UWB Emulation"

  uwb-uci-bus:
    default: "virtual"
```

## dts/bindings/video/adi,max96717.yaml
```yaml
#
# Copyright (c) 2026 Charles Dias
# SPDX-License-Identifier: Apache-2.0
#

description: |
  ADI MAX96717 GMSL2 serializer.

  The serializer sits on the I2C gate of the deserializer's link, which carries
  it. port@0 is its CSI-2 input, from the sensor; port@1 is its GMSL2 output,
  to the deserializer. Its camera-side I2C bus is an adi,max96717-i2c-gate
  child, which carries the sensor, and its MFP pins an adi,max96717-gpio child,
  which a sensor's reset or enable GPIO can point at.

  Example:

    max96717: max96717@40 {
        compatible = "adi,max96717";
        reg = <0x40>;

        ports {
            #address-cells = <1>;
            #size-cells = <0>;

            /* CSI-2 input */
            port@0 {
                reg = <0>;

                ser_csi_in: endpoint {
                    remote-endpoint-label = "imx219_ep_out";
                    bus-type = <VIDEO_BUS_TYPE_CSI2_DPHY>;
                    data-lanes = <1 2>;
                };
            };

            /* GMSL2 output */
            port@1 {
                reg = <1>;

                ser_gmsl_out: endpoint {
                    remote-endpoint-label = "des_gmsl_in";
                };
            };
        };

        ser_i2c: i2c-gate {
            compatible = "adi,max96717-i2c-gate";
            #address-cells = <1>;
            #size-cells = <0>;
        };

        ser_gpio: gpio {
            compatible = "adi,max96717-gpio";
            gpio-controller;
            #gpio-cells = <2>;
            ngpios = <11>;
        };
    };

compatible: "adi,max96717"

include: i2c-device.yaml

child-binding:
  child-binding:
    description: |
      A port: port@0 is the CSI-2 input from the sensor, port@1 the GMSL2
      output to the deserializer.

    properties:
      reg:
        type: int
        required: true
        enum: [0, 1]

    child-binding:
      include: video-interfaces.yaml
```

## dts/bindings/video/adi,max96724.yaml
```yaml
#
# Copyright (c) 2026 Charles Dias
# SPDX-License-Identifier: Apache-2.0
#

description: |
  ADI MAX96724 quad GMSL2 deserializer.

  The ports follow the Linux binding: port@0 to port@3 are the GMSL inputs of
  links A to D, port@4 to port@7 the CSI-2 outputs of PHYs 0 to 3. The driver
  uses one GMSL input and one CSI-2 output. On the CSI-2 output endpoint,
  link-frequencies is the D-PHY clock; each lane runs at twice that bit rate.
  It must be 100 to 1250 MHz in steps of 50 MHz, which runs the lanes at
  200 Mbps to 2.5 Gbps in steps of 100 Mbps.

  The I2C path to the serializer behind a link is an adi,max96724-i2c-gate
  child node, addressed by the link index.

  Example:

    max96724: max96724@27 {
        compatible = "adi,max96724";
        reg = <0x27>;
        #address-cells = <1>;
        #size-cells = <0>;

        ports {
            #address-cells = <1>;
            #size-cells = <0>;

            /* GMSL input of link A */
            port@0 {
                reg = <0>;

                des_gmsl_in: endpoint {
                    remote-endpoint-label = "ser_gmsl_out";
                };
            };

            /* CSI-2 output of PHY 2 */
            port@6 {
                reg = <6>;

                des_csi_out: endpoint {
                    remote-endpoint-label = "csi_ep_in";
                    bus-type = <VIDEO_BUS_TYPE_CSI2_DPHY>;
                    data-lanes = <1 2>;
                    link-frequencies = <750000000>;
                };
            };
        };

        i2c-gate@0 {
            compatible = "adi,max96724-i2c-gate";
            reg = <0>;
            #address-cells = <1>;
            #size-cells = <0>;
        };
    };

compatible: "adi,max96724"

include: i2c-device.yaml

properties:
  "#address-cells":
    type: int
    description: |
      Set to 1 together with "#size-cells" = 0 when the deserializer carries
      adi,max96724-i2c-gate children, addressed by GMSL link index.

  "#size-cells":
    type: int

child-binding:
  child-binding:
    description: |
      A port: port@0 to port@3 are the GMSL inputs of links A to D, port@4 to
      port@7 the CSI-2 outputs of PHYs 0 to 3.

    properties:
      reg:
        type: int
        required: true
        enum: [0, 1, 2, 3, 4, 5, 6, 7]

      link-rate-mbps:
        type: int
        enum:
          - 3000
          - 6000
        default: 6000
        description: |
          GMSL2 forward link rate of the serializer on a GMSL input port. The
          MAX96717 runs at 3000 or 6000, the MAX96717F at 3000 only. The
          deserializer's rate for the link is written at init when it differs,
          followed by a one-shot reset of the link.

    child-binding:
      include: video-interfaces.yaml
```

## dts/bindings/video/bflb,camfront.yaml
```yaml
#
# SPDX-FileCopyrightText: Copyright Panoramix Labs
# SPDX-License-Identifier: Apache-2.0
#

title: BouffaloLab Camera Front-end DVP receiver

description: |
  The BouffaloLab camera front-end handles DVP signal and handles conversion between YUV and RGB
  if needed, then feeds the output in one or both of the DVP2AXI sinks. It handles some of the
  link-level configurations.

  The naming of variables (DVPAS, DVP_AS) suggest that the point-to-point communication between
  CAMFRONT and DVP2AXI is AXI-Stream (AS) but this could not be confirmed.

  The CAMFRONT engine may start after the image sensor started to produce data, in which case it
  should correctly pick-up the next VSYNC strobe and start capturing the data after it.

  It does not support explicit JPEG frames (without HSYNC toggling, where HSYNC == VSYNC), so
  an emulation mode for the image sensor is required (see jpeg-hsync: in ovti,ov2640.yaml).

compatible: "bflb,camfront"

include: [base.yaml, pinctrl-device.yaml, reset-device.yaml]

properties:
  reg:
    required: true

  clock-divider:
    type: int
    description: The selected camera clock source is further divided by this value.
    default: 3
    min: 1
    max: 4

child-binding:
  child-binding:
    include: video-interfaces.yaml

    properties:
      reg:
        type: array
        required: true

examples:
  - |
    camfront@20050000 {
      compatible = "bflb,camfront";
      reg = <0x20050000>;

      port {
        #address-cells = <1>;
        #size-cells = <0>;

        dvp_ep_in: endpoint@0 {
          reg = <0>;
          remote-endpoint-label = "ov2640_ep_out";
          hsync-active = <1>;
          vsync-active = <1>;
        };

        dvp_ep_out0: endpoint@1 {
          reg = <1>;
          remote-endpoint-label = "dvp2axi0_ep_in";
        };

        dvp_ep_out1: endpoint@2 {
          reg = <2>;
          remote-endpoint-label = "dvp2axi1_ep_in";
        };
      };
    };
```

## dts/bindings/video/bflb,dvp2axi.yaml
```yaml
#
# SPDX-FileCopyrightText: Copyright Panoramix Labs
# SPDX-License-Identifier: Apache-2.0
#

title: BouffaloLab DVP (Digital Video Port)

description: |
  The BouffaloLab DVP2AXI engines selectively receivves the video stream from CAMFRONT and sends
  the data to memory over AXI. It is responsible for some of the link properties as well as well
  as extra transformation such as cropping or subsampling.

compatible: "bflb,dvp2axi"

include: [base.yaml, pinctrl-device.yaml, reset-device.yaml]

properties:
  reg:
    required: true

  interrupts:
    required: true

  axi-data-width:
    type: int
    required: true
    enum:
      - 32
      - 64
    description: |
      Size of the AXI bus in bits for this SoC (aka word size) for the video data path.

  axi-burst-length:
    type: int
    required: true
    enum:
      - 1
      - 4
      - 8
      - 16
      - 32
      - 64
    description: |
      AXI burst length counted in words (32-bit or 64-bit depending on the SoC).
      The longer the better throughput, but also occupying the bus for longer.

child-binding:
  child-binding:
    include: video-interfaces.yaml

examples:
  - |
    dvp0: dvp2axi@20057000 {
      compatible = "bflb,dvp2axi";
      reg = <0x20057000 DT_SIZE_K(4)>;

      port {
        dvp2axi_ep_in: endpoint {
          remote-endpoint-label = "camfront_ep_out";
        };
      };
    };
```

## dts/bindings/video/espressif,esp32-csi.yaml
```yaml
# Copyright (c) 2026 Espressif Systems (Shanghai) Co., Ltd.
# SPDX-License-Identifier: Apache-2.0

description: |
  Espressif ESP32 MIPI CSI-2 camera interface.

  The CSI-2 host receives frames from the sensor, the image signal processor
  converts them and the CSI bridge feeds the result to a DW-GDMA channel
  that writes it to memory.

  Example:

    &csi {
      status = "okay";

      port {
        csi_ep_in: endpoint {
          remote-endpoint-label = "sensor_ep_out";
          bus-type = <VIDEO_BUS_TYPE_CSI2_DPHY>;
          data-lanes = <1 2>;
        };
      };
    };

compatible: "espressif,esp32-csi"

include: base.yaml

properties:
  reg:
    required: true

  interrupts:
    required: true

  dma-channel:
    type: int
    required: true
    description: DW-GDMA channel that writes the frames to memory.

child-binding:
  child-binding:
    include: video-interfaces.yaml
```

## dts/bindings/video/espressif,esp32-i2s-cam.yaml
```yaml
# SPDX-FileCopyrightText: 2026 Muhammad Waleed Badar
# SPDX-License-Identifier: Apache-2.0

title: ESP32 I2S camera interface

description: |
  Camera slave mode of the ESP32 I2S0 controller, which captures 8-bit
  parallel (DVP) camera data.

  The node is a child of the I2S0 controller node and shares its registers,
  clock and interrupt. The controller is either an audio interface or a
  camera interface, so this node is enabled while the I2S0 controller node
  stays disabled. Only I2S0 supports camera mode, I2S1 has no such node.

  D0-D7, HREF and PCLK are routed with pinctrl to the I2S0I_DATA_IN0-7,
  I2S0I_H_ENABLE and I2S0I_WS_IN signals. VSYNC is read as a GPIO interrupt
  that delimits frames.

  The controller samples pixel clocks up to about 15 MHz. The sensor keeps
  its pixel clock within that limit when its endpoint lists the limit in
  link-frequencies. The sensor clock is not generated by the controller, a
  pwm-clock node referenced by the sensor provides it.

compatible: "espressif,esp32-i2s-cam"

include: [base.yaml, pinctrl-device.yaml]

properties:
  pinctrl-0:
    required: true

  pinctrl-names:
    required: true

  vsync-gpios:
    type: phandle-array
    required: true
    description: |
      GPIO connected to the sensor VSYNC output. The capture of a frame
      starts on the edge to the inactive level.

child-binding:
  child-binding:
    include: video-interfaces.yaml

examples:
  - |
    &i2s0_cam {
        status = "okay";
        pinctrl-0 = <&i2s0_cam_default>;
        pinctrl-names = "default";
        vsync-gpios = <&gpio0 25 GPIO_ACTIVE_HIGH>;

        port {
            i2s0_ep_in: endpoint {
                remote-endpoint-label = "gc2145_ep_out";
            };
        };
    };
```
