## dts/bindings/usb/st,stm32-usb-drd.yaml
```yaml
# Copyright (c) 2026 Hamza Bahri
# SPDX-License-Identifier: Apache-2.0

description: |
  STM32 USB_DRD_FS controller

  Dual-role variant of the STM32 USB controller: in addition to device mode,
  it has host channels and can be used by the USB host controller driver.
  Nodes keep "st,stm32-usb" as a fallback compatible for the device drivers:

    compatible = "st,stm32-usb-drd", "st,stm32-usb";

compatible: "st,stm32-usb-drd"

include: st,stm32-usb.yaml
```

## dts/bindings/video/galaxycore,gc0308.yaml
```yaml
# SPDX-FileCopyrightText: Copyright The Zephyr Project Contributors
# SPDX-FileCopyrightText: Copyright (c) 2024 Felipe Neves
# SPDX-FileCopyrightText: Copyright (c) 2026 Victor Hogeweij
#
# SPDX-License-Identifier: Apache-2.0

title: Galaxy Core GC0308 CMOS video sensor

description: |
  640x480 CMOS image sensor with a parallel DVP output, controlled over
  I2C (SCCB).

compatible: "galaxycore,gc0308"

include: i2c-device.yaml

properties:
  clocks:
    required: true
    description: |
      Clock driving the sensor XCLK pin. The sensor derives all of its timing
      from it, so the driver reads its clock-frequency to report and select
      frame intervals.
  pclk-drive-strength:
    type: int
    enum: [2, 4, 8, 10]
    default: 2
    description: |
      Drive strength in mA of the PCLK output pad.
  data-drive-strength:
    type: int
    enum: [4, 6, 10, 12]
    default: 4
    description: |
      Drive strength in mA of the pixel data output pads.
  sync-drive-strength:
    type: int
    enum: [4, 8, 12, 16]
    default: 4
    description: |
      Drive strength in mA of the HSYNC and VSYNC output pads.
  reset-gpios:
    type: phandle-array
    description: |
      The RESETn pin is asserted to disable the sensor causing a hard
      reset.  The sensor receives this as an active-low signal.
  pwdn-gpios:
    type: phandle-array
    description: |
      The PWDN pin is asserted to power down the sensor. The sensor
      receives this as an active high signal

child-binding:
  child-binding:
    include: video-interfaces.yaml
```

## dts/bindings/video/heimann,htpa-colorizer.yaml
```yaml
# SPDX-FileCopyrightText: Copyright The Zephyr Project Contributors
# SPDX-License-Identifier: Apache-2.0

description: HTPA signed sample to grayscale and false color video device

compatible: "heimann,htpa-colorizer"

include: base.yaml

properties:
  source:
    type: phandle
    required: true
    description: Video device providing HTPA signed frames
```

## dts/bindings/video/heimann,htpa-compensator.yaml
```yaml
# SPDX-FileCopyrightText: Copyright The Zephyr Project Contributors
# SPDX-License-Identifier: Apache-2.0

description: HTPA electrical offset correction and pixel sorting video device

compatible: "heimann,htpa-compensator"

include: base.yaml

properties:
  source:
    type: phandle
    required: true
    description: Video device providing HTPA raw frames
```

## dts/bindings/video/sony,imx662.yaml
```yaml
# SPDX-FileCopyrightText: Copyright The Zephyr Project Contributors
# SPDX-FileCopyrightText: Copyright (c) 2026 Kirill Shypachov
#
# SPDX-License-Identifier: Apache-2.0

description: Sony IMX662 1/2.8" STARVIS 2 CMOS image sensor (MIPI CSI-2)

compatible: "sony,imx662"

include: i2c-device.yaml

properties:
  clocks:
    required: true
    description: Sensor input clock (INCK). Only 24 MHz is supported.

  reset-gpios:
    type: phandle-array
    description: |
      The XCLR pin is asserted to cause a hard reset. The sensor
      receives this as an active-low signal.

child-binding:
  child-binding:
    include: video-interfaces.yaml
```

## dts/bindings/video/zephyr,native-sim-video-fifo.yaml
```yaml
# Copyright The Zephyr Project Contributors
# SPDX-License-Identifier: Apache-2.0

title: Native simulator host video source

description: |
  Video source reading raw frames from a host named pipe (FIFO), or
  capturing them from a host V4L2 device.

  The application selects the frame format through the video API. A FIFO
  writer must produce frames of exactly that format, and a V4L2 device must
  provide it as is, except RGB565, which is converted on the host from YUYV
  when the device does not provide it.

  See the native_sim board documentation for how to feed the FIFO and for the
  details of the driver behaviour.

examples:
  - |
    / {
        chosen {
            zephyr,camera = &video_fifo;
        };

        video_fifo: video-fifo {
            compatible = "zephyr,native-sim-video-fifo";
            fifo-path = "/dev/video0";
        };
    };

compatible: "zephyr,native-sim-video-fifo"

include: base.yaml

properties:
  fifo-path:
    type: string
    description: |
      Path of the host named pipe to read the frames from, or of a V4L2
      capture device such as /dev/video0. A FIFO is created if the path does
      not exist yet, except under /dev. Defaults to
      /tmp/zephyr-<device>-<pid>.fifo. It can be overridden at runtime with
      the --<device>=<path> command line option.

  poll-interval-ms:
    type: int
    default: 10
    description: |
      Delay before reading the host source again when it did not provide a
      complete frame: no FIFO writer is attached, the writer is slower than
      the driver, or the V4L2 device has no frame ready yet. This does not
      limit the frame rate: the driver reads again immediately after a frame
      is completed.
```

## dts/bindings/video/zephyr,video-jpegenc.yaml
```yaml
# SPDX-FileCopyrightText: Copyright The Zephyr Project Contributors
# SPDX-License-Identifier: Apache-2.0

description: |
  Software JPEG encoder based on the jpegenc module.

compatible: "zephyr,video-jpegenc"
```

## dts/bindings/w1/w1-controller.yaml
```yaml
# Copyright (c) 2022 Thomas Stranger
# SPDX-License-Identifier: Apache-2.0

# Common fields for 1-Wire controllers

include: base.yaml

class: w1

bus: w1

properties:
  active-pullup:
    type: boolean
    description: |
      Enable the active pullup for the 1-Wire bus.
```

## dts/bindings/watchdog/microchip,dwdt-g1.yaml
```yaml
# Copyright (c) 2026 Microchip Technology Inc. and its subsidiaries.
# SPDX-License-Identifier: Apache-2.0

description: Microchip Dual Watchdog Timer

compatible: "microchip,dwdt-g1-watchdog"

include: base.yaml

properties:
  reg:
    required: true

  interrupts:
    required: true
```

## dts/bindings/watchdog/renesas,rcar-gen5-wwdt.yaml
```yaml
# SPDX-FileCopyrightText: Copyright (c) 2026 Renesas Electronics Corporation
# SPDX-License-Identifier: Apache-2.0

description: |
  Renesas R-Car Gen5 window watchdog. Platform firmware must reserve the
  instance for Zephyr from the last peripheral reset, leave it stopped with its
  mode register unwritten, configure and maintain its reset route, and ensure
  the reset scope matches the requested SoC reset. The driver checks but does
  not configure or clear the route.
  The hardware has discrete timeout periods and window openings. The driver
  rounds the requested maximum and minimum up to supported values; applications
  must account for the actual window and clock rate when feeding the watchdog.

compatible: "renesas,rcar-gen5-wwdt"

include: base.yaml

properties:
  reg:
    required: true

  clocks:
    required: true
    description: Bus and counter clock inputs, in that order.

  clock-names:
    required: true
    const: ["bus", "counter"]

  bus-clock-frequency:
    type: int
    required: true
    min: 1
    description: Bus clock frequency in Hz as configured by platform firmware.

  counter-clock-frequency:
    type: int
    required: true
    min: 1
    description: Counter clock frequency in Hz as configured by platform firmware.

  renesas,ecm:
    type: phandle
    required: true
    description: |
      System controller providing an ECM reset route. Its control, status and
      reset-forwarding registers must match the layout used by the driver.

  renesas,ecm-error:
    type: array
    required: true
    min-len: 2
    max-len: 2
    description: ECM error register index and bit for the watchdog reset output.

examples:
  - |
    /* Example overlay; confirm actual clock rates with platform firmware. */
    / {
      aliases {
        watchdog0 = &wwdt0;
      };
    };

    &ecm {
      status = "okay";
    };

    &wwdt0 {
      bus-clock-frequency = <16666667>;
      counter-clock-frequency = <32768>;
      status = "okay";
    };
```

## dts/bindings/watchdog/ti,j7-rti-wdt.yaml
```yaml
# Copyright (c) 2025, Ayush Singh BeagleBoard.org Foundation
# SPDX-License-Identifier: Apache-2.0

description: K3 Watchdog timer (RTI module) available in the K3 generation of processors.

compatible: "ti,j7-rti-wdt"

include: base.yaml

properties:
  reg:
    required: true

  clock-frequency:
    type: int
    required: true
    description:
      Functional clock rate in Hz. Used when the node has no clocks
      property; otherwise the rate is read from the clock controller.

  assigned-clocks:
    type: phandle-array
    specifier-space: clock
    description:
      Clock whose parent is selected at init. Only the first entry is
      used, and it must belong to the controller named by clocks.

  assigned-clock-parents:
    type: phandle-array
    specifier-space: clock
    description:
      Parent selected for the first assigned-clocks entry at init. K3 SCMI
      firmware lets an agent select the parent of the RTI clock but not set
      its rate, and only a slow parent gives timeouts above about 1.3 s.

  interrupts:
    description:
      Watchdog interrupt line, if present NMI mode is supported.

  reset-capable:
    type: boolean
    description:
      Indicates reset mode is supported by hardware.
      If set, watchdog timeout will trigger a reset.
      The SoC can only be configured for either NMI
      or Reset mode at a time. Support for NMI or Reset is SoC
      specific.
```

## dts/bindings/wuc/nxp,rw-pmu-wuc.yaml
```yaml
# SPDX-FileCopyrightText: Copyright 2026 NXP
# SPDX-License-Identifier: Apache-2.0

description: |
  NXP RW6xx Power Management Unit wakeup controller.

  The wakeup controller is part of the nxp,rw-pmu Power Management Unit.
  Wakeup source specifiers use the NXP_RW_PMU_* identifiers defined in
  zephyr/dt-bindings/wuc/wuc_nxp_rw_pmu.h. Their values are peripheral
  interrupt numbers, without the Cortex-M exception offset of 16.
  They are not bit positions in WAKEUP_MASK.

  The PMU routes peripheral wakeup requests independently of the NVIC
  interrupt enable and peripheral configuration. Source availability
  depends on the power mode and powered domains. PM1 can wake on any
  enabled interrupt without PMU routing. PM3/PM4 support fewer sources
  than PM2; WLAN/BLE routes cannot wake a powered-off radio.

compatible: "nxp,rw-pmu-wuc"

include: [base.yaml, wuc-controller.yaml]

properties:
  '#wakeup-ctrl-cells':
    const: 1

wakeup-ctrl-cells:
  - id
```

## dts/bindings/wuc/nxp,s32-wkpu-wuc.yaml
```yaml
# SPDX-FileCopyrightText: Copyright 2026 NXP
# SPDX-License-Identifier: Apache-2.0

description: |
  NXP S32 WKPU wakeup controller. This node is a child of an nxp,s32-wkpu
  controller, which owns the shared registers and interrupt handling.

  A wakeup source ID encodes the hardware source number in bits [7:0] and
  the edge in bits [9:8] (1 = rising, 2 = falling, 3 = both). Use
  NXP_S32_WKPU_SOURCE(source, edge) from wuc_nxp_s32_wkpu.h. Sources 0-3
  are internal and support rising edges only.

  Enabling a source configures its edge and opens its wakeup request gate,
  without enabling an interrupt. Interrupt and wakeup requests share the
  same edge configuration. Conflicting edges on an armed source are
  rejected, rather than changing another consumer's configuration.

compatible: "nxp,s32-wkpu-wuc"

include: [base.yaml, wuc-controller.yaml]

properties:
  "#wakeup-ctrl-cells":
    const: 1

wakeup-ctrl-cells:
  - id
```

## lib/call_offloader/Kconfig
```kconfig
# Copyright (c) 2026 Måns Ansgariusson <mansgariusson@gmail.com>
# SPDX-License-Identifier: Apache-2.0

rsource "services/Kconfig"
```

## lib/call_offloader/services/Kconfig
```kconfig
# Copyright (c) 2026 Måns Ansgariusson <mansgariusson@gmail.com>
# SPDX-License-Identifier: Apache-2.0

config CALL_OFFLOADER_PSA
	bool "Offload PSA Crypto calls"
	depends on PSA_CRYPTO
	select CALL_OFFLOADER
	help
	  Redirect the PSA Crypto calls onto dedicated worker thread so all callers can run on a
	  much smaller stack than the PSA Crypto needs. This comes at the cost of preemption and
	  context switching, but it is overwhelmingly beneficial for memory-constrained systems.

if CALL_OFFLOADER_PSA

config CALL_OFFLOADER_PSA_STACK_SIZE
	int "PSA offloader engine stack size"
	default 3072
	help
	  Stack size of each PSA offloader engine thread, in bytes. It must
	  accommodate the deepest offloaded PSA call.

config CALL_OFFLOADER_PSA_WORKERS
	int "Number of PSA offloader engine threads"
	default 1
	help
	  Number of PSA offloader engine threads. Each thread can handle one offloaded call at a
	  time.

endif # CALL_OFFLOADER_PSA
```

## lib/memref/Kconfig
```kconfig
# Copyright (c) 2026 Måns Ansgariusson <mansgariusson@gmail.com>
# SPDX-License-Identifier: Apache-2.0

menu "Memref: reference counted memory allocation"

config MEMREF
	bool "Reference counted memory allocation"
	help
	  This option enables the memref API, which
	  allows multiple threads to share ownership of a memory block
	  through reference counting.

config MEMREF_DESTROY_CB
	bool "Destroy callback support"
	depends on MEMREF
	help
	  Store a per-allocation destroy callback in the memref control
	  block, invoked with the user pointer just before the block is
	  returned to its backend. Costs up to one alignment unit per
	  allocation, depending on the padding of the control block.

config MEMREF_DEBUG
	bool "Control block checks"
	depends on MEMREF
	depends on ASSERT
	help
	  Store a magic value in every memref control block and check it in
	  memref_ref() and memref_unref(). Passing a pointer that was not
	  allocated through the memref API, or one whose last reference was
	  already released, then fails an assertion. The check is best
	  effort: a released block may already have been reused. Costs up to
	  one alignment unit per allocation.

endmenu
```

## modules/Kconfig.simplelink
```kconfig
# CC3220/CC32XX SDK HAL configuration

config HAS_CC3220SDK
	bool

# MSP432 SDK HAL configuration

config HAS_MSP432P4XXSDK
	bool
	select HAS_CMSIS_CORE

# CC13X2 / CC26X2 SDK HAL configuration

config HAS_CC13X2_CC26X2_SDK
	bool

config HAS_CC13X2X7_CC26X2X7_SDK
	bool

# CC23X0 SDK HAL configuration

config HAS_CC23X0_SDK
	bool
```

## modules/h264swdec/Kconfig
```kconfig
# SPDX-FileCopyrightText: Copyright The Zephyr Project Contributors
# SPDX-License-Identifier: Apache-2.0

config ZEPHYR_H264SWDEC_MODULE
	bool

menuconfig H264SWDEC
	bool "h264swdec software H.264 decoder"
	depends on ZEPHYR_H264SWDEC_MODULE
	help
	  Software H.264 decoder from the h264swdec module, for Baseline and
	  Constrained Baseline streams such as those WebRTC peers send. It
	  outputs planar YUV 4:2:0 pictures and allocates from a dedicated
	  heap.

if H264SWDEC

config H264SWDEC_HEAP_SIZE
	int "Decoder heap size, in bytes"
	default 3145728
	help
	  Size of the dedicated heap the decoder allocates its picture
	  buffers from. 384 KiB holds a 320x240 stream with one reference
	  picture.

config H264SWDEC_MAX_FRAME_WIDTH
	int "Largest accepted picture width, in pixels"
	default 4080

config H264SWDEC_MAX_FRAME_HEIGHT
	int "Largest accepted picture height, in pixels"
	default 4080

config H264SWDEC_MAX_FRAME_SIZE
	int "Largest accepted picture area, in pixels"
	default 8388608
	help
	  The decoder rejects sequence parameter sets that exceed any of the
	  three limits before allocating memory for them.

module = H264SWDEC
module-str = h264swdec
source "subsys/logging/Kconfig.template.log_config"

endif # H264SWDEC
```
