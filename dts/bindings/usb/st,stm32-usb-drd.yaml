## modules/hal_nordic/ironside/te/Kconfig
```kconfig
# Copyright (c) 2026 Nordic Semiconductor ASA
# SPDX-License-Identifier: Apache-2.0

menuconfig IRONSIDE_TE_CLIENT
	bool "IronSide TE client"
	depends on ZEPHYR_IRONSIDE_INTEGRATION_KIT_MODULE
	depends on TRUSTED_EXECUTION_NONSECURE
	select ARM_NONSECURE_PREEMPTIBLE_SECURE_CALLS
	help
	  Client for the IronSide TE secure services: PSA Crypto, PSA Initial
	  Attestation, device management, the boot report and the platform
	  services.

choice PSA_CRYPTO_PROVIDER
	default PSA_CRYPTO_PROVIDER_IRONSIDE_TE

# IronSide TE is precompiled, so its PSA Crypto capabilities are fixed.
config PSA_CRYPTO_PROVIDER_IRONSIDE_TE
	bool "Use IronSide TE"
	depends on IRONSIDE_TE_CLIENT
	select PSA_PROMPTLESS
	select PSA_WANT_ALG_SHA_256
	select PSA_WANT_ALG_SHA_384
	select PSA_WANT_ALG_SHA_512
	select PSA_WANT_ALG_SHA3_224
	select PSA_WANT_ALG_SHA3_256
	select PSA_WANT_ALG_SHA3_384
	select PSA_WANT_ALG_SHA3_512
	select PSA_WANT_ALG_HMAC
	select PSA_WANT_ALG_CMAC
	select PSA_WANT_ALG_SP800_108_COUNTER_CMAC
	select PSA_WANT_ALG_HKDF
	select PSA_WANT_ALG_HKDF_EXTRACT
	select PSA_WANT_ALG_HKDF_EXPAND
	select PSA_WANT_ALG_PBKDF2_HMAC
	select PSA_WANT_ALG_PBKDF2_AES_CMAC_PRF_128
	select PSA_WANT_ALG_TLS12_PRF
	select PSA_WANT_ALG_TLS12_ECJPAKE_TO_PMS
	select PSA_WANT_ALG_CBC_NO_PADDING
	select PSA_WANT_ALG_CBC_PKCS7
	select PSA_WANT_ALG_CTR
	select PSA_WANT_ALG_ECB_NO_PADDING
	select PSA_WANT_ALG_CCM
	select PSA_WANT_ALG_GCM
	select PSA_WANT_ALG_CHACHA20_POLY1305
	select PSA_WANT_ALG_ECDSA
	select PSA_WANT_ALG_DETERMINISTIC_ECDSA
	select PSA_WANT_ALG_ECDH
	select PSA_WANT_ALG_JPAKE
	select PSA_WANT_KEY_TYPE_AES
	select PSA_WANT_KEY_TYPE_CHACHA20
	select PSA_WANT_KEY_TYPE_HMAC
	select PSA_WANT_KEY_TYPE_DERIVE
	select PSA_WANT_KEY_TYPE_PASSWORD
	select PSA_WANT_KEY_TYPE_ECC_PUBLIC_KEY
	select PSA_WANT_KEY_TYPE_ECC_KEY_PAIR_IMPORT
	select PSA_WANT_KEY_TYPE_ECC_KEY_PAIR_EXPORT
	select PSA_WANT_KEY_TYPE_ECC_KEY_PAIR_GENERATE
	select PSA_WANT_ECC_SECP_R1_256
	select PSA_WANT_ECC_SECP_R1_384
	select PSA_WANT_ECC_MONTGOMERY_255

endchoice # PSA_CRYPTO_PROVIDER
```

## modules/jpegdec/Kconfig
```kconfig
# SPDX-FileCopyrightText: Copyright The Zephyr Project Contributors
# SPDX-License-Identifier: Apache-2.0

config ZEPHYR_JPEGDEC_MODULE
	bool

config JPEGDEC
	bool "JPEGDEC software JPEG decoder"
	depends on ZEPHYR_JPEGDEC_MODULE
	help
	  Software JPEG decoder from the jpegdec module. It decodes baseline
	  JPEG images, optionally cropped or scaled to 1/2, 1/4 or 1/8, and
	  decodes progressive images at 1/8 scale only. The decoder keeps its
	  state in a caller-owned structure and does not allocate memory.
```

## modules/jpegenc/Kconfig
```kconfig
# SPDX-FileCopyrightText: Copyright The Zephyr Project Contributors
# SPDX-License-Identifier: Apache-2.0

config ZEPHYR_JPEGENC_MODULE
	bool

config JPEGENC
	bool "JPEGENC software JPEG encoder"
	depends on ZEPHYR_JPEGENC_MODULE
	help
	  Software JPEG encoder from the jpegenc module. It encodes baseline
	  JPEG images with 4:4:4 or 4:2:0 chroma subsampling from grayscale,
	  RGB565, RGB888, ARGB8888, packed YUV422, planar YUV420 or NV12
	  input. The encoder keeps its state in a caller-owned structure and
	  does not allocate memory.
```
