## dts/bindings/usb/ite,it51xxx-usb.yaml
```yaml
# Copyright (c) 2026 ITE Corporation. All Rights Reserved.
# SPDX-License-Identifier: Apache-2.0

description: ITE IT51XXX USB in device mode

compatible: "ite,it51xxx-usb"

include: [pinctrl-device.yaml, usb-ep.yaml]

properties:
  reg:
    required: true

  interrupts-extended:
    required: true

  pinctrl-0:
    required: true

  pinctrl-names:
    required: true

  wucctrl:
    type: phandles
    description: |
      UDC node WUC interrupt.

  extend-ctrl:
    type: array
    description: |
      Extend control configuration for UDC pin mapping on some
      it51xxx SoCs. It is defined as: <reg_address enable_bit disable_bit>
```

## dts/bindings/usb/ite,it82xx2-usb.yaml
```yaml
description: |
    ITE IT82XX2 USB in device mode

compatible: "ite,it82xx2-usb"

include: [base.yaml, pinctrl-device.yaml, usb-ep.yaml]

properties:
  reg:
    required: true

  interrupts:
    required: true

  pinctrl-0:
    required: true

  pinctrl-names:
    required: true

  wucctrl:
    type: phandles
    description: |
      usbd node WUC interrupt.
```

## dts/bindings/usb/maxim,max3421e_spi.yaml
```yaml
# Copyright (c) 2021 Nordic Semiconductor ASA
# SPDX-License-Identifier: Apache-2.0

description: |
    MAX3421E USB Peripheral/Host Controller controller with SPI interface

compatible: "maxim,max3421e_spi"

include: [spi-device.yaml]

properties:
  int-gpios:
    type: phandle-array
    required: true
    description: |
      Interrupt pin of MAX3421E, active low.
      If connected directly the MCU pin should be configured
      as active low.

  reset-gpios:
    type: phandle-array
    description: |
      RESET pin of MAX3421E, active low.
      If connected directly the MCU pin should be configured
      as active low.
```

## dts/bindings/usb/microchip,pic32cxsg-usb.yaml
```yaml
description: |
    Microchip PIC32CXSG USB in device mode

compatible: "microchip,pic32cxsg-usb"

include:
  - name: usb-ep.yaml
  - name: pinctrl-device.yaml

properties:
  reg:
    required: true

  interrupts:
    required: true
```

## dts/bindings/usb/microchip,sam-udc.yaml
```yaml
# Copyright (C) 2025-2026 Microchip Technology Inc. and its subsidiaries
#
# SPDX-License-Identifier: Apache-2.0
#

description: Microchip SAM UDPHS USB Device High Speed Port

compatible: "microchip,sam-udphs"

include:
  - name: usb-ep.yaml
  - name: pinctrl-device.yaml

properties:
  reg:
    required: true

  interrupts:
    required: true

  clocks:
    required: true
```

## dts/bindings/usb/microchip,sam-udphs.yaml
```yaml
# Copyright (C) 2025-2026 Microchip Technology Inc. and its subsidiaries
#
# SPDX-License-Identifier: Apache-2.0
#

description: |
  Microchip SAM UDPHS USB Device High Speed Port

examples:
  - |
    Example devicetree configuration:

      &pinctrl {
        pinctrl_usba_vbus_det: usba_vbus_det {
          pinmux = <PIN_PD11__GPIO>;
          bias-disable;
        };
      };

      zephyr_udc0: &udphsa {
        vbus-gpios = <&piod 11 GPIO_ACTIVE_HIGH>;
        pinctrl-names = "default";
        pinctrl-0 = <&pinctrl_usba_vbus_det>;
        status = "okay";
      };

compatible: "microchip,sam-udphs"

include:
  - name: usb-ep.yaml
  - name: pinctrl-device.yaml

properties:
  reg:
    required: true

  interrupts:
    required: true

  clocks:
    required: true

  dma-disable:
    type: boolean
    description: |
      Force disable DMA function, data will be transferred via FIFO.
```

## dts/bindings/usb/nordic,nrf-usbd.yaml
```yaml
# Copyright (c) 2018, Sundar Subramaniyan <sundar.subramaniyan@gmail.com>
# SPDX-License-Identifier: Apache-2.0

description: |
    Nordic nRF52 USB device controller

compatible: "nordic,nrf-usbd"

include: usb-ep.yaml

properties:
  reg:
    required: true

  interrupts:
    required: true

  num-isoin-endpoints:
    type: int
    required: true
    description: Number of ISOIN endpoints supported by hardware

  num-isoout-endpoints:
    type: int
    required: true
    description: Number of ISOOUT endpoints supported by hardware
```

## dts/bindings/usb/nordic,nrf-usbhs-bc12.yaml
```yaml
# Copyright (c) 2025 Nordic Semiconductor ASA
# SPDX-License-Identifier: Apache-2.0

description: Nordic USB PD Charging-Type Detector

compatible: "nordic,nrf-usbhs-bc12"

include: [usb-bc12.yaml]
```

## dts/bindings/usb/nordic,nrf-usbhs-wrapper.yaml
```yaml
description: |
  Nordic wrapper for USB controller and PHY hardware. The wrapper is used to
  configure, control, and enable/disable the USB PHY, and to enable/disable USB
  controller.

compatible: "nordic,nrf-usbhs-wrapper"

include: [base.yaml]

properties:
  reg:
    required: true

  regulator:
    required: true
    type: phandle
    description: |
      USB PHY and controller function depends on the USB regulator VREGUSB.
```

## dts/bindings/usb/nuvoton,nct-usbd.yaml
```yaml
# Copyright (c) 2025 Nuvoton Technology Corporation.
# SPDX-License-Identifier: Apache-2.0

description: |
    Nuvoton, NCT-USBD node

compatible: "nuvoton,nct-usbd"

include: [base.yaml, pinctrl-device.yaml, usb-ep.yaml]

properties:
  reg:
    required: true

  interrupts:
    required: true

  pinctrl-0:
    required: true

  pinctrl-names:
    required: true

  usbd-ram-size:
    type: int
    required: true
    description: Configurable RAM used as endpoint buffer (including EP0)
```

## dts/bindings/usb/nuvoton,npcm-usbd.yaml
```yaml
# Copyright (c) 2024 Nuvoton Technology Corporation.
# SPDX-License-Identifier: Apache-2.0

description: |
    Nuvoton, NPCM-USBD node

compatible: "nuvoton,npcm-usbd"

include: [base.yaml, pinctrl-device.yaml, usb-ep.yaml]

properties:
  reg:
    required: true

  interrupts:
    required: true

  pinctrl-0:
    required: true

  pinctrl-names:
    required: true

  usbd-ram-size:
    type: int
    required: true
    description: Configurable RAM used as endpoint buffer (including EP0)
```

## dts/bindings/usb/nuvoton,numaker-hsusbd.yaml
```yaml
# Copyright (c) 2022 Nuvoton Technology Corporation
# SPDX-License-Identifier: Apache-2.0

description: Nuvoton NuMaker high-speed USB 2.0 device controller

compatible: "nuvoton,numaker-hsusbd"

include: [usb-ep.yaml, reset-device.yaml, pinctrl-device.yaml]

properties:
  reg:
    required: true

  interrupts:
    required: true

  resets:
    required: true

  clocks:
    required: true

  dma-buffer-size:
    type: int
    required: true
    description: |
      Size of DMA buffer in bytes

  allow-disable-usb-on-unplug:
    type: boolean
    description: |
      Supports USB controller can be disabled temporarily when USB cable is unplugged
      and then enabled back when the cable is re-plugged.

  disable-vbus-detect:
    type: boolean
    description: |
      Nuvoton HSUSBD peripheral supports VBUS detect functionality, but some PCB designs
      may choose to use mutually exclusive USB-C peripheral for VBUS detection.
      In this case, the USB controller backed VBUS detect functionality won't work and
      needs to be disabled.
```

## dts/bindings/usb/nuvoton,numaker-usbd.yaml
```yaml
# Copyright (c) 2022 Nuvoton Technology Corporation
# SPDX-License-Identifier: Apache-2.0

description: Nuvoton NuMaker USB 1.1 device controller

compatible: "nuvoton,numaker-usbd"

include: [usb-ep.yaml, reset-device.yaml, pinctrl-device.yaml]

properties:
  reg:
    required: true

  interrupts:
    required: true

  resets:
    required: true

  clocks:
    required: true

  dma-buffer-size:
    type: int
    required: true
    description: |
      Size of DMA buffer in bytes

  disallow-iso-in-out-same-number:
    type: boolean
    description: |
      Some soc series don't allow Isochronous IN/OUT endpoints to be assigned the same numbers,
      for example, 0x82 (for Isochronous IN) and 0x02 (for Isochronous OUT) are disallowed.

  allow-disable-usb-on-unplug:
    type: boolean
    description: |
      Supports USB controller can be disabled temporarily when USB cable is unplugged
      and then enabled back when the cable is re-plugged.

  disable-vbus-detect:
    type: boolean
    description: |
      Nuvoton USBD peripheral supports VBUS detect functionality, but some PCB designs
      may choose to use mutually exclusive USB-C peripheral for VBUS detection.
      In this case, the USB controller backed VBUS detect functionality won't work and
      needs to be disabled.
```

## dts/bindings/usb/nxp,ehci.yaml
```yaml
# Copyright 2023,2025 NXP
# SPDX-License-Identifier: Apache-2.0

description: NXP EHCI USB device mode

compatible: nxp,ehci

include: "nxp,mcux-usbd.yaml"

properties:
  phy-handle:
    type: phandle

  clock-rates:
    type: array
    description: |
      Optional rate given to each clock provider in the "clocks" property.
```

## dts/bindings/usb/nxp,kinetis-usbd.yaml
```yaml
# Copyright (c) 2018 PHYTEC Messtechnik GmbH
# SPDX-License-Identifier: Apache-2.0

description: |
    NPX Kinetis USBFSOTG Controller in device mode

compatible: "nxp,kinetis-usbd"

include: usb-ep.yaml

properties:
  reg:
    required: true

  interrupts:
    required: true

  no-voltage-regulator:
    type: boolean
    description: Indicates that USB voltage regulator is not present.
```

## dts/bindings/usb/nxp,lpc-otg.yaml
```yaml
# Private Porting
# by David Hor - Xtooltech 2025
# david.hor@xtooltech.com

# Copyright (c) 2024 NXP
# SPDX-License-Identifier: Apache-2.0

description: NXP LPC USB OTG Controller

compatible: "nxp,lpc-otg"

include: base.yaml

properties:
  id-gpios:
    type: phandle-array
    description: |
      GPIO pin for USB ID detection.
      ID pin low indicates host mode, high indicates device mode.

  vbus-gpios:
    type: phandle-array
    description: |
      GPIO pin for VBUS control.
      Used to enable/disable VBUS power in host mode.

  host-controller:
    type: phandle
    description: |
      Reference to the USB host controller device.

  device-controller:
    type: phandle
    description: |
      Reference to the USB device controller device.
```

## dts/bindings/usb/nxp,lpc-usbd.yaml
```yaml
# Copyright (c) 2018 PHYTEC Messtechnik GmbH
# SPDX-License-Identifier: Apache-2.0

title: NXP LPC USBD

description: >
    NPX LPC USBFSOTG Controller in device mode

compatible: "nxp,lpc-usbd"

include: usb-ep.yaml

properties:
    reg:
      required: true

    interrupts:
      required: true
```

## dts/bindings/usb/nxp,lpcip3511.yaml
```yaml
# Copyright 2023 NXP
# SPDX-License-Identifier: Apache-2.0

description: NXP LPCIP3511 USB device mode

compatible: nxp,lpcip3511

include: "nxp,mcux-usbd.yaml"
```

## dts/bindings/usb/nxp,mcux-usbd.yaml
```yaml
# Copyright (c) 2021 NXP
# SPDX-License-Identifier: Apache-2.0

description: |
    NPX MXRT and LPC USBOTG Controller in device mode

include: [usb-ep.yaml, pinctrl-device.yaml]

properties:
  reg:
    required: true

  interrupts:
    required: true
```

## dts/bindings/usb/nxp,uhc-ehci.yaml
```yaml
# Copyright  2024 NXP
# SPDX-License-Identifier: Apache-2.0

description: NXP EHCI USB host controller

compatible: "nxp,uhc-ehci"

include: [usb-controller.yaml]

properties:
  phy-handle:
    type: phandle

  clock-rates:
    type: array
    description: |
      Optional rate given to each clock provider in the "clocks" property.
```

## dts/bindings/usb/nxp,uhc-ip3516hs.yaml
```yaml
# # Copyright  2024 NXP
# SPDX-License-Identifier: Apache-2.0

description: NXP IP3516HS USB host controller

compatible: "nxp,uhc-ip3516hs"

include: [usb-controller.yaml, pinctrl-device.yaml]

properties:
  phy_handle:
    type: phandle
```

## dts/bindings/usb/nxp,uhc-khci.yaml
```yaml
# # Copyright  2024 NXP
# SPDX-License-Identifier: Apache-2.0

description: NXP KHCI USB host controller

compatible: "nxp,uhc-khci"

include: [usb-controller.yaml]
```

## dts/bindings/usb/nxp,uhc-ohci.yaml
```yaml
# # Copyright  2024 NXP
# SPDX-License-Identifier: Apache-2.0

description: NXP OHCI USB host controller

compatible: "nxp,uhc-ohci"

include: [usb-controller.yaml, pinctrl-device.yaml]
```

## dts/bindings/usb/nxp,usbphy.yaml
```yaml
# Copyright  2024 NXP
# SPDX-License-Identifier: Apache-2.0

description: |
  NXP USB high speed phy that is used on NXP RTxxxx, RTxxx, MCX, LPC and Kinetis
  platforms if high speed usb is supported on these platforms.
  Note: Only some LPC plafforms use it (like: LPC55S69, LPC55S28 and LPC55S16 etc).

compatible: "nxp,usbphy"

include: base.yaml

properties:
  tx-d-cal:
    type: int
    required: true
    description: |
      It is board level's value that is used to trim the nominal 17.78mA
      current source for the High Speed TX drivers on USB_DP and USB_DM.

  tx-cal-45-dp-ohms:
    type: int
    required: true
    description: |
      It is board level's value that is used to trim the nominal 17.78mA
      current source for the High Speed TX drivers on USB_DP and USB_DM.

  tx-cal-45-dm-ohms:
    type: int
    required: true
    description: |
      It is board level's value that is used to trim the nominal 17.78mA
      current source for the High Speed TX drivers on USB_DP and USB_DM.
```

## dts/bindings/usb/quectel,userial.yaml
```yaml
# Copyright (c) 2025 Quectel Wireless Solutions Co
# SPDX-License-Identifier: Apache-2.0

description: USBH QUECTEL DRIVER

compatible: "quectel,stm32-userial-driver"
```
