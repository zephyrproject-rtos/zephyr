## dts/bindings/usb/zephyr,udc.yaml
```yaml
# Copyright (c) 2026 Leica Geosystems AG
# SPDX-License-Identifier: Apache-2.0

description: |
  Generic USB Device Controller (UDC) marker.

  This compatible can be added as a secondary compatible to any USB device
  controller to enable auto-discovery via DT_FOREACH_STATUS_OKAY(zephyr_udc, fn).

  Example usage in devicetree:
    zephyr_udc0: &usbotg_hs {
      compatible = "st,stm32-otghs", "zephyr,udc";
      ...
    };

  Example iteration in C code:
    #define UDC_DEVICE_GET(node_id) DEVICE_DT_GET(node_id),
    static const struct device *const all_udc_devices[] = {
      DT_FOREACH_STATUS_OKAY(zephyr_udc, UDC_DEVICE_GET)
    };

compatible: "zephyr,udc"

include: base.yaml
```

## dts/bindings/usb/zephyr,uhc-virtual.yaml
```yaml
# Copyright (c) 2022 Nordic Semiconductor ASA
# SPDX-License-Identifier: Apache-2.0

description: Virtual USB host controller

compatible: "zephyr,uhc-virtual"

include: usb-controller.yaml
```

## dts/bindings/usb/zephyr,usb-hid.yaml
```yaml
# Copyright (c) 2022 Meta Platforms
# SPDX-License-Identifier: Apache-2.0

description: |
    Common fields for USB HID devices

compatible: "zephyr,usb-hid"

properties:

    ep-mps-in:
      type: int
      default: 16
      description: |
        USB HID Device interrupt endpoint size for IN EP

    poll-interval-in:
      type: int
      default: 9
      description: |
        USB HID Device polling interval defined in the USB Descriptor for IN EP

    int-out-ep:
      type: boolean
      description: |
        Enable USB HID Device Interrupt OUT Endpoint.

    ep-mps-out:
      type: int
      default: 16
      description: |
        USB HID Device interrupt endpoint size for OUT EP

    poll-interval-out:
      type: int
      default: 9
      description: |
        USB HID Device polling interval defined in the USB Descriptor for OUT EP

    boot-protocol:
      type: boolean
      description: |
        Sets bInterfaceSubClass to 1 and enables Set_Protocol and Get_Protocol
        requests handling.
        See Chapter 4.2 of Device Class Definition for Human Interface Devices 1.11
        for more information.
```

## dts/bindings/usb/zephyr,usb-midi.yaml
```yaml
# Copyright (c) 2024 Titouan Christophe
# SPDX-License-Identifier: Apache-2.0

description: USB MIDI Class

compatible: "zephyr,usb-midi"

properties:
  "#address-cells":
    type: int
    const: 1

  "#size-cells":
    type: int
    const: 1

child-binding:
  description: |
    USB MIDI Group terminal block.
    This represent a set of contiguous Universal MIDI groups through which the
    device exchange Universal MIDI Packets with the host.

  properties:
    reg:
      type: array
      required: true
      description: |
        First MIDI Group number (address) and number of Group Terminals (size)
        in this USB-MIDI Group Terminal Block.
        The MIDI Groups 1 to 16 corresponds to address 0x0 to 0xf. There are at
        most 16 addressable groups (of 16 channels each) per USB-MIDI interface

    protocol:
      type: string
      enum:
      - "use-midi-ci"
      - "midi1-up-to-64b"
      - "midi1-up-to-128b"
      - "midi2"
      description: |
        Default MIDI protocol of the Group Terminals in this Block

    terminal-type:
      type: string
      default: "bidirectional"
      enum:
      - "bidirectional"
      - "input-only"
      - "output-only"
      description: |
        Type (data direction) of Group Terminals in this Block.
```

## dts/bindings/usb/zephyr,usb-vbus-detect-gpio.yaml
```yaml
# Copyright (c) 2026 Leica Geosystems AG
# SPDX-License-Identifier: Apache-2.0

description: GPIO-based USB VBUS detection

compatible: "zephyr,usb-vbus-detect-gpio"

include: base.yaml

properties:
  vbus-gpios:
    type: phandle-array
    required: true
    description: GPIO pin for VBUS sensing

  udc:
    type: phandles
    required: true
    description: |
      List of USB device controllers to receive VBUS events.
      All devices in this list will be notified when VBUS state changes.

  debounce-ms:
    type: int
    default: 20
    description: Debounce interval in milliseconds
```

## dts/bindings/usb/zephyr,usbh-cdc-ecm.yaml
```yaml
# Copyright (c) 2025 Linumiz GmbH
# SPDX-License-Identifier: Apache-2.0

description: |
  USB Host CDC Ethernet Control Model (ECM) implementation.
  Supports communication with CDC ECM-compliant USB Ethernet devices.

compatible: "zephyr,usbh-cdc-ecm"

include: base.yaml

properties:
  local-mac-address:
    type: uint8-array
    description: "Local MAC address for the CDC ECM device"
```

## dts/bindings/usb/zephyr,usbh-serial.yaml
```yaml
# Copyright (c) 2026 Linumiz
# SPDX-License-Identifier: Apache-2.0

description: |
 USB Host Vendor class serial support.

compatible: "zephyr,usbh-serial"

include: base.yaml
```

## dts/bindings/usb/zephyr,usbip-udc.yaml
```yaml
# Copyright (c) 2021 Nordic Semiconductor ASA
# Copyright (c) 2022 YuLong Yao <feilongphone@gmail.com>
# SPDX-License-Identifier: Apache-2.0

description: USB device controller Over IP

compatible: "zephyr,usbip-udc"

include: usb-controller.yaml
```

## dts/bindings/usb/zephyr,uvc-device.yaml
```yaml
# Copyright (c) 2025 tinyVision.ai Inc.
# SPDX-License-Identifier: Apache-2.0

description: |
  USB Video Class (UVC) device instance.

  Each UVC instance added to the USB Device Controller (UDC) node will be visible
  as a new camera from the host point of view.

compatible: "zephyr,uvc-device"

include: base.yaml
```

## dts/bindings/usb/zephyr,uvc-host.yaml
```yaml
# Copyright (c) 2025 Nordic Semiconductor ASA
# SPDX-License-Identifier: Apache-2.0

description: |
  USB Video Class (UVC) host instance.

  Each UVC instance added to the USB Host Controller (UHC) node will be visible
  as a new camera from Zephyr point of view.

  as soon as a camera is connected to USB this device will be usable by the application as a
  video device, following the video API.

compatible: "zephyr,uvc-host"

include: base.yaml
```

## dts/bindings/usbh/atmel,sam0-usbh.yaml
```yaml
# Copyright (c) 2020 PHYTEC Messtechnik GmbH
# SPDX-License-Identifier: Apache-2.0

include: usbh.yaml

compatible: "atmel,sam0-usbh"
properties:
        reg:
                required: true

        interrupts:

                required: true

        buf-len:
                type: int
                required: true

        nbr-ep-bulk:
                type: int
                required: true

        nbr-ep-intr:
                type: int
                required: true

        nbr-isoc-ep:
                type: int
                required: true
```

## dts/bindings/usbh/nxp,kinetis-usbh.yaml
```yaml
# Copyright (c) 2020 PHYTEC Messtechnik GmbH
# SPDX-License-Identifier: Apache-2.0

include: usbh.yaml

compatible: "nxp,kinetis-usbh"
properties:
        reg:
                required: true

        interrupts:

                required: true

        buf-len:
                type: int
                required: true

        nbr-ep-bulk:
                type: int
                required: true

        nbr-ep-intr:
                type: int
                required: true

        nbr-isoc-ep:
                type: int
                required: true

        dma:
                type: boolean
                required: false
        mem_addr:
                type: int
                required: true
        mem_size:
                type: int
                required: true
```

## dts/bindings/usbh/usbh.yaml
```yaml
# Copyright (c) 2020 PHYTEC Messtechnik GmbH
# SPDX-License-Identifier: Apache-2.0

include: base.yaml

description: USB-Host

properties:
        label:
                required: true

        status:
                required: false
```

## dts/bindings/vhost/xen,virtio-mmio.yaml
```yaml
# Copyright (c) 2025 TOKITA Hiroshi
# SPDX-License-Identifier: Apache-2.0

description: Xen VHost MMIO device for VIRTIO backends

compatible: "xen,vhost-mmio"

include: base.yaml

properties:
  base:
    type: int
    required: true
    description: |
      Guest physical base address of the virtio MMIO register region used by
      this Xen vhost-mmio device.

  num-queues:
    type: int
    required: true
    description: |
      Number of virtqueues exposed by this device instance.

  queue-size-max:
    type: int
    required: true
    description: |
      Maximum number of entries supported in each virtqueue for this device.

  device-id:
    type: int
    required: true
    description: |
      Virtio device ID value, as defined by the VIRTIO Specification, used to
      identify the type of device implemented by this vhost-mmio instance.

  vendor-id:
    type: int
    default: 0
    description: |
      Virtio vendor ID value reported by the device. A value of 0 selects the
      implementation-defined or Xen-provided default vendor ID.

  stack-size:
    type: int
    description: |
      Stack size (in bytes) for the instance-specific work_q thread.

  priority:
    type: int
    description: |
      Priority for the instance-specific work_q thread.

  config-data:
    type: uint8-array
    description: |
     Configuration at 0x100+ in the '4.2.2 MMIO Device Register Layout' section
     of the VIRTIO Specification.
```

## dts/bindings/video/aptina,mt9m114.yaml
```yaml
# Copyright (c) 2019, Linaro Limited
# Copyright 2024 NXP
#
# SPDX-License-Identifier: Apache-2.0

description: MT9M114 CMOS video sensor

compatible: "aptina,mt9m114"

include: i2c-device.yaml

child-binding:
  child-binding:
    include: video-interfaces.yaml
```

## dts/bindings/video/arducam,mega.yaml
```yaml
# ARDUCAM_MEGA

# Copyright (c) 2023 Arducam Technology Co., Ltd. <www.arducam.com>
# SPDX-License-Identifier: Apache-2.0

description: Arducam Mega CMOS video sensor

compatible: "arducam,mega"

include: spi-device.yaml
```

## dts/bindings/video/espressif,esp32-cam.yaml
```yaml
#
# Copyright (c) 2024 espros photonics Co.
#
# SPDX-License-Identifier: Apache-2.0
#

description: esp32 LCD CAM Peripheral interface

compatible: "espressif,esp32-lcd-cam"

include: [base.yaml, pinctrl-device.yaml]

properties:
  source:
    required: true
    type: phandle
    description: Connected source device, i.e. camera sensor

  data-width:
    type: int
    description: Camera input data width. 8/16 bits
    enum: [8, 16]

  invert-byte-order:
    type: boolean
    description: invert byte order in 16bit mode

  invert-bit-order:
    type: boolean
    description: invert bit order

  invert-pclk:
    type: boolean
    description: invert pixel clock signal

  invert-de:
    type: boolean
    description: invert data enable signal

  invert-hsync:
    type: boolean
    description: invert hsync signal

  invert-vsync:
    type: boolean
    description: invert vsync signal

  cam-clk:
    type: int
    description: camera clock frequency
```

## dts/bindings/video/heimann,htpa-120x84.yaml
```yaml
# Copyright (c) 2026 sensry.io
# SPDX-License-Identifier: Apache-2.0

compatible: "heimann,htpa-120x84"

include:
  - name: heimann,htpa-common.yaml
```

## dts/bindings/video/heimann,htpa-160x120.yaml
```yaml
# Copyright (c) 2026 sensry.io
# SPDX-License-Identifier: Apache-2.0

compatible: "heimann,htpa-160x120"

include:
  - name: heimann,htpa-common.yaml
```

## dts/bindings/video/heimann,htpa-common.yaml
```yaml
# Copyright (c) 2026 sensry.io
# SPDX-License-Identifier: Apache-2.0

description: Heimann HTPA IR Camera

include:
  - name: spi-device.yaml
  - name: video-interfaces.yaml
  - name: nvmem-consumer.yaml

properties:
  calibration-flash:
    type: phandle
    required: true
    description: Flash device containing sensor calibration data
```

## dts/bindings/video/himax,hm01b0.yaml
```yaml
#
# Copyright The Zephyr Project Contributors
#
# SPDX-License-Identifier: Apache-2.0
#

description: |
    Himax HM01B0 video sensor.

compatible: "himax,hm01b0"

include: i2c-device.yaml

child-binding:
  child-binding:
    include: video-interfaces.yaml
    properties:

      bus-width:
        type: int
        default: 8
        description: |
          Maximum number of parallel pins, 1, 4 or 8.

          Depending on the bus width, different modes can be selected by choosing a pixel format:

          When 8-bit (default) mode is used:

          - 8-bit mode gives 1 byte per pixel, no padding
          - 4-bit mode gives 2 bytes per pixel, 4-bit data, 4-bit zero,
          - 1-bit mode gives 8 bytes per pixel, 1-bit data, 7-bit zero,

          When 4-bit mode is used (with compatible receiver):

          - 4-bit mode gives 1 byte per pixel, no padding
          - 1-bit mode gives 4 bytes per pixel, 1-bit data, 3-bit zero, 1-bit data, 3-bit zero,

          When 1-bit mode is used (with compatible receiver):

          - 1-bit mode gives 1 byte per pixel, no padding

        enum: [1, 4, 8]

examples:
  - |
    &i2c0 {
      status = "okay";
      hm01b0: hm01b0@24 {
        compatible = "himax,hm01b0";
        reg = <0x24>;
        status = "okay";
        port {
          hm01b0_ep_out: endpoint {
            remote-endpoint-label = "video_pio_dma_ep_in";
            bus-width = <4>;
          };
        };
      };
    };
```

## dts/bindings/video/himax,hm0360.yaml
```yaml
#
# Copyright The Zephyr Project Contributors
#
# SPDX-License-Identifier: Apache-2.0
#

description: |
  HM0360 CMOS video sensor.

  Example of node configuration:

  &i2c4
  {
    status = "okay";
    hm0360: hm0360@24{
      compatible = "himax,hm0360";
      reg = <0x24>;
      status = "okay";
      reset-gpios = <&gpiod 4 GPIO_ACTIVE_LOW>;
      pwdn-gpios = <&gpioa 1 GPIO_ACTIVE_LOW>;
      port {
        hm0360_ep_out: endpoint {
          remote-endpoint-label = "video_pio_dma_ep_in";
        };
      };
    };
  };

compatible: "himax,hm0360"

include: i2c-device.yaml

properties:
  reset-gpios:
    type: phandle-array
    description: |
      The RESETn pin is asserted to disable the sensor causing a hard
      reset. The sensor receives this as an active-low signal.
  pwdn-gpios:
    type: phandle-array
    description: |
      The PWRDN or PWDN pin is asserted to power down the sensor. The sensor
      receives this as an active high signal

child-binding:
  child-binding:
    include: video-interfaces.yaml
```
