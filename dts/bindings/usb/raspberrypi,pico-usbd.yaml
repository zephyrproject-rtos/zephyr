## dts/bindings/usb/st,stm32u5-otghs.yaml
```yaml
# Copyright (c) 2025, STMicroelectronics
# SPDX-License-Identifier: Apache-2.0

description: STM32U5 OTGHS controller

compatible: "st,stm32u5-otghs"

include: st,stm32-otghs.yaml

properties:
  physel:
    type: string
    required: true
    enum:
      - "USB_FS_EMBEDDED_PHY"
      - "USB_OTG_HS_EMBEDDED_PHY"
    description: |
      USB PHY interface to use.

      The following interfaces are supported:
        - "USB_FS_EMBEDDED_PHY": on-chip full-speed PHY.
        - "USB_OTG_HS_EMBEDDED_PHY": on-chip high-speed PHY.
```
