## dts/bindings/usb/raspberrypi,pico-usbd.yaml
```yaml
# Copyright (c) 2021, Pete Johanson
# SPDX-License-Identifier: Apache-2.0

description: |
  RaspberryPi Pico USB Device Controller.

  Example of enabling the controller with vbus detection:

    &pinctrl {
      usb_default: usb_default {
        group1 {
          pinmux = <USB_VBUS_DET_P1>;
          input-enable;
        };
      };
    };

    zephyr_udc0: &usbd {
      status = "okay";
      pinctrl-0 = <&usb_default>;
      pinctrl-names = "default";
    };

compatible: "raspberrypi,pico-usbd"

include: [usb-ep.yaml, reset-device.yaml, pinctrl-device.yaml]

properties:
  reg:
    required: true

  interrupts:
    required: true
```

## dts/bindings/usb/realtek,rts5817-usbd.yaml
```yaml
# Copyright (c) 2026 Realtek Semiconductor, Inc.
# SPDX-License-Identifier: Apache-2.0

description: |
  RTS5817 usb device controller

compatible: "realtek,rts5817-usbd"

include: usb-ep.yaml

properties:
  reg:
    required: true

  interrupts:
    required: true

  num-endpoints:
    type: int
    required: true
    description: |
      Number of endpoints supported by hardware
      (including EP0)
```

## dts/bindings/usb/renesas,smartbond-usbd.yaml
```yaml
# Copyright (c) 2022 Renesas Electronics Corporation
# SPDX-License-Identifier: Apache-2.0

description: Renesas SmartBond USB device controller

compatible: "renesas,smartbond-usbd"

include: usb-ep.yaml

properties:
  dma-min-transfer-size:
    type: int
    description: |
      Minimum transfer size required to engage DMA.

  ep-out-buf-size:
    type: array
    required: true
    description: |
      Buffer size for OUT end points 0-3.

  fifo-read-threshold:
    type: int
    description: |
      RX FIFO is 64 bytes. When endpoint size is greater then 64,
      FIFO warning interrupt is enabled to allow read incoming data
      during frame reception.
      It is possible to stay in interrupt reading whole packet at once,
      but it may be more efficient for MCU to read as much data as
      possible and when FIFO is hardly filled exit interrupt handler
      waiting for next FIFO warning level interrupt or packet end.
      When running at 96MHz code that reads FIFO based on number of
      bytes stored in USB_RXSx_REG.USB_RXCOUNT takes enough time to
      fill FIFO with two additional bytes.
      Settings this threshold above this allows to leave interrupt
      handler and wait for more bytes before next ISR. This allows
      reduce overall ISR time to 1/3 of time that would be needed
      if ISR read as fast as possible.

  iso-out-mps:
    type: int
    description: |
      Max packet size for ISO out endpoint
```

## dts/bindings/usb/renesas/renesas,ra-uhc.yaml
```yaml
# Copyright (c) 2024 Renesas Electronics Corporation
# SPDX-License-Identifier: Apache-2.0

description: Renesas RA USB host controller

compatible: "renesas,ra-uhc"

properties:
  usb-devices-count:
    type: int
    description: |
      Number of USB devices supported by hardware
```

## dts/bindings/usb/renesas/renesas,ra-usb.yaml
```yaml
# Copyright (c) 2024 Renesas Electronics Corporation
# SPDX-License-Identifier: Apache-2.0

description: Renesas RA USB controller

compatible: "renesas,ra-usb"

include: [pinctrl-device.yaml, usb-ep.yaml]

properties:
  reg:
    required: true

  phys:
    type: phandle
    description: PHY provider specifier
```

## dts/bindings/usb/renesas/renesas,ra-usbfs.yaml
```yaml
# Copyright (c) 2024 Renesas Electronics Corporation
# SPDX-License-Identifier: Apache-2.0

description: Renesas RA USB full-speed controller

compatible: "renesas,ra-usbfs"

include: [pinctrl-device.yaml, usb-ep.yaml]

properties:
  phys-clock:
    type: phandles
    required: true
    description: USBFS physical clock.

  interrupts:
    required: true
    description: |
      IRQ number and priority to use for USBFS.

  interrupt-names:
    required: true
    enum:
      - "usbfs-i"
      - "usbfs-r"
    description: |
      Interrupts must be given corresponding names so that the shim driver can recognize them.

  reg:
    required: true

  phys:
    type: phandle
    description: PHY provider specifier
```

## dts/bindings/usb/renesas/renesas,ra-usbhs.yaml
```yaml
# Copyright (c) 2024 Renesas Electronics Corporation
# SPDX-License-Identifier: Apache-2.0

description: Renesas RA USB high-speed controller

compatible: "renesas,ra-usbhs"

include: [pinctrl-device.yaml, usb-ep.yaml]

properties:
  phys-clock:
    type: phandles
    description: |
      USBHS physical clocks. Should be provided in case internal clock source is set in phys node.

  interrupts:
    required: true
    description: |
      IRQ number and priority to use for USBHS.

  interrupt-names:
    required: true
    enum:
      - "usbhs-ir"
    description: |
      Interrupts must be given corresponding names so that the shim driver can recognize them.

  reg:
    required: true

  phys:
    type: phandle
    description: PHY provider specifier
```

## dts/bindings/usb/sifli,sf32lb-usbd.yaml
```yaml
# Copyright (c) 2026 SiFli Technologies(Nanjing) Co., Ltd.
# SPDX-License-Identifier: Apache-2.0

description: SiFli SF32LB USB device controller

compatible: "sifli,sf32lb-usbd"

include: [usb-ep.yaml, pinctrl-device.yaml, sifli-sf32lb-cfg.yaml]

properties:
  reg:
    required: true

  interrupts:
    required: true

  pinctrl-0:
    required: true

  pinctrl-names:
    required: true

  clocks:
    required: true

  sifli,cfg:
    required: true
```

## dts/bindings/usb/snps,designware-usb.yaml
```yaml
# Copyright (c) 2019 Intel Corporation
# SPDX-License-Identifier: Apache-2.0

description: Synopsys Designware USB controller

compatible: "snps,designware-usb"

include: usb-ep.yaml

properties:
  reg:
    required: true

  interrupts:
    required: true
```

## dts/bindings/usb/snps,designware_usbh.yaml
```yaml
# Copyright (c) 2023 Intel Corporation
# SPDX-License-Identifier: Apache-2.0

description: Synopsys Designware USB Host Controller

compatible: "snps,designware_usbh"

include: [base.yaml, reset-device.yaml]

properties:
  reg:
    required: true

  interrupts:
    required: true
```

## dts/bindings/usb/snps,dwc-usbd.yaml
```yaml
#
# Copyright (c) 2018 Synopsys, Inc. All rights reserved.
#
# SPDX-License-Identifier: Apache-2.0
#
---
title: Synopsys DesignWare USBD
version: 0.1

description: >
    Synopsys DesignWare USB Controller in device mode

inherits:
    !include usb-ep.yaml

properties:
    compatible:
      constraint: "snps,dwc-usbd"

    reg:
      type: array
      description: mmio register space
      generation: define
      category: required

    interrupts:
      type: array
      category: required
      description: required interrupts
      generation: define

    interrupt-names:
      type: stringlist
      category: optional
      description: readable string describing the interrupts
      generation: define
...
```

## dts/bindings/usb/snps,dwc2-usbd.yaml
```yaml
#
# Copyright (c) 2018 Synopsys, Inc. All rights reserved.
#
# SPDX-License-Identifier: Apache-2.0
#
---
title: Synopsys DesignWare USBD
version: 0.2

description: >
    Synopsys DesignWare USB 2.0 Controller in device mode

inherits:
    !include usb-ep.yaml

properties:
    compatible:
      constraint: "snps,dwc2-usbd"

    reg:
      type: array
      description: mmio register space
      generation: define
      category: required

    interrupts:
      type: array
      category: required
      description: required interrupts
      generation: define

    interrupt-names:
      type: stringlist
      category: optional
      description: readable string describing the interrupts
      generation: define
...
```

## dts/bindings/usb/snps,dwc2.yaml
```yaml
# Copyright (c) 2023 Nordic Semiconductor ASA
# SPDX-License-Identifier: Apache-2.0

description: DesignWare OTG USB 2.0 controller

compatible: "snps,dwc2"

include: [base.yaml]

bus: usb

properties:
  reg:
    required: true

  interrupts:
    required: true

  phys:
    type: phandle

  num-in-eps:
    type: int
    required: true
    description: |
      Number of configured OUT endpoints including control endpoint.

  num-out-eps:
    type: int
    required: true
    description: |
      Number of configured IN endpoints including control endpoint.

  ghwcfg1:
    type: int
    required: true
    description: |
      Value of the GHWCFG1 register. It is used to determine available endpoint
      types during driver pre-initialization.

  ghwcfg2:
    type: int
    required: true
    description: |
      Value of the GHWCFG2 register. It is used to determine available endpoint
      types during driver pre-initialization.

  ghwcfg4:
    type: int
    required: true
    description: |
      Value of the GHWCFG4 register. It is used to determine available endpoint
      types during driver pre-initialization.
```

## dts/bindings/usb/st,stm32-otgfs.yaml
```yaml
# Copyright (c) 2017, I-SENSE group of ICCS
# SPDX-License-Identifier: Apache-2.0

description: STM32 OTGFS controller

compatible: "st,stm32-otgfs"

include: [usb-ep.yaml, pinctrl-device.yaml]

properties:
  reg:
    required: true

  interrupts:
    required: true

  pinctrl-0:
    required: true

  pinctrl-names:
    required: true

  ram-size:
    type: int
    required: true
    description: |
      Size of USB dedicated RAM. STM32 SOC's reference
      manual defines a shared FIFO size.

  phys:
    type: phandle
    description: PHY provider specifier

  clocks:
    required: true
```

## dts/bindings/usb/st,stm32-otghs-common.yaml
```yaml
# Copyright (c) 2025, STMicroelectronics
# SPDX-License-Identifier: Apache-2.0

# Common fields for STM32 OTGHS controller

include: [usb-ep.yaml, pinctrl-device.yaml]

properties:
  reg:
    required: true

  interrupts:
    required: true

  ram-size:
    type: int
    required: true
    description: |
      Size of USB dedicated RAM. STM32 SOC's reference
      manual defines a shared FIFO size.

  phys:
    type: phandle
    description: PHY provider specifier

  clocks:
    required: true

  dr-mode:
    type: string
    enum:
      - "host"
      - "peripheral"
      - "otg"
    description: |
      Select the USB data role exposed by this controller instance.

      "host" instantiates the STM32 OTG HS host controller driver.
      "peripheral" instantiates the STM32 device controller driver.
      "otg" marks the controller as dual-role capable and defers the
      active Zephyr stack selection to the STM32 OTG HS OTG-role Kconfig
      choice.

      If omitted, Zephyr keeps the historical STM32 OTG HS behavior and
      treats the controller as peripheral-only.
```

## dts/bindings/usb/st,stm32-otghs.yaml
```yaml
# Copyright (c) 2017, I-SENSE group of ICCS
# Copyright (c) 2025, STMicroelectronics
# SPDX-License-Identifier: Apache-2.0

description: STM32 OTGHS controller

compatible: "st,stm32-otghs"

include: st,stm32-otghs-common.yaml

properties:
  pinctrl-0:
    required: true

  pinctrl-names:
    required: true
```

## dts/bindings/usb/st,stm32-usb.yaml
```yaml
# Copyright (c) 2017, I-SENSE group of ICCS
# SPDX-License-Identifier: Apache-2.0

description: STM32 USB controller

compatible: "st,stm32-usb"

include: [usb-ep.yaml, pinctrl-device.yaml]

properties:
  reg:
    required: true

  interrupts:
    required: true

  ram-size:
    type: int
    required: true
    description: |
      Size of USB dedicated RAM. STM32 SOC's reference
      manual defines USB packet SRAM size.

  disconnect-gpios:
    type: phandle-array
    description: |
      Some boards use a USB DISCONNECT pin to enable
      the pull-up resistor on USB Data Positive signal.

  phys:
    type: phandle
    description: PHY provider specifier

  clocks:
    required: true
```

## dts/bindings/usb/st,stm32f4-fsotg.yaml
```yaml
# Copyright (c) 2023 Nordic Semiconductor ASA
# SPDX-License-Identifier: Apache-2.0
#
description: STM32F4 OTG_FS DWC2 compatible controller.

compatible: "st,stm32f4-fsotg"

include: ["snps,dwc2.yaml", pinctrl-device.yaml]

properties:
  clocks:
    required: true

  pinctrl-0:
    required: true

  pinctrl-names:
    required: true
```

## dts/bindings/usb/st,stm32f4-otghs.yaml
```yaml
# Copyright (c) 2025, STMicroelectronics
# SPDX-License-Identifier: Apache-2.0

description: STM32F4 OTGHS controller

compatible: "st,stm32f4-otghs"

include: st,stm32-otghs.yaml

properties:
  phy-type:
    type: string
    required: true
    enum:
      - "USB_OTG_ULPI_PHY"
      - "USB_OTG_PHY_EMBEDDED"
    description: |
      ST STM32F4 USB
      OTG_HS supports the following PHY interfaces:
        - "USB_OTG_ULPI_PHY": an UTMI+ Low Pin Interface for external high-speed PHY.
        - "USB_OTG_PHY_EMBEDDED": an on-chip full-speed PHY.
```

## dts/bindings/usb/st,stm32f7-hsotg.yaml
```yaml
# SPDX-FileCopyrightText: Copyright The Zephyr Project Contributors
# SPDX-License-Identifier: Apache-2.0

description: |
  STM32F7 OTG_HS DWC2 compatible controller. The high-speed PHY is selected
  by the "phys" phandle: "st,stm32-usbphyc" node for the embedded HS PHY,
  or "usb-ulpi-phy" node for an external ULPI PHY (pin control required in
  that case).

compatible: "st,stm32f7-hsotg"

include: ["snps,dwc2.yaml", "pinctrl-device.yaml"]

properties:
  clocks:
    required: true

  vbus-gpios:
    type: phandle-array
    description: |
      GPIO controlling the external VBUS power switch in USB host mode.
      The GPIO, if defined, is used by the vendor quirk, and is active when USB
      host is enabled.
```

## dts/bindings/usb/st,stm32f7-otghs.yaml
```yaml
# Copyright (c) 2025, STMicroelectronics
# SPDX-License-Identifier: Apache-2.0

description: STM32F7 OTGHS controller

compatible: "st,stm32f7-otghs"

include: st,stm32-otghs.yaml

properties:
  physel:
    type: string
    required: true
    enum:
      - "USB_OTG_HS_PHY_ULPI"
      - "USB_FS_EMBEDDED_PHY"
    description: |
      USB PHY interface to use.

      The following interfaces are supported:
        - "USB_OTG_HS_ULPI_PHY": UTMI+ Low Pin Interface for external high-speed PHY.
        - "USB_FS_EMBEDDED_PHY": on-chip full-speed PHY.
```

## dts/bindings/usb/st,stm32h7-otghs.yaml
```yaml
# Copyright (c) 2025, STMicroelectronics
# SPDX-License-Identifier: Apache-2.0

description: STM32H7 OTGHS controller

compatible: "st,stm32h7-otghs"

include: st,stm32-otghs.yaml

properties:
  phy-type:
    type: string
    required: true
    enum:
      - "USB_OTG_ULPI_PHY"
      - "USB_OTG_PHY_EMBEDDED"
    description: |
      ST STM32H7 USB
      OTG_HS supports the following PHY interfaces:
        - "USB_OTG_ULPI_PHY": an UTMI+ Low Pin Interface for external high-speed PHY.
        - "USB_OTG_PHY_EMBEDDED": an on-chip full-speed PHY.
```

## dts/bindings/usb/st,stm32n6-otghs.yaml
```yaml
# Copyright (c) 2025, STMicroelectronics
# SPDX-License-Identifier: Apache-2.0

description: |
  STM32 OTGHS controller without pinmux

  On series such as STM32N6, the `pinctrl-0` and `pinctrl-names` properties
  are not needed as dedicated pins are reserved for USB communication.

compatible: "st,stm32n6-otghs"

include: st,stm32-otghs-common.yaml
```

## dts/bindings/usb/st,stm32u5-hsotg.yaml
```yaml
# SPDX-FileCopyrightText: Copyright The Zephyr Project Contributors
# SPDX-License-Identifier: Apache-2.0

description: |
  STM32U5 OTG_HS DWC2 compatible controller. The high-speed PHY is selected by
  the "phys" phandle.

compatible: "st,stm32u5-hsotg"

include: ["snps,dwc2.yaml", "pinctrl-device.yaml"]

properties:
  clocks:
    required: true

  vbus-gpios:
    type: phandle-array
    description: |
      GPIO controlling the external VBUS power switch in USB host mode.
      The GPIO, if defined, is used by the vendor quirk, and is active when USB
      host is enabled.
```
