## dts/bindings/usb/usb-device-controller.yaml
```yaml
# SPDX-FileCopyrightText: Copyright The Zephyr Project Contributors
# SPDX-License-Identifier: Apache-2.0

# Common fields for USB device controllers

include: usb-controller.yaml

bus: usb
```

## dts/bindings/usb/usb-ep.yaml
```yaml
# Copyright (c) 2018, I-SENSE group of ICCS
# SPDX-License-Identifier: Apache-2.0

# Common fields that give the number of endpoints supported by the USB hardware

include: usb-controller.yaml

properties:
  num-bidir-endpoints:
    type: int
    required: true
    description: |
      Number of bi-directional endpoints supported by hardware
      (including EP0)

  num-in-endpoints:
    type: int
    description: |
      Number of IN endpoints supported by hardware
      (including EP0 IN)

  num-out-endpoints:
    type: int
    description: |
      Number of OUT endpoints supported by hardware
      (including EP0 OUT)
```

## dts/bindings/usb/usb-host-controller.yaml
```yaml
# SPDX-FileCopyrightText: Copyright The Zephyr Project Contributors
# SPDX-License-Identifier: Apache-2.0

# Common fields for USB host controllers

include: usb-controller.yaml

bus: usbh
```

## dts/bindings/usb/usb.yaml
```yaml
#
# Copyright (c) 2018, I-SENSE group of ICCS
#
# SPDX-License-Identifier: Apache-2.0
#

title: USB Base Structure
version: 0.1

description: >
    This binding gives the base structures for all USB devices

inherits:
    !include base.yaml

properties:
    maximum-speed:
      type: string
      category: optional
      description: Configures USB controllers to work up to a specific
                   speed. Valid arguments are "super-speed", "high-speed",
                   "full-speed" and "low-speed". If this is not passed
                   via DT, USB controllers should use their maximum
                   hardware capability.
      generation: define
      enum:
         - "low-speed"
         - "full-speed"
         - "high-speed"
         - "super-speed"

    label:
      category: required
```
