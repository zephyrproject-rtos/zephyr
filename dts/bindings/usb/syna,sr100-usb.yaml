## dts/bindings/usb/syna,sr100-usb.yaml
```yaml
# SPDX-FileCopyrightText: Copyright (c) 2025 Synaptics Incorporated
# SPDX-License-Identifier: Apache-2.0
#
description: Synaptics SR11X DWC2 compatible controller

compatible: "syna,sr100-usb"

include: ["snps,dwc2.yaml", reset-device.yaml]
```

## dts/bindings/usb/telink,b91-usbd.yaml
```yaml
#* Copyright (c) 2022 Telink Semiconductor
# SPDX-License-Identifier: Apache-2.0

description: |
    Telink B91 USB device controller

compatible: "telink,b91-usbd"

include: usb-ep.yaml

properties:
    reg:
      required: true

    interrupts:
      required: true
```

## dts/bindings/usb/telink,b9x-usbd.yaml
```yaml
# Copyright (c) 2023 Telink Semiconductor
# SPDX-License-Identifier: Apache-2.0

description: |
    Telink B9x USB device controller

compatible: "telink,b9x-usbd"

include: usb-ep.yaml

properties:
  reg:
    required: true

  interrupts:
    required: true
```

## dts/bindings/usb/telink,tlx-usbd.yaml
```yaml
# Copyright (c) 2024 Telink Semiconductor
# SPDX-License-Identifier: Apache-2.0

description: |
    Telink TLx USB device controller

compatible: "telink,tlx-usbd"

include: usb-ep.yaml

properties:
  reg:
    required: true

  interrupts:
    required: true
```

## dts/bindings/usb/ti,am64-usb.yaml
```yaml
# Copyright 2026 Texas Instruments
# SPDX-License-Identifier: Apache-2.0

description: |
  TI AM64x USB Subsystem with Cadence CDNS3 Controller

  This binding is for TI's AM64x USB subsystem which includes a Cadence CDNS3
  USB controller with TI-specific wrapper logic.

compatible: "ti,am64-usb"

include: cdns,usb3.yaml

properties:
  reg:
    required: true

  reg-names:
    required: true

  clocks:
    required: true

  ti,vbus-divider:
    type: boolean
    description: |
      Whether USB VBUS line is connected to the VBUS pin of the SoC
      via a 1/3 voltage divider.

  ti,usb2-only:
    type: boolean
    description: |
      Force the controller to operate in USB 2.0 mode only, disabling
      USB 3.0 SuperSpeed operation.
```

## dts/bindings/usb/ti,dwc3-am62.yaml
```yaml
# Copyright (c) 2026 Texas Instruments
# SPDX-License-Identifier: Apache-2.0

description: |
    TI's AM62 quirk module for the Synopsys DWC3 controller

compatible: "ti,dwc3-am62"

include: snps,dwc3.yaml

properties:
  ti,syscon-phy-pll-refclk:
    type: phandle
    required: true
    description: |
      Specifier for conveying frequency of ref clock input. The node
      that this phandle points to contains the offset of the register
      while the parent of that node is the actual syscon node.

  ti,vbus-divider:
    type: boolean
    description: |
      Whether USB VBUS line is connected to the VBUS pin of the SoC
      via a 1/3 voltage divider.

  reg-names:
    required: true

  clocks:
    required: true
```

## dts/bindings/usb/uac2/zephyr,uac2-audio-streaming.yaml
```yaml
# Copyright (c) 2023 Nordic Semiconductor ASA
# SPDX-License-Identifier: Apache-2.0

description: USB Audio Class 2 Audio Streaming interface

compatible: "zephyr,uac2-audio-streaming"

properties:
  linked-terminal:
    type: phandle
    required: true
    description: |
      Input or Output Terminal to which this interface is connected.

  active-alternate-setting-control:
    type: string
    description: Active Alternate Setting Control capabilities
    enum:
      - "read-only"

  valid-alternate-settings-control:
    type: string
    description: Valid Alternate Settings Control capabilities
    enum:
      - "read-only"

  external-interface:
    type: boolean
    description: |
      Enable if audio stream is not transmitted over USB (Type IV Audio Stream).

  implicit-feedback:
    type: boolean
    description: |
      Enable implicit feedback on asynchronous endpoint. For IN endpoints this
      sets endpoint behaviour type to implicit feedback data endpoint. For OUT
      endpoints setting this property removes explicit feedback endpoint.

  pitch-control:
    type: string
    description: Pitch Control capabilities
    enum:
      - "read-only"
      - "host-programmable"

  data-overrun-control:
    type: string
    description: Data Overrun capabilities
    enum:
      - "read-only"

  data-underrun-control:
    type: string
    description: Data Underrun capabilities
    enum:
      - "read-only"

  lock-delay:
    type: int
    description: |
      Time it takes this endpoint to reliably lock its internal clock recovery
      circuitry. Units depend on the lock-delay-units field. Relevant only if
      linked-terminal's clock is sof-synchronized.

  lock-delay-units:
    type: string
    description: Units for lock-delay parameter.
    enum:
      - "milliseconds"
      - "decoded-pcm-samples"

  subslot-size:
    type: int
    description: |
      Number of bytes occupied by one audio subslot. Can be 1, 2, 3 or 4.

  bit-resolution:
    type: int
    description: |
      Number of effectively used bits in audio subslot.
```

## dts/bindings/usb/uac2/zephyr,uac2-channel-cluster.yaml
```yaml
# Copyright (c) 2023 Nordic Semiconductor ASA
# SPDX-License-Identifier: Apache-2.0

description: USB Audio Class 2 Audio Channel Cluster

properties:
  front-left:
    type: boolean
    description: Front Left channel present in the cluster

  front-right:
    type: boolean
    description: Front Right channel present in the cluster

  front-center:
    type: boolean
    description: Front Center channel present in the cluster

  low-frequency-effects:
    type: boolean
    description: Low Frequency Effects channel present in the cluster

  back-left:
    type: boolean
    description: Back Left channel present in the cluster

  back-right:
    type: boolean
    description: Back Right channel present in the cluster

  front-left-of-center:
    type: boolean
    description: Front Left of Center channel present in the cluster

  front-right-of-center:
    type: boolean
    description: Front Right of Center channel present in the cluster

  back-center:
    type: boolean
    description: Back Center channel present in the cluster

  side-left:
    type: boolean
    description: Side Left channel present in the cluster

  side-right:
    type: boolean
    description: Side Right channel present in the cluster

  top-center:
    type: boolean
    description: Top Center channel present in the cluster

  top-front-left:
    type: boolean
    description: Top Front Left channel present in the cluster

  top-front-center:
    type: boolean
    description: Top Front Center channel present in the cluster

  top-front-right:
    type: boolean
    description: Top Front Right channel present in the cluster

  top-back-left:
    type: boolean
    description: Top Back Left channel present in the cluster

  top-back-center:
    type: boolean
    description: Top Back Center channel present in the cluster

  top-back-right:
    type: boolean
    description: Top Back Right channel present in the cluster

  top-front-left-of-center:
    type: boolean
    description: Top Front Left of Center channel present in the cluster

  top-front-right-of-center:
    type: boolean
    description: Top Front Right of Center channel present in the cluster

  left-low-frequency-effects:
    type: boolean
    description: Left Low Frequency Effects channel present in the cluster

  right-low-frequency-effects:
    type: boolean
    description: Right Low Frequency Effects channel present in the cluster

  top-side-left:
    type: boolean
    description: Top Side Left channel present in the cluster

  top-side-right:
    type: boolean
    description: Top Side Right channel present in the cluster

  bottom-center:
    type: boolean
    description: Bottom Center channel present in the cluster

  back-left-of-center:
    type: boolean
    description: Back Left of Center channel present in the cluster

  back-right-of-center:
    type: boolean
    description: Back Right of Center channel present in the cluster

  raw-data:
    type: boolean
    description: Raw Data, mutually exclusive with all other spatial locations
```

## dts/bindings/usb/uac2/zephyr,uac2-clock-source.yaml
```yaml
# Copyright (c) 2023 Nordic Semiconductor ASA
# SPDX-License-Identifier: Apache-2.0

description: USB Audio Class 2 Clock Source entity

compatible: "zephyr,uac2-clock-source"

properties:
  clock-type:
    type: string
    required: true
    description: |
      Clock Type indicating whether the Clock Source represents an external
      clock or an internal clock with either fixed frequency, variable
      frequency, or programmable frequency.
    enum:
      - "external"
      - "internal-fixed"
      - "internal-variable"
      - "internal-programmable"

  sof-synchronized:
    type: boolean
    description: |
      True if clock is synchronized to USB Start of Frame. False if clock is
      free running. External clock must be free running.

  frequency-control:
    type: string
    description: Clock Frequency Control capabilities
    enum:
      - "read-only"
      - "host-programmable"

  validity-control:
    type: string
    description: Clock Validity Control capabilities
    enum:
      - "read-only"

  assoc-terminal:
    type: phandle
    description: |
      Input or Output Terminal associated with this Clock Source. Set if clock
      is derived from USB OUT data endpoint (point the handle to respective
      Input Terminal) or from input signal on S/PDIF connector.

  sampling-frequencies:
    type: array
    required: true
    description: |
      Sampling Frequencies, in Hz, this Clock Source Entity can generate.
```

## dts/bindings/usb/uac2/zephyr,uac2-feature-unit.yaml
```yaml
# Copyright (c) 2024 Nordic Semiconductor ASA
# SPDX-License-Identifier: Apache-2.0

description: USB Audio Class 2 Feature Unit entity

compatible: "zephyr,uac2-feature-unit"

# string-array properties start with Primary channel 0 and follow with Logical
# channel(s). The "not-present" value is allowed to facilitate having controls
# that are not present on the Primary channel, but only present at the Logical
# channel(s).

properties:
  data-source:
    type: phandle
    description: Unit or Terminal to which this Feature Unit is connected

  mute-control:
    type: string-array
    description: Mute Control capabilities
    enum:
      - "read-only"
      - "host-programmable"
      - "not-present"

  volume-control:
    type: string-array
    description: Volume Control capabilities
    enum:
      - "read-only"
      - "host-programmable"
      - "not-present"

  bass-control:
    type: string-array
    description: Bass Control capabilities
    enum:
      - "read-only"
      - "host-programmable"
      - "not-present"

  mid-control:
    type: string-array
    description: Mid Control capabilities
    enum:
      - "read-only"
      - "host-programmable"
      - "not-present"

  treble-control:
    type: string-array
    description: Treble Control capabilities
    enum:
      - "read-only"
      - "host-programmable"
      - "not-present"

  graphic-equalizer-control:
    type: string-array
    description: Graphic Equalizer capabilities
    enum:
      - "read-only"
      - "host-programmable"
      - "not-present"

  automatic-gain-control:
    type: string-array
    description: Automatic Gain Control capabilities
    enum:
      - "read-only"
      - "host-programmable"
      - "not-present"

  delay-control:
    type: string-array
    description: Delay Control capabilities
    enum:
      - "read-only"
      - "host-programmable"
      - "not-present"

  bass-boost-control:
    type: string-array
    description: Bass Boost Control capabilities
    enum:
      - "read-only"
      - "host-programmable"
      - "not-present"

  loundness-control:
    type: string-array
    description: Loundness Control capabilities
    enum:
      - "read-only"
      - "host-programmable"
      - "not-present"

  input-gain-control:
    type: string-array
    description: Input Gain Control capabilities
    enum:
      - "read-only"
      - "host-programmable"
      - "not-present"

  input-gain-pad-control:
    type: string-array
    description: Input Gain Pad Control capabilities
    enum:
      - "read-only"
      - "host-programmable"
      - "not-present"

  phase-inverter-control:
    type: string-array
    description: Phase Inverter Control capabilities
    enum:
      - "read-only"
      - "host-programmable"
      - "not-present"

  underflow-control:
    type: string-array
    description: Underflow Control capabilities
    enum:
      - "read-only"
      - "not-present"

  overflow-control:
    type: string-array
    description: Overflow Control capabilities
    enum:
      - "read-only"
      - "not-present"
```

## dts/bindings/usb/uac2/zephyr,uac2-input-terminal.yaml
```yaml
# Copyright (c) 2023 Nordic Semiconductor ASA
# SPDX-License-Identifier: Apache-2.0

description: USB Audio Class 2 Input Terminal entity

compatible: "zephyr,uac2-input-terminal"

include: zephyr,uac2-channel-cluster.yaml

properties:
  terminal-type:
    type: int
    required: true
    description: |
      Terminal Type constant specified in USB Audio Terminal Types

  assoc-terminal:
    type: phandle
    description: |
      Associated terminal for bi-directional terminal types.

  clock-source:
    type: phandle
    required: true
    description: |
      Connected clock entity

  copy-protect-control:
    type: string
    description: Copy Protect Control capabilities
    enum:
      - "read-only"

  connector-control:
    type: string
    description: Connector Control capabilities
    enum:
      - "read-only"

  overload-control:
    type: string
    description: Overload Control capabilities
    enum:
      - "read-only"

  cluster-control:
    type: string
    description: Cluster Control capabilities
    enum:
      - "read-only"

  underflow-control:
    type: string
    description: Underflow Control capabilities
    enum:
      - "read-only"

  overflow-control:
    type: string
    description: Overflow Control capabilities
    enum:
      - "read-only"
```

## dts/bindings/usb/uac2/zephyr,uac2-output-terminal.yaml
```yaml
# Copyright (c) 2023 Nordic Semiconductor ASA
# SPDX-License-Identifier: Apache-2.0

description: USB Audio Class 2 Output Terminal entity

compatible: "zephyr,uac2-output-terminal"

properties:
  terminal-type:
    type: int
    required: true
    description: |
      Terminal Type constant specified in USB Audio Terminal Types

  assoc-terminal:
    type: phandle
    description: |
      Associated terminal, e.g. for bidirectional terminal types.

  data-source:
    type: phandle
    required: true
    description: |
      Unit or Terminal this terminal receives data from

  clock-source:
    type: phandle
    required: true
    description: |
      Connected clock entity

  copy-protect-control:
    type: string
    description: Copy Protect Control capabilities
    enum:
      - "host-programmable"

  connector-control:
    type: string
    description: Connector Control capabilities
    enum:
      - "read-only"

  overload-control:
    type: string
    description: Overload Control capabilities
    enum:
      - "read-only"

  underflow-control:
    type: string
    description: Underflow Control capabilities
    enum:
      - "read-only"

  overflow-control:
    type: string
    description: Overflow Control capabilities
    enum:
      - "read-only"
```
