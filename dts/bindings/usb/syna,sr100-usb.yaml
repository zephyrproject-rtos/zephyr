## dts/bindings/usb/uac2/zephyr,uac2.yaml
```yaml
# Copyright (c) 2023 Nordic Semiconductor ASA
# SPDX-License-Identifier: Apache-2.0

description: USB Audio Class 2 instance

compatible: "zephyr,uac2"

# Child nodes of "zephyr,uac2" compatibles are supposed to be Audio Control
# entities, i.e. clock sources, input terminals, output terminals, etc.
# After all Audio Control entities, the Audio Streaming interface compatibles
# should follow (as child nodes of "zephyr,uac2").
#
# The only reason for putting Audio Streaming interfaces at the end is because
# Audio Control entities derive their unique ID from child index (+ 1). For most
# cases the order shouldn't really matter, but if there happen to be maximum
# possible number of entities (255) then the Audio Streaming would inadvertently
# "consume" one of the available IDs.

properties:
  full-speed:
    type: boolean
    description: |
      True if this instance is allowed to operate at Full-Speed.

  high-speed:
    type: boolean
    description: |
      True if this instance is allowed to operate at High-Speed.

  audio-function:
    type: int
    required: true
    description: |
      Constant, indicating the primary use of this audio function, as intended
      by the manufacturer. Use Audio Function category codes define from
      dt-bindings/usb/audio.h.

  interrupt-endpoint:
    type: boolean
    description: |
      Enable to support an optional interrupt endpoint to inform the Host about
      dynamic changes that occur on the different addressable entities.

  latency-control:
    type: string
    description: Latency Control capabilities
    enum:
      - "read-only"
      - "host-programmable"
```

## dts/bindings/usb/uhc/nxp,uhc-ehci.yaml
```yaml
# Copyright  2024 NXP
# SPDX-License-Identifier: Apache-2.0

description: NXP EHCI USB host controller

compatible: "nxp,uhc-ehci"

include: [usb-host-controller.yaml]

properties:
  phy-handle:
    type: phandle
```

## dts/bindings/usb/usb-audio-feature-volume.yaml
```yaml
# Copyright (c) 2023, LISTENAI
# SPDX-License-Identifier: Apache-2.0
#
# Specific fields for USB volume control.

description: USB volume control specific fields.

compatible: "usb-audio-feature-volume"

include: base.yaml

properties:
  volume-max:
    type: int
    default: 0x0A00
    description: |
      attention: this attribute is a signed value.
      This attribute represents the maximum volume level.
      The range from +127.9961 dB (0x7FFF) down to -127.9961 dB (0x8001).
      Valid range: 0 - 0xFFFF
  volume-min:
    type: int
    default: 0xBA00
    description: |
      attention: this attribute is a signed value.
      This attribute represents the minimum volume level.
      The range from +127.9961 dB (0x7FFF) down to -127.9961 dB (0x8001).
      Valid range: 0 - 0xFFFF
  volume-res:
    type: int
    default: 0x100
    description: |
      attention: this attribute can only take positive values.
      This attribute represents the volume resolution(step).
      1 = 1/256 dB or 0.00390625 dB.
      0x100(256) = 1dB.
      Valid range: 1 - 0x7FFF
```

## dts/bindings/usb/usb-audio-hp.yaml
```yaml
# Copyright (c) 2020 Nordic Semiconductor ASA
# SPDX-License-Identifier: Apache-2.0

# Specific fields for USB audio headphones.

description: USB Audio headphones specific fields.

compatible: "usb-audio-hp"

include: [usb-audio.yaml, usb-audio-feature-volume.yaml]

properties:
  resolution:
    type: int
    default: 16
    enum:
      - 8
      - 16
      - 24
      - 32
  sample-rate-hz:
    type: int
    default: 48000
  polling-interval:
    type: int
    default: 1
  # channel configuration options
  channel-l:
    type: boolean
    description: Enable (l) channel.
  channel-r:
    type: boolean
    description: Enable (r) channel.
  channel-c:
    type: boolean
    description: Enable (c) channel.
  channel-lfe:
    type: boolean
    description: Enable (lfe) channel.
  channel-ls:
    type: boolean
    description: Enable (ls) channel.
  channel-rs:
    type: boolean
    description: Enable (rs) channel.
  channel-lc:
    type: boolean
    description: Enable (lc) channel.
  channel-rc:
    type: boolean
    description: Enable (rc) channel.
  channel-s:
    type: boolean
    description: Enable (s) channel.
  channel-sl:
    type: boolean
    description: Enable (sl) channel.
  channel-sr:
    type: boolean
    description: Enable (sr) channel.
  channel-t:
    type: boolean
    description: Enable (t) channel.
  channel-cfg:
    type: boolean
    description: Enable (cfg) channel.
  # feature unit configuration options
  feature-mute:
    type: boolean
    required: true
    description: Enable Mute feature.
  feature-volume:
    type: boolean
    description: |
      Enable Volume feature.
      Currently not supported.
  feature-tone-control:
    type: boolean
    description: |
      Enable Tone Control (Bass, Mid, Treble) feature.
      Currently not supported.
  feature-graphic-equalizer:
    type: boolean
    description: |
      Enable  Graphic Equalizer feature.
      Currently not supported.
  feature-automatic-gain-control:
    type: boolean
    description: |
      Enable Autoamtic Gain Control feature.
      Currently not supported.
  feature-delay:
    type: boolean
    description: |
      Enable Delay feature.
      Currently not supported.
  feature-bass-boost:
    type: boolean
    description: |
      Enable Bass Boost feature.
      Currently not supported.
  feature-loudness:
    type: boolean
    description: |
      Enable Loudness feature.
      Currently not supported.
```

## dts/bindings/usb/usb-audio-hs.yaml
```yaml
# Copyright (c) 2020 Nordic Semiconductor ASA
# SPDX-License-Identifier: Apache-2.0

# Specific fields for USB audio headset.

description: USB Audio headset specific fields.

compatible: "usb-audio-hs"

include: usb-audio.yaml

properties:
  mic-resolution:
    type: int
    default: 16
    enum:
      - 8
      - 16
      - 24
      - 32
  mic-sync-type:
    default: "Synchronous"
    type: string
    description: |
      Type of endpoint synchronization for IN devices.
      Default value is Sychronous.
      Adaptive is not supported.
    enum:
      - "No Synchronization"
      - "Asynchronous"
      - "Adaptive"
      - "Synchronous"
  hp-resolution:
    type: int
    default: 16
    enum:
      - 8
      - 16
      - 24
      - 32
  # microphone channel configuration options
  mic-channel-l:
    type: boolean
    description: Enable (l) channel.
  mic-channel-r:
    type: boolean
    description: Enable (r) channel.
  mic-channel-c:
    type: boolean
    description: Enable (c) channel.
  mic-channel-lfe:
    type: boolean
    description: Enable (lfe) channel.
  mic-channel-ls:
    type: boolean
    description: Enable (ls) channel.
  mic-channel-rs:
    type: boolean
    description: Enable (rs) channel.
  mic-channel-lc:
    type: boolean
    description: Enable (lc) channel.
  mic-channel-rc:
    type: boolean
    description: Enable (rc) channel.
  mic-channel-s:
    type: boolean
    description: Enable (s) channel.
  mic-channel-sl:
    type: boolean
    description: Enable (sl) channel.
  mic-channel-sr:
    type: boolean
    description: Enable (sr) channel.
  mic-channel-t:
    type: boolean
    description: Enable (t) channel.
  mic-channel-cfg:
    type: boolean
    description: Enable (cfg) channel.
  # microphone feature unit configuration options
  mic-feature-mute:
    type: boolean
    required: true
    description: Enable Mute feature.
  mic-feature-volume:
    type: boolean
    description: |
      Enable Volume feature.
      Currently not supported.
  mic-feature-tone-control:
    type: boolean
    description: |
      Enable Tone Control (Bass, Mid, Treble) feature.
      Currently not supported.
  mic-feature-graphic-equalizer:
    type: boolean
    description: |
      Enable  Graphic Equalizer feature.
      Currently not supported.
  mic-feature-automatic-gain-control:
    type: boolean
    description: |
      Enable Autoamtic Gain Control feature.
      Currently not supported.
  mic-feature-delay:
    type: boolean
    description: |
      Enable Delay feature.
      Currently not supported.
  mic-feature-bass-boost:
    type: boolean
    description: |
      Enable Bass Boost feature.
      Currently not supported.
  mic-feature-loudness:
    type: boolean
    description: |
      Enable Loudness feature.
      Currently not supported.
# headphones channel configuration options
  hp-channel-l:
    type: boolean
    description: Enable (l) channel.
  hp-channel-r:
    type: boolean
    description: Enable (r) channel.
  hp-channel-c:
    type: boolean
    description: Enable (c) channel.
  hp-channel-lfe:
    type: boolean
    description: Enable (lfe) channel.
  hp-channel-ls:
    type: boolean
    description: Enable (ls) channel.
  hp-channel-rs:
    type: boolean
    description: Enable (rs) channel.
  hp-channel-lc:
    type: boolean
    description: Enable (lc) channel.
  hp-channel-rc:
    type: boolean
    description: Enable (rc) channel.
  hp-channel-s:
    type: boolean
    description: Enable (s) channel.
  hp-channel-sl:
    type: boolean
    description: Enable (sl) channel.
  hp-channel-sr:
    type: boolean
    description: Enable (sr) channel.
  hp-channel-t:
    type: boolean
    description: Enable (t) channel.
  hp-channel-cfg:
    type: boolean
    description: Enable (cfg) channel.
  # headphones feature unit configuration options
  hp-feature-mute:
    type: boolean
    required: true
    description: Enable Mute feature.
  hp-feature-volume:
    type: boolean
    description: |
      Enable Volume feature.
      Currently not supported.
  hp-feature-tone-control:
    type: boolean
    description: |
      Enable Tone Control (Bass, Mid, Treble) feature.
      Currently not supported.
  hp-feature-graphic-equalizer:
    type: boolean
    description: |
      Enable  Graphic Equalizer feature.
      Currently not supported.
  hp-feature-automatic-gain-control:
    type: boolean
    description: |
      Enable Autoamtic Gain Control feature.
      Currently not supported.
  hp-feature-delay:
    type: boolean
    description: |
      Enable Delay feature.
      Currently not supported.
  hp-feature-bass-boost:
    type: boolean
    description: |
      Enable Bass Boost feature.
      Currently not supported.
  hp-feature-loudness:
    type: boolean
    description: |
      Enable Loudness feature.
      Currently not supported.
```

## dts/bindings/usb/usb-audio-mic.yaml
```yaml
# Copyright (c) 2020 Nordic Semiconductor ASA
# SPDX-License-Identifier: Apache-2.0

# Specific fields for USB audio microphone.

description: USB Audio microphone specific fields.

compatible: "usb-audio-mic"

include: usb-audio.yaml

properties:
  resolution:
    type: int
    default: 16
    required: false
    enum:
     - 8
     - 16
     - 24
     - 32
  sync-type:
    required: false
    default: "Synchronous"
    type: string
    description: Type of endpoint synchronization for IN devices.
                 Default value is Sychronous.
                 Adaptive is not supported.
    enum:
     - "No Synchronization"
     - "Asynchronous"
     - "Adaptive"
     - "Synchronous"
# channel configuration options
  channel-l:
    type: boolean
    required: false
    description: Enable (l) channel.
  channel-r:
    type: boolean
    required: false
    description: Enable (r) channel.
  channel-c:
    type: boolean
    required: false
    description: Enable (c) channel.
  channel-lfe:
    type: boolean
    required: false
    description: Enable (lfe) channel.
  channel-ls:
    type: boolean
    required: false
    description: Enable (ls) channel.
  channel-rs:
    type: boolean
    required: false
    description: Enable (rs) channel.
  channel-lc:
    type: boolean
    required: false
    description: Enable (lc) channel.
  channel-rc:
    type: boolean
    required: false
    description: Enable (rc) channel.
  channel-s:
    type: boolean
    required: false
    description: Enable (s) channel.
  channel-sl:
    type: boolean
    required: false
    description: Enable (sl) channel.
  channel-sr:
    type: boolean
    required: false
    description: Enable (sr) channel.
  channel-t:
    type: boolean
    required: false
    description: Enable (t) channel.
  channel-cfg:
    type: boolean
    required: false
    description: Enable (cfg) channel.
# feature unit configuration options
  feature-mute:
    type: boolean
    required: true
    description: Enable Mute feature.
  feature-volume:
    type: boolean
    required: false
    description: Enable Volume feature.
                 Currently not supported.
  feature-tone-control:
    type: boolean
    required: false
    description: Enable Tone Control (Bass, Mid, Treble) feature.
                 Currently not supported.
  feature-graphic-equalizer:
    type: boolean
    required: false
    description: Enable  Graphic Equalizer feature.
                 Currently not supported.
  feature-automatic-gain-control:
    type: boolean
    required: false
    description: Enable Autoamtic Gain Control feature.
                 Currently not supported.
  feature-delay:
    type: boolean
    required: false
    description: Enable Delay feature.
                 Currently not supported.
  feature-bass-boost:
    type: boolean
    required: false
    description: Enable Bass Boost feature.
                 Currently not supported.
  feature-loudness:
    type: boolean
    required: false
    description: Enable Loudness feature.
                 Currently not supported.
```

## dts/bindings/usb/usb-audio.yaml
```yaml
# Copyright (c) 2020 Nordic Semiconductor ASA
# SPDX-License-Identifier: Apache-2.0

# Common fields for USB audio class

description: Common fields for USB audio devices
compatible: "usb-audio"
```

## dts/bindings/usb/usb-bc12.yaml
```yaml
# Copyright (c) 2022 Google LLC
# SPDX-License-Identifier: Apache-2.0

# Common fields for USB BC1.2 devices

include: base.yaml

properties:
  charging-mode:
    required: true
    type: string
    description: |
      Define the charging port mode supported by the BC1.2 device.
      Charging modes
      - BC12_TYPE_NONE: Device does not support charging and only supports
                        portable-device mode.
      - BC12_TYPE_SDP:  Device supports SDP (standard downstream port)
                        charging. The USB data lines are active and the
                        maximum current is limited to 0.5A.
      - BC12_TYPE_CDP:  Device supports CDP (charging downstream port)
                        charging. The USB data lines are active and the
                        maximum current is limited to 1.5A.
      - BC12_TYPE_DCP:  Device supports DCP (dedicated charging port)
                        charging. The USB data lines are disabled and the
                        maximum current is limited to 1.5A.
    enum:
      - BC12_TYPE_NONE
      - BC12_TYPE_SDP
      - BC12_TYPE_CDP
      - BC12_TYPE_DCP
```

## dts/bindings/usb/usb-controller.yaml
```yaml
# Copyright (c) 2018, I-SENSE group of ICCS
# SPDX-License-Identifier: Apache-2.0

# Common fields for USB controllers

include: base.yaml

bus: usb

properties:
  maximum-speed:
    type: string
    description: Configures USB controllers to work up to a specific
                 speed. Valid arguments are "super-speed", "high-speed",
                 "full-speed" and "low-speed". If this is not passed
                 via DT, USB controllers should use their maximum
                 hardware capability.
    enum:
      - "low-speed"
      - "full-speed"
      - "high-speed"
      - "super-speed"

  vbus-gpios:
    type: phandle-array
    description: Control VBUS via GPIO pin.
```
