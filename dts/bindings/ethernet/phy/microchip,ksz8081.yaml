## dts/bindings/ethernet/smi/microchip,smi-gpio.yaml
```yaml
# Copyright (c) 2026 Bas van Loon
# SPDX-License-Identifier: Apache-2.0

description: |
  Microchip SMI bitbang driver. This is a custom MDIO bitbang driver using GPIOs, used for
  the SMI interface of Microchip KSZ8xxx ethernet switch.

compatible: "microchip,smi-gpio"

include: smi-controller.yaml

properties:
  smi-clock-gpios:
    type: phandle-array
    required: true
    description: GPIO pin for the SMI clock line

  smi-data-gpios:
    type: phandle-array
    required: true
    description: GPIO pin for the SMI data line
```

## dts/bindings/ethernet/smi/smi-controller.yaml
```yaml
# Copyright (c) 2026 Bas van Loon
# SPDX-License-Identifier: Apache-2.0

# Common fields for SMI controllers

include: base.yaml

bus: smi
```

## dts/bindings/ethernet/smsc,lan91c111.yaml
```yaml
# Copyright (c) 2023 Arm Limited (or its affiliates). All rights reserved.
# SPDX-License-Identifier: Apache-2.0

description: SMSC (now Microchip) LAN91C111 Ethernet controller

compatible: "smsc,lan91c111"

include: [ethernet-controller.yaml, base.yaml]

properties:
  phy-handle:
    required: true

  interrupts:
    required: true
```

## dts/bindings/ethernet/smsc,lan9220.yaml
```yaml
# Copyright (c) 2018 Linaro Limited
# SPDX-License-Identifier: Apache-2.0

description: SMSC (now Microchip) LAN9220 Ethernet controller

compatible: "smsc,lan9220"

include: base.yaml

properties:
    reg:
      required: true

    interrupts:
      required: true
```
