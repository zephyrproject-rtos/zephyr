## dts/bindings/ethernet/phy/microchip,ksz8081.yaml
```yaml
# Copyright 2023 NXP
# SPDX-License-Identifier: Apache-2.0

description: Microchip KSZ8081 Ethernet PHY device

compatible: "microchip,ksz8081"

include: ethernet-phy-common.yaml

properties:
  reset-gpios:
    type: phandle-array
    description: GPIO connected to PHY reset signal pin. Reset is active low.
  int-gpios:
    type: phandle-array
    description: GPIO for interrupt signal indicating PHY state change.
  microchip,interface-type:
    type: string
    required: true
    description: Which type of phy connection the phy is set up for
    enum:
      - "mii"
      - "rmii"
      - "rmii-25MHz"
  default-speeds:
    default: ["10BASE Half-Duplex", "10BASE Full-Duplex", "100BASE Half-Duplex",
              "100BASE Full-Duplex"]
```

## dts/bindings/ethernet/phy/microchip,ksz8863-phy.yaml
```yaml
# Copyright 2026 DZG Metering GmbH
# SPDX-License-Identifier: Apache-2.0

description: KSZ8863 internal PHY exposed by the switch driver

compatible: "microchip,ksz8863-phy"

include: phy.yaml

properties:
  port:
    type: int
    required: true
    description: KSZ8863 user port index.
```

## dts/bindings/ethernet/phy/microchip,ksz9131.yaml
```yaml
# Copyright (C) 2025 Microchip Technology Inc. and its subsidiaries
# SPDX-License-Identifier: Apache-2.0

description: Microchip KSZ9131 Ethernet PHY device

compatible: "microchip,ksz9131"

include: ethernet-phy-common.yaml

properties:
  reset-gpios:
    type: phandle-array
    description: GPIO connected to PHY reset signal pin. Reset is active low.
  int-gpios:
    type: phandle-array
    description: GPIO for interrupt signal indicating PHY state change.
  default-speeds:
    default: ["10BASE Half-Duplex", "10BASE Full-Duplex", "100BASE Half-Duplex",
              "100BASE Full-Duplex", "1000BASE Half-Duplex", "1000BASE Full-Duplex"]
  microchip,rgmii-delay:
    type: string
    description: |
      Configure KSZ9131 internal RGMII clock delay mode.

      This property is only applicable when the PHY is connected
      using an RGMII interface.

      - "none": no internal delay
      - "id": enable RX and TX delay
      - "rxid": enable RX delay only
      - "txid": enable TX delay only
    enum:
      - "none"
      - "id"
      - "rxid"
      - "txid"
```

## dts/bindings/ethernet/phy/microchip,lan8742.yaml
```yaml
# Copyright (c) 2025 STMicroelectronics
# SPDX-License-Identifier: Apache-2.0

description: Single Port Ethernet PHY with RMII 10/100 trancsceiver

compatible: "microchip,lan8742"

include: [ethernet-phy-common.yaml]

on-bus: mdio

properties:
  reg:
    required: true
    description: |
      5-bit MDIO PHY address for the attached PHY.

  reset-gpios:
    type: phandle-array
    description: GPIO connected to MAC PHY reset signal pin. Reset is active low.

  default-speeds:
    default: ["10BASE Half-Duplex", "10BASE Full-Duplex", "100BASE Half-Duplex",
              "100BASE Full-Duplex"]
```

## dts/bindings/ethernet/phy/microchip,lan8840.yaml
```yaml
# Copyright (C) 2026 Microchip Technology Inc. and its subsidiaries
# SPDX-License-Identifier: Apache-2.0

description: Microchip LAN8840 Ethernet PHY device

compatible: "microchip,lan8840"

include: microchip,ksz9131.yaml
```

## dts/bindings/ethernet/phy/microchip,t1s-phy.yaml
```yaml
# Copyright (c) 2024 Microchip Technology Inc.
# Copyright 2026 NXP
# SPDX-License-Identifier: Apache-2.0

description: Microchip's 10BASE-T1S PHYs support

compatible: "microchip,t1s-phy"

include:
  - name: phy.yaml
  - name: ethernet-phy-plca.yaml

properties:
  reg:
    required: true
    description: PHY address
```

## dts/bindings/ethernet/phy/microchip,vsc8541-phy.yaml
```yaml
# Copyright (c) 2024 sensry.io
# SPDX-License-Identifier: Apache-2.0

description: Single Port Gigabit Ethernet Copper PHY with GMII/RGMII/MII/RMII Interfaces

compatible: "microchip,vsc8541"

include: [ethernet-phy.yaml]

on-bus: mdio

properties:
  reg:
    required: true
    description: |
      5-bit MDIO PHY address for the attached PHY.

  reset-gpios:
    type: phandle-array
    description: GPIO connected to MAC PHY reset signal pin. Reset is active low.

  microchip,interface-type:
    type: string
    required: true
    description: Which type of phy connection the phy is set up for
    enum:
      - "mii"
      - "rmii"
      - "gmii"
      - "rgmii"

  microchip,rgmii-rx-clk-delay:
    type: int
    default: 5
    description: |
      Used to configure the RX clock delay for RGMII interface. The value can be
      0 to 7. Refer to the datasheet for more details on the delay settings.

  microchip,rgmii-tx-clk-delay:
    type: int
    default: 5
    description: |
      Used to configure the TX clock delay for RGMII interface. The value can be
      0 to 7. Refer to the datasheet for more details on the delay settings.
```

## dts/bindings/ethernet/phy/motorcomm,yt8531.yaml
```yaml
# Copyright 2026 NXP
# SPDX-License-Identifier: Apache-2.0

description: Motorcomm YT8531 Ethernet PHY

compatible: "motorcomm,yt8531"

include: motorcomm,yt8521.yaml
```

## dts/bindings/ethernet/phy/nxp,t1s-phy.yaml
```yaml
# Copyright (c) 2024 Microchip Technology Inc.
# Copyright 2026 NXP
# SPDX-License-Identifier: Apache-2.0

description: NXP 10BASE-T1S PHY support

compatible: "nxp,t1s-phy"

include:
  - name: phy.yaml
  - name: ethernet-phy-plca.yaml

properties:
  reg:
    required: true
    description: PHY address
```

## dts/bindings/ethernet/phy/qca,ar8031.yaml
```yaml
# Copyright 2024 NXP
# SPDX-License-Identifier: Apache-2.0

description: Qualcomm Atheros AR8031 Ethernet PHY

compatible: "qca,ar8031"

include: ethernet-phy-common.yaml

properties:
  eee-en:
    type: boolean
    description: |
      Enable IEEE 802.3az Energy Efficient Ethernet which provides a mechanism
      to greatly save the power consumption between data packets burst.
  default-speeds:
    default: ["10BASE Half-Duplex", "10BASE Full-Duplex", "100BASE Half-Duplex",
              "100BASE Full-Duplex", "1000BASE Half-Duplex", "1000BASE Full-Duplex"]
```

## dts/bindings/ethernet/phy/ti,dp83867.yaml
```yaml
# Copyright 2024, PHYTEC America, LLC
# SPDX-License-Identifier: Apache-2.0

description: TI DP83867 Ethernet PHY device

compatible: "ti,dp83867"

include: ethernet-phy-common.yaml

properties:
  reset-gpios:
    type: phandle-array
    description: GPIO connected to PHY reset signal pin. Reset is active low.
  int-gpios:
    type: phandle-array
    description: GPIO for interrupt signal indicating PHY state change.
  ti,rx-internal-delay:
    type: int
    description:
      RX internal delay setting for the PHY. Required only if interface
      type is PHY_INTERFACE_MODE_RGMII_ID or PHY_INTERFACE_MODE_RGMII_RXID.
  ti,tx-internal-delay:
    type: int
    description:
      TX internal delay setting for the PHY. Required only if interface type is
      PHY_INTERFACE_MODE_RGMII_ID or PHY_INTERFACE_MODE_RGMII_TXID.
  ti,interface-type:
    type: string
    description: Which type of phy connection the phy is set up for
    default: "rgmii"
    enum:
      - "rgmii"
      - "rgmii-id"
      - "rgmii-rxid"
      - "rgmii-txid"
  default-speeds:
    default: ["10BASE Half-Duplex", "10BASE Full-Duplex", "100BASE Half-Duplex",
              "100BASE Full-Duplex", "1000BASE Half-Duplex", "1000BASE Full-Duplex"]
```

## dts/bindings/ethernet/phy/ti,dp83td510.yaml
```yaml
# Copyright (c) 2026 Texas Instruments
# SPDX-License-Identifier: Apache-2.0

description: TI DP83TD510E Ethernet PHY device

compatible: "ti,dp83td510"

include: ethernet-phy-common.yaml

properties:
  reset-gpios:
    type: phandle-array
    description: GPIO connected to PHY reset signal pin. Reset is active low.
  int-gpios:
    type: phandle-array
    description: GPIO for interrupt signal indicating PHY state change.
  ti,interface-type:
    type: string
    required: true
    description: Which type of phy connection the phy is set up for
    enum:
      - "rmii"
      - "rmii-25MHz"
  default-speeds:
    default: ["10BASE Full-Duplex"]
```

## dts/bindings/ethernet/qca,ar8031.yaml
```yaml
# Copyright 2024 NXP
# SPDX-License-Identifier: Apache-2.0

description: Qualcomm AR8031 PHY

compatible: "qca,ar8031"

include: phy.yaml

properties:
  reg:
    required: true
    description: PHY address

  EEE:
    type: boolean
    description: Energy Efficient Ethernet

  fixed-link:
    type: string
    description: This link is fixed and does not require PHY configuration
    enum:
      - "10BASE-T Half-Duplex"
      - "10BASE-T Full-Duplex"
      - "100BASE-T Half-Duplex"
      - "100BASE-T Full-Duplex"
      - "1000BASE-T Half-Duplex"
      - "1000BASE-T Full-Duplex"
```

## dts/bindings/ethernet/realtek,rtl8211f.yaml
```yaml
# Copyright 2023-2024 NXP
# SPDX-License-Identifier: Apache-2.0

description: Realtek RTL8211F Ethernet PHY device

compatible: "realtek,rtl8211f"

include: ethernet-phy.yaml

properties:
  rt,reset-gpio:
    type: phandle-array
    specifier-space: gpio
    description: GPIO connected to PHY reset signal pin. Reset is active low.
  rt,interrupt-gpio:
    type: phandle-array
    specifier-space: gpio
    description: GPIO for interrupt signal indicating PHY state change.
```

## dts/bindings/ethernet/renesas,ra-eswm.yaml
```yaml
# Copyright (c) 2025 Renesas Electronics Corporation
# SPDX-License-Identifier: Apache-2.0

description: Renesas RA Ethernet MAC Controller

compatible: "renesas,ra-eswm"

include: [base.yaml, pinctrl-device.yaml]

properties:
  interrupts:
    required: true

  clocks:
    required: true

  clock-names:
    required: true
    enum:
      - "gwcaclk"
      - "pclk"
      - "eswclk"
      - "eswphyclk"
      - "ethphyclk"
    description: |
      Clocks must be given corresponding names so that the shim driver can recognize them.
      "gwcaclk": operating clock for gateway CPU agent
      "pclk": peripheral clock for COMA and PTP timer
      "eswclk": operating clock for ethernet switch module
      "eswphyclk": operating clock for xMII interface
      "ethphyclk": operating clock for ETHPHYLCK pin output. Enable this clock if any PHY
      device use ETHPHYCLK pin output as clock source.
```

## dts/bindings/ethernet/renesas,ra-ethernet-rmac.yaml
```yaml
# Copyright (c) 2025 Renesas Electronics Corporation
# SPDX-License-Identifier: Apache-2.0

description: Renesas RA Ethernet MAC Controller

compatible: "renesas,ra-ethernet-rmac"

include: [ethernet-controller.yaml, pinctrl-device.yaml]

properties:
  channel:
    type: int
    required: true

  phy-handle:
    required: true

  phy-clock:
    type: phandle
    required: true
    description: |
      Specifies the reference clock node for PHY device.

  phy-clock-type:
    type: string
    required: true
    enum:
      - "xtal"
      - "internal"
    description: |
      Specifies the clock type of reference clock:
      "xtal": use xtal as clock source
      "internal": use ETHPHYCLK pin output as clock source

  txq-num:
    type: int
    default: 2
    description: Number of TX queues

  rxq-num:
    type: int
    default: 2
    description: Number of RX queues

  txq-len:
    type: int
    default: 4
    description: |
      Number of descriptors in each TX queue

  rxq-len:
    type: int
    default: 4
    description: |
      Number of descriptors in each RX queue

  txb-num:
    type: int
    default: 12
    description: |
      Number of TX buffers

  rxb-num:
    type: int
    default: 12
    description: |
      Number of RX buffers
```

## dts/bindings/ethernet/renesas,ra-ethernet.yaml
```yaml
# Copyright (c) 2024 Renesas Electronics Corporation
# SPDX-License-Identifier: Apache-2.0

description: Renesas RA Ethernet

compatible: "renesas,ra-ethernet"

include: [ethernet-controller.yaml, pinctrl-device.yaml]

properties:
  reg:
    required: true

  interrupts:
    required: true

  phy-handle:
    required: true
```

## dts/bindings/ethernet/sensry,sy1xx-mac.yaml
```yaml
# Copyright (c) 2024 sensry.io
# SPDX-License-Identifier: Apache-2.0

compatible: "sensry,sy1xx-mac"

include: [ethernet-controller.yaml, pinctrl-device.yaml, base.yaml]

properties:
  reg:
    required: true

  reg-names:
    required: true

  pinctrl-0:
    required: true

  pinctrl-names:
    required: true

  phy-handle:
    required: true

  promiscuous-mode:
    type: boolean
    description: |
      Optional feature flag - Enable promiscuous mode. When set, all valid
      frames will be accepted.
```

## dts/bindings/ethernet/siemens,ivshmem-eth.yaml
```yaml
# Copyright (c) 2023 Enphase Energy
# SPDX-License-Identifier: Apache-2.0

description: IVSHMEM Ethernet

compatible: "siemens,ivshmem-eth"

include: ethernet-controller.yaml

properties:

  ivshmem-v2:
    type: phandle
    required: true
    description: ivshmem-v2 driver node
```

## dts/bindings/ethernet/silabs,gecko-ethernet.yaml
```yaml
# Copyright (c) 2019 Interay Solutions B.V.
# Copyright (c) 2019 Oane Kingma
# SPDX-License-Identifier: Apache-2.0

description: SiLabs Gecko Ethernet

compatible: "silabs,gecko-ethernet"

include: ethernet-controller.yaml

properties:
  reg:
    required: true
    description: mmio register space

  interrupts:
    required: true
    description: required interrupts

  # PHY address
  phy-address:
    type: int
    required: true
    description: address of the PHY on the MDIO bus

  # RMII interface location
  location-rmii:
    type: int
    required: true
    description: location of RMII pins, configuration defined as <location>

  # PHY management interface location
  location-mdio:
    type: int
    required: true
    description: location of MDC and MDIO pins, configuration defined as <location>

  # PHY management pins
  location-phy-mdc:
    type: array
    required: true
    description: PHY MDC individual pin configuration defined as <location port pin>

  location-phy-mdio:
    type: array
    required: true
    description: PHY MDIO individual pin configuration defined as <location port pin>

  # RMII interface pins
  location-rmii-refclk:
    type: array
    required: true
    description: Reference clock individual pin configuration defined as <location port pin>

  location-rmii-crs-dv:
    type: array
    required: true
    description: Receive data valid individual pin configuration defined as <location port pin>

  location-rmii-txd0:
    type: array
    required: true
    description: Transmit data 0 individual pin configuration defined as <location port pin>

  location-rmii-txd1:
    type: array
    required: true
    description: Transmit data 1 individual pin configuration defined as <location port pin>

  location-rmii-tx-en:
    type: array
    required: true
    description: Transmit enable individual pin configuration defined as <location port pin>

  location-rmii-rxd0:
    type: array
    required: true
    description: Receive data 0 individual pin configuration defined as <location port pin>

  location-rmii-rxd1:
    type: array
    required: true
    description: Receive data 1 individual pin configuration defined as <location port pin>

  location-rmii-rx-er:
    type: array
    required: true
    description: Receive error individual pin configuration defined as <location port pin>

  # PHY control pins
  location-phy-pwr-enable:
    type: array
    description: PHY power enable individual pin configuration defined as <port pin>

  location-phy-reset:
    type: array
    description: PHY reset individual pin configuration defined as <port pin>

  location-phy-interrupt:
    type: array
    description: PHY interrupt individual pin configuration defined as <port pin>
```
