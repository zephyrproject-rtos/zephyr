## dts/bindings/ethernet/nxp,enet-qos.yaml
```yaml
# Copyright 2024 NXP
# SPDX-License-Identifier: Apache-2.0

description: NXP ENET QOS IP Module

compatible: "nxp,enet-qos"

include: [base.yaml, pinctrl-device.yaml]

properties:
  reg:
    required: true
  clocks:
    required: true
  pinctrl-0:
    required: true
  pinctrl-names:
    required: true
```

## dts/bindings/ethernet/nxp,enet.yaml
```yaml
# Copyright 2023-2024 NXP
# SPDX-License-Identifier: Apache-2.0

description: NXP ENET IP Module

compatible: "nxp,enet"

include: ["base.yaml", "nxp,rdc-policy.yaml"]

properties:
  reg:
    required: true

  clocks:
    required: true
```

## dts/bindings/ethernet/nxp,enet1g.yaml
```yaml
# Copyright 2024 NXP
# SPDX-License-Identifier: Apache-2.0

description: NXP ENET1G IP Module

compatible: "nxp,enet1g"

include: ["base.yaml", "nxp,rdc-policy.yaml"]

properties:
  reg:
    required: true

  clocks:
    required: true
```

## dts/bindings/ethernet/nxp,imx-netc-blk-ctrl.yaml
```yaml
# Copyright 2025 NXP
# SPDX-License-Identifier: Apache-2.0

description: NXP i.MX NETC Block Controller

compatible: "nxp,imx-netc-blk-ctrl"

include: [base.yaml]

properties:
  reg:
    required: true
```

## dts/bindings/ethernet/nxp,imx-netc-psi.yaml
```yaml
# Copyright 2024 NXP
# SPDX-License-Identifier: Apache-2.0

description: NXP i.MX NETC Physical Station Interface (PSI)

compatible: "nxp,imx-netc-psi"

include: [ethernet-controller.yaml, pinctrl-device.yaml]

properties:
  reg:
    required: true

  mac-index:
    required: true
    type: int
    description: The MAC index of this PSI.

  si-index:
    required: true
    type: int
    description: The SI index of this PSI.
```

## dts/bindings/ethernet/nxp,imx-netc-vsi.yaml
```yaml
# Copyright 2026 NXP
# SPDX-License-Identifier: Apache-2.0

description: |
  NXP NETC Virtual Station Interface (VSI).

  A VSI is a virtual function of an ENETC instance. Unlike the Physical Station
  Interface (PSI) it does not own the physical MAC/PHY or the MDIO bus.
  Control operations that touch those shared resources (primary MAC, filters,
  link status) are performed by messaging the PSI over the VSI-to-PSI channel.

compatible: "nxp,imx-netc-vsi"

include: ethernet-controller.yaml

properties:
  reg:
    required: true

  reg-names:
    required: true

  mac-index:
    required: true
    type: int
    description: |
      ENETC (MAC) instance this VSI belongs to.

  si-index:
    required: true
    type: int
    description: |
      Low byte of the HAL station-interface index: bits [7:4] = SI number within
      the ENETC (0=PSI, 1=VSI0, 2=VSI1), bits [3:0] = index into the SI
      base-address array.

  msi-device-id:
    type: int
    description: The device ID passed to the MSI controller (GIC-ITS based MSI only).

  clocks:
    type: phandle-array
    description: |
      Optional readiness clock: Checks whether the PSI has enabled the clock,
      so the driver can safely access the VSI. The clock is only observed and
      not controlled by the driver.
```

## dts/bindings/ethernet/nxp,imx-netc.yaml
```yaml
# Copyright 2025 NXP
# SPDX-License-Identifier: Apache-2.0

description: NXP i.MX NETC Controller

compatible: "nxp,imx-netc"

include: [base.yaml]

properties:
  msi-parent:
    type: phandle
    description: MSI controller
```

## dts/bindings/ethernet/nxp,kinetis-ethernet.yaml
```yaml
# Copyright (c) 2018, Linaro Limited
# SPDX-License-Identifier: Apache-2.0

description: NXP Kinetis Ethernet

compatible: "nxp,kinetis-ethernet"

include: ["ethernet-controller.yaml", "pinctrl-device.yaml"]

properties:
  reg:
    required: true
  interrupts:
    required: true
  phy-addr:
    type: int
    description: Address of the phy controller
    required: true
  reset-gpios:
    type: phandle-array
    description: GPIO to reset PHY. Reset signal is assumed active low.
  int-gpios:
    type: phandle-array
    description:
      interrupt GPIO for PHY. Will be pulled high before reset is asserted.

child-binding:
  description: Fixed link ethernet node
  properties:
    speed:
      type: int
      required: true
      description: The speed of fixed link
      enum:
        - 100
        - 10
    full-duplex:
      type: boolean
      description: The fixed link operates in full duplex mode
```

## dts/bindings/ethernet/nxp,kinetis-ptp.yaml
```yaml
# Copyright (c) 2018, Linaro Limited
# SPDX-License-Identifier: Apache-2.0

description: NXP Kinetis Ethernet PTP (Precision Time Protocol)

compatible: "nxp,kinetis-ptp"

include: base.yaml

properties:
    interrupts:
      required: true
```

## dts/bindings/ethernet/nxp,netc-ptp-clock.yaml
```yaml
# Copyright 2025 NXP
# SPDX-License-Identifier: Apache-2.0

description: NXP NETC PTP (Precision Time Protocol) Clock

compatible: "nxp,netc-ptp-clock"

include: ["base.yaml"]

properties:
  reg:
    required: true
```

## dts/bindings/ethernet/nxp,s32-netc-psi.yaml
```yaml
# Copyright 2022 NXP
# SPDX-License-Identifier: Apache-2.0

description: NXP S32 NETC Physical Station Interface (PSI)

compatible: "nxp,s32-netc-psi"

include: [ethernet-controller.yaml, pinctrl-device.yaml]

properties:
  reg:
    required: true

  clock-frequency:
    required: true
    type: int
    description: NETC system clock frequency operation, in Hz.

  mboxes:
    required: true

  mbox-names:
    required: true

  phy-handle:
    required: true

  vsis:
    type: array
    description: |
      List of Virtual Station Interfaces (VSI's) to enable from this PSI.
```

## dts/bindings/ethernet/nxp,s32-netc-vsi.yaml
```yaml
# Copyright 2022 NXP
# SPDX-License-Identifier: Apache-2.0

description: NXP S32 NETC Virtual Station Interface (VSI)

compatible: "nxp,s32-netc-vsi"

include: ethernet.yaml

properties:
  reg:
    required: true

  mboxes:
    required: true

  mbox-names:
    required: true
```

## dts/bindings/ethernet/nxp,tja1103.yaml
```yaml
# Copyright (c) 2023 NXP
# SPDX-License-Identifier: Apache-2.0

description: TJA1103 PHY

compatible: "nxp,tja1103"

include: phy.yaml

properties:
  reg:
    required: true
    description: PHY address

  int-gpios:
    type: phandle-array
    description:
      interrupt GPIO for PHY. Will be pulled high in its default state.

  master-slave:
    type: string
    required: true
    description: |
      100BASE-T1 Specifies that either phy has to run in master / slave mode
      Default selects the mode set by the pinstrapping on the hardware design.
    enum:
      - "default"
      - "master"
      - "slave"
```

## dts/bindings/ethernet/nxp,tja11xx.yaml
```yaml
# Copyright 2023 NXP
# SPDX-License-Identifier: Apache-2.0

description: TJA11xx PHY

compatible: "nxp,tja11xx"

include: phy.yaml

properties:
  reg:
    required: true
    description: PHY address
```

## dts/bindings/ethernet/nxp.kinetis-ptp.yaml
```yaml
# Copyright (c) 2018, Linaro Limited
# SPDX-License-Identifier: Apache-2.0

title: NXP Kinetis Ethernet PTP

description: >
    This binding gives a base representation of the NXP Kinetis Ethernet PTP

compatible: "nxp,kinetis-ptp"

properties:
    interrupts:
      required: true
```

## dts/bindings/ethernet/phy,mii.yaml
```yaml
# Copyright (c) 2021 IP-Logix Inc.
# SPDX-License-Identifier: Apache-2.0

# Common fields for MIIPHY devices

description: Generic MII PHY

compatible: "phy,mii"

include: phy.yaml

properties:
    address:
      type: int
      required: true
      description: PHY address
    mdio:
      type: phandle
      required: true
      description: MDIO driver node
    no-reset:
      type: boolean
      description: Do not reset the PHY during initialization
    fixed-link:
        type: string
        required: false
        description: This link is fixed and does not require PHY configuration
        enum:
          - "10BASE-T Half-Duplex"
          - "10BASE-T Full-Duplex"
          - "100BASE-T Half-Duplex"
          - "100BASE-T Full-Duplex"
```

## dts/bindings/ethernet/phy.yaml
```yaml
# Copyright (c) 2021 IP-Logix Inc.
# SPDX-License-Identifier: Apache-2.0

# Common fields for PHY devices

include: base.yaml
```

## dts/bindings/ethernet/phy/adi,adin1100-phy.yaml
```yaml
# Copyright (c) 2024 Analog Devices, Inc.
# Copyright (c) 2024 BayLibre, SAS
# SPDX-License-Identifier: Apache-2.0

description: ADIN1100 PHY

compatible: "adi,adin1100-phy"

include: adi,adin2111-phy.yaml
```

## dts/bindings/ethernet/phy/adi,adin2111.yaml
```yaml
# Copyright (c) 2023 PHOENIX CONTACT Electronics GmbH
# SPDX-License-Identifier: Apache-2.0

description: |
  ADIN2111 standalone 10BASE-T1L Ethernet controller with SPI interface.

  An example:

  adin2111: adin2111@0 {
          compatible = "adi,adin2111";
          reg = <0x0>;
          spi-max-frequency = <25000000>;
          int-gpios   = <&gpioe 12 (GPIO_ACTIVE_LOW | GPIO_PULL_UP)>;
          reset-gpios = <&gpioe 8 GPIO_ACTIVE_LOW>;
          port1 {
              local-mac-address = [ CA 2F B7 10 23 63 ];
          };
          port2 {
              local-mac-address = [ 3C 82 D4 A2 29 8E ];
          };
          mdio: mdio {
                  compatible = "adi,adin2111-mdio";
                  status = "okay";
                  #address-cells = <1>;
                  #size-cells = <0>;
                  ethernet-phy@1 {
                    reg = <0x1>;
                    compatible = "adi,adin2111-phy";
                    status = "okay";
                  };
                  ethernet-phy@2 {
                    reg = <0x2>;
                    compatible = "adi,adin2111-phy";
                    status = "okay";
                  };
          };
  };

compatible: "adi,adin2111"

include: [spi-device.yaml]

bus: adin2111

properties:
  int-gpios:
    type: phandle-array
    required: true
    description: |
      The interrupt pin of ADIN2111 is active low.
      If connected directly the MCU pin should be configured
      as active low.
  reset-gpios:
    type: phandle-array
    description: The reset pin of ADIN2111.
  spi-oa:
    type: boolean
    description: Enables Open Alliance SPI protocol.
  spi-oa-protection:
    type: boolean
    description: Enables Open Alliance SPI protocol protection.

child-binding:
  description: Port properties
  properties:
    local-mac-address:
      type: uint8-array
      description: |
        Specifies the MAC address that was assigned to the network device.
```

## dts/bindings/ethernet/phy/common/ethernet-phy-plca.yaml
```yaml
# Copyright (c) 2024 Microchip Technology Inc.
# Copyright 2026 NXP
# SPDX-License-Identifier: Apache-2.0

# Common fields for PHY devices with 10BASE-T1S PLCA

properties:
  plca-enable:
    type: boolean
    description: Enable or disable PLCA support
  plca-node-id:
    type: int
    description: Specify the PLCA node ID number
  plca-node-count:
    type: int
    description: Specify the PLCA node count
  plca-burst-count:
    type: int
    description: Specify the PLCA burst count
  plca-burst-timer:
    type: int
    description: Specify the PLCA burst timer value
  plca-to-timer:
    type: int
    description: Specify the PLCA TO timer value
```

## dts/bindings/ethernet/phy/ethernet-phy-common.yaml
```yaml
# Copyright The Zephyr Project Contributors
# SPDX-License-Identifier: Apache-2.0

# Common fields for MIIPHY devices

include: phy.yaml

properties:
  reg:
    required: true
    description: PHY address
  default-speeds:
    type: string-array
    description: The selected speeds are used to configure the PHY during initialization
    enum:
      - "10BASE Half-Duplex"
      - "10BASE Full-Duplex"
      - "100BASE Half-Duplex"
      - "100BASE Full-Duplex"
      - "1000BASE Half-Duplex"
      - "1000BASE Full-Duplex"
```

## dts/bindings/ethernet/phy/ethernet-phy-fixed-link.yaml
```yaml
# SPDX-FileCopyrightText: Copyright The Zephyr Project Contributors
# SPDX-License-Identifier: Apache-2.0

# Common fields for MIIPHY devices

description: Generic MII PHY with fixed link and no PHY configuration

compatible: "ethernet-phy-fixed-link"

include:
  - name: phy.yaml
  - name: ethernet-phy-default-speeds.yaml
  - name: ethernet-phy-reset-gpios.yaml

properties:
  default-speeds:
    required: true
```

## dts/bindings/ethernet/phy/ethernet-phy.yaml
```yaml
# SPDX-FileCopyrightText: Copyright The Zephyr Project Contributors
# SPDX-License-Identifier: Apache-2.0

# Common fields for MIIPHY devices

description: Generic MII PHY

compatible: "ethernet-phy"

include:
  - name: ethernet-phy-common.yaml
  - name: ethernet-phy-reset-gpios.yaml

on-bus: mdio

properties:
  no-reset:
    type: boolean
    description: Do not reset the PHY during initialization
  default-speeds:
    default: ["10BASE Half-Duplex", "10BASE Full-Duplex", "100BASE Half-Duplex",
              "100BASE Full-Duplex", "1000BASE Half-Duplex", "1000BASE Full-Duplex"]
```

## dts/bindings/ethernet/phy/intel,igc-phy.yaml
```yaml
# Copyright (c) 2025 Intel Corporation
# SPDX-License-Identifier: Apache-2.0

description: Intel IGC PHY documentation.

compatible: "intel,igc-phy"

include: [ethernet-phy.yaml]

properties:
  reg:
    required: true
    description: PHY address.
```

## dts/bindings/ethernet/phy/maxlinear,gpy111.yaml
```yaml
# Copyright (c) 2025 Renesas Electronics Corporation
# SPDX-License-Identifier: Apache-2.0

description: Maxlinear GPY111 Ethernet PHY device

compatible: "maxlinear,gpy111"

include:
  - name: ethernet-phy-common.yaml
  - name: ethernet-phy-reset-gpios.yaml

on-bus: mdio

properties:
  no-reset:
    type: boolean
    description: Do not reset the PHY during initialization

  default-speeds:
    default: ["10BASE Half-Duplex", "10BASE Full-Duplex", "100BASE Half-Duplex",
              "100BASE Full-Duplex", "1000BASE Half-Duplex", "1000BASE Full-Duplex"]

  maxlinear,interface-type:
    type: string
    required: true
    description: Which type of phy connection the phy is set up for
    enum:
      - "rgmii"
      - "gmii"

  maxlinear,rx-internal-delay:
    type: string
    enum:
      - "0"
      - "0.5"
      - "1.0"
      - "1.5"
      - "2.0"
      - "2.5"
      - "3.0"
      - "3.5"
    description: |
      RGMII Receive PHY Clock Delay defined in nano seconds.
      When undefined, use default reset values which depend on soft pin-strappings.

  maxlinear,tx-internal-delay:
    type: string
    enum:
      - "0"
      - "0.5"
      - "1.0"
      - "1.5"
      - "2.0"
      - "2.5"
      - "3.0"
      - "3.5"
    description: |
      RGMII Transmit PHY Clock Delay defined in nano seconds.
      When undefined, use default reset values which depend on soft pin-strappings.

  int-gpios:
    type: phandle-array
    description: GPIO for interrupt signal indicating PHY state change.
```
