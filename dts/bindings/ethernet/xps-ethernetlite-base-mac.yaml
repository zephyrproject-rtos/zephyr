## dts/bindings/ethernet/xps-ethernetlite-base-mac.yaml
```yaml
# Copyright (c) 2025 CISPA Helmholtz Center for Information Security
# SPDX-License-Identifier: Apache-2.0

title: Xilinx AXI Ethernet Lite MAC driver bindings.

include: [ethernet-controller.yaml]

properties:
  interrupts:
    description: Xilinx AXI Ethernet uses edge-triggered interrupts to signal RX/TX completion.

  xlnx,rx-ping-pong:
    type: boolean
    description: Does this device have a secondary RX buffer that is updated concurrently?

  xlnx,tx-ping-pong:
    type: boolean
    description: Does this device have a secondary TX buffer that is updated concurrently?
```

## dts/bindings/ethernet/zephyr,cdc-ecm-ethernet.yaml
```yaml
# Copyright (c) 2023 Nordic Semiconductor ASA
# SPDX-License-Identifier: Apache-2.0

description: USB CDC ECM virtual Ethernet controller

compatible: "zephyr,cdc-ecm-ethernet"

include: ethernet-controller.yaml

properties:
  remote-mac-address:
    type: string
    required: true
    description: |
      Remote MAC address of the virtual Ethernet connection encoded as
      a string of 12 uppercase hexadecimal characters. Do not use
      colons, dashes, or other separators. Per the USB CDC ECM
      specification (section 5.4), this string is sent as-is in the
      string descriptor referenced by the iMACAddress descriptor index
      to the USB host. Should not be the same as local-mac-address
      property.

examples:
  - |
    / {
      cdc-ecm {
        compatible = "zephyr,cdc-ecm-ethernet";
        remote-mac-address = "00005E005301";
      };
    };
```

## dts/bindings/ethernet/zephyr,cdc-ncm-ethernet.yaml
```yaml
# Copyright (c) 2024 Nordic Semiconductor ASA
# SPDX-License-Identifier: Apache-2.0

description: USB CDC NCM virtual Ethernet controller

compatible: "zephyr,cdc-ncm-ethernet"

include: ethernet-controller.yaml

properties:
  remote-mac-address:
    type: string
    deprecated: true
    description: |
      Remote (host-side) MAC address of the virtual Ethernet connection.

      Deprecated: when this property is omitted the driver derives the
      host-side MAC at runtime from the local MAC address by flipping the
      U/L bit, so the host-visible iMACAddress tracks runtime changes to
      the local MAC. If this property is set, the legacy behaviour of
      baking the string into the descriptor at build time is preserved for
      backward compatibility, but new designs should omit the property.
      Must not be the same as local-mac-address when set.
```

## dts/bindings/ethernet/zephyr,native-ptp-clock.yaml
```yaml
# SPDX-FileCopyrightText: Copyright 2026 The Zephyr Project Contributors
# SPDX-License-Identifier: Apache-2.0

title: Native Sim PTP (Precision Time Protocol) Clock
description: |
  This binding describes a simulated PTP clock for use with native_sim. It provides
  an interface to simulate a PTP clock, which can be used for testing and development
  purposes without requiring actual hardware.

compatible: "zephyr,native-ptp-clock"

include: ["base.yaml"]
```

## dts/bindings/event/event-domain.yaml
```yaml
# Copyright (c) 2025 Nordic Semiconductor ASA
# SPDX-License-Identifier: Apache-2.0

description: |
  Event domain

  Event domains map combinations of event device states to
  the resulting maximum latency of events within said domain.

  Example:

    / {
            event-domains {
                    wakeup_event_domain: wakeup {
                            compatible = "event-domain";

                            /*
                             * List of resulting maximum event latencies within domain
                             * mapped to event-device-states by index.
                             */
                            event-latencies-us = <260 /* Mapped to event-device-states idx 0 */
                                                  30  /* Mapped to event-device-states idx 1 */
                                                  9   /* Mapped to event-device-states idx 2 */
                                                  6>; /* Mapped to event-device-states idx 3 */

                            /* List of devices for which event states will be applied */
                            event-devices = <&cpu &power &rram>;

                            /*
                             * Combinations of event device states. Each combination maps
                             * to event-latencies-us by index. Each state within each
                             * combination maps to an event device in event-devices by
                             * index.
                             */
                            event-device-states = <0 0 0>, /* &cpu=0, &power=0, &rram=0, 260us */
                                                  <0 1 0>, /* &cpu=0, &power=1, &rram=0, 30us  */
                                                  <1 1 0>, /* &cpu=1, &power=1, &rram=0, 9us   */
                                                  <2 1 1>; /* &cpu=2, &power=1, &rram=1, 6us   */
                    };
            };
    };

compatible: "event-domain"

properties:
  event-latencies-us:
    type: array
    required: true

  event-devices:
    type: phandles

  event-device-states:
    type: array
```

## dts/bindings/evtc/evtc.yaml
```yaml
# Copyright (c) 2024 Nordic Semiconductor ASA
# SPDX-License-Identifier: Apache-2.0

description: Base properties for EVTC (EVenT Controller)

properties:
  evtc-request-latency-ns:
    type: int
    description: |
      Maximum latency from latency request to latency is in
      effect, in nanoseconds.

  evtc-latencies-ns:
    type: array
    required: true
    description: |
      Supported event latencies in descending order, in
      nanoseconds.
```

## dts/bindings/fan/fan-pwm.yaml
```yaml
# Copyright The Zephyr Project Contributors
# SPDX-License-Identifier: Apache-2.0

title: PWM-driven fan

description: |
    A cooling fan whose speed is controlled by a PWM signal. The PWM duty cycle sets the fan
    speed, from 0% (stopped) to 100% (full speed). An optional tachometer input allows the
    driver to report the measured rotation rate. Applications drive the fan through the generic
    fan API in <zephyr/drivers/fan.h>.

compatible: "fan-pwm"

include: base.yaml

properties:
  pwms:
    required: true
    type: phandle-array
    description: |
      PWM specifier for the channel wired to the fan speed-control input. The period cell sets
      the PWM frequency used to drive the fan; the driver adjusts the duty cycle at runtime as
      the application requests speeds. Polarity flags are forwarded to the PWM controller
      verbatim.

  tach-gpios:
    type: phandle-array
    description: |
      GPIO connected to the fan's tachometer output. When present, the driver counts pulses on
      this input to compute the rotation rate reported by fan_get_rpm(). Omit this property for
      fans without a tachometer signal.

  pulses-per-revolution:
    type: int
    default: 2
    description: |
      Number of tachometer pulses emitted per full fan revolution. Most brushless DC fans emit
      two pulses per revolution, which is the default. Only meaningful when tach-gpios is set.
```

## dts/bindings/firmware/arm,scmi-clock.yaml
```yaml
# Copyright 2024, 2026 NXP
# SPDX-License-Identifier: Apache-2.0

description: SCMI (System Control and Management Interface) clock protocol

compatible: "arm,scmi-clock"

include: [base.yaml, clock-controller.yaml]

properties:
  shmem:
    type: phandles

  reg:
    required: true
    const: [0x14]

  "#clock-cells":
    required: true
    const: 1
    description: |
      Vendor-specific clock identifier. Needs to match identifier
      expected by the SCMI platform as this is directly used in SCMI
      clock management messages.

  ignore-denied:
    type: boolean
    description: |
      Enable ignoring SCMI DENIED responses for clock enable/disable requests
      for selected clock IDs listed in ignore-denied-clock-ids.

  ignore-denied-clock-ids:
    type: array
    description: |
      List of SCMI clock identifiers for which SCMI_DENIED (mapped to -EACCES)
      should be treated as success when enabling/disabling clocks.

clock-cells:
  - name
```

## dts/bindings/firmware/arm,scmi-perf.yaml
```yaml
# Copyright 2026 NXP
# SPDX-License-Identifier: Apache-2.0

description: SCMI (System Control and Management Interface) performance domain protocol

compatible: "arm,scmi-perf"

include: [base.yaml]

properties:
  reg:
    required: true
    const: [0x13]
```

## dts/bindings/firmware/arm,scmi-pinctrl.yaml
```yaml
# Copyright 2024 NXP
# SPDX-License-Identifier: Apache-2.0

title: SCMI (System Control and Management Interface) pin control

description: SCMI pin control groups used to configure multiplexing and bias.

compatible: "arm,scmi-pinctrl"

include: base.yaml

properties:
  reg:
    required: true
    const: [0x19]

child-binding:
  description: SCMI pin protocol pin group
  properties:
    pinmux:
      required: true
      type: array
```

## dts/bindings/firmware/arm,scmi-power.yaml
```yaml
# Copyright 2024 NXP
# SPDX-License-Identifier: Apache-2.0

title: SCMI (System Control and Management Interface) power domain

description: SCMI power domain controller for agent-requested power state changes.

compatible: "arm,scmi-power"

include: [base.yaml]

properties:
  reg:
    required: true
    const: [0x11]

  "#power-domain-cells":
    type: int
    required: true
    const: 1

power-domain-cells:
  - name
```

## dts/bindings/firmware/arm,scmi-reset.yaml
```yaml
# Copyright (c) 2024 EPAM Systems
# SPDX-License-Identifier: Apache-2.0

description: SCMI Reset domain management Interface

compatible: "arm,scmi-reset"

include: [base.yaml, reset-controller.yaml]

properties:
  "#reset-cells":
    const: 1

  shmem:
    type: phandles

  reg:
    required: true
    const: [0x16]

reset-cells:
  - id
```

## dts/bindings/firmware/arm,scmi-shmem.yaml
```yaml
# Copyright 2024 NXP
# SPDX-License-Identifier: Apache-2.0

description: SCMI (System Control and Management Interface) SHMEM (shared memory)

compatible: "arm,scmi-shmem"

include: [base.yaml]

properties:
  reg:
    required: true
```

## dts/bindings/firmware/arm,scmi-smc-param.yaml
```yaml
# Copyright (c) 2024 EPAM Systems
# SPDX-License-Identifier: Apache-2.0

description: |
  SMC based System Control and Management Interface (SCMI) with
  shmem address(4KB-page, offset) as parameters

include: arm,scmi-smc.yaml

compatible: "arm,scmi-smc-param"
```

## dts/bindings/firmware/arm,scmi-smc.yaml
```yaml
# Copyright 2026 Texas Instruments Incorporated.
# SPDX-License-Identifier: Apache-2.0

description: |
        SCMI (System Control and Management Interface) with ARM SMC as doorbell
        and SHMEM (shared memory) transport.

compatible: "arm,scmi-smc"

include: [base.yaml]

properties:
  shmem:
    type: phandle
    required: true
    description: |
      Phandle to node describing TX channel shared memory area.
      This translates to a **single** SCMI transmit channel.

  arm,smc-id:
    required: true
    type: int
    description:
      SMC id required when using smc or hvc transports

  '#address-cells':
    const: 1

  '#size-cells':
    const: 0

examples:
  - |
    #include <mem.h>

    scmi_res0: memory@44611000 {
        compatible = "arm,scmi-shmem";
        reg = <0x44611000 0x80>;
    };

    scmi {
          compatible = "arm,scmi-smc";
          arm,smc-id = <0x82004000>;
          shmem = <&scmi_shmem>;

          #address-cells = <1>;
          #size-cells = <0>;

          scmi_pds: protocol@11 {
            compatible = "arm,scmi-power";
            reg = <0x11>;
            #power-domain-cells = <1>;
          };

          scmi_clk: protocol@14 {
            compatible = "arm,scmi-clock";
            reg = <0x14>;
            #clock-cells = <1>;
          };
    };
```

## dts/bindings/firmware/arm,scmi-system.yaml
```yaml
# Copyright 2025 NXP
# SPDX-License-Identifier: Apache-2.0

description: SCMI (System Control and Management Interface) system power protocol

compatible: "arm,scmi-system"

include: [base.yaml]

properties:
  reg:
    required: true
    const: [0x12]
```

## dts/bindings/firmware/arm,scmi.yaml
```yaml
# Copyright 2024 NXP
# SPDX-License-Identifier: Apache-2.0

description: |
        System Control and Management Interface (SCMI) with doorbell
        and shared memory (SHMEM) transport.

        Devicetree example:
            #include <mem.h>

            scmi_res0: memory@44611000 {
                compatible = "arm,scmi-shmem";
                reg = <0x44611000 0x80>;
            };

            mu5: mailbox@44610000 {
                compatible = "nxp,mbox-imx-mu";
                reg = <0x44610000 DT_SIZE_K(4)>;
                interrupts = <205 0>;
                #mbox-cells = <1>;
            };

            scmi {
                compatible = "arm,scmi";
                shmem = <&scmi_res0>;
                mboxes = <&mu5 0>;
                mbox-names = "tx";

                protocol@14 {
                    compatible = "arm,scmi-clock";
                    reg = <0x14>;
                    #clock-cells = <1>;
                };

                protocol@19 {
                    compatible = "arm,scmi-pinctrl";
                    reg = <0x19>;

                    pinctrl {
                        compatible = "nxp,imx95-pinctrl", "nxp,imx93-pinctrl";
                    };
                };
            };

compatible: "arm,scmi"

include: [base.yaml]

properties:
  shmems:
    type: phandle-array
    required: true
    description: |
      Phandle to node describing TX/RX channel shared memory area.
      This translates to a **single** SCMI transmit channel.

  mboxes:
    required: true
    description: |
      List of mailbox channel specifiers. It should contain one or two specifiers:
        1) tx - 1 mbox / 1 shmem (platform and agent use the same
        mailbox channel for signaling)
        2) tx_reply - 2 mbox / 1 shmem (platform and agent use different
        mailbox channels for signaling)

  mbox-names:
    required: true
    description: mailbox channel specifier names
```

## dts/bindings/firmware/nordic,ironside-call.yaml
```yaml
# Copyright (c) 2025 Nordic Semiconductor ASA
# SPDX-License-Identifier: Apache-2.0

description: IPC configuration for Nordic IRONside calls

compatible: "nordic,ironside-call"

include: base.yaml

properties:
  memory-region:
    type: phandle
    required: true
    description: phandle to shared memory region

  mboxes:
    required: true
    description: MBOX channel specifiers (TX and RX are required)

  mbox-names:
    required: true
    description: MBOX channel names (must be called "tx" and "rx")
```

## dts/bindings/firmware/nxp,imx-scu.yaml
```yaml
# Copyright 2023 NXP
# SPDX-License-Identifier: Apache-2.0

description: NXP System Controller Unit (SCU)

compatible: "nxp,imx-scu"

include: base.yaml

properties:
  mbox:
    required: true
    type: array
```

## dts/bindings/firmware/nxp,scmi-bbm.yaml
```yaml
# Copyright 2025 NXP
# SPDX-License-Identifier: Apache-2.0

description: System Control and Management Interface (SCMI) bbm protocol

compatible: "nxp,scmi-bbm"

include: [base.yaml]

properties:
  reg:
    required: true
    const: [0x81]
```

## dts/bindings/firmware/nxp,scmi-cpu.yaml
```yaml
# Copyright 2025 NXP
# SPDX-License-Identifier: Apache-2.0

title: SCMI (System Control and Management Interface) CPU (Central Processing Unit) domain

description: NXP SCMI CPU domain management for per-core power and state control.

compatible: "nxp,scmi-cpu"

include: [base.yaml]

properties:
  reg:
    required: true
    const: [0x82]
```

## dts/bindings/firmware/qemu,fw-cfg-ioport.yaml
```yaml
# Copyright (c) 2026 Maximilian Zimmermann
# SPDX-License-Identifier: Apache-2.0

description: QEMU fw_cfg (I/O port transport)

compatible: "qemu,fw-cfg-ioport"

include: [base.yaml]

properties:
  reg:
    required: true
```
