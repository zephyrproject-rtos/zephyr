## dts/bindings/firmware/qemu,fw-cfg-mmio.yaml
```yaml
# Copyright (c) 2026 Maximilian Zimmermann
# SPDX-License-Identifier: Apache-2.0

description: QEMU fw_cfg (MMIO transport)

compatible: "qemu,fw-cfg-mmio"

include: [base.yaml]

properties:
  reg:
    required: true

examples:
  - |
    fw-cfg@9020000 {
        compatible = "qemu,fw-cfg-mmio";
        reg = <0x0 0x09020000 0x0 0x18>;
        status = "okay";
    };
```

## dts/bindings/firmware/raspberrypi,bcm283x-firmware.yaml
```yaml
# Copyright (c) 2026 Muhammad Waleed Badar
# SPDX-License-Identifier: Apache-2.0

description: Raspberry Pi Firmware Interface

compatible: "raspberrypi,bcm283x-firmware"

include: [base.yaml]

properties:
  mboxes:
    required: true
    description: Phandle to the Broadcom BCM2711 Mailbox controller.

  mbox-names:
    required: true
    description: Mailbox channel specifier names.

  shared-memory:
    required: true
    type: phandle
```

## dts/bindings/firmware/ti,k2g-sci.yaml
```yaml
# Copyright 2025 Texas Instruments Incorporated.
# SPDX-License-Identifier: Apache-2.0

description: TISCI Client Driver

compatible: "ti,k2g-sci"

include: [base.yaml]

properties:
  reg:
    required: true

  ti,host-id:
    type: int
    required: true
    description: Host ID for processor

  ti,is-secure:
    type: boolean
    description: Indicates if the host is a secure entity

  mboxes:
    description: phandle to the MBOX controller (TX and RX are required)
    required: true

  mbox-names:
    description: MBOX channel names (must be called "tx" and "rx")
    required: true
```
