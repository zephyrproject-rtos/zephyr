## dts/bindings/ethernet/mdio/smsc,lan91c111-mdio.yaml
```yaml
# Copyright (c) 2023 Arm Limited (or its affiliates). All rights reserved.
# SPDX-License-Identifier: Apache-2.0

description: SMSC (now Microchip) LAN91C111 MDIO Driver node

compatible: "smsc,lan91c111-mdio"

include:
  - name: mdio-controller.yaml
```

## dts/bindings/ethernet/mdio/snps,dwmac-mdio.yaml
```yaml
# Copyright (c) 2026
# SPDX-License-Identifier: Apache-2.0

description: Synopsys DesignWare MAC MDIO controller

compatible: "snps,dwmac-mdio"

include:
  - name: mdio-controller.yaml
  - name: pinctrl-device.yaml
```

## dts/bindings/ethernet/mdio/st,stm32-mdio.yaml
```yaml
# Copyright (c) 2024 BayLibre, SAS
# Copyright (c) 2024 Analog Devices Inc.
# SPDX-License-Identifier: Apache-2.0

description: STM32 MDIO Controller

compatible: "st,stm32-mdio"

include: [mdio-controller.yaml, pinctrl-device.yaml]

properties:
  "#address-cells":
    required: true
    const: 1

  "#size-cells":
    required: true
    const: 0

  pinctrl-0:
    required: true

  pinctrl-names:
    required: true
```

## dts/bindings/ethernet/mdio/wch,mdio.yaml
```yaml
# Copyright (c) 2025 James Bennion-Pedley <james@bojit.org>
# SPDX-License-Identifier: Apache-2.0

description: WCH MDIO Controller

compatible: "wch,mdio"

include: [mdio-controller.yaml, pinctrl-device.yaml]

properties:
  "#address-cells":
    required: true
    const: 1

  "#size-cells":
    required: true
    const: 0

  pinctrl-0:
    required: true

  pinctrl-names:
    required: true
```

## dts/bindings/ethernet/mdio/xlnx,xps-ethernetlite-3.00.a-mdio.yaml
```yaml
# Copyright (c) 2025 CISPA Helmholtz Center for Information Security
# SPDX-License-Identifier: Apache-2.0

# Common fields for MDIO controllers

include: mdio-controller.yaml

compatible: xlnx,xps-ethernetlite-3.00.a-mdio

title: MDIO interface of Xilinx AXI Ethernet Lite (version 3.00.a).
```

## dts/bindings/ethernet/microchip,enc28j60.yaml
```yaml
# Copyright (c) 2018, Linaro Limited
# SPDX-License-Identifier: Apache-2.0

description: ENC28J60 standalone 10BASE-T Ethernet controller with SPI interface

compatible: "microchip,enc28j60"

include: [spi-device.yaml, ethernet.yaml]

properties:
    int-gpios:
      type: phandle-array
      required: true
      description: Interrupt pin.

        The interrupt pin of ENC28J60 is active low.
        If connected directly the MCU pin should be configured
        as active low.
```

## dts/bindings/ethernet/microchip,enc424j600.yaml
```yaml
# Copyright (c) 2019, Phytec Messtechnik GmbH
# SPDX-License-Identifier: Apache-2.0

description: |
    ENC424J600 standalone 100BASE-T Ethernet controller with SPI interface

compatible: "microchip,enc424j600"

include: [spi-device.yaml, ethernet.yaml]

properties:
  int-gpios:
    type: phandle-array
    required: true
    description: Interrupt pin.

      The interrupt pin of ENC424J600 is active low.
      If connected directly the MCU pin should be configured
      as active low.
```

## dts/bindings/ethernet/microchip,ksz8081.yaml
```yaml
# Copyright 2023 NXP
# SPDX-License-Identifier: Apache-2.0

description: Microchip KSZ8081 Ethernet PHY device

compatible: "microchip,ksz8081"

include: ethernet-phy.yaml

properties:
  mc,reset-gpio:
    type: phandle-array
    specifier-space: gpio
    description: GPIO connected to PHY reset signal pin. Reset is active low.
  mc,interrupt-gpio:
    type: phandle-array
    specifier-space: gpio
    description: GPIO for interrupt signal indicating PHY state change.
  mc,interface-type:
    type: string
    required: true
    description: Which type of phy connection the phy is set up for
    enum:
      - "mii"
      - "rmii"
      - "rmii-25MHz"
```

## dts/bindings/ethernet/microchip,ksz9131.yaml
```yaml
# Copyright (C) 2025 Microchip Technology Inc. and its subsidiaries
# SPDX-License-Identifier: Apache-2.0

description: Microchip KSZ9131 Ethernet PHY device

compatible: "microchip,ksz9131"

include: ethernet-phy.yaml

properties:
  reset-gpios:
    type: phandle-array
    description: GPIO connected to PHY reset signal pin. Reset is active low.
  int-gpios:
    type: phandle-array
    description: GPIO for interrupt signal indicating PHY state change.
```

## dts/bindings/ethernet/microchip,lan78xx.yaml
```yaml
# Copyright (c) 2026 Narek Aydinyan
# SPDX-License-Identifier: Apache-2.0

description: Microchip LAN78xx USB-to-Ethernet adapter

compatible: "microchip,lan78xx"

include: ethernet-controller.yaml

properties:
  phy-handle:
    required: true

  alt-setting:
    type: int
    default: 0
    description: |
      USB data interface alternate setting to select after endpoint discovery.
      The default 0 matches the supported LAN7800/LAN7850 adapters.

  led-enable-mask:
    type: int
    default: 0
    description: |
      Bitmask of LAN78xx LED outputs to enable in HW_CFG. The default 0 keeps
      the reset/strap LED configuration unchanged.
```

## dts/bindings/ethernet/microchip,lan865x.yaml
```yaml
# Copyright (c) 2023 DENX Software Engineering GmbH
# SPDX-License-Identifier: Apache-2.0

description: |
  LAN865x standalone 10BASE-T1L Ethernet controller with SPI interface.

compatible: "microchip,lan865x"

include: [spi-device.yaml, ethernet-controller.yaml]

properties:
  tx-cut-through-mode:
    type: boolean
    description: Enable TX cut through mode
  rx-cut-through-mode:
    type: boolean
    description: Enable RX cut through mode
  int-gpios:
    type: phandle-array
    required: true
    description: |
      The interrupt pin of LAN865X is active low.
      If connected directly the MCU pin should be configured
      as active low.
  rst-gpios:
    type: phandle-array
    required: true
    description: The reset pin of LAN865X.
```

## dts/bindings/ethernet/microchip,lan8720.yaml
```yaml
# Copyright 2024 Muhammad Waleed Badar
# SPDX-License-Identifier: Apache-2.0

description: Microchip LAN8720 Ethernet PHY device

compatible: "microchip,lan8720"

include: ethernet-phy.yaml

properties:
  reset-gpios:
    type: phandle-array
    description: GPIO connected to PHY reset signal pin. Reset is active low.
  int-gpios:
    type: phandle-array
    description: GPIO for interrupt signal indicating PHY state change.
```

## dts/bindings/ethernet/microchip,lan8720a.yaml
```yaml
# Copyright (c) 2023 Basalte bv
# SPDX-License-Identifier: Apache-2.0

description: Microchip LAN8720A PHY

compatible: "microchip,lan8720a"

include: phy.yaml

on-bus: mdio

properties:
  reg:
    required: true

  reset-gpios:
    type: phandle-array
    description: Reset pin.

      The reset pin of LAN8720A is active low.
      If connected directly the MCU pin should be configured
      as active low.

  irq-gpios:
    type: phandle-array
    required: true
    description: Interrupt pin.

      The interrupt pin of LAN8720A is active low.
      If connected directly the MCU pin should be configured
      as active low.
```

## dts/bindings/ethernet/microchip,lan9250.yaml
```yaml
# Copyright (c) 2024, Mario Paja
# SPDX-License-Identifier: Apache-2.0

description: |
    LAN9250 standalone 10/100BASE-T Ethernet controller with SPI interface

compatible: "microchip,lan9250"

include: [spi-device.yaml, ethernet-controller.yaml]

properties:
  int-gpios:
    type: phandle-array
    required: true
    description: |
      The interrupt pin of LAN9250 is active low.
      If connected directly the MCU pin should be configured
      as active low.
```

## dts/bindings/ethernet/microchip,pic32cxsg-gmac.yaml
```yaml
# Copyright (c) 2024 Microchip
# SPDX-License-Identifier: Apache-2.0

description: Microchip PIC32CXSG-family GMAC Ethernet

compatible: "microchip,pic32cxsg-gmac"

include: atmel,gmac-common.yaml
```

## dts/bindings/ethernet/microchip,sam-ethernet-controller.yaml
```yaml
# Copyright (C) 2025 Microchip Technology Inc. and its subsidiaries
# SPDX-License-Identifier: Apache-2.0

title: Microchip SAM Ethernet Controller

description: |
  Contains the Ethernet MAC and the MDIO as child nodes.

compatible: "microchip,sam-ethernet-controller"

include: base.yaml

properties:
  reg:
    required: true
```

## dts/bindings/ethernet/microchip,t1s-phy.yaml
```yaml
# Copyright (c) 2024 Microchip Technology Inc.
# SPDX-License-Identifier: Apache-2.0

description: Microchip's 10BASE-T1S PHYs support

compatible: "microchip,t1s-phy"

include: phy.yaml

properties:
  reg:
    required: true
    description: PHY address
  plca-enable:
    type: boolean
    description: Enable or disable PLCA support
  plca-node-id:
    type: int
    description: Specify the PLCA node ID number
  plca-node-count:
    type: int
    description: Specify the PLCA node count
  plca-burst-count:
    type: int
    description: Specify the PLCA burst count
  plca-burst-timer:
    type: int
    description: Specify the PLCA burst timer value
  plca-to-timer:
    type: int
    description: Specify the PLCA to timer value
```

## dts/bindings/ethernet/motorcomm,yt8521.yaml
```yaml
# Copyright 2025 NXP
# SPDX-License-Identifier: Apache-2.0

description: Motorcomm YT8521 Ethernet PHY

compatible: "motorcomm,yt8521"

include: ethernet-phy.yaml
```

## dts/bindings/ethernet/nuvoton,nct-ethernet.yaml
```yaml
# Copyright (c) 2025 Nuvoton Technology Corporation.
# SPDX-License-Identifier: Apache-2.0

description: NUVOTON NCT Ethernet controller

compatible: "nuvoton,nct-ethernet"

include: ["ethernet-controller.yaml", "pinctrl-device.yaml"]

properties:
  reg:
    required: true
  clocks:
    required: true
  interrupts:
    required: true
  pinctrl-0:
    required: true
  pinctrl-names:
    required: true
```

## dts/bindings/ethernet/nuvoton,npcm-ethernet.yaml
```yaml
# Copyright (c) 2024 Nuvoton Technology Corporation.
# SPDX-License-Identifier: Apache-2.0

description: NUVOTON NPCM Ethernet controller

compatible: "nuvoton,npcm-ethernet"

include: ["ethernet-controller.yaml", "pinctrl-device.yaml"]

properties:
  reg:
    required: true
  clocks:
    required: true
  interrupts:
    required: true
  pinctrl-0:
    required: true
  pinctrl-names:
    required: true
```

## dts/bindings/ethernet/nuvoton,numicro-ethernet-controller.yaml
```yaml
# Copyright (c) 2026 Fiona Behrens <me@kloenk.dev>
# SPDX-License-Identifier: Apache-2.0

description: Contains the Ethernet MAC and the MDIO as child nodes.

compatible: "nuvoton,numicro-ethernet-controller"

include: [base.yaml, reset-device.yaml]

properties:
  reg:
    required: true
```

## dts/bindings/ethernet/nuvoton,numicro-ethernet.yaml
```yaml
# Copyright (c) 2026 Fiona Behrens <me@kloenk.dev>
# SPDX-License-Identifier: Apache-2.0

description: Nuvoton, Numiro Ethernet

compatible: "nuvoton,numicro-ethernet"

include: [ethernet-controller.yaml, pinctrl-device.yaml]

properties:
  interrupts:
    required: true

  phy-handle:
    required: true
```

## dts/bindings/ethernet/nxp,enet-mac.yaml
```yaml
# Copyright 2023 NXP
# SPDX-License-Identifier: Apache-2.0

description: NXP ENET MAC/L2 Device

compatible: "nxp,enet-mac"

include: ["ethernet-controller.yaml", "pinctrl-device.yaml"]

properties:
  interrupts:
    required: true

  nxp,mdio:
    type: phandle
    required: true
    description: |
      Corresponding mdio device

  nxp,ptp-clock:
    type: phandle
    required: true
    description: |
      Corresponding ptp clock device

  nxp,unique-mac:
    type: boolean
    description: |
      Use part of the unique silicon ID to generate the MAC.
      This property will be overridden if the node has
      zephyr,random-mac-address or local-mac-address also.
      This option is intended for cases where a very low likelihood
      that the mac address is the same as another on the network
      is sufficient, such as, testing, bringup, demos, etc.
      The first 3 bytes will be the freescale OUI and the next
      3 bytes will come from the chip's unique ID.

  nxp,fused-mac:
    type: boolean
    description: |
      Use the MAC address from fuse shadow register.
      Not all platforms have a fusable MAC address.
```

## dts/bindings/ethernet/nxp,enet-qos-mac.yaml
```yaml
# Copyright 2024 NXP
# SPDX-License-Identifier: Apache-2.0

description: NXP ENET QOS MAC

compatible: "nxp,enet-qos-mac"

include: ethernet-controller.yaml

properties:
  interrupts:
    required: true

  interrupt-names:
    required: true

  nxp,unique-mac:
    type: boolean
    description: |
      Use part of the unique silicon ID to generate the MAC.
      This property will be overridden if the node has
      zephyr,random-mac-address or local-mac-address also.
      This option is intended for cases where a very low likelihood
      that the mac address is the same as another on the network
      is sufficient, such as, testing, bringup, demos, etc.
      The first 3 bytes will be the freescale OUI and the next
      3 bytes will come from the chip's unique ID.
```

## dts/bindings/ethernet/nxp,enet-qos-ptp-clock.yaml
```yaml
# SPDX-FileCopyrightText: Copyright 2026 NXP
# SPDX-License-Identifier: Apache-2.0

description: NXP ENET QoS PTP (Precision Time Protocol) Clock

compatible: "nxp,enet-qos-ptp-clock"

include: ["base.yaml"]
```
