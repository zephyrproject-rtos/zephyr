## dts/bindings/ethernet/mdio/opencores,ethoc-mdio.yaml
```yaml
# SPDX-FileCopyrightText: Copyright The Zephyr Project Contributors
# SPDX-License-Identifier: Apache-2.0

description: |
  OpenCores ethmac MDIO controller

  This node must be a child of the "opencores,ethoc" MAC node, whose
  registers it uses.

compatible: "opencores,ethoc-mdio"

include: mdio-controller.yaml

examples:
  - |
    ethernet@92000000 {
        compatible = "opencores,ethoc";
        reg = <0x92000000 0x800>;
        interrupts = <4>;
        phy-handle = <&phy>;

        mdio {
            compatible = "opencores,ethoc-mdio";
            #address-cells = <1>;
            #size-cells = <0>;

            phy: ethernet-phy@1 {
                compatible = "ethernet-phy";
                reg = <1>;
            };
        };
    };
```

## dts/bindings/ethernet/mdio/xlnx,gem-mdio.yaml
```yaml
# Copyright (c) 2026 Immo Birnbaum
# SPDX-License-Identifier: Apache-2.0

description: |
  Xilinx GEM MDIO node.

  Deprecated. Use cdns,macb-mdio with the Cadence MACB/GEM driver instead.

compatible: "xlnx,gem-mdio"

include: mdio-controller.yaml
```

## dts/bindings/ethernet/microchip,gmac-g1-eth.yaml
```yaml
# Copyright (c) 2026 Microchip Technology Inc.
# SPDX-License-Identifier: Apache-2.0

title: Microchip G1 GMAC Ethernet Controller

description: |
  Microchip GMAC Ethernet

  Group G1 Ethernet device supports following hardware peripherals:
    - module name="GMAC" id="U2005" version="1.0.0"

  The MDIO bus is provided by this device and is used to communicate
  with Ethernet PHY.

compatible: "microchip,gmac-g1-eth"

include:
  - name: ethernet-controller.yaml
  - name: pinctrl-device.yaml

properties:
  phy-handle:
    required: true

  num-queues:
    type: int
    required: true
    description: |
      Number of hardware TX and RX queues.
      Range: 1 - 8

  max-frame-size:
    type: int
    default: 1518
    description: |
      Maximum ethernet frame size.

      The current ethernet frame sizes supported by hardware are 1518,
      1536 and 10240 (jumbo frames).  This means that normally gmac
      will reject any frame above max-frame-size value. The default
      value is 1518, which represents an usual IEEE 802.3 ethernet frame:

      Ethernet Frame [ 14 MAC HEADER | 1500 MTU | 4 FCS ] = 1518 bytes

      When using value 1536 it is possible extend ethernet MAC HEADER up
      to 32 bytes.  The hardware have support to jumbo frames and it can be
      enabled by selecting the value 10240.

  max-speed:
    type: int
    default: 100
    description: |
      Maximum speed in Mbit/s supported by the device.

      The gmac driver supports 10Mbit/s and 100Mbit/s.  Using 100, as default
      value, enables driver to configure 10 and 100Mbit/s speeds.

  mac-eeprom:
    type: phandle
    description: phandle to I2C eeprom device node.

  phy-connection-type:
    default: "rmii"

  clocks:
    type: phandle-array

examples:
  - |
    &gmac {
      compatible = "microchip,gmac-g1-eth";
      interrupts = <84 0>;
      interrupt-names = "gmac";
      num-queues = <1>;
    };
```

## dts/bindings/ethernet/microchip,gmac-g2-eth.yaml
```yaml
# SPDX-FileCopyrightText: Copyright The Zephyr Project Contributors
# SPDX-License-Identifier: Apache-2.0

title: Microchip G2 GMAC Ethernet controller

description: |
  Microchip G2 GMAC Ethernet controller, the "ETH" peripheral of PIC32CZ CA.

  A Cadence GEM core behind a Microchip wrapper. The wrapper (CTRLA, CTRLB,
  EVCTRL, SYNCB, WPCTRL) occupies the start of the block and the MAC core
  follows at offset 0x1000; one reg entry covers both. The MAC supports
  GMII at 1000 Mbit/s, and MII and RMII at 10/100 Mbit/s.

  The core has several DMA queues, each with its own interrupt line. The
  driver moves all traffic through queue 0, parks the others on an inert
  descriptor and leaves every interrupt source of theirs masked, so their
  lines stay unconnected and never assert.

  This is not the peripheral microchip,gmac-g1-eth drives: that one is the
  10/100 GMAC of SAM E5x and PIC32CX SG, with a different register map and no
  wrapper.

  The MDIO bus is a child node, compatible "microchip,gmac-g2-mdio", and the
  PHY sits under that. Nesting them this way also orders their drivers: at
  equal init priority a device is initialized after the devicetree nodes it
  depends on, so the controller applies its pin configuration before the PHY
  driver releases the PHY from reset.

compatible: "microchip,gmac-g2-eth"

include:
  - name: ethernet-controller.yaml
  - name: pinctrl-device.yaml

properties:
  reg:
    required: true

  interrupts:
    required: true
    description: |
      One interrupt per DMA queue, queue 0 first. Only queue 0 is serviced.

  num-queues:
    type: int
    required: true
    description: |
      Number of hardware TX and RX queues.
      Range: 1 - 8

  clocks:
    required: true

  clock-names:
    required: true
    description: |
      "mclk-ahb" and "mclk-apb", the bus clocks; "gclk-tx", the 125 MHz
      generic clock that becomes GTXCK in GMII mode; and "gclk-tsu", the
      timestamp unit clock. The wrapper's software reset does not complete
      without gclk-tsu running, so it is required even with no PTP in use.

  phy-handle:
    required: true

  phy-connection-type:
    required: true
    description: |
      "gmii", "mii" or "rmii"; any other value fails the build. Only "gmii"
      reaches 1000 Mbit/s.

  pinctrl-0:
    required: true

  pinctrl-names:
    required: true
```

## dts/bindings/ethernet/microchip,ksz8851snl.yaml
```yaml
# SPDX-FileCopyrightText: Copyright The Zephyr Project Contributors
# SPDX-License-Identifier: Apache-2.0

description: |
    KSZ8851SNL single-port 10/100BASE-T Ethernet controller with SPI
    interface. The device integrates a MAC and PHY, accessed through
    the same SPI register interface.

compatible: "microchip,ksz8851snl"

include: [spi-device.yaml, ethernet-controller.yaml]

properties:
  int-gpios:
    type: phandle-array
    required: true
    description: |
      Interrupt pin.

      The interrupt pin of KSZ8851SNL is active low.
      If connected directly the MCU pin should be configured
      as active low.

  reset-gpios:
    type: phandle-array
    description: |
      Reset pin.

      The reset pin of KSZ8851SNL is active low.
      If connected directly the MCU pin should be configured
      as active low.
```

## dts/bindings/ethernet/microchip,mpfs-gem.yaml
```yaml
# SPDX-FileCopyrightText: Copyright The Zephyr Project Contributors
# SPDX-License-Identifier: Apache-2.0

description: |
  Cadence GEM in the Microchip PolarFire SoC and PIC64GX MSS.

  The GEM DMA reaches the cached DDR window through the CPU core complex
  and is coherent with the caches of the cores. With SGMII the transmit
  clock comes from the PCS, so no "tx_clk" is needed. The "resets"
  property is the MSS peripheral reset of the MAC, which also gates its
  clock.

compatible: "microchip,mpfs-gem"

include: cdns,gem.yaml
```

## dts/bindings/ethernet/microchip,pic32cz-ca-gem.yaml
```yaml
# SPDX-FileCopyrightText: Copyright The Zephyr Project Contributors
# SPDX-License-Identifier: Apache-2.0

description: |
  Cadence GEM in the Microchip PIC32CZ CA, the "ETH" peripheral.

  The GEM sits behind a Microchip wrapper (CTRLA, CTRLB, SYNCB) which
  resets and enables it and selects GMII. The wrapper occupies the start
  of the block and the GEM follows at offset 0x1000, so the first register
  range is the GEM and the second the wrapper.

  The GEM has six DMA queues, each raising its own interrupt. The driver
  moves all traffic through queue 0; the other queues are tied off and
  their interrupts are left unconnected.

compatible: "microchip,pic32cz-ca-gem"

include:
  - name: cdns,gem.yaml
  - name: pinctrl-device.yaml

properties:
  reg-names:
    required: true
    description: |
      Names of the register ranges: "mac" for the GEM itself and "wrapper"
      for the Microchip wrapper in front of it.

  interrupts:
    description: |
      One interrupt per DMA queue, queue 0 first. Only queue 0 is serviced.

  clocks:
    required: true

  clock-names:
    required: true
    description: |
      "mclk-ahb" and "mclk-apb", the bus clocks; "gclk-tx", the 125 MHz
      generic clock that becomes GTXCK in GMII mode; and "gclk-tsu", the
      timestamp unit clock. The wrapper's software reset does not complete
      without gclk-tsu running, so it is required even with no PTP in use.

  phy-connection-type:
    required: true
    description: |
      "gmii", the only interface supported. It also carries 10 and
      100 Mbit/s links.

  pinctrl-0:
    required: true
    description: |
      Applied before the PHY driver releases the PHY from reset, as the
      PHY node descends from this one. A PHY that latches its strap-in
      values from the receive pins gets them from the pulls in this state.
      The MDIO pins belong in it as well.

  pinctrl-names:
    required: true
```

## dts/bindings/ethernet/nuvoton,numaker-ethernet.yaml
```yaml
# Copyright (c) 2023 Nuvoton Technology Corporation.
# SPDX-License-Identifier: Apache-2.0

title: Nuvoton, NuMaker Ethernet controller

compatible: "nuvoton,numaker-ethernet"

include:
  - name: snps,dwmac.yaml
  - name: reset-device.yaml
  - name: pinctrl-device.yaml

properties:
  reg:
    required: true

  interrupts:
    required: true

  resets:
    required: true

  clocks:
    required: true

  phy-addr:
    type: int
    description: Address of the phy controller
    required: true

  ptp-clock:
    type: phandle
    description: |
      IEEE 1588 timestamp clock inside this MAC. When present the driver reports
      ETHERNET_PTP, returns this device from get_ptp_clock(), and enables per-frame
      timestamp snapshotting; the referenced driver owns the timebase itself.
```

## dts/bindings/ethernet/nxp,enet-ptp-clock.yaml
```yaml
# Copyright 2023 NXP
# SPDX-License-Identifier: Apache-2.0

description: NXP ENET PTP (Precision Time Protocol) Clock

compatible: "nxp,enet-ptp-clock"

include: ["base.yaml", "pinctrl-device.yaml"]

properties:
  interrupts:
    required: true

  clock-mux:
    type: int
    enum: [0, 1, 2, 3, 4, 5, 6, 7]
    description: |
      Source of the clock root of the 1588 timer. Used by the i.MX RT11xx SoCs only.
      The default is 4 (SYS_PLL1_DIV2), which gives 100 MHz together with the default
      divider.

        0: OSC_RC_48M_DIV2
        1: OSC_24M
        2: OSC_RC_400M
        3: OSC_RC_16M
        4: SYS_PLL1_DIV2
        5: AUDIO_PLL_CLK
        6: SYS_PLL1_DIV5
        7: SYS_PLL2_PFD1

      The source must be running before the Ethernet driver starts the timer, which for
      AUDIO_PLL_CLK means the driver that sets up that PLL must initialize first. The root
      frequency must not exceed the maximum of the SoC voltage mode (i.MX RT1170: 100 MHz in
      under-drive, 200 MHz in nominal and overdrive).

  clock-div:
    type: int
    description: |
      Divider of the clock root of the 1588 timer, from 1 to 256. Used by the i.MX RT11xx
      SoCs only. The default is 5.
```

## dts/bindings/ethernet/nxp,s32-gmac.yaml
```yaml
# Copyright 2023 NXP
# SPDX-License-Identifier: Apache-2.0

title: NXP S32 GMAC/EMAC driver

compatible: "nxp,s32-gmac"

include:
  - name: snps,dwmac.yaml
  - name: pinctrl-device.yaml

properties:
  reg:
    required: true

  interrupts:
    required: true

  interrupt-names:
    required: true
```

## dts/bindings/ethernet/opencores,ethoc.yaml
```yaml
# SPDX-FileCopyrightText: Copyright The Zephyr Project Contributors
# SPDX-License-Identifier: Apache-2.0

description: |
  OpenCores 10/100 Mbps Ethernet MAC (ethmac)

  The register region covers the control registers and the buffer
  descriptors at offset 0x400. Frame buffers are placed in system memory,
  so the MAC must be able to access it.

  The MDIO controller is described by an "opencores,ethoc-mdio" child node.

compatible: "opencores,ethoc"

include: ethernet-controller.yaml

properties:
  reg:
    required: true

  interrupts:
    required: true

  phy-handle:
    required: true

examples:
  - |
    ethernet@92000000 {
        compatible = "opencores,ethoc";
        reg = <0x92000000 0x800>;
        interrupts = <4>;
        phy-handle = <&phy>;

        mdio {
            compatible = "opencores,ethoc-mdio";
            #address-cells = <1>;
            #size-cells = <0>;

            phy: ethernet-phy@1 {
                compatible = "ethernet-phy";
                reg = <1>;
            };
        };
    };
```

## dts/bindings/ethernet/phy/adi,adin1140-phy.yaml
```yaml
# Copyright (c) 2024-2026 Analog Devices Inc.
# SPDX-License-Identifier: Apache-2.0

description: ADIN1140 PHY

compatible: "adi,adin1140-phy"

include:
  - name: phy.yaml
  - name: ethernet-phy-plca.yaml

on-bus: mdio

properties:
  reg:
    required: true
    description: 5-bit physical/port address (PRTAD).
```

## dts/bindings/ethernet/phy/brcm,bcm54213pe.yaml
```yaml
# Copyright (c) 2026 Muhammad Waleed Badar
# SPDX-License-Identifier: Apache-2.0

description: Broadcom BCM54213PE Ethernet PHY

compatible: "brcm,bcm54213pe"

include: ethernet-phy-common.yaml

properties:
  default-speeds:
    default: ["10BASE Half-Duplex", "10BASE Full-Duplex", "100BASE Half-Duplex",
              "100BASE Full-Duplex", "1000BASE Half-Duplex", "1000BASE Full-Duplex"]

  brcm,rgmii-delay:
    type: string
    description: |
      Internal RGMII clock delay added by the PHY.

      - "none": no internal delay
      - "id": enable RX and TX delay
      - "rxid": enable RX delay only
      - "txid": enable TX delay only

      Use "id" when the MAC adds no delay and the board has no delay traces,
      e.g. GENET in "rgmii" mode on Raspberry Pi 4.
    enum:
      - "none"
      - "id"
      - "rxid"
      - "txid"
    default: "id"
```

## dts/bindings/ethernet/phy/common/ethernet-phy-common.yaml
```yaml
# Copyright The Zephyr Project Contributors
# SPDX-License-Identifier: Apache-2.0

# Common fields for MIIPHY devices

include:
  - name: phy.yaml
  - name: ethernet-phy-default-speeds.yaml

properties:
  reg:
    required: true
    description: PHY address

  rx-internal-delay-ps:
    type: int
    description: |
      Specifies the internal delay of the receive path in picoseconds.
      Only for RGMII interfaces. Applied by the PHY.

  tx-internal-delay-ps:
    type: int
    description: |
      Specifies the internal delay of the transmit path in picoseconds.
      Only for RGMII interfaces. Applied by the PHY.
```

## dts/bindings/ethernet/phy/common/ethernet-phy-reset-gpios.yaml
```yaml
# SPDX-FileCopyrightText: Copyright The Zephyr Project Contributors
# SPDX-License-Identifier: Apache-2.0

# Common reset gpio properties for MIIPHY devices

properties:
  reset-gpios:
    type: phandle-array
    description: |
      Optional GPIO used to reset the PHY
  reset-assert-us:
    type: int
    description: |
      Time in microseconds to hold the reset-gpios pin asserted.
  reset-deassert-us:
    type: int
    description: |
      Time in microseconds to wait after deasserting the reset-gpios pin.
```
