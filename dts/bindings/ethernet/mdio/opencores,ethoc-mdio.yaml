## dts/bindings/ethernet/phy/microchip,vsc8541.yaml
```yaml
# Copyright (c) 2024 sensry.io
# SPDX-License-Identifier: Apache-2.0

description: Single Port Gigabit Ethernet Copper PHY with GMII/RGMII/MII/RMII Interfaces

compatible: "microchip,vsc8541"

include: [ethernet-phy-common.yaml]

on-bus: mdio

properties:
  reg:
    required: true
    description: |
      5-bit MDIO PHY address for the attached PHY.

  reset-gpios:
    type: phandle-array
    description: GPIO connected to MAC PHY reset signal pin. Reset is active low.

  int-gpios:
    type: phandle-array
    description: GPIO connected to MAC PHY interrupt signal pin. Interrupt is active low.

  microchip,interface-type:
    type: string
    required: true
    description: Which type of phy connection the phy is set up for
    enum:
      - "mii"
      - "rmii"
      - "gmii"
      - "rgmii"

  microchip,rgmii-rx-clk-delay:
    type: int
    default: 5
    description: |
      Used to configure the RX clock delay for RGMII interface. The value can be
      0 to 7. Refer to the datasheet for more details on the delay settings.

  microchip,rgmii-tx-clk-delay:
    type: int
    default: 5
    description: |
      Used to configure the TX clock delay for RGMII interface. The value can be
      0 to 7. Refer to the datasheet for more details on the delay settings.

  vsc8531,vddmac:
    type: int
    default: 3300
    enum: [3300, 2500, 1800, 1500]
    description: |
      VDDMAC supply voltage in millivolts. The driver uses the voltage to
      select the edge-rate conversion table. The property does not change
      the supply voltage.

      The default matches the Linux binding. When setting
      vsc8531,edge-slowdown, override the default if the board uses a
      different VDDMAC voltage.

  vsc8531,edge-slowdown:
    type: int
    default: 0
    enum: [0, 2, 3, 4, 5, 6, 7, 9, 10, 14, 16, 17, 21, 23, 29, 35, 37, 42,
           52, 53, 58, 63, 76, 77]
    description: |
      Percentage reduction in MAC-interface output edge rate relative to
      the fastest setting. Zero selects the fastest setting. The default
      matches the hardware power-on default and the Linux binding.
      Set a nonzero value to select a slower edge rate.

      Valid percentages depend on vsc8531,vddmac:

      - 3300 mV: 0, 2, 4, 7, 10, 17, 29, 53 (recommended: 7)
      - 2500 mV: 0, 3, 6, 10, 14, 23, 37, 63 (recommended: 10)
      - 1800 mV: 0, 5, 9, 16, 23, 35, 52, 76 (recommended: 0)
      - 1500 mV: 0, 6, 14, 21, 29, 42, 58, 77 (recommended: 0)

      The percentages select settings from the datasheet's MAC Interface
      Edge Rate Control table, as in the Linux binding. The percentages
      describe measurements on typical silicon at nominal supply voltage
      and room temperature. The actual edge rate depends on the board
      and operating conditions.

  default-speeds:
    default: ["10BASE Half-Duplex", "10BASE Full-Duplex", "100BASE Half-Duplex",
              "100BASE Full-Duplex", "1000BASE Half-Duplex", "1000BASE Full-Duplex"]
```

## dts/bindings/ethernet/phy/motorcomm,yt8521.yaml
```yaml
# Copyright 2025 NXP
# SPDX-License-Identifier: Apache-2.0

description: Motorcomm YT8521 Ethernet PHY

compatible: "motorcomm,yt8521"

include: ethernet-phy-common.yaml

properties:
  motorcomm,rx-delay-sel:
    type: int
    description: |
      RGMII RX_CLK delay train configuration, about 150ps per step.
      See RGMII_Config1 (EXT_0xA003) register for details
  motorcomm,tx-delay-sel:
    type: int
    description: |
      RGMII RX_CLK delay train configuration, about 150ps per step.
      See RGMII_Config1 (EXT_0xA003) register for details
  motorcomm,tx-delay-sel-fe:
    type: int
    enum: [0, 1, 2, 3, 4, 5, 6, 7, 8, 9, 10, 11, 12, 13, 14, 15]
    description: |
      RGMII TX_CLK delay train configuration at 10 and 100 Mbps, about
      150ps per step. Left unchanged when not set.
      See RGMII_Config1 (EXT_0xA003) register for details
  motorcomm,rxc-delay-en:
    type: boolean
    description: |
      Enable the PHY RX_CLK delay of about 2 ns.
      See Chip_Config (EXT_0xA001) register for details
  default-speeds:
    default: ["10BASE Half-Duplex", "10BASE Full-Duplex", "100BASE Half-Duplex",
              "100BASE Full-Duplex", "1000BASE Half-Duplex", "1000BASE Full-Duplex"]
```

## dts/bindings/ethernet/phy/realtek,rtl8211f.yaml
```yaml
# Copyright 2023-2024 NXP
# SPDX-License-Identifier: Apache-2.0

description: Realtek RTL8211F Ethernet PHY device

compatible: "realtek,rtl8211f"

include: ethernet-phy-common.yaml

properties:
  reset-gpios:
    type: phandle-array
    description: GPIO connected to PHY reset signal pin. Reset is active low.
  int-gpios:
    type: phandle-array
    description: GPIO for interrupt signal indicating PHY state change.
  realtek,rgmii-delay:
    type: string
    description: |
      Configure RTL8211F internal RGMII clock delay mode.

      This property is only applicable when the PHY is connected using an
      RGMII interface.

      - "none": no internal delay
      - "id": enable RX and TX delay
      - "rxid": enable RX delay only
      - "txid": enable TX delay only
    enum:
      - "none"
      - "id"
      - "rxid"
      - "txid"
    default: "id"
  default-speeds:
    default: ["10BASE Half-Duplex", "10BASE Full-Duplex", "100BASE Half-Duplex",
              "100BASE Full-Duplex", "1000BASE Half-Duplex", "1000BASE Full-Duplex"]
  timing-role:
    type: string
    description: |
      1000BASE-T master/slave role. Omit for IEEE auto resolution (default).

      - "forced-master"    - manual MS enable, MS=1
      - "forced-slave"     - manual MS enable, MS=0
      - "preferred-master" - auto resolution, prefer MS=1
      - "preferred-slave"  - auto resolution, prefer MS=0

      Use "forced-master" on a direct point-to-point link to a PC/RPi NIC
      if the link flaps or caps at 100 Mb (auto master/slave never agrees
      with some NICs). Never force the same role on both ends.
    enum:
      - "forced-master"
      - "forced-slave"
      - "preferred-master"
      - "preferred-slave"
```

## dts/bindings/ethernet/phy/ti,dp83tc811.yaml
```yaml
# Copyright (c) 2026 ZAL Zentrum für Angewandte Luftfahrtforschung GmbH
# SPDX-License-Identifier: Apache-2.0

description: |
  TI DP83TC811 100BASE-T1 automotive Ethernet PHY.

  The link is always 100 Mbit/s full duplex. The MAC interface (MII, RMII,
  RGMII) and the master/slave role are selected by strap pins only.

compatible: "ti,dp83tc811"

include:
  - name: ethernet-phy-common.yaml
  - name: ethernet-phy-reset-gpios.yaml

on-bus: mdio

properties:
  int-gpios:
    type: phandle-array
    description: |
      Interrupt GPIO. If present, link changes are signalled by interrupt;
      otherwise the link is polled every CONFIG_PHY_MONITOR_PERIOD.

  default-speeds:
    default: ["100BASE Full-Duplex"]
```

## dts/bindings/ethernet/rockchip,rk3588-gmac.yaml
```yaml
# Copyright (c) 2026 KylinSoft Corporation
# SPDX-License-Identifier: Apache-2.0

title: Rockchip RK3588 GMAC

description: |
  Rockchip RK3588 Gigabit Ethernet MAC based on Synopsys DesignWare MAC.

compatible: "rockchip,rk3588-gmac"

include:
  - name: snps,dwmac.yaml
  - name: reset-device.yaml

properties:
  reg:
    required: true

  interrupts:
    required: true

  clocks:
    required: true
    type: phandle-array
    description: |
      CRU clock phandles. See include/zephyr/dt-bindings/clock/rk3588-cru.h
      for clock IDs. Typical clocks are CLK_GMAC_125M, CLK_GMAC_50M,
      PCLK_GMACn, ACLK_GMACn, and CLK_GMACn_PTP_REF.

  clock-names:
    type: string-array
    description: |
      Names for clocks listed in the clocks property. Typical names are
      "stmmaceth", "clk_mac_ref", "pclk_mac", "aclk_mac", and "ptp_ref".

  resets:
    required: true

  clock-in-out:
    type: string
    enum:
      - "input"
      - "output"
    default: "input"
    description: |
      RGMII clock direction. "input" means the 125 MHz RGMII reference
      clock comes from the PHY. "output" means the SoC provides the
      reference clock. RMII uses the same values for the 50 MHz clock.

  rockchip,grf:
    type: phandle
    required: true
    description: |
      Phandle to the system GRF syscon, which holds the RGMII clock delay
      configuration.

  rockchip,php-grf:
    type: phandle
    required: true
    description: |
      Phandle to the PHP GRF syscon, which holds the RGMII interface select
      and the transmit clock divider.

  tx-delay:
    type: int
    default: 0x30
    min: 0
    max: 0x7f
    description: TX RGMII delay value programmed in sys-GRF.

  rx-delay:
    type: int
    default: 0x10
    min: 0
    max: 0x7f
    description: RX RGMII delay value programmed in sys-GRF.
```

## dts/bindings/ethernet/sifive,fu540-c000-gem.yaml
```yaml
# SPDX-FileCopyrightText: Copyright The Zephyr Project Contributors
# SPDX-License-Identifier: Apache-2.0

description: |
  Cadence GEM in the SiFive FU540.

  The second register range is the GEMGXL management register, through
  which the driver provides the transmit clock of the MAC itself and
  switches it between the gigabit and the slower rates to follow the link
  speed. The clocks "pclk" and "hclk" are the GEMGXL PLL of the PRCI, as
  in the Linux devicetree.

compatible: "sifive,fu540-c000-gem"

include: cdns,gem.yaml

properties:
  reg-names:
    required: true
    description: |
      Names of the register ranges: "mac" for the GEM itself and "mgmt"
      for the GEMGXL management register.
```

## dts/bindings/ethernet/snps,designware-ethernet.yaml
```yaml
# Copyright (c) 2021, BayLibre SAS
# SPDX-License-Identifier: Apache-2.0

title: Synopsys DesignWare Ethernet

compatible: "snps,designware-ethernet"

include: snps,dwmac.yaml

properties:
  reg:
    required: true
  interrupts:
    required: true
```

## dts/bindings/ethernet/snps,dwmac.yaml
```yaml
# SPDX-FileCopyrightText: Copyright The Zephyr Project Contributors
# SPDX-License-Identifier: Apache-2.0

title: Synopsys DesignWare MAC

description: |
  Synopsys DesignWare MAC (DW MAC) is a highly configurable, high-performance
  Ethernet Media Access Controller (MAC) IP core, that is used by many SoC vendors.
  This binding is derived from the matching Linux kernel binding.

compatible: "snps,dwmac"

include: ethernet-controller.yaml

properties:
  snps,clk-csr:
    type: int
    description: |
      Value programmed into the MAC MDIO Address CR field.
      When present, this fixed value is used directly instead of deriving
      the MDIO clock range from the MAC clock rate.

  snps,multicast-filter-bins:
    type: int
    enum: [64, 128, 256]
    description: |
      Number of multicast hash filter bins the hardware was configured
      with. The absence of this property means the hardware cannot hash
      multicast addresses.

  snps,perfect-filter-entries:
    type: int
    default: 1
    min: 1
    description: |
      Number of MAC address (perfect) filter entries the hardware was
      configured with, including entry 0 which holds the station address.
      The default corresponds to the minimal hardware configuration.
```

## dts/bindings/ethernet/snps,ethernet-cyclonev.yaml
```yaml
# SPDX-License-Identifier: Apache-2.0
# Copyright (C) 2022, Intel Corporation

title: Ethernet driver for Cyclone V SoC

compatible: "snps,ethernet-cyclonev"

include: snps,dwmac.yaml

properties:
  reg:
    required: true
  interrupts:
    required: true
  emac-index:
    type: int
    required: true
```

## dts/bindings/ethernet/st,stm32-ethernet.yaml
```yaml
# Copyright (c) 2020, Linaro Limited
# Copyright (c) 2024, STMicroelectronics
# SPDX-License-Identifier: Apache-2.0

title: ST STM32 Ethernet MAC

compatible: "st,stm32-ethernet"

include:
  - name: snps,dwmac.yaml
  - name: pinctrl-device.yaml

properties:
  reg:
    required: true
  clocks:
    required: true
  clock-names:
    required: true
  interrupts:
    required: true
  pinctrl-0:
    required: true
  pinctrl-names:
    required: true
  phy-connection-type:
    required: true
  phy-handle:
    required: true
```
