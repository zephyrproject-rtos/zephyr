## dts/bindings/ethernet/snps,dwmac-ptp-clock.yaml
```yaml
# SPDX-License-Identifier: Apache-2.0

description: Synopsys DesignWare MAC PTP (Precision Time Protocol) Clock

compatible: "snps,dwmac-ptp-clock"

include: ["base.yaml"]
```

## dts/bindings/ethernet/st,stm32-ethernet-common.yaml
```yaml
# Copyright (c) 2024, STMicroelectronics
# SPDX-License-Identifier: Apache-2.0

# Common fields for STM32 Ethernet peripherals.

include: [ethernet-controller.yaml, pinctrl-device.yaml]

properties:
  reg:
    required: true
  interrupts:
    required: true
  clocks:
    required: true
  clock-names:
    required: true
  pinctrl-0:
    required: true
  pinctrl-names:
    required: true
```

## dts/bindings/ethernet/st,stm32-ethernet-controller.yaml
```yaml
# Copyright The Zephyr Project Contributors
# SPDX-License-Identifier: Apache-2.0

title: STM32 Ethernet Controller

description: |
  Contains the Ethernet MAC and the MDIO as child nodes.

compatible: "st,stm32-ethernet-controller"

include: base.yaml

properties:
  reg:
    required: true
  clocks:
    required: true
  clock-names:
    required: true
```

## dts/bindings/ethernet/st,stm32h5-ethernet.yaml
```yaml
# Copyright (c) 2025, Benjamin Klaric <benjamin.klaric01@gmail.com>
# SPDX-License-Identifier: Apache-2.0

description: |
  STM32H5 Ethernet

  This binding file describes the device tree properties required to configure
  and use the Ethernet controller on STM32H5 series microcontrollers.

compatible: "st,stm32h5-ethernet"

include: st,stm32-ethernet-common.yaml
```

## dts/bindings/ethernet/st,stm32h7-ethernet.yaml
```yaml
# Copyright (c) 2024, STMicroelectronics
# SPDX-License-Identifier: Apache-2.0

description: |
  STM32H7 Ethernet

  This binding file describes the device tree properties required to configure
  and use the Ethernet controller on STM32H7 series microcontrollers.

compatible: "st,stm32h7-ethernet"

include:
  - "st,stm32-ethernet-common.yaml"
  - "memory-region.yaml"

properties:
  memory-regions:
    required: true
    description: |
      Reference to SRAM node used for Ethernet DMA buffer and descriptor.
```

## dts/bindings/ethernet/st,stm32mp13-ethernet.yaml
```yaml
# Copyright (c) 2025, STMicroelectronics
# SPDX-License-Identifier: Apache-2.0

description: |
  STM32MP13 Ethernet

  This binding file describes the device tree properties required to configure
  and use the Ethernet controller on STM32MP13 series microprocessor.

compatible: "st,stm32mp13-ethernet"

include:
  - "st,stm32-ethernet-common.yaml"
  - "memory-region.yaml"

properties:
  memory-regions:
    required: true
    description: |
      Memory region in which the Ethernet DMA lists and data buffers will be
      placed. The memory region has to be non-cacheable and accessible by the
      Ethernet peripheral.
  st,ext-phyclk:
    type: boolean
    description:
      Set this property in RMII mode when you have PHY without crystal 50MHz and want to
      select RCC clock instead of ETH_REF_CLK, or in RGMII mode when you want to select
      RCC clock instead of ETH_CLK125.
```

## dts/bindings/ethernet/st,stm32n6-ethernet.yaml
```yaml
# Copyright (c) 2025, STMicroelectronics
# SPDX-License-Identifier: Apache-2.0

description: |
  ST STM32N6 Ethernet

  This binding file describes the device tree properties required to configure
  and use the Ethernet controller on STM32N6 series microcontrollers.

compatible: "st,stm32n6-ethernet"

include: st,stm32-ethernet-common.yaml
```

## dts/bindings/ethernet/ti,am62l-cpsw.yaml
```yaml
# Copyright (c) 2026 Texas Instruments Incorporated
# Author: Siddharth Vadapalli <s-vadapalli@ti.com>
# SPDX-License-Identifier: Apache-2.0

description: TI AM62L Common Platform Switch (CPSW)

compatible: "ti,am62l-cpsw"

include: base.yaml

properties:
  reg:
    required: true
    description: |
      CPSW NU Subsystem Register region.

  reg-names:
    required: true
    description: |
      "cpsw_nuss" for the CPSW NU Subsystem register region,
      "gmii_sel" for the GMII configuration CTRL MMR registers, and
      "mac_efuse" for the eFuse register holding the MAC Port 1 address.

  dmas:
    required: true
    description: |
      DMA Channels for transmitting data to and receiving data from
      CPSW. The Address Select (ASEL) parameter is specified along
      with the DMA Channel. The Accelerator Coherency Port (ACP) in
      the ARM Cluster on the SoC enables IO Coherency in the following
      manner:
      A) Device initiated reads to System Memory go through the L2
      cache controller ensuring that the device gets the correct data
      if the data hasn't been flushed to System Memory yet.
      B) Device initiated writes to System Memory also go through the
      L2 cache controller ensuring that the cache is updated to reflect
      the correct contents of System Memory.
      The ASEL parameter is utilized to enable this feature and the
      valid values are:
      ASEL 14
      => Write transactions cause L2 cache allocation for cache warming
      ASEL 15
      => Write transactions do not cause L2 cache allocation
      Read transactions do not result in L2 cache allocation independent
      of the ASEL value.

  dma-names:
    required: true
    description: |
      The DMA Channels should be named in the format of "tx0", "tx1" and
      so on for transmit and "rx" for receive (there is a single RX DMA
      Channel). Transmit and receive are defined from the perspective of
      Host Software. Hence, "transmit" refers to DMA Channels moving data
      from System Memory to CPSW whereas "receive" refers to DMA Channels
      moving data from CPSW to System Memory.

child-binding:
  description: Ethernet Ports

  properties:
    "#address-cells":
      type: int
      const: 1

    "#size-cells":
      type: int
      const: 0

  child-binding:
    description: MAC Port

    include:
      - name: ethernet-controller.yaml
        property-blocklist:
          - compatible

    properties:
      reg:
        required: true
        type: array
        max-len: 1
        description: |
          The MAC Port number (starting from 1 for MAC Port 1).
          The CPSW Host Port (CPU facing port) is numbered 0 and
          doesn't have to be described.

      ti,mac-only:
        type: boolean
        description: Port is MAC only (no L2 switching to/from other MAC Ports).
```

## dts/bindings/ethernet/ti,dp83822-phy.yaml
```yaml
# Copyright (c) 2025 Immo Birnbaum
# SPDX-License-Identifier: Apache-2.0

description: |
  Texas Instruments DP83822 100 MBit/s PHY

compatible: "ti,dp83822"

include: ethernet-phy.yaml

on-bus: mdio

properties:
  reg:
    required: true
    description: 5-bit physical/port address (PRTAD).
```

## dts/bindings/ethernet/ti,dp83825.yaml
```yaml
# Copyright 2023-2024 NXP
# SPDX-License-Identifier: Apache-2.0

description: TI DP83825 Ethernet PHY device

compatible: "ti,dp83825"

include: ethernet-phy.yaml

properties:
  reset-gpios:
    type: phandle-array
    description: GPIO connected to PHY reset signal pin. Reset is active low.
  int-gpios:
    type: phandle-array
    description: GPIO for interrupt signal indicating PHY state change.
  ti,interface-type:
    type: string
    required: true
    description: Which type of phy connection the phy is set up for
    enum:
      - "rmii"
      - "rmii-25MHz"
```

## dts/bindings/ethernet/ti,dp83867.yaml
```yaml
# Copyright 2024, PHYTEC America, LLC
# SPDX-License-Identifier: Apache-2.0

description: TI DP83867 Ethernet PHY device

compatible: "ti,dp83867"

include: ethernet-phy.yaml

properties:
  reset-gpios:
    type: phandle-array
    description: GPIO connected to PHY reset signal pin. Reset is active low.
  int-gpios:
    type: phandle-array
    description: GPIO for interrupt signal indicating PHY state change.
```

## dts/bindings/ethernet/ti,stellaris-ethernet.yaml
```yaml
# Copyright (c) 2018 Zilogic Systems
# SPDX-License-Identifier: Apache-2.0

description: TI Stellaris Ethernet

compatible: "ti,stellaris-ethernet"

include: ethernet.yaml

properties:
    reg:
      required: true
    interrupts:
      required: true
```

## dts/bindings/ethernet/tsnlab,tsn-nic.yaml
```yaml
# Copyright (c) 2024 Junho Lee <junho@tsnlab.com>
# SPDX-License-Identifier: Apache-2.0

description: TSN NIC Ethernet driver

compatible: "tsnlab,tsn-nic-eth"

include: ethernet-controller.yaml
```

## dts/bindings/ethernet/virtio,net.yaml
```yaml
# Copyright (c) 2025 Antmicro <www.antmicro.com>
# SPDX-License-Identifier: Apache-2.0

description: VIRTIO Network device

compatible: "virtio,net"

include: [ethernet-controller.yaml]
```

## dts/bindings/ethernet/wch,ch32-ethernet-controller.yaml
```yaml
# Copyright The Zephyr Project Contributors
# SPDX-License-Identifier: Apache-2.0

title: WCH Ethernet Controller

description: |
  Contains the Ethernet MAC and the MDIO as child nodes.

compatible: "wch,ch32-ethernet-controller"

include: base.yaml

properties:
  reg:
    required: true
  clocks:
    required: true
```

## dts/bindings/ethernet/wch,ch390.yaml
```yaml
# Copyright (c) 2026
# SPDX-License-Identifier: Apache-2.0

description: WCH CH390 10/100BASE-T Ethernet controller with SPI interface

compatible: "wch,ch390"

include: [spi-device.yaml, ethernet-controller.yaml]

properties:
  int-gpios:
    type: phandle-array
    required: true
    description: |
      Interrupt pin of CH390. The interrupt pin polarity is configured from
      the GPIO active flag.

  reset-gpios:
    type: phandle-array
    description: |
      Optional hardware reset pin. If absent, the driver uses the CH390
      software reset sequence.
```

## dts/bindings/ethernet/wch,ethernet-controller.yaml
```yaml
# Copyright 2025 James Bennion-Pedley <james@bojit.org>
# SPDX-License-Identifier: Apache-2.0

description: |
  Contains the Ethernet MAC and the MDIO as child nodes.

compatible: "wch,ethernet-controller"

include: base.yaml

properties:
  reg:
    required: true
  clocks:
    required: true
```

## dts/bindings/ethernet/wiznet,wiz550io.yaml
```yaml
# Copyright (c) 2024 Enphase Energy
# SPDX-License-Identifier: Apache-2.0

description: |
  WIZ550io standalone 10/100BASE-T Ethernet controller with SPI interface
  and preconfigured unique MAC address.

  This is a specialization of the W5500 Ethernet controller.

  Example:
    &spi3 {
        status = "okay";
        pinctrl-0 = <&spi3_sck_pb3 &spi3_miso_pb4 &spi3_mosi_pb5>;
        pinctrl-names = "default";
        cs-gpios = <&gpioa 4 (GPIO_ACTIVE_LOW | GPIO_PULL_UP)>;

        eth_wiz550io: eth_wiz550io@0 {
            status = "okay";
            compatible = "wiznet,wiz550io", "wiznet,w5500";
            reg = <0x0>;
            spi-max-frequency = <DT_FREQ_M(80)>;
            int-gpios = <&gpioa 6 GPIO_ACTIVE_LOW>;
            reset-gpios = <&gpioa 5 GPIO_ACTIVE_LOW>;
            ready-gpios = <&gpiod 14 GPIO_ACTIVE_HIGH>;
            preconfigured-mac-address;
        };
    };

compatible: "wiznet,wiz550io"

include: wiznet,w5500.yaml

properties:
  ready-gpios:
    type: phandle-array
    description: |
      Ready pin.
      The WIZ550io module has an extra GPIO pin that signals
      when the PIC12F519 has finished configuring the W5500.
      This is optional to shorten the hardware reset delay.
  preconfigured-mac-address:
    type: boolean
    description: |
      Preconfigured W5500 MAC address.
      The WIZ550io module has a preconfigured unique MAC address
      assigned by the PIC12F519 after hardware reset.
      This functionality depends on having a reset GPIO.
      Enable this option to use that MAC address.
```

## dts/bindings/ethernet/xlnx,axi-ethernet-1.00.a.yaml
```yaml
# Copyright (c) 2024 CISPA Helmholtz Center for Information Security
# SPDX-License-Identifier: Apache-2.0

description: Xilinx AXI 1G/2.5G Ethernet Subsystem base bindings.

include: [ethernet-controller.yaml]

compatible: "xlnx,axi-ethernet-1.00.a"

properties:
  interrupts:
    description: Xilinx AXI Ethernet has an optional interrupt for updating statistics.

  reg:
    description:
      Control registers of the MDIO device are also used for the Ethernet MAC controller.
      Thus, both devices should have a parent node with compatible "xlnx,axi-ethernet-subsystem-7.2"
      which defines the reg property, and MAC and MDIO should NOT have a reg property.

  clock-frequency:
    type: int

  axistream-connected:
    type: phandle
    required: true
    description: Xilinx AXI DMA that is connected to the data streams.

  axistream-control-connected:
    type: phandle
    description:
      Xilinx AXI DMA that is connected to the control streams.
      Automatically generated by Xilinx' device tree generator.
      Included in the schema to prevent spurious warnings for such autogenerated device trees.

  xlnx,rxcsum:
    type: int
    default: 0
    description: RX checksum offloading. 0 = none, 2 = full. 1 = partial is not supported.
    enum:
      - 0
      - 2
  xlnx,txcsum:
    type: int
    default: 0
    description: TX checksum offloading. 0 = none, 2 = full. 1 = partial is not supported.
    enum:
      - 0
      - 2
```

## dts/bindings/ethernet/xlnx,axi-ethernet-7.2.yaml
```yaml
# Copyright (c) 2024 CISPA Helmholtz Center for Information Security
# SPDX-License-Identifier: Apache-2.0

description: Xilinx AXI 1G/2.5G Ethernet Subsystem base bindings.

include: ["xlnx,axi-ethernet-base.yaml"]

compatible: "xlnx,axi-ethernet-7.2"
```

## dts/bindings/ethernet/xlnx,axi-ethernet-base.yaml
```yaml
# Copyright (c) 2024 CISPA Helmholtz Center for Information Security
# SPDX-License-Identifier: Apache-2.0

description: Xilinx AXI 1G/2.5G Ethernet Subsystem base bindings.

include: [base.yaml]

# multiple "compatible" properties match the same driver and options

properties:
  interrupts:
    type: array
    description: Xilinx AXI Ethernet has an optional interrupt for updating statistics.
  interrupt-parent:
    type: phandle
    description: Interrupt controller that the DMA is connected to.
  reg:
    type: array
    description: |
      Control registers of the MDIO device are also used for the Ethernet MAC controller.
      Thus, both devices should have a parent node with compatible "xlnx,axi-ethernet-subsystem-7.2"
      which defines the reg property, and MAC and MDIO should NOT have a reg property.
  clocks:
    type: phandle-array
  clock-frequency:
    type: int
  local-mac-address:
    type: uint8-array
    description: Ethernet adapter MAC address.
    required: true

  axistream-connected:
    type: phandle
    required: true
    description: Xilinx AXI DMA that is connected to the data streams.

  axistream-control-connected:
    type: phandle
    required: true
    description: Xilinx AXI DMA that is connected to the control streams.

  phy-mode:
    type: string
    required: true
    description: Type of the PHY used, e.g., RGMII.

  phy-handle:
    type: phandle
    required: true
    description: Handle to PHY device that is used by the Ethernet.

  xlnx,rxcsum:
    type: int
    default: 0
    description: RX checksum offloading. 0 = none, 2 = full. 1 = partial is not supported.
    enum:
      - 0
      - 2
  xlnx,txcsum:
    type: int
    default: 0
    description: TX checksum offloading. 0 = none, 2 = full. 1 = partial is not supported.
    enum:
      - 0
      - 2
```

## dts/bindings/ethernet/xlnx,gem-controller.yaml
```yaml
# Copyright (c) 2025 Immo Birnbaum
# SPDX-License-Identifier: Apache-2.0

title: Xilinx GEM Ethernet Controller node

compatible: "xlnx,gem-controller"

description: |
  This specifies the parent node of each instance of the Xilinx
  GEM Ethernet controller, with separate MAC and MDIO nodes
  contained as child nodes.

include: base.yaml

properties:
  reg:
    required: true
```
