## dts/bindings/ethernet/wch,ch9120.yaml
```yaml
# SPDX-License-Identifier: Apache-2.0

description: |
  CH9120 offload ethernet driver

compatible: "wch,ch9120"

include:
  - uart-device.yaml

properties:
  reset-gpios:
    type: phandle-array
    required: true
    description: Reset, active low

  config-gpios:
    type: phandle-array
    required: true
    description: Network configuration enable switch, when the level is low,
                enter serial port configuration mode.

  tcpcs-gpios:
    type: phandle-array
    required: true
    description: In TCP client mode, indicate the connection status;
                a low level signifies a successful connection
```

## dts/bindings/ethernet/wch,ethernet.yaml
```yaml
# Copyright (c) 2025 James Bennion-Pedley <james@bojit.org>
# SPDX-License-Identifier: Apache-2.0

title: Ethernet MAC Controller for WCH CH32 series MCUs

compatible: "wch,ethernet"

include:
  - name: snps,dwmac.yaml
  - name: pinctrl-device.yaml

properties:
  reg:
    required: true
  clocks:
    required: true
  interrupts:
    required: true
  pinctrl-0:
    required: true
  pinctrl-names:
    required: true
  phy-connection-type:
    required: true
  phy-handle:
    required: true
  internal-phy-pllmul:
    type: string
    description: |
      PLL Multiplier of the Internal PHY PLL (PLL3). Adjust so PHY clocks at 60 MHz
    enum:
      - "2.5"
      - "12.5"
      - "4"
      - "5"
      - "6"
      - "7"
      - "8"
      - "9"
      - "10"
      - "11"
      - "12"
      - "13"
      - "14"
      - "15"
      - "16"
      - "20"
  internal-phy-prediv:
    type: string
    description: |
      Pre-Divisor of the Internal PHY PLL (PREDIV2). Adjust so PHY clocks at 60 MHz
    enum:
      - "1"
      - "2"
      - "3"
      - "4"
      - "5"
      - "6"
      - "7"
      - "8"
      - "9"
      - "10"
      - "11"
      - "12"
      - "13"
      - "14"
      - "15"
      - "16"
```

## dts/bindings/ethernet/wiznet,ethernet-common.yaml
```yaml
# Copyright (c) 2026 RAKwireless Technology Limited
# SPDX-License-Identifier: Apache-2.0

description: Common properties for WIZnet standalone Ethernet controllers

include: [spi-device.yaml, ethernet-controller.yaml]

properties:
  int-gpios:
    type: phandle-array
    description: |
      Interrupt pin.

      The interrupt pin is active low.
      If connected directly the MCU pin should be configured
      as active low.
      Bindings that do not mark this property as required
      operate in polling mode when it is omitted.

  reset-gpios:
    type: phandle-array
    description: |
      Reset pin.

      The reset pin is active low.
      If connected directly the MCU pin should be configured
      as active low.
```

## dts/bindings/ethernet/wiznet,w5100s.yaml
```yaml
# Copyright (c) 2026 RAKwireless Technology Limited
# SPDX-License-Identifier: Apache-2.0

title: WIZnet W5100S Ethernet Controller

description: W5100S standalone 10/100BASE-T Ethernet controller with SPI interface

compatible: "wiznet,w5100s"

include: wiznet,ethernet-common.yaml
```

## dts/bindings/ethernet/wiznet,w5500.yaml
```yaml
# Copyright (c) 2020 Linumiz
# SPDX-License-Identifier: Apache-2.0

title: WIZnet W5500 Ethernet Controller

description: W5500 standalone 10/100BASE-T Ethernet controller with SPI interface

compatible: "wiznet,w5500"

include: wiznet,ethernet-common.yaml
```

## dts/bindings/ethernet/wiznet,w6100.yaml
```yaml
# SPDX-FileCopyrightText: Copyright 2026 Sayed Naser Moravej
# SPDX-License-Identifier: Apache-2.0

title: WIZnet W6100 Ethernet Controller

description: W6100 standalone 10/100BASE-T Ethernet controller with SPI interface

compatible: "wiznet,w6100"

include: wiznet,ethernet-common.yaml

properties:
  int-gpios:
    required: true
```

## dts/bindings/ethernet/wiznet,w6300-common.yaml
```yaml
# Copyright (c) 2025 WIZnet Co., Ltd.
# SPDX-License-Identifier: Apache-2.0

description: |
    Common properties for the WIZnet W6300 standalone 10/100BASE-T Ethernet
    controller, shared by the SPI and MSPI (QSPI) variants of the binding.

include: ethernet-controller.yaml

properties:
  int-gpios:
    type: phandle-array
    required: true
    description: Interrupt pin.

      The interrupt pin of W6300 is active low.
      If connected directly the MCU pin should be configured
      as active low.

  reset-gpios:
    type: phandle-array
    description: Reset pin.

      The reset pin of W6300 is active low.
      If connected directly the MCU pin should be configured
      as active low.
```

## dts/bindings/ethernet/wiznet,w6300-mspi.yaml
```yaml
# Copyright (c) 2025 WIZnet Co., Ltd.
# SPDX-License-Identifier: Apache-2.0

description: |
    W6300 standalone 10/100BASE-T Ethernet controller accessed over MSPI in
    quad data line (QSPI) mode.

    The W6300 QSPI frame starts with a single data line instruction byte and
    then switches to four data lines for the address, dummy and data phases,
    which corresponds to MSPI_IO_MODE_QUAD_1_4_4.  Both read and write
    transfers insert one dummy byte (two clock cycles in quad mode) between
    the address and data phases, so rx-dummy and tx-dummy are fixed by the
    driver rather than taken from devicetree.

compatible: "wiznet,w6300"

include: [mspi-device.yaml, "wiznet,w6300-common.yaml"]

properties:
  mspi-io-mode:
    required: true
```

## dts/bindings/ethernet/wiznet,w6300-spi.yaml
```yaml
# Copyright (c) 2025 WIZnet Co., Ltd.
# SPDX-License-Identifier: Apache-2.0

description: |
    W6300 standalone 10/100BASE-T Ethernet controller accessed over SPI.

    The W6300 is driven in single data line (SPI) mode: the variable length
    data mode instruction, the 16-bit address and the payload are all clocked
    out on MOSI/MISO.

compatible: "wiznet,w6300"

include: [spi-device.yaml, "wiznet,w6300-common.yaml"]
```

## dts/bindings/ethernet/wiznet,w6300.yaml
```yaml
# Copyright (c) 2025 WIZnet Co., Ltd.
# SPDX-License-Identifier: Apache-2.0

title: WIZnet W6300 Ethernet Controller

description: W6300 standalone 10/100BASE-T Ethernet controller with SPI interface

compatible: "wiznet,w6300"

include: wiznet,ethernet-common.yaml

properties:
  int-gpios:
    required: true
```

## dts/bindings/ethernet/xlnx,zynq-gem.yaml
```yaml
# SPDX-FileCopyrightText: Copyright The Zephyr Project Contributors
# SPDX-License-Identifier: Apache-2.0

description: |
  Cadence GEM in the Xilinx Zynq-7000 processing system.

  The clocks come from the clock controller of the SLCR (xlnx,ps7-clkc),
  as in the Linux devicetree: the GEM AMBA clock as "pclk" and "hclk" and
  the GEM reference clock as "tx_clk", which the driver retunes to the
  link speed through its dividers.
  The MAC does not support half duplex at 1000 Mbit/s; restrict the PHY
  with its default-speeds property if that matters.

compatible: "xlnx,zynq-gem"

include: cdns,gem.yaml
```

## dts/bindings/ethernet/xlnx,zynqmp-gem.yaml
```yaml
# SPDX-FileCopyrightText: Copyright The Zephyr Project Contributors
# SPDX-License-Identifier: Apache-2.0

description: |
  Cadence GEM in the Xilinx ZynqMP processing system.

  The clocks come from the clock controller (xlnx,zynqmp-clk), as in the
  Linux devicetree: the low power domain bus clock as "pclk", the GEM
  reference clock as "hclk", the GEM transmit clock as "tx_clk", which the
  driver retunes to the link speed through the dividers of the reference
  clock, the GEM receive clock as "rx_clk" and the clock of the 1588 time
  stamp unit as "tsu_clk". Retuning the transmit clock lifts the CRL_APB
  write protection, which needs the CRL_APB registers to be accessible at
  their physical address.

compatible: "xlnx,zynqmp-gem"

include: cdns,gem.yaml
```

## dts/bindings/ethernet/zephyr,native-tap.yaml
```yaml
# SPDX-FileCopyrightText: Copyright The Zephyr Project Contributors
# SPDX-License-Identifier: Apache-2.0

title: Native Sim TAP Ethernet

description: |
  This binding describes a TAP Ethernet interface for use with native_sim.
  It provides network connectivity between the host and Zephyr through a Linux
  TAP interface, which can be used for testing and development purposes without
  requiring actual hardware.

compatible: "zephyr,native-tap"

include: ethernet-controller.yaml

properties:
  host-interface:
    type: string
    description: |
      Name of the host TAP network interface to use (e.g. zeth). It can be
      overridden from the command line using the per-instance "<node>_eth-if"
      option (or the "eth-if" option for the first interface).
```

## dts/bindings/ethernet/zephyr,slip-eth.yaml
```yaml
# SPDX-FileCopyrightText: Copyright The Zephyr Project Contributors
# SPDX-License-Identifier: Apache-2.0

description: |
  SLIP (Serial Line IP) network interface on a UART carrying Ethernet frames
  (TAP mode, CONFIG_ETH_SLIP_TAP). The host side runs tunslip6 from
  net-tools with TAP support.

  The node is a child of the UART node used for the serial link. A node may
  also carry the zephyr,slip compatible. It is then used by this driver by
  default, or by the IP driver (CONFIG_SLIP) when that is enabled instead.
  Only one of the two drivers can use the node.

  Without local-mac-address or zephyr,random-mac-address the interface
  gets a random address from the 00:00:5E:00:53:00/40 documentation range.

compatible: "zephyr,slip-eth"

include: [uart-device.yaml, ethernet-controller.yaml]

examples:
  - |
    &uart1 {
        status = "okay";
        current-speed = <115200>;

        slip0: slip {
            compatible = "zephyr,slip-eth", "zephyr,slip";
            status = "okay";
        };
    };
```

## dts/bindings/fan/zephyr,pwm-fan.yaml
```yaml
# Copyright (c) 2026 Kasper Sloth
# SPDX-License-Identifier: Apache-2.0

description: |
  Generic PWM fan.

  The fan is driven by a single PWM channel. Its speed may optionally be
  monitored through an arbitrary tachometer, referenced by phandle. Any
  device that reports SENSOR_CHAN_RPM (for example zephyr,tach-gpio,
  nuvoton,npcx-tach, ite,it8xxx2-tach, microchip,xec-tach,
  maxim,max31790-fan-speed, ...) can be used.

  Example:

    fan_tach: fan-tach {
        compatible = "zephyr,tach-gpio";
        gpios = <&gpioc 7 GPIO_ACTIVE_HIGH>;
        pulses-per-round = <2>;
    };

    fan0: fan {
        compatible = "zephyr,pwm-fan";
        pwms = <&pwm1 1 PWM_KHZ(25) PWM_POLARITY_INVERTED>;
        tach = <&fan_tach>;
    };

compatible: "zephyr,pwm-fan"

include: sensor-device.yaml

properties:
  pwms:
    type: phandle-array
    required: true
    description: PWM channel used to drive the fan.

  tach:
    type: phandle
    description: |
      Optional phandle to a tachometer sensor device that reports
      SENSOR_CHAN_RPM. Omit for open-loop fans without RPM feedback.
```

## dts/bindings/firmware/linaro,scmi-optee.yaml
```yaml
# Copyright 2026 EPAM Systems
# SPDX-License-Identifier: Apache-2.0

description: |
        SCMI (System Control and Management Interface) transport using OP-TEE SCMI PTA.

compatible: "linaro,scmi-optee"

include: [base.yaml]

properties:
  linaro,optee-channel-id:
    required: true
    type: int
    description: |
      Channel specifier required when using OP-TEE transport.

  '#address-cells':
    const: 1

  '#size-cells':
    const: 0

examples:
  - |
    scmi {
          compatible = "linaro,scmi-optee";
          linaro,optee-channel-id = <0>;

          #address-cells = <1>;
          #size-cells = <0>;

          scmi_pds: protocol@11 {
            compatible = "arm,scmi-power";
            reg = <0x11>;
            #power-domain-cells = <1>;
          };

          scmi_clk: protocol@14 {
            compatible = "arm,scmi-clock";
            reg = <0x14>;
            #clock-cells = <1>;
          };
    };
```

## dts/bindings/flash/beken,bk7258-flash.yaml
```yaml
# Copyright (c) 2026 Beken Corporation
# SPDX-License-Identifier: Apache-2.0

description: >
  Beken BK7258 flash, as seen by this core.

  The core never talks to the controller: the flash command pipeline is shared
  with the other core and is left in quad / continuous-read mode, so any
  command from here would take both cores down. Read, program and erase go to
  the flash service on the other core over the inter-core mailbox.

  The XIP window at 0x02000000 is where the core executes from, and it is not
  a general read path either: it serves the packed image area, in which every
  32 bytes of data are followed by 2 bytes of CRC, and reading a region that
  was not written that way resets the chip. Measured: reading physical
  0x165000 (packed image) through the window is fine, reading physical
  0x290000 (a data partition) resets the chip whether or not that sector has
  been erased, and reading 0x7FA000 (EasyFlash ENV) does the same.

compatible: "beken,bk7258-flash"

include: [flash-controller.yaml, base.yaml]

properties:
  size:
    type: int
    required: true
    description: >
      Physical size of the flash in bytes, that is, the address space a
      controller read command operates on.

      There are two address spaces; do not mix them up:

        physical  the raw byte stream: every 32 bytes of data are followed
                  by 2 bytes of CRC
        XIP       what the core sees through the window at 0x02000000, where
                  the hardware has already consumed the CRC bytes

      xip = (physical / 34) * 32 + (physical % 34)

      Offsets used by this driver are physical, matching the partition table
      and the bootloader.

  crc-step:
    type: int
    default: 34
    description: Physical bytes in one CRC group (32 data + 2 CRC)

  crc-data:
    type: int
    default: 32
    description: Payload bytes in one CRC group
```

## dts/bindings/flash_controller/abov,abov32-flash-controller.yaml
```yaml
# Copyright (c) 2026 ABOV Semiconductor Co., Ltd.
# SPDX-License-Identifier: Apache-2.0

description: ABOV32 code flash memory controller (CFMC)

compatible: "abov,abov32-flash-controller"

include: flash-controller.yaml
```

## dts/bindings/flash_controller/beken,bk7258-flash-controller.yaml
```yaml
# Copyright (c) 2026 Embracecactus
# SPDX-License-Identifier: Apache-2.0

description: Beken BK7258 flash controller

compatible: "beken,bk7258-flash-controller"

include: flash-controller.yaml
```

## dts/bindings/flash_controller/gd,gd32f527-flash-controller.yaml
```yaml
# Copyright (c) 2026 GigaDevice Semiconductor Inc.
# SPDX-License-Identifier: Apache-2.0

description: |
  GD32F527 flash controller.

  The main flash starts at 0x08000000 and holds Bank0 and, on dual-bank
  parts, Bank1 right after it (512KB, 1MB, 2MB or 4MB in total). Parts
  with the extended Bank1_Ex have it at the fixed address 0x08400000
  (up to 3584KB), which is not contiguous with the smaller main flash
  layouts. All banks are erased by 4KB page and programmed in 64-bit
  double-words. Bank swapping through SYSCFG FMC_SWP is not supported.

  The main flash is a "gd,gd32-nv-flash" child node that also carries
  "soc-nv-flash". Bank1_Ex, when present, is a "gd,gd32-nv-flash" child
  node without "soc-nv-flash", and the driver exposes it as its own flash
  device. Both must use write-block-size = <8>.

compatible: "gd,gd32f527-flash-controller"

include: gd,gd32-flash-controller.yaml
```

## dts/bindings/flash_controller/hpmicro,xpi.yaml
```yaml
# Copyright (C) 2026 Cody Gu <gujiaqi@iscas.ac.cn>
# SPDX-License-Identifier: Apache-2.0

description: HPMicro XPI flash controller

compatible: "hpmicro,xpi"

include: flash-controller.yaml

properties:
  ranges:
    required: true

  "#address-cells":
    required: true
    const: 1

  "#size-cells":
    required: true
    const: 1
```
