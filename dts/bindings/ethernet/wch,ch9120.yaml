## dts/bindings/flash_controller/infineon,flash-controller.yaml
```yaml
description: Infineon CAT1 flash controller

compatible: "infineon,flash-controller"

include: flash-controller.yaml

properties:
  erase-value:
    type: int
    default: 0xff
    description: |
      Byte value a flash cell reads back after an erase. This is a fixed
      characteristic of the flash IP (e.g. 0xff on PSoC4/PSoC6, 0x00 on the
      MXS40FLASHC used by PSC3), not a software-configurable option.

  infineon,explicit-erase:
    type: boolean
    description: |
      The flash IP requires an explicit erase of a row before it can be
      programmed (e.g. MXS40FLASHC on PSC3). When this property is absent the
      program operation performs an implicit erase-on-write (e.g. PSoC4/PSoC6).

  infineon,cache-invalidate:
    type: string
    default: "flashc-buffer"
    enum:
      - "none"
      - "flashc-buffer"
      - "icache0"
    description: |
      Cache/prefetch invalidation mechanism the CPU must run after a program or
      erase so subsequent reads are coherent.
        - none:          no invalidation required.
        - flashc-buffer: clear the FLASHC cache/prefetch buffer via the PDL
                         (PSoC4).
        - icache0:       invalidate the CM33 instruction cache by writing
                         ICACHE0->CMD (PSC3).
```

## dts/bindings/flash_controller/infineon,smif.yaml
```yaml
# SPDX-FileCopyrightText: Copyright (c) 2026 Infineon Technologies AG,
# SPDX-FileCopyrightText: or an affiliate of Infineon Technologies AG. All rights reserved.
#
# SPDX-License-Identifier: Apache-2.0

description: |
  Infineon SMIF (Serial Memory InterFace) controller.

  The SMIF block is the memory-mapped QSPI/OSPI bus controller that hosts up
  to four external memory devices, one per chip-select (slave-select) slot on
  a single SMIF instance. This node describes the controller itself: its
  register window, the shared bus pads (via pinctrl) and whether the driver
  must bring the controller up from reset.

  The attached memory devices are described by child nodes on the "smif" bus
  (for example infineon,smif-nor). Each child selects its slot through its
  own "infineon,chip-select" property. The child drivers obtain the
  controller register base and the shared PDL SMIF context from this parent
  node.

  On parts where an earlier boot stage (ROM extended boot) already configured
  the SMIF controller and placed it into XIP mode, this node must NOT re-init
  the controller. Leave "infineon,hw-init" unset in that case: the driver
  still enumerates the attached devices (which the PDL leaves the running XIP
  configuration untouched for) but does not touch the controller PHY/clock
  configuration. Set "infineon,hw-init" only when the controller is
  unconfigured at start-up, e.g. when the first stage boots from internal
  RRAM under MCUboot or when targeting a SMIF instance different from the
  one the execute-in-place is running from.

compatible: "infineon,smif"

include: [base.yaml, pinctrl-device.yaml]

bus: smif

properties:
  reg:
    required: true
    description: |
      Base address and length of the SMIF controller register window.

  "#address-cells":
    required: true
    const: 1

  "#size-cells":
    required: true
    const: 1

  pinctrl-0:
    required: true

  pinctrl-names:
    required: true

  infineon,hw-init:
    type: boolean
    description: |
      When set, the driver fully initialises the SMIF controller (peripheral-group
      release, Cy_SMIF_Init) at start-up. Required when no earlier boot stage has
      configured this SMIF instance (e.g. booting from internal RRAM).
      When unset, the driver assumes the controller is already running (typically
      brought up by the boot ROM in XIP mode) and only enumerates the attached
      memory devices.

  infineon,input-frequency-mhz:
    type: int
    default: 200
    description: |
      SMIF interface input clock frequency in MHz. Only used when
      "infineon,hw-init" is set (passed to Cy_SMIF_Init).

  infineon,deselect-delay:
    type: int
    default: 7
    description: |
      Minimum number of interface clock cycles the chip select is held
      deasserted between transfers. Only used when "infineon,hw-init" is set.
```

## dts/bindings/flash_controller/microchip,nand-g1-flash.yaml
```yaml
# Copyright (c) 2026 Microchip Technology Inc.
# SPDX-License-Identifier: Apache-2.0

description: |
  Microchip SAM NAND Flash driver G1

examples:
  - |
    Example devicetree configuration:

      nand0: nandflash {
        compatible = "microchip,nand-g1-flash";
        nand-controller = <&nfc>;
        cs-gpios = <&piod 4 GPIO_ACTIVE_LOW>;
        status = "okay";
      };

compatible: "microchip,nand-g1-flash"

include:
  - name: base.yaml

properties:
  nand-controller:
    type: phandle
    required: true
    description: |
      Hold a phandle reference to the nand-controller.

  cs-gpios:
    type: phandle-array
    description: GPIO cs pin.

child-binding:
  description: |
    Child device nodes represent NAND Flash ID devices.

  properties:
    nand-id:
      type: uint8-array
      required: true
      description: |
        Array[0] contains the NAND Manufacturer ID.
        Array[1] contains the NAND Device ID.

    nand-page-size:
      type: int
      required: true
      description: |
        Size of the NAND page data area, in bytes.

    nand-oob-size:
      type: int
      required: true
      description: |
        Size of the NAND OOB (spare) area per page, in bytes.

    nand-block-pages:
      type: int
      required: true
      description: |
        Number of pages per NAND block.

    nand-block-count:
      type: int
      required: true
      description: |
        Number of blocks in the NAND device.

    nand-ecc-bits:
      type: int
      required: true
      description: |
        ECC correction strength, in bits per sector.

    nand-ecc-sector:
      type: int
      required: true
      description: |
        Size of an ECC sector, in bytes.

    nand-features:
      type: int
      description: |
        NAND features supported, as specified in the ONFI parameter page.

    nand-optional-commands:
      type: int
      description: |
        NAND optional commands supported, as specified in the ONFI parameter page.

    nand-timing-mode:
      type: int
      description: |
        NAND timing mode support, as specified in the ONFI parameter page.
```

## dts/bindings/flash_controller/microchip,nfc-g1-flash.yaml
```yaml
# Copyright (c) 2026 Microchip Technology Inc.
# SPDX-License-Identifier: Apache-2.0

description: |
  Microchip NAND Flash Controller (NFC) G1.

  SAM NFC is based on the following hardware peripheral:
    - module name="SMC" id="11036" version="304"

examples:
  - |
    Example devicetree configuration:

      &nfc {
        status = "okay";
      };

compatible: "microchip,nfc-g1-flash"

include:
  - name: base.yaml

properties:
  reg:
    required: true

  nfc-sram:
    type: phandle
    required: true
    description: |
      Hold a phandle reference to the nfc-sram.

  nfc-io:
    type: phandle
    required: true
    description: |
      Hold a phandle reference to the nfc-io.

  ecc-engine:
    type: phandle
    required: true
    description: |
      Hold a phandle reference to the pmecc.
```
