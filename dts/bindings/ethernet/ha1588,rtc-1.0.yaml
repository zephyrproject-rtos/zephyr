## dts/bindings/ethernet/ha1588,rtc-1.0.yaml
```yaml
# Copyright 2025 CISPA Helmholtz Center for Information Security gGmbH
# SPDX-License-Identifier: Apache-2.0

description: ha1588 PTP (Precision Time Protocol) Clock and TSU

compatible: "ha1588,rtc-1.0"

include: ["base.yaml"]

properties:
  ha1588,period:
    required: true
    type: array
    description: |
      Nominal period of ha1588 RTC clock.
      Provided as array of period in nanoseconds followed by fractional nanoseconds.
      For example, set the property like this for a 125 MHz frequency / 8 ns clock:
      ha1588,period = <0x8 0x0>;
  ha1588,tsu:
    required: true
    type: boolean
    description: |
      Does the ha1588 instance have the time stamping unit enabled?
      This is true for almost all ha1588 devices.
  ha1588,ts-all-supported:
    required: true
    type: boolean
    description: |
      Does the ha1588 instance have a TSU that can timestamp all
      incoming packets (including non-TSU packets)?
      This is a non-standard option and only available in some
      ha1588 devices.
```

## dts/bindings/ethernet/infineon,xmc4xxx-ethernet.yaml
```yaml
# Copyright (c) 2023 SLB
# SPDX-License-Identifier: Apache-2.0

description: XMC 4XXX Ethernet

compatible: "infineon,xmc4xxx-ethernet"

include:
  - name: ethernet-controller.yaml
  - name: pinctrl-device.yaml

properties:
  interrupts:
    required: true

  pinctrl-0:
    required: true

  pinctrl-names:
    required: true

  phy-connection-type:
    required: true

  rxd0-port-ctrl:
    required: true
    type: string
    description: Receive bit 0 (rxd0) signal GPIO connection. Used for RMII and MII interfaces.
    enum:
      - "P2_2"
      - "P0_2"
      - "P14_8"
      - "P5_0"

  rxd1-port-ctrl:
    required: true
    type: string
    description: Receive bit 1 (rxd1) signal GPIO connection. Used for RMII and MII interfaces.
    enum:
      - "P2_3"
      - "P0_3"
      - "P14_9"
      - "P5_1"

  rxd2-port-ctrl:
    type: string
    description: Receive bit 2 (rxd2) signal GPIO connection. Only used for MII interface.
    enum:
      - "P5_8"
      - "P6_4"

  rxd3-port-ctrl:
    type: string
    description: Receive bit 2 (rxd2) signal GPIO connection. Only used for MII interface.
    enum:
      - "P5_9"
      - "P6_3"

  rmii-rx-clk-port-ctrl:
    required: true
    description: |
      If the RMII interface is used it connects GPIO to the rmii-clk signal.
      Otherwise, if the MII interface is used, then it connects to the Receive clock (rx-clk)
      signal.
    type: string
    enum:
      - "P2_1"
      - "P0_0"
      - "P15_8"
      - "P6_5"

  crs-rx-dv-port-ctrl:
    required: true
    description: |
      If the RMII interface is used it connects GPIO to the Carrier Sense Data Valid (crs-dv)
      signal. Otherwise, if the MII interface is used, it connects to the
      Receive Data Valid (rx-dv) signal.
    type: string
    enum:
      - "P2_5"
      - "P0_1"
      - "P15_9"
      - "P5_2"

  crs-port-ctrl:
    description: Carrier Sense (crs) signal GPIO connection. Only used for the MII interface.
    type: string
    enum:
      - "P5_11"
      - "unused1"
      - "unused2"
      - "P5_4"

  rxer-port-ctrl:
    required: true
    description: Receive Error (rxer) signal GPIO connection. Used for MII and RMII interfaces.
    type: string
    enum:
      - "P2_4"
      - "P0_11"
      - "unused1"
      - "P5_3"

  col-port-ctrl:
    description: Collision (col) signal GPIO connection. Only used for MII interface.
    type: string
    enum:
      - "P2_15"
      - "unused1"
      - "unused2"
      - "P5_5"

  tx-clk-port-ctrl:
    description: Transmit clock (tx-clk) GPIO connection. Only used for MII interface.
    type: string
    enum:
      - "P5_10"
      - "P6_6"
```

## dts/bindings/ethernet/intel,e1000.yaml
```yaml
# Copyright (c) 2018 Intel Corporation.
# SPDX-License-Identifier: Apache-2.0

description: Intel E1000 Ethernet controller

compatible: "intel,e1000"

include: [base.yaml, pcie-device.yaml]

properties:
  interrupts:
    required: true

  rdmts:
    type: int
    default: 0
    enum:
      - 0
      - 1
      - 2
    description: |
      Receive Descriptor Minimum Threshold Size
      Controls when RXDMT0 interrupt is set.
      0: interrupt set when 1/2 of RDLEN is free
      1: interrupt set when 1/4 of RDLEN is free
      2: interrupt set when 1/8 of RDLEN is free
      The default value is the hardware reset value

  itr:
    type: int
    default: 0
    description: |
      Interrupt Throttling Rate
      Controls inter-interrupt delay. Non-zero value
      enables it and adjusts the interval in 256ns
      increments. The maximum value is 2^16 - 1.
      The default value is the hardware reset value
```

## dts/bindings/ethernet/intel,eth-plat.yaml
```yaml
# Copyright (c) 2025 Intel Corporation
# SPDX-License-Identifier: Apache-2.0

description: Intel Ethernet parent platform device.

compatible: "intel,eth-plat"

include: [base.yaml, ethernet-controller.yaml, pcie-device.yaml]
```

## dts/bindings/ethernet/intel,igc-mac.yaml
```yaml
# Copyright 2025 Intel Corporation
# SPDX-License-Identifier: Apache-2.0

description: Intel IGC MAC bindings.

compatible: "intel,igc-mac"

include: [base.yaml, ethernet-controller.yaml]

properties:
  num-queues:
    type: int
    default: 4
    description: Number of queues supported by the IGC MAC.

  num-tx-desc:
    type: int
    default: 512
    description: The number of transmit descriptors per queue can range from 128 to 4096,
                 depending on the configuration.

  num-rx-desc:
    type: int
    default: 512
    description: The number of receive descriptors per queue can range from 128 to 4096,
                 depending on the configuration.
```

## dts/bindings/ethernet/intel,igc-phy.yaml
```yaml
# Copyright (c) 2025 Intel Corporation
# SPDX-License-Identifier: Apache-2.0

description: Intel IGC PHY documentation.

compatible: "intel,igc-phy"

include: [phy.yaml, ethernet-controller.yaml]

properties:
  reg:
    required: true
    description: PHY address.

  multi-gigabit-support:
    type: boolean
    description: It Enable 2.5Gbps multi-gigabit mode.
```

## dts/bindings/ethernet/litex,eth0.yaml
```yaml
# Copyright (c) 2019 Antmicro <www.antmicro.com>
# SPDX-License-Identifier: Apache-2.0

description: LiteX Ethernet

compatible: "litex,eth0"

include: ethernet.yaml

properties:
  reg:
    required: true

  interrupts:
    required: true
```

## dts/bindings/ethernet/litex,liteeth.yaml
```yaml
# Copyright (c) 2019 Antmicro <www.antmicro.com>
# SPDX-License-Identifier: Apache-2.0

description: LiteX Ethernet

compatible: "litex,liteeth"

include: ethernet-controller.yaml

properties:
  reg:
    required: true

  interrupts:
    required: true
```

## dts/bindings/ethernet/lowrisc-eth.yaml
```yaml
description: Low Risc Ethernet controller

compatible: "lowrisc-eth"

include: base.yaml

properties:
    reg:
      required: true

    interrupts:
      required: true

    local-mac-address:
      type: uint8-array
      required: false
      description: Specifies the MAC address that was assigned to the network device 

    label:
      required: true
```

## dts/bindings/ethernet/marvell,88e1xxx-phy.yaml
```yaml
# Copyright (c) 2025 Immo Birnbaum
# SPDX-License-Identifier: Apache-2.0

description: Marvell Alaska 88E1xxx 1 GBit/s PHY family

compatible: "marvell,88e1xxx"

include: phy.yaml

on-bus: mdio

properties:
  reg:
    required: true
    description: 5-bit physical/port address (PRTAD).
```

## dts/bindings/ethernet/mdio/adi,adin1140-mdio.yaml
```yaml
# Copyright (c) 2024-2026 Analog Devices Inc.
# SPDX-License-Identifier: Apache-2.0

description: ADIN1140 MDIO Driver node

compatible: "adi,adin1140-mdio"

include: mdio-controller.yaml
```

## dts/bindings/ethernet/mdio/adi,adin2111-mdio.yaml
```yaml
# Copyright (c) 2023 PHOENIX CONTACT Electronics GmbH
# SPDX-License-Identifier: Apache-2.0

description: ADIN2111 MDIO Driver node

compatible: "adi,adin2111-mdio"

include: mdio-controller.yaml

on-bus: adin2111
```

## dts/bindings/ethernet/mdio/atmel,sam-mdio.yaml
```yaml
# Copyright (c) 2021 IP-Logix Inc.
# SPDX-License-Identifier: Apache-2.0

description: Atmel SAM Family MDIO Driver node

compatible: "atmel,sam-mdio"

include:
  - name: mdio-controller.yaml
  - name: pinctrl-device.yaml

properties:
  clocks:
    type: phandle-array
```

## dts/bindings/ethernet/mdio/brcm,genet-mdio.yaml
```yaml
# Copyright (c) 2026 Muhammad Waleed Badar
# SPDX-License-Identifier: Apache-2.0

description: Broadcom GENET MDIO Controller

compatible: "brcm,genet-mdio"

include: mdio-controller.yaml
```

## dts/bindings/ethernet/mdio/davicom,dm9000-mdio.yaml
```yaml
# Copyright (c) 2026 Fuyu Fei
# SPDX-License-Identifier: Apache-2.0

description: |
  Davicom DM9000 integrated MII management (MDIO) controller.

  The DM9000 reaches its integrated 10/100 PHY through the EPCR/EPAR/EPDR
  registers of the parent controller rather than through a dedicated MDC/MDIO
  pin pair, so this node has no register block of its own and must be a child
  of the davicom,dm9000 controller node. It exists only to describe the
  integrated PHY as an "ethernet-phy" node on an MDIO bus so the generic
  phy_mii driver can manage it.

compatible: "davicom,dm9000-mdio"

include: mdio-controller.yaml
```

## dts/bindings/ethernet/mdio/litex,liteeth-mdio.yaml
```yaml
# Copyright (c) 2024 Vogl Electronic GmbH
# SPDX-License-Identifier: Apache-2.0

description: LiteX LiteEth MDIO bitbang driver

compatible: "litex,liteeth-mdio"

include: mdio-controller.yaml
```

## dts/bindings/ethernet/mdio/mdio-controller.yaml
```yaml
# Copyright (c) 2021 IP-Logix Inc.
# SPDX-License-Identifier: Apache-2.0

# Common fields for MDIO controllers

include: base.yaml

bus: mdio

properties:
  "#address-cells":
    required: true
    const: 1

  "#size-cells":
    required: true
    const: 0

  suppress-preamble:
    type: boolean
    description: |
      When present, the SMA suppresses the 32-bit preamble and transmits
      MDIO frames with only 1 preamble bit. By default, the MDIO frame
      always has 32 bits of preamble as defined in the IEEE 802.3 specs.

  clock-frequency:
    type: int
    default: 2500000
    description: |
      Some MDIO controllers have the ability to configure the MDC frequency.
      If present, this property may be used to specify the MDC frequency based
      on what the PHYs connected to the mdio bus can support. Default of 2.5MHz
      is the standard and should supported by all PHYs.
```

## dts/bindings/ethernet/mdio/microchip,gmac-g1-mdio.yaml
```yaml
# Copyright (c) 2026 Microchip Technology Inc.
# SPDX-License-Identifier: Apache-2.0

title: Microchip G1 GMAC MDIO Controller

description: |
  Microchip GMAC MDIO

  Group G1 MDIO device supports following hardware peripherals:
    - module name="GMAC" id="U2005" version="1.0.0"

  This bus shall be a DT subnode of an 'microchip,gmac-g1-eth'
  compatible node and is used to access Ethernet PHY.

compatible: "microchip,gmac-g1-mdio"

include:
  - name: mdio-controller.yaml
  - name: pinctrl-device.yaml

examples:
  - |
    &mdio {
      compatible = "microchip,gmac-g1-mdio";
    };
```

## dts/bindings/ethernet/mdio/microchip,lan78xx-mdio.yaml
```yaml
# Copyright (c) 2026 Narek Aydinyan
# SPDX-License-Identifier: Apache-2.0

description: Microchip LAN78xx MDIO controller

compatible: "microchip,lan78xx-mdio"

include: mdio-controller.yaml
```

## dts/bindings/ethernet/mdio/microchip,lan865x-mdio.yaml
```yaml
# Copyright (c) 2024 Microchip Technology Inc.
# SPDX-License-Identifier: Apache-2.0

description: LAN865X MDIO Driver node

compatible: "microchip,lan865x-mdio"

include: mdio-controller.yaml

on-bus: lan865x
```

## dts/bindings/ethernet/mdio/nuvoton,numicro-mdio.yaml
```yaml
# Copyright (c) 2026 Fiona Behrens <me@kloenk.dev>
# SPDX-License-Identifier: Apache-2.0

description: Nuvoton Numicro MDIO Controller

compatible: "nuvoton,numicro-mdio"

include: [mdio-controller.yaml, pinctrl-device.yaml]

properties:
  "#address-cells":
    required: true
    const: 1

  "#size-cells":
    required: true
    const: 0

  pinctrl-0:
    required: true

  pinctrl-names:
    required: true

  clocks:
    required: true

  speed:
    type: int
    description: Speed of the MDIO bus. Set to 0 to not calculate the clock divier on the fly.
```

## dts/bindings/ethernet/mdio/nxp,s32-gmac-mdio.yaml
```yaml
# Copyright 2023 NXP
# SPDX-License-Identifier: Apache-2.0

description: |
  NXP S32 GMAC MDIO controller.

  Driver for the GMAC Station Management Agent (SMA), which is a two wire
  interface (MDC/MDIO), implemented as per IEEE 802.3 specification. SMA
  supports both MDIO Clause 45 and Clause 22 frame structure.

compatible: "nxp,s32-gmac-mdio"

include: [mdio-controller.yaml, pinctrl-device.yaml]

properties:
  pinctrl-0:
    required: true

  pinctrl-names:
    required: true

  clocks:
    required: true
```

## dts/bindings/ethernet/mdio/nxp,s32-netc-emdio.yaml
```yaml
# Copyright 2022 NXP
# SPDX-License-Identifier: Apache-2.0

description: NXP S32 NETC External MDIO controller

compatible: "nxp,s32-netc-emdio"

include: [mdio-controller.yaml, pinctrl-device.yaml]

properties:
  reg:
    required: true

  pinctrl-0:
    required: true

  pinctrl-names:
    required: true
```

## dts/bindings/ethernet/mdio/renesas,ra-mdio-rmac.yaml
```yaml
# Copyright (c) 2025 Renesas Electronics Corporation
# SPDX-License-Identifier: Apache-2.0

description: Renesas RA External MDIO controller

compatible: "renesas,ra-mdio-rmac"

include: [mdio-controller.yaml, pinctrl-device.yaml]

properties:
  channel:
    type: int
    required: true

  pinctrl-0:
    required: true

  pinctrl-names:
    required: true

  mdio-hold-time-ns:
    type: int
    default: 0
    description: |
      Time for changing MDO after rising edge of MDC in nanoseconds. This value depends on PHY chip
      AC Characteristics. Use 0 to disable.

  mdio-capture-time-ns:
    type: int
    default: 0
    description: |
      Time for sampling MDI after rising edge of MDC in nanoseconds. This value depends on PHY chip
      AC Characteristics. Use 0 to disable.
```

## dts/bindings/ethernet/mdio/renesas,ra-mdio.yaml
```yaml
# Copyright (c) 2024 Renesas Electronics Corporation
# SPDX-License-Identifier: Apache-2.0

description: Renesas RA External MDIO controller

compatible: "renesas,ra-mdio"

include: [mdio-controller.yaml, pinctrl-device.yaml]

properties:
  pinctrl-0:
    required: true

  pinctrl-names:
    required: true
```
