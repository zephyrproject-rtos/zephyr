## dts/bindings/flash_controller/nxp,msf1.yaml
```yaml
# Copyright 2024 NXP
# SPDX-License-Identifier: Apache-2.0

description: NXP MSF1 Flash Memory Module (FMU)

compatible: "nxp,msf1"

include: flash-controller.yaml
```

## dts/bindings/flash_controller/nxp,onfi-nand.yaml
```yaml
description: |
    NXP ONFI NAND controller

    Representation of a serial nand flash on a spi bus:

        mx30lf2ge8ab: mx30lf2ge8ab@0 {
                compatible = "nxp,onfi-nand";                
                status = "okay";
        };

on-bus: semc

compatible: "nxp,onfi-nand"

properties:    
      label:
         type: string
         required: false
      reg:
         type: array
         required: true
      status:
         type: string
         required: false
         description: indicates the operational status of a device
         enum:
           - "ok" # Deprecated form
           - "okay"
           - "disabled"
           - "reserved"
           - "fail"
           - "fail-sss"
      block_size:
         type: int
         required: false
      block_offset:
         type: int
         required: false
      page_size:
         type: int
         required: false
      page_offset:
         type: int
         required: false   


       
    
```

## dts/bindings/flash_controller/nxp,qspi-nor.yaml
```yaml
# Copyright 2026 NXP
# SPDX-License-Identifier: Apache-2.0

description: NXP QSPI NOR Flash

compatible: "nxp,qspi-nor"

include: ["base.yaml", "jedec,jesd216.yaml"]

properties:
  device-name:
    type: string
    required: true
    description: Memory device name used to select the device configuration.

  size:
    type: int
    required: true
    description: Total memory size in bytes.
```

## dts/bindings/flash_controller/nxp,s32k3x-c40-flash.yaml
```yaml
# SPDX-License-Identifier: Apache-2.0
title: NXP S32K3x C40 Internal Flash Controller

description: >
  On-chip C40 flash used in NXP S32K3x MCUs (e.g. S32K344). This node
  represents the internal code flash region (typically bound to &flash0)
  used by Zephyr’s flash API / FLASH_MAP / MCUboot.

compatible: "nxp,s32k3x-c40-flash"

# Inherit common SoC flash schema (reg/status, partitions, etc.)
include: soc-nv-flash.yaml

properties:
  erase-block-size:
    type: int
    const: 8192
    description: Minimum erase size for C40 is 8 KiB.

  write-block-size:
    type: int
    const: 8
    description: Smallest programmable unit is 8 bytes.
```

## dts/bindings/flash_controller/openisa,rv32m1-ftfe.yaml
```yaml
description: OpenISA Flash Memory Module E (FTFE)

compatible: "openisa,rv32m1-ftfe"

include: flash-controller.yaml
```

## dts/bindings/flash_controller/raspberrypi,pico-flash-controller.yaml
```yaml
# Copyright (c) 2022 Yonatan Schachter
# SPDX-License-Identifier: Apache-2.0

description: Raspberry Pi Pico flash controller

compatible: "raspberrypi,pico-flash-controller"

include: flash-controller.yaml
```

## dts/bindings/flash_controller/realtek,bee-nor-flash-controller.yaml
```yaml
description: Realtek Bee Nor Flash Controller

compatible: "realtek,bee-nor-flash-controller"

include: flash-controller.yaml
```

## dts/bindings/flash_controller/realtek,rtl8752h-flash-controller.yaml
```yaml
description: RealTek rtl8752h flash controller

compatible: "realtek,rtl8752h-flash-controller"

include: flash-controller.yaml
```

## dts/bindings/flash_controller/realtek,rtl87x2g-flash-controller.yaml
```yaml
description: RealTek rtl87x2g flash controller

compatible: "realtek,rtl87x2g-flash-controller"

include: flash-controller.yaml
```

## dts/bindings/flash_controller/realtek,rts5817-qspi.yaml
```yaml
# Copyright (c) 2026 Realtek Semiconductor, Inc.
# SPDX-License-Identifier: Apache-2.0

description: Realtek RTS5817 flash controller

compatible: "realtek,rts5817-qspi"

include: flash-controller.yaml

properties:
  bus-width:
    type: int
    required: true
    description: |
     The width of QSPI bus to which flash memory is connected.

     Possible values are :
      - <1> = Single read mode (1 - 1 - 1)
      - <2> = Dual read mode (1 - 1 - 2)
      - <4> = Quad read mode (1 - 1 - 4)
    enum:
      - 1
      - 2
      - 4
    default: 4
```

## dts/bindings/flash_controller/realtek,rts5912-flash-controller.yaml
```yaml
# SPDX-License-Identifier: Apache-2.0
#
# Copyright (c) 2025 Realtek Semiconductor Corporation, SIBG-SD7
#

description: Realtek RTS5912 flash controller

compatible: "realtek,rts5912-flash-controller"

include: flash-controller.yaml
```

## dts/bindings/flash_controller/renesas,ra-flash-region-ctrl.yaml
```yaml
# Copyright (c) 2026 Renesas Electronics Corporation
# SPDX-License-Identifier: Apache-2.0

description: Renesas RA flash region controller

include: base.yaml

compatible: "renesas,ra-flash-region-ctrl"

properties:
  programming-enable:
    type: boolean
    description: |
      Enable code flash programming configuration

  erase-value-undefined:
    type: boolean
    description: |
      Areas of flash that are in an erased state will read back undefined values.
```

## dts/bindings/flash_controller/renesas,ra-mram-controller.yaml
```yaml
# Copyright (c) 2025 Renesas Electronics Corporation
# SPDX-License-Identifier: Apache-2.0

description: Renesas RA flash MRAM controller

compatible: "renesas,ra-mram-controller"

include: flash-controller.yaml
```

## dts/bindings/flash_controller/renesas,rx-flash.yaml
```yaml
# Copyright (c) 2024 Renesas Electronics Corporation
# SPDX-License-Identifier: Apache-2.0

description: Renesas RX Flash controller

compatible: "renesas,rx-flash"

include: flash-controller.yaml
```

## dts/bindings/flash_controller/renesas,smartbond-flash-controller.yaml
```yaml
# Copyright (c) 2022 Renesas Electronics Corporation
# SPDX-License-Identifier: Apache-2.0

description: Renesas SmartBond(tm) family flash controller

compatible: "renesas,smartbond-flash-controller"

include: flash-controller.yaml

properties:
  read-cs-idle-delay:
    type: int
    description: |
      Between the transmissions of two different
      instructions to the flash memory, the SPI bus stays
      in idle state (QSPI_CS high) for at least this number
      of ns. See the QSPIC_ERS_CS_HI register for some exceptions.

  erase-cs-idle-delay:
    type: int
    description: |
      After the execution of instructions: write enable,
      erase, erase suspend and erase resume, the  QSPI_CS
      remains high for at least this number of ns.
```

## dts/bindings/flash_controller/silabs,gecko-flash-controller.yaml
```yaml
# Copyright (c) 2018, Piotr Mienkowski
# SPDX-License-Identifier: Apache-2.0

description: Silicon Labs Gecko flash controller

compatible: "silabs,gecko-flash-controller"

include: flash-controller.yaml
```

## dts/bindings/flash_controller/silabs,series2-flash-controller.yaml
```yaml
# Copyright (c) 2025 Silicon Laboratories Inc.
# SPDX-License-Identifier: Apache-2.0

title: Silicon Labs Series 2 MSC (Memory System Controller)

description: |
  Memory System Controller for Silicon Labs Series 2 SoCs.

compatible: "silabs,series2-flash-controller"

include: flash-controller.yaml

properties:
  low-power-write:
    type: boolean
    description: |
      Reduce current consumption during write, doubling write time
```

## dts/bindings/flash_controller/silabs,si32-flash-controller.yaml
```yaml
# Copyright (c) 2024 GARDENA GmbH
#
# SPDX-License-Identifier: Apache-2.0

compatible: "silabs,si32-flash-controller"

description: Silabs Si32 flash controller

include: flash-controller.yaml
```

## dts/bindings/flash_controller/silabs,siwx91x-flash-controller.yaml
```yaml
# Copyright (c) 2024 Silicon Laboratories Inc.
# SPDX-License-Identifier: Apache-2.0

description: Silicon Labs SiWx91x flash controller

compatible: "silabs,siwx91x-flash-controller"

include: flash-controller.yaml
```

## dts/bindings/flash_controller/st,stm32-ospi-nor.yaml
```yaml
# Copyright (c) 2021, STMicroelectronics
# SPDX-License-Identifier: Apache-2.0

description: |
    STM32 OSPI Flash controller supporting the JEDEC CFI interface

    Representation of a serial flash on a octospi bus:

        mx25lm51245: ospi-nor-flash@0 {
                compatible = "st,stm32-ospi-nor";
                reg = <0>;
                data-mode = <OSPI_OPI_MODE>; /* access on 8 data lines */
                data-rate = <OSPI_DTR_TRANSFER>; /* access in DTR */
                ospi-max-frequency = <DT_FREQ_M(50)>;
                size = <DT_SIZE_M(64*8)>; /* 512 Mbit */
                status = "okay";
        };

compatible: "st,stm32-ospi-nor"

include: ["flash-controller.yaml", "jedec,jesd216.yaml"]

on-bus: ospi

properties:
  reg:
    required: true
  ospi-max-frequency:
    type: int
    required: true
    description: Maximum clock frequency of device's OSPI interface in Hz
  size:
    required: true
    description: Flash Memory size in bits
  reset-gpios:
    type: phandle-array
    description: RESETn pin
  spi-bus-width:
    type: int
    required: true
    description: |
     The width of (Octo)SPI bus to which flash memory is connected.

     Possible values are :
      - OSPI_SPI_MODE  <1> = SPI mode on 1 data line
      - OSPI_DUAL_MODE <2> = Dual mode on 2 data lines
      - OSPI_QUAD_MODE <4> = Quad mode on 4 data lines
      - OSPI_OPI_MODE  <8> = Octo mode on 8 data lines
    enum:
      - 1
      - 2
      - 4
      - 8
  data-rate:
    type: int
    required: true
    description: |
     The SPI data Rate is STR or DTR

     Possible values are :
      - OSPI_STR_TRANSFER <1> = Single Rate Transfer
      - OSPI_DTR_TRANSFER <2> = Dual Rate Transfer (only with OSPI_OPI_MODE)
    enum:
      - 1
      - 2
  writeoc:
    type: string
    enum:
      - "PP"            # Page program, PP (0x02) up to 256 bytes
      - "PP_1_1_2"      # Dual page program, PP 1-1-2 (0xA2)
      - "PP_1_1_4"      # Quad data line SPI, PP 1-1-4 (0x32)
      - "PP_1_4_4"      # Quad data line SPI, PP 1-4-4 (0x38)
    description: |
      The value encodes number of I/O lines used for the opcode,
      address, and data.

      There is no info about quad page program opcodes in the SFDP
      tables, hence it has been assumed that NOR flash memory
      supporting 1-4-4 mode also would support fast page programming.

      Intended for modes other than OSPI_OPI_MODE.

      If absent, then program page opcode is determined by the
      `spi-bus-width`:

      * OSPI_SPI_MODE -> PP 1-1-1 (0x02)
      * OSPI_DUAL_MODE -> PP 1-1-2 (0xA2)
      * OSPI_QUAD_MODE -> PP 1-4-4 (0x38)
  four-byte-opcodes:
    type: boolean
    description: |
      Some NOR-Flash ICs use different opcodes when operating in
      4 byte addressing mode.

      When enabled, then 3 byte opcodes will be converted to
      4 byte opcodes.

      * PP 1-1-1 (0x02) -> PP 1-1-1 4B (0x12)
      * PP 1-1-4 (0x32) -> PP 1-1-4 4B (0x34)
      * PP 1-4-4 (0x38) -> PP 1-4-4 4B (0x3E)

      * READ 1-1-1 (0x03) -> READ 1-1-1 4B (0x13)
      * READ FAST 1-1-1 (0x0B) -> READ FAST 1-1-1 4B (0x0C)
      * DREAD 1-1-2 (0x3B) -> DREAD 1-1-2 4B (0x3C)
      * 2READ 1-2-2 (0xBB) -> 2READ 1-2-2 4B (0xBC)
      * QREAD 1-1-4 (0x6B) -> QREAD 1-1-4 4B (0x6C)
      * 4READ 1-4-4 (0xEB) -> 4READ 1-4-4 4B (0xEC)
```

## dts/bindings/flash_controller/st,stm32-qspi-nor.yaml
```yaml
# Copyright (c) 2020, Linaro limited
# SPDX-License-Identifier: Apache-2.0

description: |
    STM32 QSPI Flash controller supporting the JEDEC CFI interface

    Representation of a serial flash on a quadspi bus:

        mx25r6435f: qspi-nor-flash@0 {
                compatible = "st,stm32-qspi-nor";
                reg = <0>;
                size = <DT_SIZE_M(64)>; /* 64 Mbits */
                qspi-max-frequency = <80000000>;
                reset-gpios = <&gpiod 3 GPIO_ACTIVE_LOW>;
                reset-gpios-duration = <1>;
                spi-bus-width = <4>;
                status = "okay";
        };

compatible: "st,stm32-qspi-nor"

include: ["flash-controller.yaml", "jedec,jesd216.yaml"]

on-bus: qspi

properties:
  size:
    required: true
    description: Flash Memory size in bits
  reg:
    required: true
    description: Flash Memory base address and size in bytes
  qspi-max-frequency:
    type: int
    required: true
    description: Maximum clock frequency of device's QSPI interface in Hz
  reset-gpios:
    type: phandle-array
    description: RESETn pin
  reset-gpios-duration:
    type: int
    description: The duration (in ms) for the flash memory reset pulse
  reset-cmd:
    type: boolean
    description: Send reset command on initialization
  reset-cmd-wait:
    type: int
    default: 10
    description: The duration (in us) to wait after reset command
  spi-bus-width:
    type: int
    description: The width of (Q)SPI bus to which flash memory is connected.
                 Now only value of 4 (when using SIO[0123]) is supported.
  writeoc:
    type: string
    enum:
      - "PP_1_1_4"      # Quad data line SPI, PP 1-1-4 (0x32)
      - "PP_1_4_4"      # Quad data line SPI, PP 1-4-4 (0x38)
    description: |
      The value encodes number of I/O lines used for the opcode,
      address, and data.

      There is no info about quad page program opcodes in the SFDP
      tables, hence it has been assumed that NOR flash memory
      supporting 1-4-4 mode also would support fast page programming.

      If absent, then 1-4-4 program page is used in quad mode.

  requires-ulbpr:
    type: boolean
    description: |
      Indicates the device requires the ULBPR (0x98) command.

      Some flash chips such as the Microchip SST26VF series have a block
      protection register that initializes to write-protected.  Use this
      property to indicate that the BPR must be unlocked before write
      operations can proceed.

  st,read-id-dummy-cycles:
    type: int
    default: 8
    description: The number of dummy-cycles required when reading jedec id

  cs-high-time:
    type: int
    default: 8
    enum:
      - 1
      - 2
      - 3
      - 4
      - 5
      - 6
      - 7
      - 8
    description: |
      Minimum number of QSPI clock cycles the chip select signal must remain
      high between commands issued to the flash memory.

      The minimum acceptable value depends on the flash memory model and the
      QSPI clock frequency. Using a value higher than the minimum required
      by the flash memory would not lead to communication errors but is
      suboptimal as it would reduce the throughput.

      Defaults to 8 clock cycles, which is the maximum supported value.
```

## dts/bindings/flash_controller/st,stm32-spi-nand.yaml
```yaml
# Copyright (c) 2020, Linaro limited
# SPDX-License-Identifier: Apache-2.0

description: |
    STM32 SPI Flash controller supporting the JEDEC CFI interface

    Representation of a serial nand flash on a spi bus:

        mx31lf1ge4bc: spi-nand-flash@0 {
                compatible = "st,stm32-spi-nand";
                label = "MX31LF1GE4BC";
                reg = <0>;
                spi-max-frequency = <80000000>;
                size = <0x4000000>;
                status = "okay";
        };

compatible: "st,stm32-spi-nand"

include: "spi-device.yaml"

on-bus: spi

properties:
    reg:
      required: true
    spi-max-frequency:
      type: int
      required: true
      description: Maximum clock frequency of device's SPI interface in Hz
    label:
      required: true
    size:
      type: int
      required: true
    block-size:
      type: int
      required: true
    page-size:
      type: int
      required: true
    id:
      type: uint8-array
      required: true
```
