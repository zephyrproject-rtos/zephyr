## dts/bindings/flash_controller/nordic,nrf53-flash-controller.yaml
```yaml
description: Nordic NVMC (Non-Volatile Memory Controller)

compatible: "nordic,nrf53-flash-controller"

include: flash-controller.yaml

properties:
    partial-erase:
      type: boolean
      description: |
        If set, indicates that the NVMC supports partial erase of flash pages.
```

## dts/bindings/flash_controller/nordic,nrf91-flash-controller.yaml
```yaml
description: Nordic NVMC (Non-Volatile Memory Controller)

compatible: "nordic,nrf91-flash-controller"

include: flash-controller.yaml
```

## dts/bindings/flash_controller/nordic,rram-controller.yaml
```yaml
#
# Copyright (c) 2023 Nordic Semiconductor ASA
#
# SPDX-License-Identifier: Apache-2.0
#

description: |
  Nordic RRAMC (Resistive random access memory controller)

  The resistive random access memory controller (RRAMC) is used for writing
  the internal RRAM memory, the secure information configuration registers (SICR),
  and the user information configuration registers (UICR).

compatible: "nordic,rram-controller"

include: base.yaml
```

## dts/bindings/flash_controller/nuvoton,nct-fiu-qspi.yaml
```yaml
# Copyright (c) 2025 Nuvoton Technology Corporation.
# SPDX-License-Identifier: Apache-2.0

description: |
    Properties defining the NCT Quad-SPI peripheral of Flash Interface Unit (FIU).
    A nct quad-fiu-spi dt node would typically looks like:

        &qspi_fiu0 {
            status = "okay";

            int_flash: w25q400@0 {
                status = "okay";
                reg = <0>;
                ...
            };

            ext_flash: w25q256@1 {
                status = "okay";
                reg = <1>;
                ...
            };
        };

    `int_flash` and `ext_flash` are the devices accessed by this peripheral.

compatible: "nuvoton,nct-fiu-qspi"

include: [base.yaml, pinctrl-device.yaml]

bus: qspi

properties:
  reg:
    required: true
  clocks:
    required: true
```

## dts/bindings/flash_controller/nuvoton,nct-nor.yaml
```yaml
# Copyright (c) 2025 Nuvoton Technology Corporation.
# SPDX-License-Identifier: Apache-2.0

description: |
    The SPI NOR flash devices accessed by Nuvoton Flash Driver.

    Representation of a SPI NOR flash on a qspi bus looks like:

      ext_flash: w25q256jv@0 {
            compatible ="nuvoton,nct-nor";
            size = <DT_SIZE_K(32 * 8)>;
            reg = <0>;

            qspi-flags = <NCT_QSPI_SW_CS1>;
            mapped-addr = <0x70000000>;
            pinctrl-0 = <&fiu0_shd_cs_io0_io1_clk_gp44_45_46_47>;
            pinctrl-names = "default";
      };

compatible: "nuvoton,nct-nor"

include: [flash-controller.yaml, pinctrl-device.yaml, "jedec,spi-nor-common.yaml"]

on-bus: qspi

properties:
  mapped-addr:
    type: int
    description: Mapped memory address of direct read access for spi nor flash.
  max-timeout:
    type: int
    default: 10000
    description: Typically, it equals to max timeout of chip erase in ms.
  qspi-flags:
    type: int
    required: true
    description: The definitions for configuring the Quad-SPI peripherals.
  rd-mode:
    type: string
    default: "NCT_RD_MODE_FAST_DUAL"
    description: |
      Selects the SPI read access type of Direct Read Access. Usually, we choose
      Fast Read Dual I/O mode for better performance. If the nor spi flash does
      not support this mode, please set this property explicitly.
    enum:
      - "NCT_RD_MODE_NORMAL" # Direct read access by command code 03h
      - "NCT_RD_MODE_FAST" # Direct read access by command code 0bh
      - "NCT_RD_MODE_FAST_DUAL" # Direct read access by command code bbh
      - "NCT_RD_MODE_QUAD" # Direct read access by command code ebh
```

## dts/bindings/flash_controller/nuvoton,nct-spip-qspi.yaml
```yaml
# Copyright (c) 2025 Nuvoton Technology Corporation.
# SPDX-License-Identifier: Apache-2.0

description: |
    Properties defining the NCT Quad-SPI peripheral of SERIAL PERIPHERAL INTERFACE (SPIP).
    A nct quad-spip-spi dt node would typically looks like:

        &qspi_spip {
            status = "okay";

            int_flash: w25q400@0 {
                status = "okay";
                reg = <0>;
                ...
            };

            ext_flash: w25q256@1 {
                status = "okay";
                reg = <1>;
                ...
            };
        };

    `int_flash` and `ext_flash` are the devices accessed by this peripheral.

compatible: "nuvoton,nct-spip-qspi"

include: [base.yaml, pinctrl-device.yaml]

bus: qspi

properties:
  reg:
    required: true
  clocks:
    required: true
```

## dts/bindings/flash_controller/nuvoton,npcm-nor.yaml
```yaml
# Copyright (c) 2024 Nuvoton Technology Corporation.
# SPDX-License-Identifier: Apache-2.0

description: |
    The SPI NOR flash devices accessed by Nuvoton Flash Driver.

    Representation of a SPI NOR flash on a qspi bus looks like:

      ext_flash: w25q256jv@0 {
            compatible ="nuvoton,npcm-nor";
            size = <DT_SIZE_K(32 * 8)>;
            reg = <0>;

            qspi-flags = <NPCM_QSPI_SW_CS1>;
            mapped-addr = <0x70000000>;
            pinctrl-0 = <&fiu0_shd_cs_io0_io1_clk_gp44_45_46_47>;
            pinctrl-names = "default";
      };

compatible: "nuvoton,npcm-nor"

include: [flash-controller.yaml, pinctrl-device.yaml, "jedec,spi-nor-common.yaml"]

on-bus: qspi

properties:
  mapped-addr:
    type: int
    description: Mapped memory address of direct read access for spi nor flash.
  max-timeout:
    type: int
    default: 10000
    description: Typically, it equals to max timeout of chip erase in ms.
  qspi-flags:
    type: int
    required: true
    description: The definitions for configuring the Quad-SPI peripherals.
  rd-mode:
    type: string
    default: "NPCM_RD_MODE_FAST_DUAL"
    description: |
      Selects the SPI read access type of Direct Read Access. Usually, we choose
      Fast Read Dual I/O mode for better performance. If the nor spi flash does
      not support this mode, please set this property explicitly.
    enum:
      - "NPCM_RD_MODE_NORMAL" # Direct read access by command code 03h
      - "NPCM_RD_MODE_FAST" # Direct read access by command code 0bh
      - "NPCM_RD_MODE_FAST_DUAL" # Direct read access by command code bbh
      - "NPCM_RD_MODE_QUAD" # Direct read access by command code ebh
```

## dts/bindings/flash_controller/nuvoton,npcm-spip-qspi.yaml
```yaml
# Copyright (c) 2024 Nuvoton Technology Corporation.
# SPDX-License-Identifier: Apache-2.0

description: |
    Properties defining the NPCM Quad-SPI peripheral of SERIAL PERIPHERAL INTERFACE (SPIP).
    A npcm quad-spip-spi dt node would typically looks like:

        &qspi_spip {
            status = "okay";

            int_flash: w25q400@0 {
                status = "okay";
                reg = <0>;
                ...
            };

            ext_flash: w25q256@1 {
                status = "okay";
                reg = <1>;
                ...
            };
        };

    `int_flash` and `ext_flash` are the devices accessed by this peripheral.

compatible: "nuvoton,npcm-spip-qspi"

include: [base.yaml, pinctrl-device.yaml]

bus: qspi

properties:
  reg:
    required: true
  clocks:
    required: true
```

## dts/bindings/flash_controller/nuvoton,npcx-fiu-nor.yaml
```yaml
# Copyright (c) 2023 Nuvoton Technology Corporation.
# SPDX-License-Identifier: Apache-2.0

description: |
    The SPI NOR flash devices accessed by Nuvoton Flash Interface Unit (FIU).

    Representation of a SPI NOR flash on a qspi bus looks like:

      int_flash: w25q40@0 {
            compatible ="nuvoton,npcx-fiu-nor";
            size = <DT_SIZE_K(512 * 8)>;
            reg = <0>;

            qspi-flags = <NPCX_QSPI_SW_CS1>;
            mapped-addr = <0x64000000>;
            pinctrl-0 = <&int_flash_sl>;
            pinctrl-names = "default";
      };

compatible: "nuvoton,npcx-fiu-nor"

include: [flash-controller.yaml, pinctrl-device.yaml, "jedec,spi-nor-common.yaml"]

on-bus: qspi

properties:
  mapped-addr:
    type: int
    required: true
    description: Mapped memory address of direct read access for spi nor flash.
  max-timeout:
    type: int
    default: 10000
    description: Typically, it equals to max timeout of chip erase in ms.
  qspi-flags:
    type: int
    required: true
    description: The definitions for configuring the Quad-SPI peripherals.
  rd-mode:
    type: string
    default: "NPCX_RD_MODE_FAST_DUAL"
    description: |
      Selects the SPI read access type of Direct Read Access. Usually, we choose
      Fast Read Dual I/O mode for better performance. If the nor spi flash does
      not support this mode, please set this property explicitly.
    enum:
      - "NPCX_RD_MODE_NORMAL" # Direct read access by command code 03h
      - "NPCX_RD_MODE_FAST" # Direct read access by command code 0bh
      - "NPCX_RD_MODE_FAST_DUAL" # Direct read access by command code bbh
  spi-dev-size:
    type: string
    description: |
      Select the size of the address space allocated for SPI device. This affects
      the address space for any direct flash access.
    enum:
      - "NPCX_SPI_DEV_SIZE_1M"
      - "NPCX_SPI_DEV_SIZE_2M"
      - "NPCX_SPI_DEV_SIZE_4M"
      - "NPCX_SPI_DEV_SIZE_8M"
      - "NPCX_SPI_DEV_SIZE_16M"
      - "NPCX_SPI_DEV_SIZE_32M"
      - "NPCX_SPI_DEV_SIZE_64M"
      - "NPCX_SPI_DEV_SIZE_128M"
```

## dts/bindings/flash_controller/nuvoton,npcx-fiu-qspi.yaml
```yaml
# Copyright (c) 2023 Nuvoton Technology Corporation.
# SPDX-License-Identifier: Apache-2.0

description: |
    Properties defining the NPCX Quad-SPI peripheral of Flash Interface Unit (FIU).
    A npcx quad-spi dt node would typically looks like:

        &qspi_fiu0 {
            status = "okay";

            int_flash: w25q400@0 {
                status = "okay";
                reg = <0>;
                ...
            };

            ext_flash: w25q256@1 {
                status = "okay";
                reg = <1>;
                ...
            };
        };

    `int_flash` and `ext_flash` are the devices accessed by this peripheral.

compatible: "nuvoton,npcx-fiu-qspi"

include: [base.yaml, pinctrl-device.yaml]

bus: qspi

properties:
  reg:
    required: true
  clocks:
    required: true
  en-direct-access-2dev:
    type: boolean
    description: |
      Two external SPI devices are supported for Direct Read Access (DRA) on QSPI bus.
  flash-dev-inv:
    type: boolean
    description: |
      Inverse the device connected to the base address.
  dmas:
    description: |
      Optional DMA channel specifier. If DMA should be used, specifier should
      hold a phandle reference to the dma controller and its channel.
  support-npcxn-v1:
    type: boolean
    description: |
      This option enables the FIU support for NPCXn V1.
  support-npcxn-v2:
    type: boolean
    description: |
      This option enables the FIU support for NPCXn V2.
  support-npckn-v1:
    type: boolean
    description: |
      This option enables the FIU support for NPCKn V1.
```

## dts/bindings/flash_controller/nuvoton,numaker-fmc.yaml
```yaml
description: Nuvoton NuMaker Flash Controller

compatible: "nuvoton,numaker-fmc"

include: flash-controller.yaml

properties:
  reg:
    required: true
```

## dts/bindings/flash_controller/nuvoton,numaker-rmc.yaml
```yaml
description: Nuvoton NuMaker RRAM Memory Controller

compatible: "nuvoton,numaker-rmc"

include: flash-controller.yaml

properties:
  reg:
    required: true
```

## dts/bindings/flash_controller/nxp,c40-flash-controller.yaml
```yaml
# Copyright 2025 NXP
# SPDX-License-Identifier: Apache-2.0
title: NXP C40 Flash Controller

description: |
  Controller for the on-chip NXP C40 flash array.

compatible: "nxp,c40-flash-controller"

include: base.yaml

properties:
  "#address-cells":
    const: 1
    description: Number of address cells for child flash nodes.

  "#size-cells":
    const: 1
    description: Number of size cells for child flash nodes.
```

## dts/bindings/flash_controller/nxp,iap-fmc11.yaml
```yaml
# Copyright (c) 2019, NXP
# SPDX-License-Identifier: Apache-2.0

description: |
  NXP (In-Application Programming) flash memory controller for the lpc11u6x family.

compatible: "nxp,iap-fmc11"

include: flash-controller.yaml
```

## dts/bindings/flash_controller/nxp,iap-fmc54.yaml
```yaml
# Copyright (c) 2019, NXP
# SPDX-License-Identifier: Apache-2.0

description: |
  NXP (In-Application Programming) flash memory controller for the lpc54xxx family.

compatible: "nxp,iap-fmc54"

include: flash-controller.yaml
```

## dts/bindings/flash_controller/nxp,iap-fmc55.yaml
```yaml
# Copyright (c) 2019, NXP
# SPDX-License-Identifier: Apache-2.0

description: |
  NXP (In-Application Programming) flash memory controller for
  the lpc55xxx family, except lpc553x

compatible: "nxp,iap-fmc55"

include: flash-controller.yaml
```

## dts/bindings/flash_controller/nxp,iap-fmc553.yaml
```yaml
# Copyright (c) 2019, NXP
# SPDX-License-Identifier: Apache-2.0

description: |
  NXP (In-Application Programming) flash memory controller for
  the lpc553x family

compatible: "nxp,iap-fmc553"

include: flash-controller.yaml
```

## dts/bindings/flash_controller/nxp,iap-fmc84x.yaml
```yaml
# Copyright (c) 2026 Aerlync Labs Inc
# SPDX-License-Identifier: Apache-2.0

description: NXP LPC84x on chip flash controller (ROM IAP, FMC)

compatible: "nxp,iap-fmc84x"

include:
  - name: flash-controller.yaml

properties:
  clocks:
    required: true
    description: Clock required for the flash controller.

  flash-access-time:
    type: int
    required: true
    enum: [0, 1, 2]
    description: |
      Controls flash read wait-state count written to FLASHCFG.FLASHTIM
      - 0 : 1 system clock, 18 MHz
      - 1 : 2 system clocks, 24 MHz
      - 2 : 3 system clocks, 30 MHz (hardware reset default)
      Must match the actual system clock frequency to avoid flash read errors.
```

## dts/bindings/flash_controller/nxp,iap-k32.yaml
```yaml
# Copyright (c) 2019, NXP
# SPDX-License-Identifier: Apache-2.0

description: |
  NXP (In-Application Programming) flash memory controller for
  the k32 family

compatible: "nxp,iap-k32"

include: flash-controller.yaml
```

## dts/bindings/flash_controller/nxp,imx-flexspi.yaml
```yaml
# Copyright (c) 2018, NXP
# SPDX-License-Identifier: Apache-2.0

description: NXP FlexSPI controller

compatible: "nxp,imx-flexspi"

include: flash-controller.yaml

properties:
    reg:
      required: true

    interrupts:
      required: true

    "#address-cells":
      required: true
      const: 1

    "#size-cells":
      required: true
      const: 1
```

## dts/bindings/flash_controller/nxp,kinetis-ftfa.yaml
```yaml
description: NXP Kinetis Flash Memory Module A (FTFA)

compatible: "nxp,kinetis-ftfa"

include: flash-controller.yaml

properties:
  fsec:
    type: int
    description: |
      Configures the reset value of the FSEC register, which includes
      backdoor key access, mass erase, factory access, and flash security
      options.

  fopt:
    type: int
    description: |
      Configures the reset value of the FOPT register, which includes boot,
      NMI, and EzPort options.

  config-field-offset:
    type: int
    description: |
      Flash configuration field offset
```

## dts/bindings/flash_controller/nxp,kinetis-ftfc.yaml
```yaml
# Copyright 2025 NXP
# SPDX-License-Identifier: Apache-2.0

description: NXP Kinetis Flash Memory Module C (FTFC)

compatible: "nxp,kinetis-ftfc"

include: flash-controller.yaml

properties:
  fsec:
    type: int
    description: |
      Configures the reset value of the FSEC register, which includes
      backdoor key access, mass erase, factory access, and flash security
      options.

  fopt:
    type: int
    description: |
      Configures the reset value of the FOPT register, which includes boot,
      NMI, and EzPort options.
```
