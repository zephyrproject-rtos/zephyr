## dts/bindings/flash_controller/nxp,kinetis-ftfe.yaml
```yaml
description: NXP Kinetis Flash Memory Module E (FTFE)

compatible: "nxp,kinetis-ftfe"

include: flash-controller.yaml
```

## dts/bindings/flash_controller/nxp,kinetis-ftfl.yaml
```yaml
description: NXP Kinetis Flash Memory Module L (FTFL)

compatible: "nxp,kinetis-ftfl"

include: flash-controller.yaml
```

## dts/bindings/flash_controller/nxp,lpc-iap.yaml
```yaml
# Copyright (c) 2019, NXP
# SPDX-License-Identifier: Apache-2.0

description: NXP LPC IAP (In-Application Programming) flash memory controller

compatible: "nxp,lpc-iap"

include: flash-controller.yaml
```
