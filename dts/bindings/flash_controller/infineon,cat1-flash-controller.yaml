## dts/bindings/flash_controller/infineon,cat1-flash-controller.yaml
```yaml
description: |
  Infineon CAT1C (TRAVEO T2G) FLASHC flash controller.

  This controller manages multiple NVM regions (main code flash and
  work flash). Each region is described as a soc-nv-flash child node.

compatible: "infineon,cat1-flash-controller"

include: flash-controller.yaml
```

## dts/bindings/flash_controller/infineon,cat1-qspi-flash.yaml
```yaml
# ==================================================================================================
# Copyright (c) 2025 Cypress Semiconductor Corporation (an Infineon company) or
# an affiliate of Cypress Semiconductor Corporation
#
# SPDX-License-Identifier: Apache-2.0
# ==================================================================================================

description: Infineon CAT1 QSPI flash controller

compatible: "infineon,cat1-qspi-flash"

include: flash-controller.yaml
```

## dts/bindings/flash_controller/infineon,psoc4-flash.yaml
```yaml
description: Infineon PSOC4 flash controller

compatible: "infineon,psoc4-flash"

include: flash-controller.yaml
```

## dts/bindings/flash_controller/infineon,qspi-flash.yaml
```yaml
description: Infineon QSPI flash controller

compatible: "infineon,qspi-flash"

include: flash-controller.yaml
```

## dts/bindings/flash_controller/infineon,rram-controller.yaml
```yaml
# SPDX-FileCopyrightText: <text>Copyright (c) 2026 Infineon Technologies AG,
# or an affiliate of Infineon Technologies AG. All rights reserved.</text>
#
# SPDX-License-Identifier: Apache-2.0

description: Infineon CAT1 RRAM controller

compatible: "infineon,rram-controller"

include: flash-controller.yaml
```

## dts/bindings/flash_controller/infineon,serial-memory-qspi.yaml
```yaml
# Copyright (c) 2025 Infineon Technologies AG,
# or an affiliate of Infineon Technologies AG.
#
# SPDX-License-Identifier: Apache-2.0

description: Infineon Serial Memory based QSPI flash controller

compatible: "infineon,serial-memory-qspi"

include: flash-controller.yaml
```

## dts/bindings/flash_controller/infineon,smif-memslot.yaml
```yaml
description: |
  Infineon SMIF memory-slot (memslot) binding.

  One node per external memory device attached to a SMIF (Serial Memory
  InterFace) controller. The QSPI Configurator (cycfg_qspi_memslot.c)
  generates one cy_stc_smif_block_config_t per SMIF instance
  (smif0BlockConfig, smif1BlockConfig). The driver selects the matching
  block config from the node's "reg" base address; both the non-secure and
  secure CBUS aliases for a given SMIF resolve to the same block-config:
    0x44460000 / 0x54460000 -> SMIF0
    0x444A0000 / 0x544A0000 -> SMIF1
  "infineon,chip-select" selects which slot within that block config holds
  the memory device described by this node.

compatible: "infineon,smif-memslot"

include: [flash-controller.yaml, pinctrl-device.yaml]

properties:
  infineon,chip-select:
    type: int
    default: 1
    enum:
      - 0
      - 1
      - 2
      - 3
    description: |
      Chip-select slot index (memNum) within the selected SMIF block
      configuration that addresses this memory device. Matches the slot
      used in the QSPI Configurator.

  infineon,hw-init:
    type: boolean
    description: |
      When set, the driver fully initialises the SMIF peripheral (pinctrl,
      Cy_SMIF_Init) at start-up. Required when the boot ROM has not configured
      this SMIF core (e.g. when the first stage boots from internal RRAM).
```

## dts/bindings/flash_controller/infineon,xmc4xxx-flash-controller.yaml
```yaml
description: XMC4XXX flash controller

compatible: "infineon,xmc4xxx-flash-controller"

include: flash-controller.yaml
```

## dts/bindings/flash_controller/intel,pflash-cfi01.yaml
```yaml
# Copyright (c) 2026 Analog Devices, Inc
# SPDX-License-Identifier: Apache-2.0

description: Intel CFI01 parallel flash (QEMU pflash)

compatible: "intel,pflash-cfi01"

include: flash-controller.yaml

properties:
  bank-width:
    type: int
    description: |
      Data bus width in bytes. Valid values are 1, 2, or 4.
      Determines the width of memory-mapped reads and writes.
    enum:
      - 1
      - 2
      - 4
    default: 1
  device-width:
    type: int
    description: |
      Width of the flash device in bytes for x8/x16/x32 mode handling.
    enum:
      - 1
      - 2
      - 4
    default: 1

  max-device-width:
    type: int
    description: |
      Maximum device width in bytes for x8/x16/x32 mode handling.
      Defaults to bank-width if not specified.
      Rarely needed; kept for compatibility with real CFI implementations.
```

## dts/bindings/flash_controller/ite,it51xxx-manual-flash-1k.yaml
```yaml
# Copyright (c) 2025 ITE Corporation. All Rights Reserved.
# SPDX-License-Identifier: Apache-2.0

description: ITE IT51XXX manual flash 1k(M1k)

compatible: "ite,it51xxx-manual-flash-1k"

include: [flash-controller.yaml, pinctrl-device.yaml]

properties:
  pinctrl-0:
    description: |
      Access internal flash does not need to configure pinctrl,
      so require is not true.

  pinctrl-names:
    description: |
      As above.

  m1k-sel-access-flash:
    type: string
    default: "internal"
    enum:
      - "internal"
      - "external-fspi-cs0"
      - "external-fspi-cs1"
    description: |
      This option enables access to the internal e-Flash or
      external SPI flash via FSCE# or FSCE1#.
```

## dts/bindings/flash_controller/ite,it8xxx2-flash-controller.yaml
```yaml
# Copyright (c) 2020 ITE Corporation. All Rights Reserved.
# SPDX-License-Identifier: Apache-2.0

description: ITE IT8XXX2 flash memory

compatible: "ite,it8xxx2-flash-controller"

include: flash-controller.yaml
```

## dts/bindings/flash_controller/microchip,igloo2-envm-controller.yaml
```yaml
# Copyright (c) 2026 Space Cubics Inc.
# SPDX-License-Identifier: Apache-2.0

description: Microchip IGLOO2 eNVM controller

compatible: "microchip,igloo2-envm-controller"

include: flash-controller.yaml

properties:
  "#address-cells":
    required: true
    const: 1

  "#size-cells":
    required: true
    const: 1
```

## dts/bindings/flash_controller/microchip,nvmctrl-g1-flash.yaml
```yaml
# Copyright (c) 2025 Microchip Technology Inc.
# SPDX-License-Identifier: Apache-2.0

title: Microchip NVMCTRL (Nonvolatile Memory Controller)

description: |
  Microchip NVMCTRL Flash driver

  Group g1 NVMCTRL Flash driver supports following hardware peripherals:
    - module name="NVMCTRL" id="U2409" version="1.0.0"

compatible: "microchip,nvmctrl-g1-flash"

include: flash-controller.yaml

properties:
  lock-regions:
    type: int
    required: true
    description: |
      Number of lock regions.

      The main address space is divided into 32 equal size regions. The region size is
      dependent on the flash memory size.Each region can be protected against write or
      erase operation.
```

## dts/bindings/flash_controller/microchip,nvmctrl-g2.yaml
```yaml
# Copyright (c) 2026 Microchip Technology Inc.
# SPDX-License-Identifier: Apache-2.0

title: Microchip NVMCTRL (Nonvolatile Memory Controller)

description: |
  Microchip NVMCTRL driver for Flash

  Group g2 NVMCTRL driver supports following hardware peripherals:
    - module name="NVMCTRL" id="03929" version="1a0"

compatible: "microchip,nvmctrl-g2"

include: flash-controller.yaml

examples:
  - |
    /*
     * clock-parent phandle referes to the node label that
     * holds clock device in the tree. Flash driver uses this
     * phandle to initialize clocks for flash operations
     */
    nvmctrl: flash-controller@41004000 {
      compatible = "microchip,nvmctrl-g2";
      reg = <0x41004000 0xa0>;
      /* ... */
      clock-parent = <&clock>;

      flash0: flash@0 {
        compatible = "microchip,flash-g2", "soc-nv-flash";
        /* ... */
      };
    };

properties:
  clock-parent:
    type: phandle
    description: Reference to the clock node
```

## dts/bindings/flash_controller/microchip,nvmctrl-g3.yaml
```yaml
# Copyright (c) 2026 Microchip Technology Inc.
# SPDX-License-Identifier: Apache-2.0

description: Microchip flash controller

compatible: "microchip,nvmctrl-g3"

include: flash-controller.yaml

examples:
  - |
    /*
     * clock-parent phandle referes to the node label that
     * holds clock device in the tree. Flash driver uses this
     * phandle to initialize clocks for flash operations
     *
     */
    nvmctrl: flash-controller@44002000 {
      compatible = "microchip,nvmctrl-g3";
      reg = <0x44002000 0x7c>, <0x44004000 0x60>;
      /* ... */
      clock-parent = <&clock>;

      flash0: flash@8000000 {
        compatible = "microchip,flash-g3", "soc-nv-flash";
        /* ... */
      };
    };

properties:
  clock-parent:
    type: phandle
    description: Reference to the clock node
```

## dts/bindings/flash_controller/microchip,pic32cxsg-nvmctrl.yaml
```yaml
description: Microchip PIC32CXSG NVMC (Non-Volatile Memory Controller)

compatible: "microchip,pic32cxsg-nvmctrl"

include: flash-controller.yaml

properties:
  lock-regions:
    type: int
    required: true
    description: Number of lock regions
```

## dts/bindings/flash_controller/microchip,qspi-controller.yaml
```yaml
# Copyright (c) 2025-2026 Microchip Technology  Inc. and its subsidiaries
#
# SPDX-License-Identifier: Apache-2.0

description: Microchip QSPI Flash controller

compatible: "microchip,sama7g5-qspi"

include:
 - flash-controller.yaml
 - pinctrl-device.yaml

properties:
  pinctrl-0:
    required: true

  pinctrl-names:
    required: true

  clocks:
    required: true

  dmas:
    description: |
      Optional DMA channel specifier. If DMA should be used, specifier should
      hold a handle reference to the dma controller and its channel.

  dma-names:
    description: |
      Required if the dmas property exists.

  requires-ulbpr:
    type: boolean
    description: |
      Indicates the device requires the ULBPR (0x98) command.

      Some flash chips such as the Microchip SST26VF series have a block
      protection register that initializes to write-protected. Use this
      property to indicate that the BPR must be unlocked before write
      operations can proceed.
      For example, SST26VF064B on SAMA7G54-CURIOITY board.

  skip-sfdp:
    type: boolean
    description: |
      Indicates the device to skip parsing SFDP( the Serial Flash
      Discoverable Parameter tables) to obtain flash parameters.

      Some flash chips (such as the MX66LM1G45G on SAMA7G54-EK board)
      do not support SFDP.

  size:
    type: int
    default: 0x0
    description: |
      Flash Memory size in bits, required if skip-sfdp is enabled.
```

## dts/bindings/flash_controller/microchip,smartfusion2-flash-controller.yaml
```yaml
# SPDX-FileCopyrightText: Copyright The Zephyr Project Contributors
# SPDX-License-Identifier: Apache-2.0

description: Microchip SmartFusion2 embedded NVM controller

compatible: "microchip,smartfusion2-flash-controller"

include: flash-controller.yaml
```

## dts/bindings/flash_controller/micron,mt25qu02g.yaml
```yaml
# Copyright (c) 2022 Intel Corporation
# SPDX-License-Identifier: Apache-2.0

description: Micron QSPI Flash

compatible: "micron,mt25qu02g"

include: flash-controller.yaml

properties:
  size:
    type: int
    description: Flash memory size in bit.
```

## dts/bindings/flash_controller/micron,mt29f4g08.yaml
```yaml
# Copyright (c) 2025 Endress+Hauser GmbH+Co. KG
# SPDX-License-Identifier: Apache-2.0

description: |
  NAND flash driver for Micron MT29F4G08 flash memory.

  The MT29F4G08 is a 4 Gb NAND flash organised in pages of 2048 bytes each.

  Refer to the Micron MT29F4G08 datasheet for more details.

compatible: "micron,mt29f4g08"

properties:
  reg:
    type: int
    required: true

  page-size:
    type: int
    required: true

  spare-area-size:
    type: int
    required: true

  block-size:
    type: int
    required: true

  plane-size:
    type: int
    required: true

  flash-size:
    type: int
    required: true

  setup-time:
    type: int
    default: 0

  wait-setup-time:
    type: int
    default: 0

  hold-setup-time:
    type: int
    default: 0

  hiz-setup-time:
    type: int
    default: 0
```

## dts/bindings/flash_controller/nordic,nrf-mramc.yaml
```yaml
#
# Copyright (c) 2025 Nordic Semiconductor ASA
#
# SPDX-License-Identifier: Apache-2.0
#

description: |
  Nordic MRAMC (Magnetoresistive Random Access Memory Controller)

  The Magnetoresistive random access memory controller (MRAMC) is used for writing
  the internal MRAM memory, the secure information configuration registers (SICR),
  and the user information configuration registers (UICR).

compatible: "nordic,nrf-mramc"

include: base.yaml
```

## dts/bindings/flash_controller/nordic,nrf-qspi-flash-controller.yaml
```yaml
---
title: Nordic QSPI peripheral
version: 0.1

description: >
    This binding gives a base representation of the Nordic QSPI peripheral

inherits:
    !include [flash-controller.yaml, spi.yaml]

properties:
    compatible:
      constraint: "nordic,nrf-qspi-flash-controller"

    sck-pin:
      type: int
      description: SCK pin
      generation: define
      category: required

    csn-pin:
      type: int
      description: CSN pin
      generation: define
      category: optional

    io-pins:
      type: int
      description: IO pins
      category: required
      generation: define

    qspi-max-frequency:
      type: u32
      category: required
      description: Maximum clock frequency of device's QSPI interface in Hz
      generation: define

...
```

## dts/bindings/flash_controller/nordic,nrf-qspi.yaml
```yaml
# Copyright (c) 2019 Nordic Semiconductor ASA
# SPDX-License-Identifier: Apache-2.0

description: |
    Properties defining the interface for the Nordic QSPI peripheral.

    The reg property describes two register blocks: one for the memory
    corresponding to the QSPI peripheral registers, and another for
    the memory mapped XIP area:

        qspi: qspi@2b000 {
                compatible = "nordic,nrf-qspi";
                reg = <0x2b000 0x1000>, <0x10000000 0x10000000>;
                reg-names = "qspi", "qspi_mm";
                ...
        };

    Above, the register block with base address 0x2b000 and name
    "qspi" are the QSPI peripheral registers. The register block with
    base address 0x10000000 and name "qspi_mm" is the XIP area.

compatible: "nordic,nrf-qspi"

interrupt-source: true

include: [flash-controller.yaml, pinctrl-device.yaml]

bus: qspi

properties:
  "#address-cells":
    required: true
    const: 1

  "#size-cells":
    required: true
    const: 0

  pinctrl-0:
    required: true
```

## dts/bindings/flash_controller/nordic,nrf51-flash-controller.yaml
```yaml
description: Nordic NVMC (Non-Volatile Memory Controller)

compatible: "nordic,nrf51-flash-controller"

include: flash-controller.yaml
```

## dts/bindings/flash_controller/nordic,nrf52-flash-controller.yaml
```yaml
description: Nordic NVMC (Non-Volatile Memory Controller)

compatible: "nordic,nrf52-flash-controller"

include: flash-controller.yaml

properties:
  partial-erase:
    type: boolean
    description: |
      If set, indicates that the NVMC supports partial erase of flash pages.
```
