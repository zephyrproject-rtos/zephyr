## dts/bindings/flash_controller/microchip,nvmctrl-g4.yaml
```yaml
# SPDX-FileCopyrightText: Copyright The Zephyr Project Contributors
# SPDX-License-Identifier: Apache-2.0

title: Microchip NVMCTRL G4 flash controller

description: |
  Flash controller built from the FCW write controller and the FCR read
  controller.

  Group g4 supports the following hardware peripherals:
    - module name="FCW" id="04971" version="2a0"
    - module name="FCR" id="04972" version="2a0"

  The driver serves the program flash child only, and needs program_flash
  as its node label.

compatible: "microchip,nvmctrl-g4"

include: flash-controller.yaml

properties:
  reg:
    required: true
    description: FCW register block first, FCR register block second.

  reg-names:
    required: true
    description: Must be "fcw" then "fcr".
```

## dts/bindings/flash_controller/microchip,pmecc-g1-flash.yaml
```yaml
# Copyright (c) 2026 Microchip Technology Inc.
# SPDX-License-Identifier: Apache-2.0

description: |
  Microchip Programmable Multibit Error Correcting Code (PMECC) G1.

  SAM PMECC is based on the following hardware peripherals:
    - module name="PMECC" id="11038" version="105"
    - module name="PMERRLOC" id="11039" version="102"
    - module name="SMC" id="11036" version="304"

examples:
  - |
    Example devicetree configuration:

      &pmecc {
        status = "okay";
      };

compatible: "microchip,pmecc-g1-flash"

include:
  - name: base.yaml

properties:
  reg:
    required: true

  ecc-rom:
    type: phandle
    required: true
    description: |
      Hold a phandle reference to the BCH Galois Field tables.

  max-strength:
    type: int
    default: 24
    enum:
      - 24
      - 32
    description: |
      Maximum ECC strength bits.
      ECC bit support
      SAMA7  2, 4, 8, 12, 24, 32
      SAM9X7 2, 4, 8, 12, 24
```

## dts/bindings/flash_controller/nuvoton,npcm-fiu-qspi.yaml
```yaml
# Copyright (c) 2024 Nuvoton Technology Corporation.
# SPDX-License-Identifier: Apache-2.0

description: |
    Properties defining the NPCM Quad-SPI peripheral of Flash Interface Unit (FIU).
    A npcm quad-fiu-spi dt node would typically looks like:

        &qspi_fiu0 {
            status = "okay";

            ext_flash_shd: shd-flash@1 {
                status = "okay";
                reg = <1>;
                ranges = <0x0 0x70000000 DT_SIZE_M(32)>;
                ...
            };
        };

    Child flash nodes are addressed by their chip select (reg) and describe
    their Direct Read Access window with their own ranges property.

compatible: "nuvoton,npcm-fiu-qspi"

include: [base.yaml, pinctrl-device.yaml]

bus: qspi

properties:
  reg:
    required: true
  clocks:
    required: true
```

## dts/bindings/flash_controller/nxp,xspi-nor.yaml
```yaml
# Copyright 2024-2026 NXP
# SPDX-License-Identifier: Apache-2.0

description: NXP XSPI Flash Controller

compatible: "nxp,xspi-nor"

include: ["nxp,xspi-device.yaml", "jedec,jesd216.yaml"]

properties:
  reset-gpios:
    type: phandle-array
    description: |
      RESET# pin of the flash device.

  initial-soft-reset:
    type: boolean
    description: |
      Issue a software reset sequence at initialization.
```

## dts/bindings/flash_controller/puya,py32f0-flash-controller.yaml
```yaml
# SPDX-FileCopyrightText: Copyright The Zephyr Project Contributors
# SPDX-License-Identifier: Apache-2.0

description: Puya PY32F0 internal flash controller

compatible: "puya,py32f0-flash-controller"

include: flash-controller.yaml
```

## dts/bindings/flash_controller/renesas,ra-flash-hp-controller.yaml
```yaml
# Copyright (c) 2024-2026 Renesas Electronics Corporation
# SPDX-License-Identifier: Apache-2.0

description: Renesas RA family flash high-performance controller

compatible: "renesas,ra-flash-hp-controller"

include: base.yaml

properties:
  programming-enable:
    type: boolean
    description: |
      Enable code flash programming configuration

  erase-value-undefined:
    type: boolean
    description: |
      Areas of flash that are in an erased state will read back undefined values.

  command-interface:
    type: phandle
    required: true
    description: |
      Phandle to command interface node.
```

## dts/bindings/flash_controller/renesas,ra-flash-lp-controller.yaml
```yaml
# Copyright (c) 2025-2026 Renesas Electronics Corporation
# SPDX-License-Identifier: Apache-2.0

description: Renesas RA family flash low-power controller

compatible: "renesas,ra-flash-lp-controller"

include: base.yaml

properties:
  programming-enable:
    type: boolean
    description: |
      Enable code flash programming configuration

  command-interface:
    type: phandle
    required: true
    description: |
      Phandle to command interface node.
```

## dts/bindings/flash_controller/renesas,ra-ospi-b-nor.yaml
```yaml
# Copyright (c) 2024-2026 Renesas Electronics Corporation
# SPDX-License-Identifier: Apache-2.0

description: Renesas RA OSPI FLASH controller

compatible: "renesas,ra-ospi-b-nor"

include: [base.yaml, "jedec,jesd216.yaml"]

properties:
  jedec-id:
    required: true
    description: |
      The JEDEC ID of the flash memory connected to OSPI. This is used to match the flash
      memory to a compatible flash driver, and to ensure the correct SPI NOR flash

  protocol-mode:
    type: int
    required: true
    enum: [1, 4, 8]
    description: |
     The width of OSPI bus to which flash memory is connected.
     Possible values are :
      - OSPI_SPI_MODE  <1> = SPI mode on 1 data line
      - OSPI_QUAD_MODE <4> = Quad mode on 4 data lines
      - OSPI_OPI_MODE  <8> = Octo mode on 8 data lines

  nor-max-frequency:
    type: int
    required: true
    description: |
      Max frequency input of the NOR flash memory connected to OSPI.

  enter-4byte-command:
    type: int
    description: |
      Enter 4-byte address mode command (Only required if SPI NOR
      Flash has the incorrect BFPT DW16 information in SFDP)

  rdsr-addr-4bytes:
    type: boolean
    description: |
      Whether RDSR command requires 4-byte address (Only required if SPI NOR
      Flash has the incorrect PROFILE1 DW1 information in SFDP)

  default-8d-dummy-cycles:
    type: int
    description: |
      Default dummy cycles for read command (Only required if SPI NOR Flash enter 8D mode
      but don't has dummy cycles information or the information is incorrect in SFDP)

  seq-enable-qpi:
    type: int
    description: |
      Override for the SFDP BFP DW15 "4-4-4 Enable Sequences" bitfield, used to select the
      command sequence for entering 4S-4S-4S (QPI) mode (Only required if SPI NOR Flash
      doesn't have or has incorrect BFPT DW15 information in SFDP).

      Possible values are :
       - <x_xxx1b> = Issue 0x38 after enabling Quad mode via the QE bit (quad-enable-requirements)
       - <x_xx1xb> = Issue 0x38, no prior QE bit write required
       - <x_x1xxb> = Issue 0x35, no prior QE bit write required
```

## dts/bindings/flash_controller/renesas,rx-flash-controller.yaml
```yaml
# Copyright (c) 2025 Renesas Electronics Corporation
#
# SPDX-License-Identifier: Apache-2.0

description: Renesas RX Flash Controller

compatible: "renesas,rx-flash-controller"

include: base.yaml

properties:
  programming-enable:
    type: boolean
    description: |
      Enable code flash programming. If present, code flash is available.

  bgo-enable:
    type: boolean
    description: |
      Enable Background Operations (BGO) mode. If present, BGO mode is enabled
      for data flash operations.

  flash-if:
    type: phandle
    description: |
      Phandle to command interface node.
```

## dts/bindings/flash_controller/renesas,rx-flashif.yaml
```yaml
# Copyright (c) 2026 Renesas Electronics Corporation
# SPDX-License-Identifier: Apache-2.0

description: Renesas RX Flash Command Interface

compatible: "renesas,rx-flashif"

include: flash-controller.yaml

properties:
  interrupts:
    description: |
      IRQ number and priority to use for Flash controller.

  interrupt-names:
    enum:
      - "frdyi"
    description: |
      Interrupts must be given corresponding names so that the driver can recognize them.
```

## dts/bindings/flash_controller/renesas,rx-maci.yaml
```yaml
# Copyright (c) 2026 Renesas Electronics Corporation
# SPDX-License-Identifier: Apache-2.0

description: Renesas RX MRAM Application Command Interface

compatible: "renesas,rx-maci"

include: flash-controller.yaml
```

## dts/bindings/flash_controller/renesas,rx-mram-controller.yaml
```yaml
# Copyright (c) 2026 Renesas Electronics Corporation
# SPDX-License-Identifier: Apache-2.0

description: Renesas RX MRAM controller

compatible: "renesas,rx-mram-controller"

include: base.yaml

properties:
  command-interface:
    type: phandle
    required: true
    description: |
      Phandle to command interface node.
```

## dts/bindings/flash_controller/renesas,rz-qspi-spibsc.yaml
```yaml
# Copyright (c) 2025 Renesas Electronics Corporation
# SPDX-License-Identifier: Apache-2.0

description: |
    Renesas RZ SPIBSC NOR FLASH controller supporting the JEDEC CFI interface.

compatible: "renesas,rz-qspi-spibsc"

include: ["flash-controller.yaml", "jedec,jesd216.yaml"]

on-bus: qspi

examples:
  - |
    ext_flash_ctrl: flash-controller@0 {
      compatible = "renesas,rz-qspi-spibsc";
      reg = <0>;
      status = "okay";
      #address-cells = <1>;
      #size-cells = <1>;
      ranges = <0x0 0x20000000 DT_SIZE_M(16)>;

      at25ql128a: qspi-nor-flash@0 {
        compatible = "soc-nv-flash";
        reg = <0x0 DT_SIZE_M(16)>;
        write-block-size = <1>;
        erase-block-size = <4096>;
        #address-cells = <1>;
        #size-cells = <1>;
        ranges;

        partitions {
          ranges;
          #address-cells = <1>;
          #size-cells = <1>;

          reserved: partition@0 {
            compatible = "zephyr,mapped-partition";
            reg = <0x00000000 0x20000>;
            read-only;
          };

          header: partition@20000 {
            label = "header";
            compatible = "zephyr,mapped-partition";
            reg = <0x00020000 0x200>;
            read-only;
          };

          slot0_partition: partition@20200 {
            label = "image-0";
            compatible = "zephyr,mapped-partition";
            reg = <0x00020200 DT_SIZE_M(4)>;
            read-only;
          };

          storage_partition: partition@420200 {
            label = "storage";
            compatible = "zephyr,mapped-partition";
            reg = <0x00420200 (DT_SIZE_M(16) - DT_SIZE_M(4) - 0x20200)>;
          };
        };
      };
    };
```

## dts/bindings/flash_controller/renesas,rz-qspi-xspi.yaml
```yaml
# Copyright (c) 2025 Renesas Electronics Corporation
# SPDX-License-Identifier: Apache-2.0

description: |
    Renesas RZ XSPI NOR FLASH controller supporting the JEDEC CFI interface.

compatible: "renesas,rz-qspi-xspi"

include: ["flash-controller.yaml", "jedec,jesd216.yaml"]

on-bus: qspi

examples:
  - |
    ext_flash_ctrl: flash-controller@0 {
      compatible = "renesas,rz-qspi-xspi";
      reg = <0>;
      status = "okay";
      #address-cells = <1>;
      #size-cells = <1>;
      ranges = <0x0 0x60000000 DT_SIZE_M(64)>;

      mx25u51245g: qspi-nor-flash@0 {
        compatible = "soc-nv-flash";
        reg = <0x0 DT_SIZE_M(64)>;
        write-block-size = <1>;
        erase-block-size = <4096>;

        ranges;
        #address-cells = <1>;
        #size-cells = <1>;

        partitions {
          ranges;
          #address-cells = <1>;
          #size-cells = <1>;

          loader_param: partition@0 {
            compatible = "zephyr,mapped-partition";
            label = "loader-param";
            reg = <0x00000000 0x4c>;
            read-only;
          };

          loader_program: partition@4c {
            compatible = "zephyr,mapped-partition";
            label = "loader-program";
            reg = <0x0000004c (DT_SIZE_K(56) - 0x4C)>;
            read-only;
          };

          slot0_partition: partition@e000 {
            compatible = "zephyr,mapped-partition";
            label = "image-0";
            reg = <0x0000e000 DT_SIZE_M(4)>;
            read-only;
          };

          storage_partition: partition@40e000 {
            compatible = "zephyr,mapped-partition";
            label = "storage";
            reg = <0x0040e000
                  (DT_SIZE_M(64) - DT_SIZE_M(4) - DT_SIZE_K(56))>;
          };
        };
      };
    };
```

## dts/bindings/flash_controller/renesas,rza2m-qspi-spibsc.yaml
```yaml
# Copyright (c) 2025 Renesas Electronics Corporation
# SPDX-License-Identifier: Apache-2.0

description: |
    Renesas RZ/A2M SPIBSC NOR FLASH controller supporting the JEDEC CFI interface.

compatible: "renesas,rza2m-qspi-spibsc"

include: ["flash-controller.yaml", "jedec,jesd216.yaml"]

on-bus: qspi

examples:
  - |
    ext_flash_ctrl: flash-controller@0 {
      compatible = "renesas,rza2m-qspi-spibsc";
      reg = <0>;
      status = "okay";
      #address-cells = <1>;
      #size-cells = <1>;
      ranges = <0x0 0x20000000 DT_SIZE_M(64)>;

      mx25l51245g: qspi-nor-flash@0 {
        compatible = "soc-nv-flash";
        reg = <0x0 DT_SIZE_M(64)>;
        write-block-size = <2>;
        erase-block-size = <4096>;
        #address-cells = <1>;
        #size-cells = <1>;
        ranges;

        partitions {
          ranges;
          #address-cells = <1>;
          #size-cells = <1>;

          loader_program: partition@0 {
            compatible = "zephyr,mapped-partition";
            label = "loader-program";
            reg = <0x00000000 DT_SIZE_K(56)>;
            read-only;
          };

          slot0_partition: partition@e000 {
            compatible = "zephyr,mapped-partition";
            label = "image-0";
            reg = <0x0000e000 DT_SIZE_M(4)>;
            read-only;
          };

          storage_partition: partition@40e000 {
            compatible = "zephyr,mapped-partition";
            label = "storage";
            reg = <0x0040e000
                  (DT_SIZE_M(64) - DT_SIZE_M(4) - DT_SIZE_K(56))>;
          };
        };
      };
    };
```

## dts/bindings/flash_controller/silabs,series3-extmem.yaml
```yaml
# Copyright (c) 2025 Silicon Laboratories Inc.
# SPDX-License-Identifier: Apache-2.0

title: Silicon Labs Series 3 EXTMEM (External Memory Interface)

description: |
  External Memory Interface on Silicon Labs Series 3 SoCs.
  This subsystem accesses and controls external serial flash memory used as the
  main off-chip program memory.

compatible: "silabs,series3-extmem"

include: base.yaml

properties:
  clock-frequency:
    type: int
    description: QSPI clock frequency (Hz).
```
