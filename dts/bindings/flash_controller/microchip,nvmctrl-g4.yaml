## dts/bindings/flash_controller/st,stm32-flash-controller.yaml
```yaml
description: STM32 Family flash controller

compatible: "st,stm32-flash-controller"

include: flash-controller.yaml

properties:
  st,rdp1-enable-byte:
    type: int
    default: 0x55
    description: |
      This property provides a byte which should used to enable non-permanent
      readout protection (RDP1). Actually, any byte except 0xAA and 0xCC
      (which are used by RDP0 and RDP2 respectively) can be used to enable
      RDP1 but in multi-image environment, some other image could check if
      RDP1 is enabled by comparing it to some hardcoded value. The byte has to
      be different than 0xAA and 0xCC.

  st,flash-latency:
    type: int
    description: |
      Flash wait-state (LATENCY) count to program directly into the flash
      controller's access control register, bypassing the VOS-only
      algorithm. Optional: when absent, flash wait-states are computed
      from VOS alone as before (unchanged behavior).

      No build-time validation is performed against HCLK or supply
      voltage: the board author is expected to have already consulted
      their exact part's reference manual wait-state table for the
      correct value given their actual HCLK and the parameters that
      govern it on their series (e.g. VDD, VCO frequency). Consult that
      table before setting this -- e.g. some parts only characterize
      their lowest voltage bands with the flash prefetch buffer disabled
      (see e.g. RM0090 Section 3.5.1 for STM32F405xx/407xx/415xx/417xx);
      CONFIG_STM32_FLASH_PREFETCH is not touched by this property.

      Useful whenever the reference manual's wait-state table cannot be
      reduced to the vendor algorithm's computation -- e.g. a board that
      runs below the nominal voltage range VOS alone assumes (level-
      shifted to match a companion SoC's logic level), or a series where
      latency depends on a factor (such as VCO frequency) the vendor
      algorithm doesn't account for.
```

## dts/bindings/flash_controller/st,stm32g0-flash-controller.yaml
```yaml
description: STM32G0 flash controller

compatible: "st,stm32g0-flash-controller"

include: flash-controller.yaml

properties:
  st,single-bank:
    type: boolean
    description: |
      The flash memory is configured as a single bank (DUAL_BANK option bit
      cleared) on a device that supports both single- and dual-bank modes.
```

## dts/bindings/flash_controller/st,stm32g5-flash-controller.yaml
```yaml
# Copyright (c) 2026 STMicroelectronics
# SPDX-License-Identifier: Apache-2.0

description: STM32G5 flash controller

compatible: "st,stm32g5-flash-controller"

include: flash-controller.yaml
```

## dts/bindings/flash_controller/st,stm32h7p-flash-controller.yaml
```yaml
# SPDX-FileCopyrightText: Copyright (c) 2026 STMicroelectronics
# SPDX-License-Identifier: Apache-2.0

title: STM32H7P flash controller

description: STM32H7P on-chip flash memory controller

compatible: "st,stm32h7p-flash-controller"

include: flash-controller.yaml
```

## dts/bindings/flash_controller/ti,cc27xx-flash-controller.yaml
```yaml
description: Texas Instruments CC27XX flash controller

compatible: "ti,cc27xx-flash-controller"

include: flash-controller.yaml
```

## dts/bindings/flash_controller/ti,mspm0-flash-controller.yaml
```yaml
# Copyright (c) 2026 Texas Instruments Incorporated
# Copyright (c) 2026 Linumiz
# SPDX-License-Identifier: Apache-2.0

description: TI MSPM0 internal flash controller

compatible: "ti,mspm0-flash-controller"

include: flash-controller.yaml

properties:
  ti,num-banks:
    type: int
    default: 1
    description: |
      Number of flash banks the MAIN region is made of. The banks are equally
      sized and contiguous in the system address space, and are described by
      a single soc-nv-flash child node. The DATA bank is not part of it.

  ti,no-weprota:
    type: boolean
    description: |
      The flash controller does not implement the CMDWEPROTA register.
      The write and erase protection of the MAIN region is handled by
      CMDWEPROTB only, one bit per group of 8 sectors starting from the
      sector 0 of each bank.
```

## dts/bindings/fpga/lattice,machxo2-fpga.yaml
```yaml
# Copyright (c) 2026 FIRST RF
# SPDX-License-Identifier: Apache-2.0

description: |
  Lattice MachXO2 CPLD/FPGA configured through the sysCONFIG slave SPI port.

  The optional GPIOs expose the PROGRAMN, DONE and INITN signals. The
  configuration interface is only usable while the bitstream keeps the
  sysCONFIG SSPI port enabled; when it does not, status and information
  reads may fail and the driver reports them as unavailable.

compatible: "lattice,machxo2-fpga"

include: [spi-device.yaml]

properties:
  reset-gpios:
    type: phandle-array
    description: |
      Optional GPIO connected to the active-low PROGRAMN input. When present
      the driver can assert it to turn the device off, release it to turn the
      device on, and pulse it to force a configuration reset.

  done-gpios:
    type: phandle-array
    description: |
      Optional GPIO connected to the DONE output. When present the driver uses
      the pin instead of the status register to report the configuration state.

  initn-gpios:
    type: phandle-array
    description: |
      Optional GPIO connected to the open-drain INITN output. Requires an
      external pull-up. When present the driver waits for INITN to deassert
      after a reset and treats an asserted INITN as a configuration error.

  reset-delay-us:
    type: int
    default: 1000
    description: |
      Time in microseconds to hold PROGRAMN asserted and to wait for the device
      to settle when no INITN GPIO is available.
```

## dts/bindings/fuel-gauge/adi,ltc2941.yaml
```yaml
# SPDX-FileCopyrightText: Copyright (c) 2026 RAKwireless Technology Limited
# SPDX-License-Identifier: Apache-2.0

description: |
  Analog Devices LTC2941 battery gas gauge / coulomb counter.

  The device integrates current through an external sense resistor and stores
  a 16-bit accumulated charge. It does not measure voltage, current, or
  temperature (those features belong to LTC2942 and later).

  STATUS bits other than the chip ID clear on read once the cause is gone.
  Initialization reads STATUS and therefore consumes a latched UVLO. The
  driver returns that bit on the next FUEL_GAUGE_STATUS or FUEL_GAUGE_FLAGS
  read, then clears it.

compatible: "adi,ltc2941"

include: [base.yaml, i2c-device.yaml, fuel-gauge.yaml]

properties:
  reg:
    required: true

  rsense-milliohms:
    type: int
    required: true
    description: |
      External sense resistor in milliohms, between SENSE+ and SENSE-.
      Charge LSB is qLSB = 0.085 mAh * (50 mOhm / rsense) * (M / 128),
      where M is the coulomb-counter prescaler. The datasheet example and
      the +/-50 mV sense range use 50 mOhm for a 1 A application.

  prescaler:
    type: int
    default: 128
    enum:
      - 1
      - 2
      - 4
      - 8
      - 16
      - 32
      - 64
      - 128
    description: |
      Coulomb counter prescaler M (control register B[5:3]).
      Default 128 matches the LTC2941 power-on value (B[5:3] = 111).

  design-capacity-microamp-hours:
    type: int
    description: |
      Battery design capacity in microamp-hours. Used to report
      FUEL_GAUGE_DESIGN_CAPACITY and state-of-charge. Omit this property
      if the host will program accumulated charge against the 16-bit
      full-scale range only.

      In charge-complete mode (control B[2:1] = 01), a high level on AL/CC
      sets the accumulated-charge register to 0xFFFF to mark a full battery.
      Remaining capacity then counts down from this design capacity by qLSB.
      Outside that mode the register is a raw coulomb count.
```

## dts/bindings/fuel-gauge/adi,ltc3337.yaml
```yaml
# SPDX-FileCopyrightText: Copyright (c) 2026 Federico Borgo
# SPDX-License-Identifier: Apache-2.0

description: |
  Analog Devices LTC3337 primary battery state of health monitor with
  precision coulomb counter.

  The chip counts the charge drawn from the battery. It does not know the capacity of the
  battery, so the count is reported as FUEL_GAUGE_CONSUMED_CAPACITY_UAH, and
  FUEL_GAUGE_REMAINING_CAPACITY_UAH is not supported. The counter has 16 bits: choose the
  prescaler (FUEL_GAUGE_CC_CONFIG) so that it covers the capacity of the battery and does not
  wrap during its life.

  The chip has no flag that tells when the automatic conversions have completed, and their
  result registers read zero after power up. The voltage is not available (-ENODATA) while the
  BAT_IN result is zero, and the temperature while the die temperature code is zero. A zero
  result is outside the operating range of the chip (BAT_IN of 1.8 V to 5.5 V, die temperature
  of -40 degC to 125 degC, code zero being -41 degC), so it is taken as "no conversion yet".
  The first voltage result can take a few seconds after power up when the load is very low.
  Both are also not available while the coulomb counter is shut down through
  FUEL_GAUGE_CC_CONFIG, because they are then only updated by a conversion that the driver
  does not start.

compatible: "adi,ltc3337"

include: [base.yaml, i2c-device.yaml, fuel-gauge.yaml]

properties:
  reg:
    required: true

  ipeak-milliamp:
    type: int
    required: true
    enum:
      - 5
      - 10
      - 15
      - 20
      - 25
      - 50
      - 75
      - 100
    description: |
      Peak input current selected by the IPK[2:0] pins (datasheet Table 1).
      The pins are hard wired, so this value must match the board. It sets
      the charge represented by one counter LSB. The driver compares it with
      the pin state read back from the chip and fails to initialize on a mismatch.
```
