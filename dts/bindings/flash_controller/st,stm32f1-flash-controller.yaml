## dts/bindings/flash_controller/st,stm32f1-flash-controller.yaml
```yaml
description: STM32F1 flash controller

compatible: "st,stm32f1-flash-controller"

include: flash-controller.yaml
```

## dts/bindings/flash_controller/st,stm32f2-flash-controller.yaml
```yaml
description: STM32F2 flash controller

compatible: "st,stm32f2-flash-controller"

include: flash-controller.yaml
```

## dts/bindings/flash_controller/st,stm32f3-flash-controller.yaml
```yaml
description: STM32 F3 flash controller

compatible: "st,stm32f3-flash-controller"

include: flash-controller.yaml
```

## dts/bindings/flash_controller/st,stm32f4-flash-controller.yaml
```yaml
description: STM32F4 flash controller

compatible: "st,stm32f4-flash-controller"

include: flash-controller.yaml
```

## dts/bindings/flash_controller/st,stm32f7-flash-controller.yaml
```yaml
description: STM32F7 flash controller

compatible: "st,stm32f7-flash-controller"

include: flash-controller.yaml
```

## dts/bindings/flash_controller/st,stm32g4-flash-controller.yaml
```yaml
description: STM32G4 flash controller

compatible: "st,stm32g4-flash-controller"

include: flash-controller.yaml
```

## dts/bindings/flash_controller/st,stm32h7-flash-controller.yaml
```yaml
description: STM32H7 flash controller

compatible: "st,stm32h7-flash-controller"

include: flash-controller.yaml
```

## dts/bindings/flash_controller/st,stm32l0-flash-controller.yaml
```yaml
# Copyright (c) 2020, Linaro Limited
# SPDX-License-Identifier: Apache-2.0

description: STM32 L0 flash controller

compatible: "st,stm32l0-flash-controller"

include: flash-controller.yaml
```

## dts/bindings/flash_controller/st,stm32l1-flash-controller.yaml
```yaml
description: STM32 L1 flash controller

compatible: "st,stm32l1-flash-controller"

include: flash-controller.yaml
```

## dts/bindings/flash_controller/st,stm32l4-flash-controller.yaml
```yaml
description: STM32L4 flash controller

compatible: "st,stm32l4-flash-controller"

include: flash-controller.yaml
```

## dts/bindings/flash_controller/st,stm32l5-flash-controller.yaml
```yaml
description: STM32L5 flash controller

compatible: "st,stm32l5-flash-controller"

include: flash-controller.yaml
```

## dts/bindings/flash_controller/st,stm32u3-flash-controller.yaml
```yaml
description: STM32U3 flash controller

compatible: "st,stm32u3-flash-controller"

include: flash-controller.yaml
```

## dts/bindings/flash_controller/st,stm32u5-flash-controller.yaml
```yaml
description: STM32 U5 flash controller

compatible: "st,stm32u5-flash-controller"

include: flash-controller.yaml
```

## dts/bindings/flash_controller/st,stm32wb-flash-controller.yaml
```yaml
description: STM32WB flash controller

compatible: "st,stm32wb-flash-controller"

include: flash-controller.yaml

properties:
  single-bank:
    type: boolean
    description: dual-bank mode not enabled (page erase 4096k)

  dual-bank:
    type: boolean
    description: dual-bank mode enabled (page erase 2048k)
```

## dts/bindings/flash_controller/st,stm32wb0-flash-controller.yaml
```yaml
# Copyright (c) 2024 STMicroelectronics
# SPDX-License-Identifier: Apache-2.0

description: STM32WB0 series flash controller

compatible: "st,stm32wb0-flash-controller"

include: flash-controller.yaml
```

## dts/bindings/flash_controller/st,stm32wba-flash-controller.yaml
```yaml
description: STM32 WBA flash controller

compatible: "st,stm32wba-flash-controller"

include: flash-controller.yaml
```

## dts/bindings/flash_controller/telink,b91-flash-controller.yaml
```yaml
description: Telink B91 Flash Controller

compatible: "telink,b91-flash-controller"

include: flash-controller.yaml
```

## dts/bindings/flash_controller/telink,b9x-flash-controller.yaml
```yaml
# Copyright (c) 2022-2024, Telink Semiconductor
# SPDX-License-Identifier: Apache-2.0

description: Telink B91 Flash Controller

compatible: "telink,b9x-flash-controller"

include: flash-controller.yaml

properties:
  reg:
    required: true
```

## dts/bindings/flash_controller/telink,tlx-flash-controller.yaml
```yaml
# Copyright (c) 2024, Telink Semiconductor
# SPDX-License-Identifier: Apache-2.0

description: Telink TLx Flash Controller

compatible: "telink,tlx-flash-controller"

include: flash-controller.yaml

properties:
  reg:
    required: true
```

## dts/bindings/flash_controller/telink,w91-flash-controller.yaml
```yaml
description: Telink W91 Flash Controller

compatible: "telink,w91-flash-controller"
```

## dts/bindings/flash_controller/ti,cc13xx-cc26xx-flash-controller.yaml
```yaml
description: Texas Instruments CC13xx/CC26xx flash controller

compatible: "ti,cc13xx-cc26xx-flash-controller"

include: flash-controller.yaml
```

## dts/bindings/flash_controller/ti,cc23x0-flash-controller.yaml
```yaml
description: Texas Instruments CC23X0 flash controller

compatible: "ti,cc23x0-flash-controller"

include: flash-controller.yaml
```

## dts/bindings/flash_controller/ti,stellaris-flash-controller.yaml
```yaml
# Copyright (c) 2020, Linaro Limited
# SPDX-License-Identifier: Apache-2.0

description: TI Stellaris flash controller

compatible: "ti,stellaris-flash-controller"

include: flash-controller.yaml
```

## dts/bindings/flash_controller/wch,ch32v-flash-controller.yaml
```yaml
description: WCH CH32V series flash controller

compatible: "wch,ch32v-flash-controller"

include: flash-controller.yaml

properties:
  erase-value:
    type: int
    default: 0xffff
    description: >
      Value of each uint16_t in an erased page. This is 0xFFFF on
      the CH32V003 and CH32V00X and 0xE339 on the CH32V20x and 30x.
```

## dts/bindings/flash_controller/xhsc,hc32-flash-controller.yaml
```yaml
# Copyright (C) 2024-2025, Xiaohua Semiconductor Co., Ltd.
# SPDX-License-Identifier: Apache-2.0

description: HC32 F4 flash controller

compatible: "xhsc,hc32-flash-controller"

include: flash-controller.yaml
```
