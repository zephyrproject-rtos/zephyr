## dts/bindings/flash_controller/xhsc,hc32f4a0-flash-controller.yaml
```yaml
# Copyright (c) 2026 Liu Changjie <liucj1228@outlook.com>
# SPDX-License-Identifier: Apache-2.0

description: XHSC HC32F4A0 flash controller

compatible: "xhsc,hc32f4a0-flash-controller"

include: flash-controller.yaml
```

## dts/bindings/flash_controller/zephyr,disk-flash.yaml
```yaml
# SPDX-License-Identifier: Apache-2.0

description: Emulates a flash using the disk access subsystem

compatible: "zephyr,disk-flash"

include: base.yaml

properties:
  size:
    type: int
    description: emulated flash capacity in bits
    required: true
  page-size:
    type: int
    description: emulated flash page size
    required: true
  write-block-size:
    type: int
    description: >
      emulated write block size of the flash. If this value is set to 0 the
      disk-sector-size will be used as write block size.
    default: 0
  disk-name:
    type: string
    description: the name of the underlying disk to be used
    required: true
  disk-sector-size:
    type: int
    description: the sector size in byte of the underlying disk to be used
    required: true
  disk-offset:
    type: int
    description: >
      offset on the disk in bytes. If the offset is 10 the 10th byte will
      be the first one used.
    default: 0
  init-level:
    type: string
    description: >
      The initialization level of this driver. It is important, that the underlying disk has
      already been initialized.
    default: "POST_KERNEL"
```

## dts/bindings/flash_controller/zephyr,native-posix-flash-controller.yaml
```yaml
description: Native POSIX flash controller

compatible: "zephyr,native-posix-flash-controller"

include: flash-controller.yaml
```

## dts/bindings/flash_controller/zephyr,null-controller.yaml
```yaml
description: |
  Special no-controller device used as parent for soc-nv-flash
  devices that are only used to define flash region used during
  compilation to define application placement in NV-memory.
  soc-nv-flash nodes hanging from such controller may not be
  accessed, using flash_api, at run-time but can still be evaluated
  at compile time using DT macros.

compatible: "zephyr,null-controller"

include: base.yaml
```

## dts/bindings/flash_controller/zephyr,semihost-flash.yaml
```yaml
# SPDX-License-Identifier: Apache-2.0
# Copyright (c) 2026 Analog Devices, Inc.

description: Semihost file-backed flash memory

compatible: "zephyr,semihost-flash"

include: base.yaml

properties:
  filename:
    type: string
    default: "flash.bin"
    description: |
      Host-side file path for flash backing store. Defaults to "flash.bin"
      in the working directory of the application providing
      semihosting services (typically the build folder) The file will be
      created upon first flash write if it does not already exist.
```

## dts/bindings/flash_controller/zephyr,sim-flash.yaml
```yaml
# SPDX-License-Identifier: Apache-2.0

description: Simulated flash memory

compatible: "zephyr,sim-flash"

include: base.yaml

properties:
  erase-value:
    type: int
    enum: [0xff, 0x00]
    description: Value of erased flash cell
  memory-region:
    type: phandle
    description: |
      Memory region used by the simulated flash memory. If this option is used
      the memory that is used by the simulated flash memory is not erased.
  no-explicit-erase:
    type: boolean
    description: |
      When set, this instance behaves as a RAM-like device that does not
      require explicit erase before write. Overrides the global
      CONFIG_FLASH_SIMULATOR_EXPLICIT_ERASE Kconfig option for this instance,
      allowing different simulator instances to have different erase modes.
```

## dts/bindings/fpga/lattice,ice40-fpga-base.yaml
```yaml
# Copyright (c) 2022 Meta
# SPDX-License-Identifier: Apache-2.0

description: Lattice iCE40 FPGA base

compatible: "lattice,ice40-fpga-base"

include: spi-device.yaml

properties:
  cdone-gpios:
    type: phandle-array
    required: true
    description: |
      Configuration Done output from iCE40.
      Example usage:
      cdone-gpios = <&gpio0 0 0>;
  creset-gpios:
    type: phandle-array
    required: true
    description: |
      Configuration Reset input on iCE40.
      Example usage:
      creset-gpios = <&gpio0 1 GPIO_PUSH_PULL);
  creset-delay-us:
    type: int
    default: 1
    description: |
      Delay (in microseconds) between asserting CRESET_B and releasing CRESET_B.
      The datasheet specifies a minimum of 200ns, therefore the default is set
      to 1us.
  config-delay-us:
    type: int
    default: 1200
    description: |
      Delay (in microseconds) after releasing CRESET_B to clear internal configuration memory.
      The datasheet specifies a minimum of 1200us, which is the default.
  leading-clocks:
    type: int
    default: 8
    description: |
      Prior to sending the bitstream, issue this number of leading clocks with SPI_CS pulled high.
      The datasheet specifies 8 dummy cycles, which is the default.
  trailing-clocks:
    type: int
    default: 49
    description: |
      After sending the bitstream, issue this number of trailing clocks with SPI_CS pulled high.
      The datasheet specifies 49 dummy cycles, which is the default.
```

## dts/bindings/fpga/lattice,ice40-fpga-bitbang.yaml
```yaml
# Copyright (c) 2022 Meta
# Copyright (c) 2024 SILA Embedded Solutions GmbH
# SPDX-License-Identifier: Apache-2.0

description: Lattice iCE40 FPGA GPIO bitbang based driver

compatible: "lattice,ice40-fpga-bitbang"

include: lattice,ice40-fpga-base.yaml

properties:
  clk-gpios:
    type: phandle-array
    required: true
    description: |
      SPI Clock GPIO input on iCE40.
      Example usage:
      clk-gpios = <&gpio0 5 GPIO_PUSH_PULL>;
  pico-gpios:
    type: phandle-array
    required: true
    description: |
      Peripheral-In Controller-Out GPIO input on iCE40.
      Example usage:
      pico-gpios = <&gpio0 7 GPIO_PUSH_PULL>;
  gpios-set-reg:
    type: int
    required: true
    description: |
      Register address for setting a GPIO.
      Example usage:
      gpios-set-reg = <0x60004008>;
  gpios-clear-reg:
    type: int
    required: true
    description: |
      Register address for clearing a GPIO.
      Example usage:
      gpios-clear-reg = <0x6000400c>;
  mhz-delay-count:
    type: int
    default: 0
    description: |
      in order to create a 1 MHz square wave in the following
      process.
      while(true) {
        *gpios_set_reg |= BIT(n);
        for(int i = mhz_delay_count; i > 0; --i);
        *gpios_clear_reg |= BIT(n);
        for(int i = mhz_delay_count; i > 0; --i);
      }
      The default disables the delay.
```

## dts/bindings/fpga/lattice,ice40-fpga.yaml
```yaml
# Copyright (c) 2022 Meta
# SPDX-License-Identifier: Apache-2.0

description: Lattice iCE40 FPGA SPI based driver

compatible: "lattice,ice40-fpga"

include: lattice,ice40-fpga-base.yaml
```

## dts/bindings/fpga/rapidsi,fcb.yaml
```yaml
# Copyright (c) 2024 Rapid Silicon
# SPDX-License-Identifier: Apache-2.0

description: Rapid Silicon FPGA driver bindings

# Below Bindings refer to rapidsi fpga / fabric configuration block 
# drivers for basic properties.
compatible: "rapidsi,fcb"

include: [base.yaml]
```

## dts/bindings/fpga/rapidsi,icb.yaml
```yaml
# Copyright (c) 2024 Rapid Silicon
# SPDX-License-Identifier: Apache-2.0

description: Rapid Silicon FPGA driver bindings

# Below Bindings refer to rapidsi input / output configuration block 
# drivers for basic properties.
compatible: "rapidsi,icb"

include: [base.yaml]
```

## dts/bindings/fpga/rapidsi,pcb.yaml
```yaml
# Copyright (c) 2024 Rapid Silicon
# SPDX-License-Identifier: Apache-2.0

description: Rapid Silicon FPGA driver bindings

# Below Bindings refer to rapidsi BRAM preload configuration block 
# drivers for basic properties.
compatible: "rapidsi,pcb"

include: [base.yaml]
```

## dts/bindings/fpga/rapidsi,rigel.yaml
```yaml
# Copyright (c) 2024 Rapid Silicon
# SPDX-License-Identifier: Apache-2.0

description: Rapid Silicon FPGA driver bindings

# Below Bindings refer to rapidsi fpga drivers for basic properties.
compatible: "rapidsi,rigel"

include: [base.yaml]
```

## dts/bindings/fpga/renesas,slg47105.yaml
```yaml
# Copyright 2024 Vogl Electronic GmbH
# SPDX-License-Identifier: Apache-2.0

description: Renesas SLG47105 GreenPAK Configurable Mixed-Signal IC

compatible: "renesas,slg47105"

include: renesas,slg471x5.yaml
```

## dts/bindings/fpga/renesas,slg47115.yaml
```yaml
# Copyright 2024 Vogl Electronic GmbH
# SPDX-License-Identifier: Apache-2.0

description: Renesas SLG47115 GreenPAK Configurable Mixed-Signal IC

compatible: "renesas,slg47115"

include: renesas,slg471x5.yaml
```

## dts/bindings/fpga/renesas,slg471x5.yaml
```yaml
# Copyright 2024 Vogl Electronic GmbH
# SPDX-License-Identifier: Apache-2.0

description: Renesas SLG47105/SLG47115 GreenPAK Configurable Mixed-Signal IC

compatible: "renesas,slg471x5"

include: i2c-device.yaml

properties:
  try-unconfigured:
    type: boolean
    description: |
      If selected driver will test transaction on address 0x0 first, before
      trying address defined in devicetree.
```

## dts/bindings/fpga/renesas,slg47910.yaml
```yaml
# Copyright (c) 2026 Sameer Srivastava <l1zard78@proton.me>
# SPDX-License-Identifier: Apache-2.0

description: Renesas SLG47910 FPGA

compatible: "renesas,slg47910"

include: [spi-device.yaml]

properties:
  pwr-gpios:
    type: phandle-array
    required: true
    description: |
      GPIO connected to the FPGA power enable pin (active high).

  en-gpios:
    type: phandle-array
    required: true
    description: |
      GPIO connected to the FPGA EN pin (active high).
      Must be brought high together with pwr-gpios before configuration.

  ss-gpios:
    type: phandle-array
    required: true
    description: |
      GPIO used as the manual SPI slave-select / configuration-mode pin.
      This is driven by the driver as a plain GPIO (not by the SPI
      controller).
```

## dts/bindings/fpga/xlnx,fpga.yaml
```yaml
# Copyright (c) 2022 Antmicro <www.antmicro.com>
# SPDX-License-Identifier: Apache-2.0

description: Zynqmp FPGA driver

compatible: "xlnx,fpga"
```

## dts/bindings/fs/zephyr,fstab,ext2.yaml
```yaml
# Copyright (C) 2025 Arch-Embedded B.V.
# SPDX-License-Identifier: Apache-2.0

description: |
    Pre-defined EXT2 file systems.

compatible: "zephyr,fstab,ext2"

include: zephyr,fstab-common.yaml

properties:
  disk-name:
    type: string
    required: true
    description: |
      The disk name where the file system is mounted.
```

## dts/bindings/fs/zephyr,fstab,fatfs.yaml
```yaml
# Copyright (C) 2025 Endress+Hauser AG
# SPDX-License-Identifier: Apache-2.0

description: |
    Description of pre-defined fatfs file systems.

compatible: "zephyr,fstab,fatfs"

include: zephyr,fstab-common.yaml
```

## dts/bindings/fs/zephyr,fstab,littlefs.yaml
```yaml
# Copyright (C) 2020 Nordic Semiconductor ASA
# SPDX-License-Identifier: Apache-2.0

description: |
    Description of pre-defined file systems.

compatible: "zephyr,fstab,littlefs"

include: "zephyr,fstab-common.yaml"

properties:
  # num-files and num-dirs are not filesystem-specific.

  read-size:
    type: int
    required: true
    description: |
      The size of file system read operations, in bytes.

      All read operations will be a multiple of this value.  A
      reasonable default is 16.

      This corresponds to CONFIG_FS_LITTLEFS_READ_SIZE.

  prog-size:
    type: int
    required: true
    description: |
      The size of file system program (write) operations, in bytes.

      All program operations will be a multiple of this value.  A
      reasonable default is 16.

      This corresponds to CONFIG_FS_LITTLEFS_PROG_SIZE.

  cache-size:
    type: int
    required: true
    description: |
      The size of block caches, in bytes.

      Each cache buffers a portion of a block in RAM.  The littlefs
      needs a read cache, a program cache, and one additional cache per
      file. Larger caches can improve performance by storing more data
      and reducing the number of disk accesses. Must be a multiple of
      the read and program sizes of the underlying flash device, and a
      factor of the block size.

      A reasonable default is 64.

      This corresponds to CONFIG_FS_LITTLEFS_CACHE_SIZE.

  lookahead-size:
    type: int
    required: true
    description: |
      The size of the lookahead buffer, in bytes.

      A larger lookahead buffer increases the number of blocks found
      during an allocation pass. The lookahead buffer is stored as a
      compact bitmap, so each byte of RAM can track 8 blocks. Must be a
      multiple of 8.

      A reasonable default is 32.

      This corresponds to CONFIG_FS_LITTLEFS_LOOKAHEAD_SIZE.

  block-cycles:
    type: int
    required: true
    description: |
      The number of erase cycles before moving data to another block.

      For dynamic wear leveling, the number of erase cycles before data
      is moved to another block.  Set to a non-positive value to disable
      leveling.

      This corresponds to CONFIG_FS_LITTLEFS_BLOCK_CYCLES.

  disk-version:
    type: int
    description: |
      The littlefs disk version.

      To maintain backward compatibility with existing littlefs
      with the same major disk version.

      The default version is LFS_DISK_VERSION.
```

## dts/bindings/fs/zephyr,fstab-common.yaml
```yaml
# Copyright (C) 2020 Nordic Semiconductor ASA
# SPDX-License-Identifier: Apache-2.0

# Common properties for Zephyr filesystem compatibles

include: base.yaml

properties:
  mount-point:
    type: string
    required: true
    description: |
      The absolute path used as the file system mount point.

  partition:
    type: phandle
    required: true
    description: |
      A reference to the file system's partition.

  automount:
    type: boolean
    description: |
      Mount file system on boot if present.

      During initialization the file system driver will attempt to mount
      this partition.

  read-only:
    type: boolean
    description: |
      Mount file system read-only if present.

      This adds the FS_MOUNT_FLAG_READ_ONLY option to be set in the
      mount descriptor generated for the file system.

  no-format:
    type: boolean
    description: |
      Do not format file system if mount fails.

      This causes the FS_MOUNT_FLAG_NO_FORMAT option to be set in the
      mount descriptor generated for the file system.

  disk-access:
    type: boolean
    description: |
      Use disk-access for accessing storage media.

      This causes the FS_MOUNT_FLAG_USE_DISK_ACCESS option to be set in
      the mount descriptor generated for the file system.
```

## dts/bindings/fs/zephyr,fstab.yaml
```yaml
# Copyright (C) 2020 Nordic Semiconductor ASA
# SPDX-License-Identifier: Apache-2.0

description: |
    Description of pre-defined file systems.

    This is a container for child nodes that provide at minimum the
    properties described in zephyr,fstab-common.yaml.

compatible: "zephyr,fstab"

include: base.yaml
```
