## dts/bindings/clock-mgmt/clock-node.yaml
```yaml
# Copyright 2024 NXP
# SPDX-License-Identifier: Apache-2.0

# Common fields for nodes within clock controller clock tree

properties:
  "#clock-cells":
    type: int
    required: true
    description: Number of items to expect in a node specifier

  clock-output:
    type: boolean
    description: |
      Set if the clock node is usable as a clock source within the system.

  clock-id:
    type: string
    required: true
    description: |
      Clock identifier. Unique string identifying this clock within the
      system clock tree
```

## dts/bindings/clock-mgmt/clock-output.yaml
```yaml
# Copyright 2024 NXP
# SPDX-License-Identifier: Apache-2.0

description: |
  Clock output node. This node describes a clock output, which accepts one
  specifier. This specifier will be used as a frequency setting for the
  clock output, provided support for rate setting is enabled in the clock
  management subsystem.

compatible: "clock-output"

include: [clock-node.yaml]

properties:
  "#clock-cells":
    const: 1

clock-cells:
  - frequency
```

## dts/bindings/clock-mgmt/clock-source.yaml
```yaml
# Copyright 2024 NXP
# SPDX-License-Identifier: Apache-2.0

description: Generic clock source

compatible: "clock-source"

include: [clock-node.yaml, base.yaml]

properties:
  "#clock-cells":
    const: 1

clock-cells:
  - frequency
```

## dts/bindings/clock-mgmt/fixed-clock-source.yaml
```yaml
# Copyright 2024 NXP
# SPDX-License-Identifier: Apache-2.0

description: |
  Fixed clock source node. This node describes a fixed clock source, which
  is not configurable at runtime. It does not accept any specifiers.

compatible: "fixed-clock-source"

include: [clock-node.yaml]

properties:
  frequency:
    type: int
    required: true
    description: |
      frequency this clock source provides, in Hz

  "#clock-cells":
    const: 0
```

## dts/bindings/clock-mgmt/nxp,lpc55xxx-pll.yaml
```yaml
# Copyright 2024 NXP
# SPDX-License-Identifier: Apache-2.0

description: LPC55xxx PLL

compatible: "nxp,lpc55xxx-pll"

include: [clock-node.yaml, base.yaml]

properties:
  "#clock-cells":
    const: 6

clock-cells:
  - multiplier
  - divider
  - pdec
  - seli
  - selp
  - selr
```

## dts/bindings/clock-mgmt/nxp,lpc55xxx-syscon.yaml
```yaml
# Copyright 2024 NXP
# SPDX-License-Identifier: Apache-2.0

description: LPC55xxx SYSCON

compatible: "nxp,lpc55xxx-syscon"

include: [clock-controller.yaml, base.yaml]

properties:
  reg:
    required: true

  "#clock-cells":
    const: 0
```

## dts/bindings/clock-mgmt/nxp-syscon/nxp,syscon-clock-div.yaml
```yaml
# Copyright 2024 NXP
# SPDX-License-Identifier: Apache-2.0

description: |
  LPC SYSCON divider clock node. Accepts one specifier, which sets the
  integer factor to divide the input clock by. Setting this value to 0
  has undefined behavior. The range of values supported is specific
  to each clock node.

compatible: "nxp,syscon-clock-div"

include: [clock-node.yaml]

properties:
  reg:
    required: true
    description: |
      Tuple containing address of register and width of the bitfield
      to set to set the divider value

  "#clock-cells":
    const: 1

clock-cells:
  - divider
```
