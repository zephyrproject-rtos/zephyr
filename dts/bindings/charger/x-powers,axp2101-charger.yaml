## dts/bindings/charger/x-powers,axp2101-charger.yaml
```yaml
# Copyright 2025 BayLibre SAS
# SPDX-License-Identifier: Apache-2.0

description: |
  Charger part of the AXP2101 PMU MFD device.

  This charger should be instantiated as child of the AXP2101 MFD device, i.e.

  axp2101@34 {
    compatible = "x-powers,axp2101";
    reg = <0x34>;

    charger {
      compatible = "x-powers,axp2101-charger";
      constant-charge-current-max-microamp = <300000>;
      constant-charge-voltage-max-microvolt = <4200000>;
    };

    regulators {
    ...
    }
  }

compatible: "x-powers,axp2101-charger"

on-bus: axp2101

include:
  - base.yaml
  - battery.yaml

properties:
  # Extending the definition from battery.yaml
  constant-charge-current-max-microamp:
    required: true
    enum:
      - 100000
      - 125000
      - 150000
      - 175000
      - 200000
      - 300000
      - 400000
      - 500000
      - 600000
      - 700000
      - 800000
      - 900000
      - 1000000

  # Extending the definition from battery.yaml
  constant-charge-voltage-max-microvolt:
    required: true
    enum:
      - 4000000
      - 4100000
      - 4200000
      - 4350000
      - 4400000

  # Extending the definition from battery.yaml
  charge-term-current-microamp:
    enum:
      - 0
      - 25000
      - 50000
      - 75000
      - 100000
      - 125000
      - 150000
      - 200000

  vbackup-enable:
    type: boolean
    description:
      Enable Vbackup on boot. This is normally used to charge a button battery
      that is used by some RTC IC.
```

## dts/bindings/clock-management/clock-gate.yaml
```yaml
# Copyright 2024 NXP
# Copyright 2026 Analog Devices, Inc.
# SPDX-License-Identifier: Apache-2.0

description: |
  Generic clock gate node. This node accepts one specifier, which
  either gates the clock (when set to 0), or ungates the clock (when set to 1).
  Other specifier values may cause undefined behavior. A gate is assumed to have
  a single bit that controls whether the clock is gated or not.

compatible: "clock-gate"

include: [clock-node.yaml]

properties:
  input:
    type: phandle
    required: true
    description: |
      phandle to upstream clock that this gate controls.

  reg:
    required: true
    description: |
      Tuple containing address of register and width of the bitfield
      to set to ungate the clock.

  offset:
    type: int
    required: true
    description: |
      Offset of bitfield within register to set to ungate clock.

  "#clock-cells":
    const: 1

clock-cells:
  - gate
```

## dts/bindings/clock-management/clock-mux.yaml
```yaml
# Copyright 2026 Analog Devices, Inc.
# SPDX-License-Identifier: Apache-2.0

description: |
  Multiplexer clock node. Accepts one specifier, which sets the clock
  multiplexer selection to the given zero based index in the "input-sources"
  phandle array for the given node.

compatible: "clock-mux"

include: [clock-node.yaml]

properties:
  reg:
    required: true
    description: |
      Tuple containing address of register and width of the bitfield
      to set to set the multiplexer selection.

  offset:
    type: int
    required: true
    description: |
      Offset of bitfield within register to set to configure multiplexer.

  input-sources:
    type: phandles
    required: true
    description: |
      List of all input sources provided to the multiplexer. These sources
      should be references to other clock nodes within the clock tree.

  "#clock-cells":
    const: 1

clock-cells:
  - mux
```

## dts/bindings/clock-management/clock-node.yaml
```yaml
# Copyright 2024 NXP
# SPDX-License-Identifier: Apache-2.0

# Common fields for nodes within clock controller tree

include: base.yaml

properties:
  "#clock-cells":
    type: int
    required: true
    description: Number of items to expect in a node setpoint specifier
  clock-ranking:
    type: int
    default: 0
    description: |
      Ranking value for this clock, used when clock set rate features are
      enabled. By default this value is set to 0, the highest possible
      rank. If two clocks can both satisfy a given request, the one with the
      lower rank will be selected.
  clock-rank-factor:
    type: int
    default: 0
    description: |
      Ranking factor for this clock, used when clock set rate features are
      enabled. This value is multiplied by the requested rate to
      determine the effective rate for ranking purposes. By default this
      value is set to 1, meaning the effective rate is the same as the
      requested rate.
```

## dts/bindings/clock-management/clock-output.yaml
```yaml
# Copyright 2024 NXP
# SPDX-License-Identifier: Apache-2.0

description: |
  Clock output node. This node describes a clock output. Clock outputs may be
  used by consumers to query rate, or request a new rate. Static clock states
  may also be defined as children of these nodes, and can be applied directly
  by consumers.

compatible: "clock-output"

include: [clock-node.yaml]

properties:
  "#clock-cells":
    const: 0
```

## dts/bindings/clock-management/clock-source.yaml
```yaml
# Copyright 2024 NXP
# SPDX-License-Identifier: Apache-2.0

description: |
  Generic clock source that may be gated. This node accepts one specifier,
  which either gates the clock (when set to 0), or ungates the clock
  (when nonzero)
  Other specifier values may cause undefined behavior.

compatible: "clock-source"

include: [clock-node.yaml]

properties:
  reg:
    required: true
    description: |
      Tuple containing address of register and width of the bitfield
      to set to enable the clock source

  frequency:
    type: int
    required: true
    description: |
      frequency this clock source provides, in Hz

  gate-offset:
    type: int
    required: true
    description: |
      Offset of bitfield within register to set to enable clock

  "#clock-cells":
    const: 1

clock-cells:
  - gate
```

## dts/bindings/clock-management/nxp-syscon/nxp,lpc55sxx-pll-pdec.yaml
```yaml
# Copyright 2024 NXP
# SPDX-License-Identifier: Apache-2.0

description: |
  LPC SYSCON LPC55Sxx PLL post divider. This node accepts one specifier,
  which sets the division factor for the parent PLL (PDEC field). The post
  divider only accepts division factors of 2 (for example /2, /4, /6 ..)

compatible: "nxp,lpc55sxx-pll-pdec"

include: [clock-node.yaml]

properties:
  reg:
    required: true
    description: |
      Tuple containing address of register, and width of the bitfield
      to set to configure the post divider

  "#clock-cells":
    const: 1

clock-cells:
  - pdec
```

## dts/bindings/clock-management/nxp-syscon/nxp,lpc55sxx-pll0.yaml
```yaml
# Copyright 2024 NXP
# SPDX-License-Identifier: Apache-2.0

description: |
  LPC SYSCON LPC55Sxx PLL0. The node configures PLL0 on the LPC55Sxx series,
  which offers a spread spectrum generator. The node accepts nine specifiers,
  which have the following meanings:
  - frequency: output frequency (before postdiv) this PLL will generate.
    Set to 0 to power down.
  - ndec: PLL pre divider setting
  - mdec: If nonzero, sets PLL0 to use provided MDEC value in normal mode
  - selr: Bandwidth select R value. Should be 0 for normal applications
  - seli: Bandwidth select I value. See reference manual to calculate this
  - selp: Bandwidth select P value. See reference manual to calculate this
  - sscg_en: If nonzero, use PLL0 in spread spectrum mode.
  - sscg0: sets SSCG0 register directly when sscg_en is nonzero
  - sscg1: sets SSCG1 register directly when sscg_en is nonzero
  Note that for most applications, the PLL can be used with sscg_en set to 0.
  In this mode, the PLL operates like a fractional PLL, with the following
  output equation: (input_clock * (mdec / ndec))

compatible: "nxp,lpc55sxx-pll0"

include: [clock-node.yaml]

properties:
  reg:
    required: true
    description: PLL0CTRL register address for this block

  "#clock-cells":
    const: 9

clock-cells:
  - frequency
  - ndec
  - mdec
  - selr
  - seli
  - selp
  - sscg_en
  - sscg0
  - sscg1
```

## dts/bindings/clock-management/nxp-syscon/nxp,lpc55sxx-pll1.yaml
```yaml
# Copyright 2024 NXP
# SPDX-License-Identifier: Apache-2.0

description: |
  LPC SYSCON LPC55Sxx PLL1. The node configures PLL1 on the LPC55Sxx series.
  The node accepts six specifiers, which have the following meanings:
  - frequency: output frequency (before postdiv) this PLL will generate.
    Set to 0 to power down.
  - ndec: PLL pre divider setting
  - mdec: PLL multiplier setting
  - selr: Bandwidth select R value. Should be 0 for normal applications
  - seli: Bandwidth select I value. See reference manual to calculate this
  - selp: Bandwidth select P value. See reference manual to calculate this
  PLL1 operates as a fractional PLL, with the following
  output equation: (input_clock * (mdec / ndec))

compatible: "nxp,lpc55sxx-pll1"

include: [clock-node.yaml]

properties:
  reg:
    required: true
    description: PLL1CTRL register address for this block

  "#clock-cells":
    const: 6

clock-cells:
  - frequency
  - ndec
  - mdec
  - selr
  - seli
  - selp
```

## dts/bindings/clock-management/nxp-syscon/nxp,syscon-clock-gate.yaml
```yaml
# Copyright 2024 NXP
# SPDX-License-Identifier: Apache-2.0

description: |
  LPC SYSCON clock gate node. This node accepts one specifier, which
  either gates the clock (when set to 0), or ungates the clock (when set to 1).
  Other specifier values may cause undefined behavior.

compatible: "nxp,syscon-clock-gate"

include: [clock-node.yaml]

properties:
  reg:
    required: true
    description: |
      Tuple containing address of register and width of the bitfield
      to set to ungate the clock

  offset:
    type: int
    required: true
    description: |
      Offset of bitfield within register to set to ungate clock

  "#clock-cells":
    const: 1

clock-cells:
  - gate
```

## dts/bindings/clock-management/nxp-syscon/nxp,syscon-clock-source.yaml
```yaml
# Copyright 2024 NXP
# SPDX-License-Identifier: Apache-2.0

description: |
  LPC SYSCON Clock source node. This node accepts one specifier, which
  either gates the clock (when set to 0), or ungates the clock (when set to 1).
  Other specifier values may cause undefined behavior.

compatible: "nxp,syscon-clock-source"

include: [clock-node.yaml]

properties:
  reg:
    required: true
    description: |
      Tuple containing address of register and width of the bitfield
      to set to enable the clock source

  frequency:
    type: int
    required: true
    description: |
      frequency this clock source provides, in Hz

  offset:
    type: int
    required: true
    description: |
      Offset of bitfield within register to set to enable clock

  pdown-mask:
    type: int
    default: 0
    description: |
      Mask to set in power control registers to power down the clock source

  "#clock-cells":
    const: 1

clock-cells:
  - gate
```

## dts/bindings/clock-management/nxp-syscon/nxp,syscon-flexfrg.yaml
```yaml
# Copyright 2024 NXP
# SPDX-License-Identifier: Apache-2.0

description: |
  LPC SYSCON Flexcomm Fractional Rate Divider. This node accepts one
  specifier, which sets the numerator of the flexcomm fractional rate divider.
  The resulting clock frequency will be input_clock / (1 + MULT / 256)

compatible: "nxp,syscon-flexfrg"

include: [clock-node.yaml]

properties:
  reg:
    required: true
    description: |
      Address of flexfrg control register

  input:
    type: phandle
    required: true
    description: |
      Clock node that is the input to this clock gate.

  "#clock-cells":
    const: 1

clock-cells:
  - numerator
```

## dts/bindings/clock-management/nxp-syscon/nxp,syscon-rtcclk.yaml
```yaml
# Copyright 2024 NXP
# SPDX-License-Identifier: Apache-2.0

description: |
  LPC SYSCON RTC clock divider node. This node accepts one specifier, which
  sets the integer divider value for the RTC clock. The range of values
  supported is specific to each clock node.

compatible: "nxp,syscon-rtcclk"

include: [clock-node.yaml]

properties:
  reg:
    required: true
    description: |
      Tuple containing address of register and width of the bitfield
      to set to configure the RTC divider

  offset:
    type: int
    required: true
    description: |
      Offset of bitfield within register to set to configure divider

  add-factor:
    type: int
    required: true
    description: |
      Integer factor to subtract when calculating register value for
      a given divisor request

  "#clock-cells":
    const: 1

clock-cells:
  - divider
```

## dts/bindings/clock-mgmt/clock-device.yaml
```yaml
# Copyright 2024 NXP
# SPDX-License-Identifier: Apache-2.0

description: |
  This file needs to be included by devices that need to specify clock
  controller states. The maximum number of states currently defined is 5
  (clock-state-0...clock-state-4) but can be incremented if required.
  Clock state nodes are used to configure a clock controller, by setting
  properties on clock nodes declared as children of the clock controller.
  Clock states may represent a full clock tree, but there is no requirement
  for them to.
properties:
  clock-outputs:
    type: phandles
    description: Output clock sources

  clock-state-0:
    type: phandle-array
    specifier-space: clock
    description: |
      Clock configuration/s for the first state. Content should be a series of
      references to the clock nodes declared as children of the clock
      controller. The specifier cells to these clock nodes are specific to the
      implementation of the system's clock controller

  clock-state-1:
    type: phandle-array
    specifier-space: clock
    description: |
      Clock configuration/s for the second state. See clock-state-0.

  clock-state-2:
    type: phandle-array
    specifier-space: clock
    description: |
      Clock configuration/s for the third state. See clock-state-0.

  clock-state-3:
    type: phandle-array
    specifier-space: clock
    description: |
      Clock configuration/s for the fourth state. See clock-state-0.

  clock-state-4:
    type: phandle-array
    specifier-space: clock
    description: |
      Clock configuration/s for the fifth state. See clock-state-0.

  clock-state-names:
    type: string-array
    description: |
      Names for the provided states. The number of names needs to match the
      number of states.
```

## dts/bindings/clock-mgmt/clock-div.yaml
```yaml
# Copyright 2024 NXP
# SPDX-License-Identifier: Apache-2.0

description: Generic clock divider

compatible: "clock-div"

include: [clock-node.yaml, base.yaml]

properties:
  "#clock-cells":
    const: 1

clock-cells:
  - divider
```

## dts/bindings/clock-mgmt/clock-gate.yaml
```yaml
# Copyright 2024 NXP
# SPDX-License-Identifier: Apache-2.0

description: Generic clock gate node

compatible: "clock-gate"

include: [clock-node.yaml, base.yaml]

properties:
  "#clock-cells":
    const: 1

clock-cells:
  - enable
```

## dts/bindings/clock-mgmt/clock-multiplier.yaml
```yaml
# Copyright 2024 NXP
# SPDX-License-Identifier: Apache-2.0

description: Generic clock multiplier

compatible: "clock-multiplier"

include: [clock-node.yaml, base.yaml]

properties:
  "#clock-cells":
    const: 1

clock-cells:
  - multiplier
```

## dts/bindings/clock-mgmt/clock-mux.yaml
```yaml
# Copyright 2024 NXP
# SPDX-License-Identifier: Apache-2.0

description: Generic clock multiplexor

compatible: "clock-mux"

include: [clock-node.yaml, base.yaml]

properties:
  "#clock-cells":
    const: 1

  input-sources:
    type: phandles
    required: true
    description: |
      List of all input sources provided to the mux. These sources should
      be references to other clock nodes within the clock tree.

clock-cells:
  - selector
```
