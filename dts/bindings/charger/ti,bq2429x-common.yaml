## dts/bindings/clock-monitor/nxp,anactrl-freqme.yaml
```yaml
# SPDX-FileCopyrightText: 2026 NXP
# SPDX-License-Identifier: Apache-2.0

description: |
  NXP ANACTRL (Analog Control) frequency-measurement.

  Measures a target clock against a reference clock and reports the result in Hz.
  Only the clock_monitor MEASURE (one-shot) mode is supported.

  The reference and target clocks are fixed by the node's two child nodes,
  "reference-source" and "target-source". Each child pairs a MUX route
  with a frequency provider.

  Place an NXP_ANACTRL_<series>_REF_* cookie in "reference-source" and an
  NXP_ANACTRL_<series>_TAR_* cookie in "target-source". See
  <zephyr/dt-bindings/clock-monitor/nxp-anactrl.h>.

compatible: "nxp,anactrl-freqme"

include: [base.yaml]

properties:
  reg:
    required: true

  clocks:
    required: true
    description: |
      The ANACTRL peripheral gate clock, enabled by the driver via
      clock_control_on().

child-binding:
  description: |
    One ANACTRL freq-measure clock source: a MUX route paired with a frequency
    provider. A node has exactly two such children, named "reference-source" and
    "target-source"; the child's status property is not consulted, both are
    always used.

  include: [mux-consumer.yaml]

  properties:
    mux-states:
      required: true
      description: |
        MUX route for this source, given as a single mux-states entry
        <&inputmuxN index connection> where:
          - &inputmuxN is the MUX controller device providing the route
          - index is the destination index (0 for ANACTRL freq-measure)
          - connection is an inputmux_connection_t cookie from the device's
            fsl_inputmux_connections.h. Use the NXP_ANACTRL_<series>_REF_* /
            NXP_ANACTRL_<series>_TAR_* macros in
            <zephyr/dt-bindings/clock-monitor/nxp-anactrl.h>.
        The route is applied through the mux subsystem (mux_state_apply()).

    clocks:
      type: phandle-array
      description: |
        Rate provider queried through clock_control_get_rate(), ignored when
        clock-frequency is present. Not switched on by the driver.

    clock-frequency:
      type: int
      description: |
        Fixed frequency provider in Hz, used verbatim without querying
        clock_control. Takes precedence over clocks.
```

## dts/bindings/clock-monitor/nxp,fmeas.yaml
```yaml
# SPDX-FileCopyrightText: 2026 NXP
# SPDX-License-Identifier: Apache-2.0

description: |
  NXP BASIC Frequency Measurement (FREQME / fmeas) module.

  Single-register FREQMECTRL variant (RT6xx / RT5xx / RW6xx) driven through
  the MCUX SDK fsl_fmeas HAL. Measures a target clock against a reference
  clock and returns the result in Hz. The reference and target inputs are
  routed through the INPUTMUX peripheral via the Zephyr mux subsystem.

  This hardware has no interrupt line and no MIN/MAX threshold registers, so
  the Zephyr clock_monitor MEASURE (one-shot) mode is the only mode supported;
  WINDOW mode is rejected with -ENOTSUP. The measurement window is HW/HAL-fixed
  at 2^20 reference-clock cycles, so a MEASURE window_ns request is advisory.

  Selectable clock sources are declared with two container child nodes,
  "reference-sources" and "target-sources". Each container holds one child
  node per selectable source, pairing an INPUTMUX route with an optional
  frequency provider. The child marked "default-source" is the power-on
  selection. clock_monitor_set_source() switches between the declared sources
  at runtime, keyed by the INPUTMUX connection cookie (see mux-states).

  A source's frequency provider is either "clock-frequency" (a fixed constant
  in Hz) or "clocks" (queried through clock_control_get_rate()). When both are
  present "clock-frequency" wins. A reference source must resolve to a nonzero
  frequency (required by the driver to convert the raw result counter into Hz).
  A target source may omit both (MEASURE-only; no frequency is predicted).

  The driver does not enable the selected source clocks. The application must
  ensure the chosen reference and target clocks are running before
  configure()/start(); a source left off simply measures zero edges and is
  reported as CLOCK_LOST.

  Place NXP_FMEAS_*_REF_* cookies in "reference-sources" children and
  NXP_FMEAS_*_TAR_* (or the shared NXP_FMEAS_* cookies) in "target-sources"
  children. See <zephyr/dt-bindings/clock-monitor/nxp-fmeas.h>.

compatible: "nxp,fmeas"

include: [base.yaml, reset-device.yaml]

properties:
  reg:
    required: true

  clocks:
    required: true
    description: |
      FREQME peripheral gate clock (ipg), enabled by the driver via
      clock_control_on().

  resets:
    required: true
    description: |
      FREQME peripheral reset line. The driver toggles it once at init to
      release the block from reset; without it the FREQMECTRL register is
      inert (writes dropped, reads return 0) and every measurement reports 0.

child-binding:
  description: |
    Container for a set of selectable fmeas clock sources. Instantiated
    twice per fmeas node, as "reference-sources" and "target-sources".

  child-binding:
    description: |
      One selectable fmeas clock source: an INPUTMUX route paired with an
      optional frequency provider.

    include: [mux-consumer.yaml]

    properties:
      mux-states:
        required: true
        description: |
          INPUTMUX route for this source, given as a single mux-states entry
          <&inputmux channel connection> where:
            - &inputmux is the INPUTMUX mux controller
            - channel selects the FMEASURE_CH_SEL slot:
                0 = reference (FMEASURE_CH_SEL[0])
                1 = target    (FMEASURE_CH_SEL[1])
            - connection is an NXP_FMEAS_* cookie from
              <zephyr/dt-bindings/clock-monitor/nxp-fmeas.h>.
          The connection cookie is also the runtime clock_monitor_set_source()
          selector for this source.

      clocks:
        type: phandle-array
        description: |
          Frequency provider queried through clock_control_get_rate().
          Ignored when clock-frequency is present.

      clock-frequency:
        type: int
        description: |
          Fixed frequency provider in Hz, used verbatim without querying
          clock_control. Takes precedence over clocks. Use for sources whose
          rate the clock_control driver cannot report (e.g. an external
          crystal).

      default-source:
        type: boolean
        description: |
          Marks this source as the power-on selection for its container.
          Exactly one child of each container must set it.
```

## dts/bindings/clock-monitor/nxp,sfa.yaml
```yaml
# SPDX-FileCopyrightText: 2026 NXP
# SPDX-License-Identifier: Apache-2.0

description: |
  NXP Signal Frequency Analyser (SFA).

  Measures a clock under test (the clock_monitor target) against a reference
  clock with two 32-bit counters. Both clock_monitor modes are supported:

    - MEASURE: one-shot frequency measurement.
    - WINDOW: the SFA monitor mode with the low/high limits.

  The reference and target inputs are fixed per instance; select another pair
  in a board overlay.

  Selector values for each SoC are in
  <zephyr/dt-bindings/clock-monitor/nxp-sfa.h>.

compatible: "nxp,sfa"

include: base.yaml

properties:
  reg:
    required: true

  interrupts:
    required: true

  clocks:
    required: true
    description: |
      SFA peripheral gate clock.

  reference-select:
    type: int
    required: true
    description: |
      Reference clock (NXP_SFA_*_REF_*).

  reference-frequency:
    type: int
    required: true
    description: |
      Reference clock rate in Hz.

  target-select:
    type: int
    required: true
    description: |
      Clock under test (NXP_SFA_*_CUT_*).

  target-frequency:
    type: int
    description: |
      Nominal rate of the clock under test in Hz.
```

## dts/bindings/clock/abov,abov32-cctl.yaml
```yaml
# Copyright (c) 2026 ABOV Semiconductor Co., Ltd.
# SPDX-License-Identifier: Apache-2.0

title: ABOV32 System Control Clock Unit (CCTL)

description: |
  ABOV 32-bit SoC System Control Unit (SCU) clock sub-system. Configures the
  HSE/HSI/LSE/LSI oscillators, the PLL, and the MCLK/HCLK/PCLK dividers via
  the ABOV HAL SCU_CLK API (hal_scu_clk.h).

  To specify a clock in a peripheral node, use the standard clocks property
  with one of the ABOV32_CLOCK_* identifiers from
  include/zephyr/dt-bindings/clock/abov32-clock.h, e.g.:

    uart0: uart@xxx {
        ...
        clocks = <&cctl ABOV32_CLOCK_PCLK>;
        ...
    };

  The PLL output frequency is not derived from the divider fields, since
  their register-level scaling is chip-specific; it must be supplied
  directly via pll-output-frequency, computed from the datasheet by the
  board integrator.

compatible: "abov,abov32-cctl"

include: [clock-controller.yaml, base.yaml]

properties:
  reg:
    required: true

  "#clock-cells":
    const: 1

  hse-frequency:
    type: int
    description: HSE (high-speed external) crystal frequency in Hz. Enables HSE if present.

  lse-frequency:
    type: int
    description: LSE (low-speed external) crystal frequency in Hz. Enables LSE if present.

  hsi-frequency:
    type: int
    default: 8000000
    description: HSI (high-speed internal) oscillator frequency in Hz. Fixed by the SoC.

  lsi-frequency:
    type: int
    default: 0
    description: |
      LSI (low-speed internal) oscillator frequency in Hz. Must be set to
      the value from the SoC datasheet before any LSI-derived clock is
      used; the default of 0 is a placeholder, not a valid oscillator
      frequency.

  pll-source-hse:
    type: boolean
    description: Use HSE as the PLL input source. Defaults to HSI if not set.

  pll-source-div:
    type: int
    default: 0
    description: PLL input source divider, as a SCUCLK_DIV_e index (0 = /1, 1 = /2, 2 = /4, ...).

  pll-pre-div:
    type: int
    default: 0
    description: PLL input pre-divider register field (un8PreDiv).

  pll-out-div:
    type: int
    default: 0
    description: PLL feedback/output divider register field (un8OutDiv).

  pll-post-div1:
    type: int
    default: 0
    description: PLL post-divider 1 register field (un8PostDiv1).

  pll-post-div2:
    type: int
    default: 0
    description: PLL post-divider 2 register field (un8PostDiv2).

  pll-vco2x:
    type: boolean
    description: Run the PLL VCO at twice the output frequency. Defaults to matching FOUT.

  pll-output-frequency:
    type: int
    description: |
      Resulting PLL output frequency in Hz, computed from the datasheet by
      the board integrator. Presence of this property enables the PLL.

  mclk-source:
    type: int
    default: 1
    description: Main clock source, one of the ABOV32_CLOCK_* identifiers (default ABOV32_CLOCK_HSI).

  mclk-pre-div:
    type: int
    default: 0
    description: Main clock pre-divider, as a SCUCLK_DIV_e index.

  mclk-post-div:
    type: int
    default: 0
    description: Main clock post-divider (yields HCLK/FCLK), as a SCUCLK_DIV_e index.

  pclk-div:
    type: int
    default: 0
    description: Peripheral clock (PCLK) divider, as a SCUCLK_DIV_e index.

clock-cells:
  - id
```
