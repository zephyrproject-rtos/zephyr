## dts/bindings/clock/adi,ad9523-1.yaml
```yaml
# Copyright (c) 2026 Analog Devices, Inc.
# SPDX-License-Identifier: Apache-2.0

description: |
  Analog Devices AD9523-1 dual-PLL clock generator / SYSREF distributor.

  Each used output is described by a child node. Outputs without a child node
  are parked tristate and powered down by the driver. The node needs
  #address-cells = <1> and #size-cells = <0> for the child nodes.

compatible: "adi,ad9523-1"

include:
  - name: spi-device.yaml
  - name: clock-controller.yaml

properties:
  "#clock-cells":
    const: 1

  sync-gpios:
    type: phandle-array
    description: |
      SYNC pin; held asserted it freezes all output dividers. Driver parks it
      high at init. Optional.

  adi,vcxo-freq:
    type: int
    required: true
    description: VCXO / OSCIN frequency in Hz (the PLL2 reference).

  adi,spi-3wire-enable:
    type: boolean
    description: |
      The SPI bus is 3-wire (bidirectional SDIO, no separate SDO). The driver
      leaves SDO_ACTIVE clear so the chip returns readback data on SDIO. Must
      match the board wiring: on a 3-wire board a 4-wire config makes every
      register readback return zero.

      Reads are full-duplex transfers, so SDIO must reach the controller's
      MISO input. Half-duplex controllers are not supported.

  adi,pll1-bypass-enable:
    type: boolean
    description: |
      Bypass PLL1 (single-loop mode): the VCXO drives PLL2 directly. PLL1 lock
      has no meaning in this mode and the driver does not evaluate it.

  adi,refa-r-divider:
    type: int
    default: 0
    description: |
      PLL1 REFA R divider (0-1023, 0 and 1 divide by 1). Defaults to the
      reset value.

  adi,refb-r-divider:
    type: int
    default: 0
    description: |
      PLL1 REFB R divider (0-1023, 0 and 1 divide by 1). Defaults to the
      reset value.

  adi,pll1-feedback-divider:
    type: int
    default: 0
    description: |
      PLL1 feedback (N) divider (0-1023, 0 and 1 divide by 1). Defaults to
      the reset value.

  adi,pll1-charge-pump-current-na:
    type: int
    default: 6000
    description: |
      PLL1 charge pump current in nA (500 nA steps, max 63500). Defaults to
      the reset value.

  adi,pll1-loopfilter-rzero:
    type: int
    default: 0
    enum: [0, 1, 2, 3, 4, 5, 6, 7, 8]
    description: |
      PLL1 loop filter RZERO code: 0 = 883k, 1 = 677k, 2 = 341k, 3 = 135k,
      4-7 = 10k, 8 = external. Defaults to the reset value.

  adi,ref-mode:
    type: int
    default: 0
    enum: [0, 1, 2, 3, 4]
    description: |
      PLL1 reference selection mode: 0 = stay on REFB, 1 = revert to REFA,
      2 = REFA, 3 = REFB, 4 = REF_SEL pin. Defaults to the reset value.

  adi,zero-delay-mode-internal-enable:
    type: boolean
    description: Enable PLL1 internal zero-delay mode.

  adi,osc-in-feedback-enable:
    type: boolean
    description: Route OSCIN into the PLL1 feedback path.

  adi,refa-diff-rcv-enable:
    type: boolean
    description: Enable the PLL1 REFA differential receiver.

  adi,refb-diff-rcv-enable:
    type: boolean
    description: Enable the PLL1 REFB differential receiver.

  adi,zd-in-diff-enable:
    type: boolean
    description: Enable the zero-delay input differential receiver.

  adi,osc-in-diff-enable:
    type: boolean
    description: Enable the OSCIN differential receiver.

  adi,refa-cmos-neg-inp-enable:
    type: boolean
    description: Enable the REFA CMOS negative-input receiver.

  adi,refb-cmos-neg-inp-enable:
    type: boolean
    description: Enable the REFB CMOS negative-input receiver.

  adi,zd-in-cmos-neg-inp-enable:
    type: boolean
    description: Enable the zero-delay-input CMOS negative-input receiver.

  adi,osc-in-cmos-neg-inp-enable:
    type: boolean
    description: Enable the OSCIN CMOS negative-input receiver.

  adi,pll2-charge-pump-current-na:
    type: int
    required: true
    description: PLL2 charge pump current in nA (3500 nA steps, max 892500).

  adi,pll2-freq-doubler-enable:
    type: boolean
    description: |
      Enable the PLL2 reference frequency doubler. Only valid on the explicit
      divider path; the derive path forces it off.

  adi,pll2-m1-freq:
    type: int
    description: |
      DERIVE PATH. Target VCO1 output frequency in Hz. When set, the driver
      solves r2/ndiv(a,b)/m1 (doubler off, M2 off) to reach VCO1 = this value
      with the VCO inside the AD9523-1 2.94-3.1 GHz band, and the explicit
      adi,pll2-* dividers below must be absent. Not verified on hardware.

  adi,pll2-r2-div:
    type: int
    description: |
      EXPLICIT PATH. PLL2 R2 divider (1-31). Set this and the other explicit
      adi,pll2-* dividers, or set adi,pll2-m1-freq instead -- never both.

  adi,pll2-ndiv-a-cnt:
    type: int
    description: |
      EXPLICIT PATH. PLL2 feedback N-divider A counter (0-3). NDIV = 4*B + A.

  adi,pll2-ndiv-b-cnt:
    type: int
    description: |
      EXPLICIT PATH. PLL2 feedback N-divider B counter (0-63).

  adi,pll2-vco-div-m1:
    type: int
    description: |
      EXPLICIT PATH. PLL2 VCO output M1 divider (3-5), feeding VCO1.

  adi,pll2-vco-div-m2:
    type: int
    description: |
      EXPLICIT PATH. PLL2 VCO output M2 divider (3-5), feeding VCO2. 0 leaves
      M2 (VCO2) powered down.

  adi,rpole2:
    type: int
    default: 0
    enum: [0, 1, 2, 3]
    description: |
      PLL2 loop filter pole 2 resistor code: 0 = 900, 1 = 450, 2 = 300,
      3 = 225 ohm. The default is the register reset value.

  adi,rzero:
    type: int
    default: 0
    enum: [0, 1, 2, 3, 4, 5, 6, 7]
    description: |
      PLL2 loop filter zero resistor code: 0 = 3250, 1 = 2750, 2 = 2250,
      3 = 2100, 4 = 3000, 5 = 2500, 6 = 2000, 7 = 1850 ohm. The default is the
      register reset value.

  adi,cpole1:
    type: int
    default: 0
    enum: [0, 1, 2, 3, 4, 5, 6, 7]
    description: |
      PLL2 loop filter pole 1 capacitor code: 0 = 0, 1 = 8, 2 = 16, 3 = 24,
      4 = 24, 5 = 32, 6 = 40, 7 = 48 pF. The default is the register reset
      value.

  adi,rzero-bypass-enable:
    type: boolean
    description: Bypass the PLL2 loop filter Rzero.

child-binding:
  description: |
    One AD9523 clock output. Outputs with no child node are parked tristate and
    powered down.

  properties:
    reg:
      type: array
      required: true
      description: Output number, 0-13.

    adi,channel-divider:
      type: int
      required: true
      description: |
        Output divide ratio (1-1024) applied to this output's VCO source
        frequency.

    adi,driver-mode:
      type: int
      default: 0
      description: |
        Output driver mode (register field DRIVER_MODE, 0-15). 0 tristates the
        output (reset value), non-zero selects a logic-level family.

    adi,divider-phase:
      type: int
      default: 0
      description: |
        Output divider phase offset in half periods of the divider input
        clock (0-63). Defaults to no offset.

    adi,extended-name:
      type: string
      description: |
        Descriptive name for this output, used in the driver's log lines.
        Prefer the net name from the board schematic, e.g. "ADC_CLK".

    adi,use-alt-clock-src:
      type: boolean
      description: |
        Route this output from the alternate VCO source (VCXO for outputs 0-3,
        VCO2/M2 for outputs 4-9) rather than the default VCO1/M1.

    adi,output-dis:
      type: boolean
      description: Program this output but leave its distribution stage powered down.

    adi,sync-ignore-enable:
      type: boolean
      description: This output ignores chip-level SYNC events.

    adi,low-power-mode-enable:
      type: boolean
      description: Run this output's distribution stage in low-power mode.

    adi,divider-output-invert-enable:
      type: boolean
      description: Invert this output's divider output.

# Consumers name an output as `clocks = <&ad9523 N>`. N is the raw output
# number 0-13, not the clock_control subsystem handle -- see AD9523_CLK_OUT()
# in <zephyr/drivers/clock_control/ad9523.h>, which biases it by one because
# output 0 exists and a raw 0 handle would collide with CLOCK_CONTROL_SUBSYS_ALL.
clock-cells:
  - output
```

## dts/bindings/clock/adi,axi-clkgen.yaml
```yaml
# Copyright (c) 2026 Analog Devices, Inc.
# SPDX-License-Identifier: Apache-2.0

description: Analog Devices AXI Clock Generator (MMCM wrapper)

compatible: "adi,axi-clkgen"

include: [base.yaml, clock-controller.yaml]

properties:
  reg:
    required: true

  clock-frequency:
    type: int
    required: true
    description: Reference (input) clock frequency in Hz

  "#clock-cells":
    const: 0
```

## dts/bindings/clock/adi,max32-erfo.yaml
```yaml
# Copyright (c) 2026 Analog Devices, Inc.
# SPDX-License-Identifier: Apache-2.0

compatible: "adi,max32-erfo"

include: fixed-clock.yaml

properties:
  capacitance-erfoctrl:
    type: int
    description: This is only supported on MAX32657. Refer to documentation on the
                 ERFO Control register for guidance on how to set the register.
```

## dts/bindings/clock/adi,max32-ertco.yaml
```yaml
# Copyright (c) 2026 Analog Devices, Inc.
# SPDX-License-Identifier: Apache-2.0

compatible: "adi,max32-ertco"

include: fixed-clock.yaml

properties:
  capacitance-rtcx1:
    type: int
    description: ERTCO load capacitance for 32KIN in pF.
  capacitance-rtcx2:
    type: int
    description: ERTCO load capacitance for 32KOUT in pF.
```

## dts/bindings/clock/adi,max32-extclk.yaml
```yaml
# Copyright (c) 2026 Analog Devices, Inc.
# SPDX-License-Identifier: Apache-2.0

description: Analog Device MAX32 External Clock

compatible: "adi,max32-extclk"

include: [fixed-clock.yaml, pinctrl-device.yaml]
```

## dts/bindings/clock/aesc,clock-controller.yaml
```yaml
#
# SPDX-FileCopyrightText: 2026 Aesc Silicon
#
# SPDX-License-Identifier: Apache-2.0
#

title: Aesc Silicon Clock Controller

description: |
  Clock controller for the ElemRV platform. Each clock domain exposes a control
  register (enable + lock status) and a ratio register (multiplier / divider).
  The output rate of a domain is computed as

      rate = reference * mult / div

  where the reference clock frequency is read from the syscon device referenced
  by the "syscon" property.

  The clock specifier is the zero-based domain index, e.g. HYDROGEN_CLK_SYSTEM.

compatible: "aesc,clock-controller"

include: [clock-controller.yaml, base.yaml]

properties:
  reg:
    required: true

  syscon:
    type: phandle
    required: true
    description: |
      Reference to the syscon node that publishes the reference clock
      frequency (in Hz) used to compute each domain's rate.

  "#clock-cells":
    const: 1

clock-cells:
  - domain
```

## dts/bindings/clock/alif,clock-mux.yaml
```yaml
# SPDX-FileCopyrightText: Copyright Alif Semiconductor
# SPDX-License-Identifier: Apache-2.0

description: |
  Alif clock source multiplexer

  Describes which input a clock multiplexer is switched to. The node has no
  register of its own; it records the selection so that consumers of the
  multiplexer output can resolve its rate. The selection must match the state
  the hardware is actually in, unless a driver programs the multiplexer from
  it.

  The first user is the S32K_CLK multiplexer, which selects between the LFRC
  and the LFXO oscillator. It is configured outside zephyr and for example,
  a board whose S32K_CLK runs from the LFXO records that with:

      &clk_s32k {
              clocks = <&clk_lfxo>;
      };

compatible: "alif,clock-mux"

include:
  - name: base.yaml
    property-allowlist:
      - status
      - compatible
      - clocks

properties:
  clocks:
    required: true
    description: The input the multiplexer is switched to.
```

## dts/bindings/clock/aspeed,ast27xx-scu1-clock.yaml
```yaml
# Copyright (c) 2023 Aspeed Technology Inc.
# SPDX-License-Identifier: Apache-2.0

description: |
  ASPEED AST27XX SCU1 clock controller.

  The node is a child of the SCU1 syscon node, whose register block holds the
  clock stop, clock select and PLL registers. The clock specifier cell is an
  ID from include/zephyr/dt-bindings/clock/ast27xx_clock.h.

compatible: "aspeed,ast27xx-scu1-clock"

include: [clock-controller.yaml, base.yaml]

properties:
  "#clock-cells":
    const: 1

clock-cells:
  - clkid
```

## dts/bindings/clock/beken,bk7258-cgu.yaml
```yaml
# Copyright The Zephyr Project Contributors
# SPDX-License-Identifier: Apache-2.0

description: |
  Beken BK7258 clock generation unit (CGU).

  The clock controller in the SYS block. It gates the peripheral clocks and
  selects the source and divider of the clocks derived from the crystal and
  the PLLs.

  The clock specifier has one cell, the clock ID. Clock IDs are defined in
  include/zephyr/dt-bindings/clock/beken_bk7258_clock.h.

compatible: "beken,bk7258-cgu"

include: [clock-controller.yaml, base.yaml]

properties:
  reg:
    required: true

  clock-frequency:
    type: int
    required: true
    description: Frequency of the crystal driving the SoC, in Hz.

  "#clock-cells":
    const: 1

clock-cells:
  - id

examples:
  - |
    cgu: clock-controller@44010000 {
        compatible = "beken,bk7258-cgu";
        reg = <0x44010000 0x40>;
        clock-frequency = <DT_FREQ_M(26)>;
        #clock-cells = <1>;
    };

    uart0: serial@44820000 {
        compatible = "beken,bk7258-uart";
        reg = <0x44820000 0x100>;
        clocks = <&cgu BK7258_CLK_UART0>;
    };
```

## dts/bindings/clock/beken,bk7258-clock-controller.yaml
```yaml
# SPDX-License-Identifier: Apache-2.0

description: Beken BK7258 clock controller

compatible: "beken,bk7258-clock-controller"

include: [base.yaml, clock-controller.yaml]

properties:
  reg:
    required: true

  reg-names:
    required: true
    enum: ["select", "enable"]

  "#clock-cells":
    const: 1

clock-cells:
  - id
```
