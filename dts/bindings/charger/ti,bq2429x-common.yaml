## dts/bindings/charger/ti,bq2429x-common.yaml
```yaml
# Copyright 2026 Sacra Systems Private Limited
# SPDX-License-Identifier: Apache-2.0

include: [battery.yaml, i2c-device.yaml]

properties:
  constant-charge-current-max-microamp:
    required: true
    description: |
      The charge current target for the constant current phase of the
      charge profile. This value will be programmed during driver
      initialization.

  constant-charge-voltage-max-microvolt:
    required: true
    description: |
      The voltage regulation target for the constant voltage phase of the
      charge profile. This value will be programmed during driver
      initialization.

  watchdog-timeout-ms:
    type: int
    required: true
    enum:
      - 0
      - 40000
      - 80000
      - 160000
    description: |
      Watchdog timer timeout in milliseconds.

      A value of 0 disables the watchdog timer.

  ce-gpios:
    type: phandle-array
    description: |
      Active-low charge enable pin.
```

## dts/bindings/charger/ti,bq25620-charger.yaml
```yaml
# Copyright (c) 2026 Testo SE & Co. KGaA
# SPDX-License-Identifier: Apache-2.0

title: TI BQ25620 battery charger function

description: |
  Charger function of the TI BQ25620. Must be a child node of a "ti,bq25620"
  node.

  The driver programs all settings described here at initialization, so the
  configuration does not depend on the state left by a previous boot. Optional
  properties that are not set are programmed to the power-on reset value of the
  device, except ti,input-current-limit-microamp.

compatible: "ti,bq25620-charger"

include: [base.yaml, battery.yaml]

properties:
  constant-charge-current-max-microamp:
    required: true
    description: |
      Fast charge current applied at initialization and upper limit for
      CHARGER_PROP_CONSTANT_CHARGE_CURRENT_UA.
      Range: 80 mA to 3.52 A in 80 mA steps.

  constant-charge-voltage-max-microvolt:
    required: true
    description: |
      Charge voltage applied at initialization and upper limit for
      CHARGER_PROP_CONSTANT_CHARGE_VOLTAGE_UV.
      Range: 3.5 V to 4.8 V in 10 mV steps.

  precharge-current-microamp:
    description: |
      Pre-charge current.
      Range: 20 mA to 620 mA in 20 mA steps.

  charge-term-current-microamp:
    description: |
      Termination current.
      Range: 10 mA to 620 mA in 10 mA steps.

  re-charge-threshold-microvolt:
    type: int
    enum:
      - 100000
      - 200000
    description: |
      Recharge threshold below the charge voltage.

  ce-gpios:
    type: phandle-array
    description: |
      Charge enable pin. The pin is active low on the device, so it is
      typically flagged GPIO_ACTIVE_LOW. With the pin, charging is disabled
      after initialization until it is enabled by the application. Without
      the pin, charging is enabled after initialization.

  ti,input-current-limit-microamp:
    type: int
    description: |
      Input current limit applied at initialization. The device overrides the
      limit with the result of the USB adapter detection and resets it when
      the adapter is removed. If not set, the limit is left to the device.
      Range: 100 mA to 3.2 A in 20 mA steps.

  ti,input-voltage-limit-microvolt:
    type: int
    description: |
      Input voltage limit.
      Range: 3.8 V to 16.8 V in 40 mV steps.

  ti,min-sys-voltage-microvolt:
    type: int
    description: |
      Minimal system voltage.
      Range: 2.56 V to 3.84 V in 80 mV steps.

  ti,vindpm-bat-track-microvolt:
    type: int
    enum:
      - 0
      - 400000
    description: |
      Offset above the battery voltage for the input voltage limit. The
      effective input voltage limit is the higher of the configured limit and
      the battery voltage plus this offset. 0 disables the tracking.

  ti,q1-fullon:
    type: boolean
    description: |
      Force the reverse blocking FET (Q1) into its low resistance state,
      regardless of the input current limit.

  ti,q4-fullon:
    type: boolean
    description: |
      Force the battery FET (Q4) into its low resistance state, regardless of
      the charge current. Raises the minimal pre-charge current to 80 mA and
      the minimal termination current to 120 mA.

  ti,disable-safety-timers:
    type: boolean
    description: |
      Disable the trickle charge, pre-charge and fast charge safety timers.

  ti,disable-timer-2x:
    type: boolean
    description: |
      Do not slow down the safety timers by 2x during input current, input
      voltage or thermal regulation.

  ti,precharge-timer:
    type: string
    enum:
      - "2.5h"
      - "0.62h"
    description: |
      Pre-charge safety timer.

  ti,fast-charge-timer:
    type: string
    enum:
      - "14.5h"
      - "28h"
    description: |
      Fast charge safety timer.

  ti,disable-auto-battery-discharge:
    type: boolean
    description: |
      Do not apply a discharge current to the battery during a battery over
      voltage fault.

  ti,vbus-ovp-microvolt:
    type: int
    enum:
      - 6300000
      - 18500000
    description: |
      VBUS over voltage protection threshold.

  ti,ibat-peak-current-microamp:
    type: int
    enum:
      - 6000000
      - 12000000
    description: |
      Battery discharge peak current protection threshold.

  ti,charge-rate:
    type: string
    enum:
      - "1C"
      - "2C"
      - "4C"
      - "6C"
    description: |
      Charge rate of the fast charge stage, used to derive the fold back
      charge current.

  ti,thermal-regulation-celsius:
    type: int
    enum:
      - 60
      - 120
    description: |
      Junction temperature threshold of the thermal regulation.

  ti,switching-frequency-hz:
    type: int
    enum:
      - 1500000
      - 1350000
      - 1650000
    description: |
      Switching frequency of the buck converter.

  ti,converter-drive-strength:
    type: string
    enum:
      - "weak"
      - "normal"
      - "strong"
    description: |
      Drive strength of the buck converter switches, trading efficiency
      against EMI.

  ti,ts-ignore:
    type: boolean
    description: |
      Ignore the TS pin feedback. The device treats the battery temperature
      as always good, e.g. for designs without a battery thermistor.
```

## dts/bindings/charger/ti,bq25896-charger.yaml
```yaml
# SPDX-FileCopyrightText: Copyright The Zephyr Project Contributors
# SPDX-License-Identifier: Apache-2.0

title: TI BQ25896 battery charger function

description: |
  Battery charger function of the TI BQ25896, described as a child node of
  the "ti,bq25896" node. The fast charge current range is 0 A to 3.008 A.

compatible: "ti,bq25896-charger"

include: ti,bq2589x-charger-common.yaml

examples:
  - |
    bq25896@6b {
      compatible = "ti,bq25896";
      reg = <0x6b>;

      charger {
        compatible = "ti,bq25896-charger";
        constant-charge-current-max-microamp = <512000>;
        constant-charge-voltage-max-microvolt = <4208000>;
      };
    };
```

## dts/bindings/charger/ti,bq25896.yaml
```yaml
# SPDX-FileCopyrightText: Copyright The Zephyr Project Contributors
# SPDX-License-Identifier: Apache-2.0

title: TI BQ25896 battery charger

description: |
  TI BQ25896 I2C controlled 3 A single cell switching battery charger with
  power path management and USB OTG boost. The fast charge current range is
  0 A to 3.008 A.

compatible: "ti,bq25896"

include: ti,bq2589x-common.yaml

examples:
  - |
    charger: charger@6b {
      compatible = "ti,bq25896";
      reg = <0x6b>;
      constant-charge-current-max-microamp = <512000>;
      constant-charge-voltage-max-microvolt = <4208000>;
    };
```

## dts/bindings/charger/ti,bq2589x-common.yaml
```yaml
# SPDX-FileCopyrightText: Copyright The Zephyr Project Contributors
# SPDX-License-Identifier: Apache-2.0

description: Common properties of the TI BQ2589X family of battery chargers

include: [battery.yaml, i2c-device.yaml]

properties:
  constant-charge-current-max-microamp:
    required: true
    description: |
      Fast charge current target, programmed during driver initialization.
      The value is rounded down to a 64 mA step.

  constant-charge-voltage-max-microvolt:
    required: true
    description: |
      Charge voltage regulation target, programmed during driver
      initialization. Range: 3.840 V to 4.608 V. The value is rounded down
      to a 16 mV step.

  precharge-current-microamp:
    description: |
      Pre-charge current, programmed during driver initialization when
      present. Range: 64 mA to 1024 mA. The value is rounded down to a
      64 mA step.

  charge-term-current-microamp:
    description: |
      Charge termination current, programmed during driver initialization
      when present. Range: 64 mA to 1024 mA. The value is rounded down to a
      64 mA step.
```

## dts/bindings/charger/zephyr,charger-gpio.yaml
```yaml
# Copyright 2026 Embeint Inc
# SPDX-License-Identifier: Apache-2.0

description: |
  GPIO controlled charging state and status inputs. At least one of
  ctrl-gpios or charging-gpios must be provided. Status-only devices do not
  support enabling or disabling charging through the driver.

compatible: "zephyr,charger-gpio"

properties:
  ctrl-gpios:
    type: phandle-array
    description: |
      Pin that controls the charging state. Charging is enabled when active.

  charging-gpios:
    type: phandle-array
    description: |
      Input that is active while charging. When inactive, the charger reports
      not charging unless charge-done-gpios is active.

  charge-done-gpios:
    type: phandle-array
    description: |
      Input that is active when charging is complete. Requires charging-gpios.
      If both status inputs are active, the charger reports unknown status.
```

## dts/bindings/clock-management/adi-max32/adi,max32-clock-div.yaml
```yaml
# Copyright 2026 Analogue Devices, Inc.
# SPDX-License-Identifier: Apache-2.0

description: |
  ADI MAX32 clock divider node. Accepts one specifier, which sets the power
  of two factor to divide the input clock by. Valid powers are 0 to 7, which
  correspond to divider values of 1 to 128.

compatible: "adi,max32-clock-div"

include: [clock-node.yaml]

properties:
  reg:
    required: true
    description: |
      Tuple containing address of register and width of the bitfield
      to set to set the divider value.

  offset:
    type: int
    required: true
    description: |
      Bit offset of the bitfield to set the divider value.

  input-source:
    type: phandle
    required: true
    description: |
      phandle to the input clock source for this divider.

  "#clock-cells":
    const: 1

clock-cells:
  - divider
```

## dts/bindings/clock-management/adi-max32/adi,max32-clock-source.yaml
```yaml
# Copyright 2026 Analog Devices, Inc.
# SPDX-License-Identifier: Apache-2.0

description: |
  ADI MAX32 Clock source node. This node accepts one specifier, which
  either gates the clock (when set to 0), or ungates the clock (when set to 1).
  Other specifier values may cause undefined behavior.

compatible: "adi,max32-clock-source"

include: [clock-node.yaml]

properties:
  reg:
    required: true
    description: |
      Tuple containing address of register and width of the bitfield
      to set to enable the clock source.

  offset:
    type: int
    required: true
    description: |
      Bit offset of the bitfield to set to enable the clock source.

  frequency:
    type: int
    required: true
    description: |
      Frequency this clock source provides, in Hz.

  enum:
    type: int
    required: true
    description: |
      Enum value of the clock source as defined by the MAX32 HAL.

  "#clock-cells":
    const: 1

clock-cells:
  - gate
```

## dts/bindings/clock-management/clock-device.yaml
```yaml
# Copyright 2024 NXP
# Copyright (c) 2026 Analog Devices, Inc.
# SPDX-License-Identifier: Apache-2.0

description: |
  This file needs to be included by devices that need to specify clock
  controller requests. The maximum number of requests currently defined is 5
  (clock-request-0...clock-request-4) but can be incremented if required.
  Clock requests are defined as a set of suitable clock states. Clock
  states will apply to the clock node they are defined as a child of.
  If multiple clock states are defined as suitable for a given clock node,
  the lowest rank state will be selected. If other clock consumers
  have outstanding requests on a given clock node, these requests
  will be considered when selecting the best clock state for a given clock node.
properties:
  clock-outputs:
    type: phandles
    description: Output clock sources

  clock-output-names:
    type: string-array
    description: |
      Names for clock outputs. The number of names needs to match the number
      of output clock sources.

  clock-request-0:
    type: phandles
    description: |
      Clock request/s for the first state. Each clock request should define a
      set of suitable clock states. These states will apply to the clock node
      they are defined as a child of.

  clock-request-0-locking:
    type: boolean
    description: |
       Set if the clock request for the first state should "lock" any of the
       outputs the state affects. If set, the clock outputs this state affects
       will deny any future reconfiguration attempts.

  clock-request-1:
    type: phandles
    description: |
      Clock configuration/s for the second state. See clock-request-0.

  clock-request-1-locking:
    type: boolean
    description: |
      Clock lock setting for the second state. See clock-request-0-locking.

  clock-request-2:
    type: phandles
    description: |
      Clock configuration/s for the third state. See clock-request-0.

  clock-request-2-locking:
    type: boolean
    description: |
      Clock lock setting for the third state. See clock-request-0-locking.

  clock-request-3:
    type: phandles
    description: |
      Clock configuration/s for the fourth state. See clock-request-0.

  clock-request-3-locking:
    type: boolean
    description: |
      Clock lock setting for the fourth state. See clock-request-0-locking.

  clock-request-4:
    type: phandles
    description: |
      Clock configuration/s for the fifth state. See clock-request-0.

  clock-request-4-locking:
    type: boolean
    description: |
      Clock lock setting for the fifth state. See clock-request-5-locking.

  clock-request-names:
    type: string-array
    description: |
      Names for the provided states. The number of names needs to match the
      number of states.
```

## dts/bindings/clock-management/clock-state.yaml
```yaml
# Copyright 2024 NXP
# SPDX-License-Identifier: Apache-2.0

compatible: "clock-state"

description: |
  Statically defined clock configurations for this clock output. Each
  configuration should define a frequency and settings for parent nodes of
  this clock to produce that frequency.

properties:
  clocks:
    type: phandle-array
    required: true
    description: |
      Settings for parent nodes of this clock output to apply when this state
      is selected.
  rank:
    type: int
    default: 0
    description: |
      Rank of this configuration. Lower rank values are preferred over higher
      rank values when the user requests a clock state with the best ranking.
      Defaults to 0, the highest possible rank.
```
