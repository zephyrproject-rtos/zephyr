## dts/bindings/stepper/ramp-parameters.yaml
```yaml
# SPDX-FileCopyrightText: Copyright (c) 2025 Jilay Sandeep Pandya
# SPDX-License-Identifier: Apache-2.0

description: |
  Collection of ramp parameters for stepper motors.

properties:
  acceleration:
    type: int
    default: 0
    description: |
      Maximum acceleration in micro-steps per second squared.

  max-speed:
    type: int
    default: 0
    description: |
      Maximum speed in micro-steps per second.

  deceleration:
    type: int
    default: 0
    description: |
      Maximum deceleration in micro-steps per second squared.

  pre-decel-steps:
    type: int
    default: 0
    description: |
      Maximum Number of steps over which to decelerate while changing motor-direction
      during active ramping, Higher number corresponds to longer deceleration, hence
      smoother change in direction of motion

  ramp-type:
    type: int
    description: |
      Type of ramping to be used. The options are:
      1: Linear ramping - trapezoidal ramping with constant acceleration and deceleration
      Further ramping types can be added in <include/zephyr/dt-bindings/stepper/ramp.h>
    default: 1
    enum:
      - 1
```

## dts/bindings/stepper/st,stm32-stepperctl.yaml
```yaml
# Copyright (c) 2020, Teslabs Engineering S.L.

description: STM32 Stepper Controller

compatible: "st,stm32-stepperctl"

include: base.yaml

properties:
    "#address-cells":
        required: true
        const: 1
    "#size-cells":
        required: true
        const: 0
    label:
        required: true
    master-timer:
        type: phandle
        required: true
        description: Master timer
    slave-timer:
        type: phandle
        required: true
        description: Slave timer
    itr:
        type: int
        required: true
        description: |
          Master/Slave trigger settings. Definitions are available from
          dt-bindings/timers/stm32_timers_xx.h.

child-binding:
    description: Stepper motor
    properties:
        reg:
            type: int
            required: true
            description: Master timer channel
        microsteps:
            type: int
            required: true
            default: 1
            description: Microsteps
        enable-gpios:
            type: phandle-array
            required: true
            description: Enable pin
        direction-gpios:
            type: phandle-array
            required: true
            description: Direction pin
```

## dts/bindings/stepper/step-dir-timing.yaml
```yaml
# SPDX-FileCopyrightText: Copyright (c) 2025 Jilay Sandeep Pandya
# SPDX-License-Identifier: Apache-2.0

description: Step/Dir Control Signal Timing

properties:
  step-width-ns:
    type: int
    description: |
      Minimum pulse width in nanoseconds for the step signal.
```

## dts/bindings/stepper/stepper-controller.yaml
```yaml
# SPDX-FileCopyrightText: Copyright (c) 2024 Carl Zeiss Meditec AG
# SPDX-License-Identifier: Apache-2.0

description: Stepper Controller

include:
  - name: pinctrl-device.yaml

properties:
  invert-direction:
    type: boolean
    description: |
      Invert motor direction.

  micro-step-res:
    type: int
    default: 1
    enum:
      - 1
      - 2
      - 4
      - 8
      - 16
      - 32
      - 64
      - 128
      - 256
    description: |
      micro-step resolution to be set while initializing the device driver.

  en-gpios:
    type: phandle-array
    description: |
      GPIO pins used to control the enable signal of the motor driver.

  step-gpios:
    type: phandle-array
    description: |
      The GPIO pins used to send step signals to the stepper motor.

  dir-gpios:
    type: phandle-array
    description: |
      The GPIO pins used to send direction signals to the stepper motor.
      Pin will be driven high for forward direction and low for reverse direction.

  counter:
    type: phandle
    description: Counter used for generating step-accurate pulse signals.

  step-generator:
    type: phandle
    description: Counter used for generating step-accurate pulse signals.

  step-counter:
    type: phandle
    description: Counter used for counting steps.

  trigger-input:
    type: int
    description: |
      Value describing the connection between step-generator otput and step-counter
      clocking input, depends on board and used counters

  output-channel:
    type: int
    description: |
      Output channel of the timer for the step signal. Note that this is completely
      distinct from step-gpios. It needs to match the channel of the pinctrl.
```

## dts/bindings/stepper/stepper.yaml
```yaml
# SPDX-FileCopyrightText: Copyright (c) 2024 Carl Zeiss Meditec AG
# SPDX-License-Identifier: Apache-2.0

description: Stepper Controller

properties:
  invert-direction:
    type: boolean
    description: |
      Invert motor direction.

  micro-step-res:
    type: int
    default: 1
    enum:
      - 1
      - 2
      - 4
      - 8
      - 16
      - 32
      - 64
      - 128
      - 256
    description: |
      micro-step resolution to be set while initializing the device driver.

  en-gpios:
    type: phandle-array
    description: |
      GPIO pins used to control the enable signal of the motor driver.

  step-gpios:
    type: phandle-array
    description: |
      The GPIO pins used to send step signals to the stepper motor.

  dir-gpios:
    type: phandle-array
    description: |
      The GPIO pins used to send direction signals to the stepper motor.
      Pin will be driven high for forward direction and low for reverse direction.

  counter:
    type: phandle
    description: Counter used for generating step-accurate pulse signals.
```

## dts/bindings/stepper/ti/ti,drv8424.yaml
```yaml
# SPDX-FileCopyrightText: Copyright (c) 2024 Navimatix GmbH
# SPDX-License-Identifier: Apache-2.0

description: |
  TI DRV8424 stepper motor driver.
  SAFETY:
  The counter needs to support both set_top_value functionalities: Setting a new top value and
  attaching an ISR to the turnaround.
  SAFETY:
  The step gpio pin needs to be connected directly to the SOC GPIO controller, connecting the
  pin to a controller connected via a bus such as i2c or others will lead to undefined behaviour.

  Example:
  drv8424: drv8424 {
    status = "okay";
    compatible = "ti,drv8424";

    dir-gpios = <&arduino_header 18 0>;
    step-gpios = <&arduino_header 19 0>;
    sleep-gpios = <&arduino_header 15 GPIO_ACTIVE_LOW>;
    en-gpios  = <&arduino_header 14 0>;
    m0-gpios = <&mikroe_stepper_gpios 0 0>;
    m1-gpios = <&mikroe_stepper_gpios 1 0>;
    counter = <&counter2>;
  };


compatible: "ti,drv8424"

include:
  - name: stepper-controller.yaml
    property-allowlist:
      - micro-step-res
      - step-gpios
      - dir-gpios
      - en-gpios
      - counter

properties:
  fault-gpios:
    type: phandle-array
    description: Fault pin.

  sleep-gpios:
    type: phandle-array
    description: Sleep pin (active low).

  m0-gpios:
    required: true
    type: phandle-array
    description: Microstep configuration pin 0.

  m1-gpios:
    required: true
    type: phandle-array
    description: Microstep configuration pin 1.
```

## dts/bindings/stepper/ti/ti,drv84xx.yaml
```yaml
# SPDX-FileCopyrightText: Copyright (c) 2024 Navimatix GmbH
# SPDX-License-Identifier: Apache-2.0

description: |
  TI DRV84XX stepper motor driver.
  Compatible with drv8424, drv8425, drv8426, drv8434 and drv8436.

compatible: "ti,drv84xx"

include:
  - name: stepper-driver.yaml
  - name: step-dir-timing.yaml

properties:
  step-width-ns:
    default: 970

  fault-gpios:
    type: phandle-array
    description: Fault pin.

  sleep-gpios:
    type: phandle-array
    description: Sleep pin (active low).

  m0-gpios:
    type: phandle-array
    description: Microstep configuration pin 0.

  m1-gpios:
    type: phandle-array
    description: Microstep configuration pin 1.

examples:
  - |
    drv8424: drv8424 {
      status = "okay";
      compatible = "ti,drv84xx";

      fault-gpios = <&arduino_header 16 0>;
      sleep-gpios = <&arduino_header 15 GPIO_ACTIVE_LOW>;
      en-gpios  = <&arduino_header 14 0>;
      m0-gpios = <&mikroe_stepper_gpios 0 0>;
      m1-gpios = <&mikroe_stepper_gpios 1 0>;
    };
```

## dts/bindings/stepper/zephyr,fake-encoder.yaml
```yaml
# Copyright (c) 2026 Contributors to the Zephyr Project
# SPDX-License-Identifier: Apache-2.0

description: |
  A fake encoder sensor for use as a mock in testing closed-loop
  stepper motor controllers.

compatible: "zephyr,fake-encoder"
```

## dts/bindings/stepper/zephyr,fake-stepper-controller.yaml
```yaml
# Copyright (c) 2025 Jilay Sandeep Pandya
# SPDX-License-Identifier: Apache-2.0

description: |
    A fake stepper controller for use as either a stub or a mock in testing.

compatible: "zephyr,fake-stepper-controller"
```

## dts/bindings/stepper/zephyr,fake-stepper.yaml
```yaml
# Copyright (c) 2024 Fabian Blatz <fabianblatz@gmail.com>
# SPDX-License-Identifier: Apache-2.0

description: |
    A fake stepper for use as either a stub or a mock in Zephyr testing.

compatible: "zephyr,fake-stepper"

include: stepper.yaml
```

## dts/bindings/stepper/zephyr,gpio-step-dir-controller.yaml
```yaml
# SPDX-FileCopyrightText: Copyright (c) 2025 Jilay Sandeep Pandya
# SPDX-License-Identifier: Apache-2.0

description: |
  CPU based Stepper Motion Controller for controlling stepper motors using GPIO pins.
  It is used to generate step and direction signals for a stepper motor driver.
  Example:
  step_dir_motion_control: step_dir_motion_control {
      compatible = "zephyr,gpio-step-dir-controller";
      step-gpios = <&gpio0 10 GPIO_ACTIVE_HIGH>;
      dir-gpios = <&gpio0 11 GPIO_ACTIVE_HIGH>;
      invert-direction;
      counter = <&counter1>;
  };

compatible: "zephyr,gpio-step-dir-controller"

properties:
  invert-direction:
    type: boolean
    description: |
      Invert motor direction.

  step-gpios:
    type: phandle-array
    description: |
      The GPIO pins used to send step signals to the stepper motor.

  dir-gpios:
    type: phandle-array
    description: |
      The GPIO pins used to send direction signals to the stepper motor.
      Pin will be driven high for forward direction and low for reverse direction.

  counter:
    type: phandle
    description: |
      Counter used for generating step-accurate pulse signals.
      This should be a reference to a counter node in the device tree.
      When this property is present, the stepper motion controller will use
      the counter as a timing source instead of the default work queue timing.
      This enables more precise step timing control.

  step-width-ns:
    type: int
    required: true
    description: |
      Minimum pulse width in nanoseconds for the step signal.

  dual-edge-step:
    type: boolean
    description: |
      If present, the stepper motor controller supports dual edge step signals.
      This means that the step signal can be toggled on both the rising and falling edge.
```

## dts/bindings/stepper/zephyr,gpio-step-dir-stepper.yaml
```yaml
# SPDX-FileCopyrightText: Copyright (c) 2025 Jilay Sandeep Pandya
# SPDX-License-Identifier: Apache-2.0

description: |
  CPU based Stepper Motion Controller for controlling stepper motors using GPIO pins.
  It is used to generate step and direction signals for a stepper motor driver.

compatible: "zephyr,gpio-step-dir-stepper"

properties:
  invert-direction:
    type: boolean
    description: |
      Invert motor direction.

  step-gpios:
    type: phandle-array
    description: |
      The GPIO pins used to send step signals to the stepper motor.

  dir-gpios:
    type: phandle-array
    description: |
      The GPIO pins used to send direction signals to the stepper motor.
      Pin will be driven high for forward direction and low for reverse direction.

  counter:
    type: phandle
    description: |
      Counter used for generating step-accurate pulse signals.
      This should be a reference to a counter node in the device tree.
      When this property is present, the stepper motion controller will use
      the counter as a timing source instead of the default work queue timing.
      This enables more precise step timing control.

      Note: The counter needs to support both set_top_value functionalities:
            - Setting a new top value
            - Attaching an ISR to the turnaround

  stepper-drv:
    type: phandle
    description: |
      Reference to the stepper driver device.
      This property, if provided, will result in configuring the driver with the
      step-width-ns and dual-edge-step properties from the stepper driver node.

examples:
  - |
    step_dir_motion_control: step_dir_motion_control {
        compatible = "zephyr,gpio-step-dir-stepper";
        step-gpios = <&gpio0 10 GPIO_ACTIVE_HIGH>;
        dir-gpios = <&gpio0 11 GPIO_ACTIVE_HIGH>;
        invert-direction;
        counter = <&counter1>;
        stepper-drv = <&tmc2209>; /* Optional stepper-drv driver reference */
    };
```

## dts/bindings/stepper/zephyr,gpio-stepper.yaml
```yaml
# SPDX-FileCopyrightText: Copyright (c) 2024 Carl Zeiss Meditec AG
# SPDX-FileCopyrightText: Copyright (c) 2024 Jilay Sandeep Pandya
# SPDX-License-Identifier: Apache-2.0

description: |
  GPIO Stepper Controller for darlington transistor arrays or dual H-bridge

  Example:
    /* Lead A is connected Lead C and Lead B is connected to Lead D*/
    stepper: stepper {
        compatible = "zephyr,gpio-stepper";
        gpios = <&gpioa 9 GPIO_ACTIVE_HIGH>,  /* Lead A1/A */
                <&gpioc 7 GPIO_ACTIVE_HIGH>,  /* Lead B1/B */
                <&gpiob 0 GPIO_ACTIVE_HIGH>,  /* Lead A2/C */
                <&gpioa 7 GPIO_ACTIVE_HIGH>;  /* Lead B2/D */
    };

compatible: "zephyr,gpio-stepper"

include: stepper-controller.yaml

properties:
  gpios:
    type: phandle-array
    required: true
    description: |
      The gpio pin array on which the stepper inputs are to be connected
```

## dts/bindings/stepper/zephyr,h-bridge-stepper.yaml
```yaml
# SPDX-FileCopyrightText: Copyright (c) 2024 Carl Zeiss Meditec AG
# SPDX-FileCopyrightText: Copyright (c) 2024 Jilay Sandeep Pandya
# SPDX-License-Identifier: Apache-2.0

description: |
  GPIO Stepper Controller for darlington transistor arrays or dual H-bridge

compatible: "zephyr,h-bridge-stepper"

properties:
  invert-direction:
    type: boolean
    description: |
      Invert motor direction.

  gpios:
    type: phandle-array
    required: true
    description: |
      The gpio pin array on which the stepper inputs are to be connected

  lut-step-gap:
    type: int
    default: 1
    enum:
      - 1
      - 2
    description: |
      Step mode selection.
      1 - Half step mode
      2 - Full step mode

  counter:
    type: phandle
    description: |
      Counter used for generating step-accurate pulse signals.
      This should be a reference to a counter node in the device tree.
      When this property is present, the stepper motion controller will use
      the counter as a timing source instead of the default work queue timing.
      This enables more precise step timing control.

      Note: The counter needs to support both set_top_value functionalities:
            - Setting a new top value
            - Attaching an ISR to the turnaround

examples:
  - |
    /* Lead A is connected Lead C and Lead B is connected to Lead D*/
    h_bridge_stepper: h_bridge_stepper {
        compatible = "zephyr,h-bridge-stepper";
        gpios = <&gpioa 9 GPIO_ACTIVE_HIGH>,  /* Lead A1/A */
                <&gpioc 7 GPIO_ACTIVE_HIGH>,  /* Lead B1/B */
                <&gpiob 0 GPIO_ACTIVE_HIGH>,  /* Lead A2/C */
                <&gpioa 7 GPIO_ACTIVE_HIGH>;  /* Lead B2/D */
    };
```
