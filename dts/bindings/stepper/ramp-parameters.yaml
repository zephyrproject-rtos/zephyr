## dts/bindings/stepper/zephyr,stepper-closed-loop.yaml
```yaml
# Copyright (c) 2026 Contributors to the Zephyr Project
# SPDX-License-Identifier: Apache-2.0

description: |
  Closed-loop stepper motion controller that wraps an open-loop
  stepper_ctrl device and a rotary encoder (sensor device) to provide
  encoder-corrected positioning via a PID control loop.

  The application uses the standard stepper_ctrl API. The closed-loop
  driver reads the encoder via the sensor API and issues corrective
  steps on the inner controller to eliminate position error.

  Example:

    closed_loop_stepper: closed-loop-stepper {
        compatible = "zephyr,stepper-closed-loop";
        stepper-ctrl = <&gpio_step_dir_ctrl>;
        encoder = <&qdec0>;
        encoder-counts-per-rev = <4096>;
        motor-steps-per-rev = <200>;
        pid-kp = <65536>;
        pid-ki = <6554>;
        pid-kd = <3277>;
        pid-output-max = <500>;
        position-error-threshold = <100>;
        feedback-interval-us = <2000>;
    };

compatible: "zephyr,stepper-closed-loop"

properties:
  stepper-ctrl:
    type: phandle
    required: true
    description: |
      Reference to the underlying open-loop stepper motion controller
      device. Must implement the stepper_ctrl driver API.

  encoder:
    type: phandle
    required: true
    description: |
      Reference to the encoder sensor device used for position feedback.
      Must implement the sensor API and provide SENSOR_CHAN_ROTATION or
      SENSOR_CHAN_ENCODER_COUNT.

  encoder-channel:
    type: string
    default: "rotation"
    enum:
      - "rotation"
      - "encoder-count"
    description: |
      Sensor channel to read from the encoder device.
        "rotation" = SENSOR_CHAN_ROTATION (degrees, for absolute encoders)
        "encoder-count" = SENSOR_CHAN_ENCODER_COUNT (raw counts, for QDEC)
      Default is "rotation".

  encoder-counts-per-rev:
    type: int
    required: true
    description: |
      Number of encoder counts per full motor shaft revolution.
      Used to convert between encoder counts and motor micro-steps.

  motor-steps-per-rev:
    type: int
    default: 200
    description: |
      Full steps per motor revolution (typically 200 for 1.8-degree
      stepper motors, 400 for 0.9-degree motors).

  pid-kp:
    type: int
    required: true
    description: |
      PID proportional gain in Q16.16 fixed-point format.
      Use 65536 for a gain of 1.0, 32768 for 0.5, etc.

  pid-ki:
    type: int
    default: 0
    description: |
      PID integral gain in Q16.16 fixed-point format.

  pid-kd:
    type: int
    default: 0
    description: |
      PID derivative gain in Q16.16 fixed-point format.

  pid-output-max:
    type: int
    default: 1000
    description: |
      Maximum absolute PID output magnitude in micro-steps per
      correction cycle. Limits the size of corrective steps.

  position-error-threshold:
    type: int
    default: 0
    description: |
      Maximum tolerable position error in encoder counts before a
      STEPPER_CTRL_EVENT_POSITION_ERROR event is raised. Set to 0
      to disable threshold checking.

  feedback-interval-us:
    type: int
    default: 1000
    description: |
      Interval in microseconds between encoder readings and PID
      updates. Determines the control loop bandwidth. Typical values
      range from 500 (2 kHz) to 10000 (100 Hz).

  settling-window:
    type: int
    default: 2
    description: |
      Position error (in encoder counts) within which the motor is
      considered to have reached its target position.

  settling-count:
    type: int
    default: 5
    description: |
      Number of consecutive control loop cycles the position error
      must remain within the settling window before the
      STEPPER_CTRL_EVENT_STEPS_COMPLETED event is fired.
```

## dts/bindings/stepper/zephyr,stepper-motion-control.yaml
```yaml
# SPDX-FileCopyrightText: Copyright (c) 2025 Jilay Sandeep Pandya
# SPDX-License-Identifier: Apache-2.0

description: |
  CPU based Stepper Motion Controller for stepper motor drivers
  This binding is used to configure the stepper controller in Zephyr.
  It is used to control the stepper motor driver.
  Example:
  stepper_motion_control: stepper_motion_control {
      compatible = "zephyr,stepper-motion-control";
      stepper = <&gpio_stepper>;
  };

compatible: "zephyr,stepper-motion-control"

properties:
  counter:
    type: phandle
    description: |
      Counter used for generating step-accurate pulse signals.
      This should be a reference to a counter node in the device tree.
      When this property is present, the stepper motion controller will use
      the counter as a timing source instead of the default work queue timing.
      This enables more precise step timing control.

  stepper:
    type: phandle
    required: true
    description: |
      The stepper motor driver to be controlled by the stepper motion controller.
      This should be a reference to a stepper motor driver node in the device tree.
```

## dts/bindings/stepper_control/adi/adi,tmc50xx.yaml
```yaml
# SPDX-FileCopyrightText: Copyright (c) 2025 Jilay Sandeep Pandya
# SPDX-License-Identifier: Apache-2.0

compatible: "adi,tmc50xx"

include:
  - name: spi-device.yaml
  - name: adi,trinamic-gconf.yaml
    property-allowlist:
      - poscmp-enable
      - test-mode
      - lock-gconf
      - shaft1
      - shaft2

properties:
  "#address-cells":
    default: 1
    const: 1

  "#size-cells":
    default: 0
    const: 0

  clock-frequency:
    type: int
    required: true
    description: |
      The frequency of the clock signal provided to the TMC50XX.
      This is used for real world conversion.

      Hint: µstep velocity v[Hz] µsteps / s v[Hz] = v[50xx] * ( fCLK[Hz]/2 / 2^23 )
            where v[50xx] is the value written to the TMC50XX.
```

## dts/bindings/stepper_control/adi/adi,tmc50xx_stepper_control.yaml
```yaml
# SPDX-FileCopyrightText: Copyright (c) 2024 Jilay Sandeep Pandya
# SPDX-License-Identifier: Apache-2.0

description: |
    Analog Devices TMC50xx stepper motor motion controller driver.

compatible: "adi,tmc50xx_stepper_control"

include:
  - name: base.yaml
    property-allowlist:
      - reg
  - name: adi,trinamic-ramp-generator.yaml
    property-allowlist:
      - vstart
      - a1
      - v1
      - amax
      - vmax
      - dmax
      - d1
      - vstop
      - tzerowait
      - vhigh
      - vcoolthrs
      - ihold
      - irun
      - iholddelay
```

## dts/bindings/stepper_control/zephyr,stepper-control.yaml
```yaml
# SPDX-FileCopyrightText: Copyright (c) 2024 Jilay Sandeep Pandya

description: |
    Stepper Controller for stepper motor drivers
    This binding is used to configure the stepper controller in Zephyr.
    It is used to control the stepper motor driver.

    Example:
    stepper_control: stepper_control {
        compatible = "zephyr,stepper-control";
        stepper = <&gpio_stepper>;
        step-tick-ns = <1000000>;
    };

compatible: "zephyr,stepper-control"

properties:
  stepper:
    type: phandle
    required: true
    description: |
      The phandle to the stepper motor driver node.

  step-tick-ns:
    type: int
    required: true
    description: |
      The time in nanoseconds between each step signal.
```

## dts/bindings/stepper_motor/stepper-motor-controller.yaml
```yaml
# SPDX-FileCopyrightText: Copyright (c) 2024 Carl Zeiss Meditec AG
# SPDX-License-Identifier: Apache-2.0

description: Stepper Motor Controller

bus: motor

include: base.yaml
```

## dts/bindings/stepper_motor/stepper-motor-device.yaml
```yaml
# SPDX-FileCopyrightText: Copyright (c) 2024 Carl Zeiss Meditec AG
# SPDX-License-Identifier: Apache-2.0

description: Stepper Motor Device

include: base.yaml

on-bus: motor

compatible: "stepper-motor-device"

properties:

  friendly-name:
    type: string
    description: |
      Human readable string describing the stepper motor. It can be used to
      distinguish multiple instances of the same model.

  gear-ratio:
    type: string
    default: "1.0"
    description: |
      Gear ratio from stepper motor to end transmission, This value can be in float and hence
      the property type string

  micro-step-res:
    type: int
    enum:
      - 1
      - 2
      - 4
      - 8
      - 16
      - 32
      - 64
      - 128
      - 256
    description: |
      Enter the microstep resolution from one of the enum values

  steps-per-revolution:
    type: int
    default: 200
    description: |
      Full steps per revolution, a default value of 200 signifies that 1 step rotates the shaft
      by 1.8°, which is the case in lot of stepper motors

  controller-spec-reg-settings:
    type: array
    description: |
      This property allows for setting controller-spec-register values directly from the dts.
      The driver will iterate through this array and will treat all even elements are reg_addresses
      and odd elements as reg_values.

      Note: Enter key-value pairs as follows

      controller-spec-reg-settings = <reg_a_address reg_a_value>, <reg_b_address, reg_b_value>;
```

## dts/bindings/stepper_motor/tmc5041-stepper-motor-device.yaml
```yaml
# SPDX-FileCopyrightText: Copyright (c) 2024 Carl Zeiss Meditec AG
# SPDX-License-Identifier: Apache-2.0

description: TMC5041 based Stepper Motor Device

include: stepper-motor-device.yaml

compatible: "tmc5041-stepper-motor-device"

properties:
  stall-guard-setting:
    type: int
    default: 0
    description: |
      The signed value controls StallGuard2 level for stall output
      and sets the optimum measurement range for readout.
      A lower value gives a higher sensitivity.
      Zero is the starting value working with most motors.
      For instance, in case of tmc5041, range is -64 to +63
      A higher value makes StallGuard2 less sensitive
      and requires more torque to indicate a stall.
```

## dts/bindings/stepper_motor/trinamic,tmc5041.yaml
```yaml
# SPDX-FileCopyrightText: Copyright (c) 2024 Carl Zeiss Meditec AG
# SPDX-License-Identifier: Apache-2.0

description: TRINAMIC TMC5041

compatible: "trinamic,tmc5041"

include: [stepper-motor-controller.yaml, spi-device.yaml]

properties:
  int-gpios:
    type: phandle-array
    description: |
      Identifies pin for the INT signal on the module. Tristate
      interrupt output based on ramp generator flags RAMP_STAT
      bits 4, 5, 6 & 7. Outputs positive active interrupt signal.

  "#address-cells":
    default: 1
    const: 1

  "#size-cells":
    default: 0
    const: 0
```

## dts/bindings/stepper_motor_controller/stepper-motor-controller.yaml
```yaml
# SPDX-FileCopyrightText: Copyright (c) 2024 Carl Zeiss Meditec AG
# SPDX-License-Identifier: Apache-2.0

description: Stepper Motor Controller

include: base.yaml

properties:
  reg:
    type: array
  micro-step-res:
    type: int
    enum:
      - 1
      - 2
      - 4
      - 8
      - 16
      - 32
      - 64
      - 128
      - 256
```

## dts/bindings/stepper_motor_controller/trinamic,tmc5041.yaml
```yaml
# SPDX-FileCopyrightText: Copyright (c) 2024 Carl Zeiss Meditec AG
# SPDX-License-Identifier: Apache-2.0

description: TRINAMIC TMC5041

compatible: "trinamic,tmc5041"

include: [spi-device.yaml]

properties:
  "#address-cells":
    default: 1
    const: 1

  "#size-cells":
    default: 0
    const: 0

child-binding:
  include:
    - name: stepper-motor-controller.yaml
      property-allowlist:
        - micro-step-res
        - reg
  properties:
    stall-guard-setting:
      type: int
      default: 0
      description: |
        The signed value controls StallGuard2 level for stall output
        and sets the optimum measurement range for readout.
        A lower value gives a higher sensitivity.
        Zero is the starting value working with most motors.
        For instance, in case of tmc5041, range is -64 to +63
        A higher value makes StallGuard2 less sensitive
        and requires more torque to indicate a stall.
```
