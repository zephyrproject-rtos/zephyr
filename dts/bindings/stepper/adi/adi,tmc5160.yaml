## dts/bindings/stepper/adi/adi,tmc522x-base.yaml
```yaml
# SPDX-FileCopyrightText: Copyright (c) 2026 Cherrence Sarip <Cherrence.sarip@analog.com>
# SPDX-License-Identifier: Apache-2.0

description: |
  Trinamic TMC522x stepper motor controller (MFD parent binding)

  This is the Multi-Function Device (MFD) parent binding for TMC522x family:
  - TMC5221 (SPI variant) - use adi,tmc522x-spi.yaml
  - TMC5222 (I2C variant) - use adi,tmc522x-i2c.yaml

  The TMC522x uses split stepper API architecture with separate child devices:
  - adi,tmc522x-stepper: Motion control (stepper API)
  - adi,tmc522x-stepper-drv: Driver configuration (stepper_drv API)

  Do not use this file directly - use adi,tmc522x-spi.yaml or adi,tmc522x-i2c.yaml.

include:
  - name: adi,trinamic-gconf.yaml
    property-allowlist:
      - poscmp-enable
      - test-mode
      - lock-gconf

properties:
  # Clock Configuration
  clock-frequency:
    type: int
    default: 16000000
    description: |
      The frequency of the clock signal provided to the TMC522x.
      This is used for velocity and acceleration calculations.
      Default is 16 MHz internal oscillator.

  # GPIO Hardware Enable Pins (CRITICAL for operation)
  drven-gpios:
    type: phandle-array
    description: |
      Driver enable pin (active high). REQUIRED for motor operation.
      Enables the power stage when high. Must be set HIGH to enable motor outputs.

  sleepn-gpios:
    type: phandle-array
    description: |
      Sleep/wake pin (active high). REQUIRED for chip operation.
      Must be set high for normal operation. If not specified in devicetree,
      the SLEEPN pin MUST be tied to VDD in hardware.
      Per datasheet: Set SLEEPN=1 before accessing registers, wait 10ms.

  # Interrupt/Diagnostic Pins (Optional)
  diag0-gpios:
    type: phandle-array
    description: |
      GPIO connection for DIAG0 interrupt pin (StallGuard event).
      This pin is configured as active-low push-pull output by the chip.

  diag1-gpios:
    type: phandle-array
    description: |
      GPIO connection for DIAG1 interrupt pin (Position reached event).
      This pin is configured as active-low push-pull output by the chip.

  interrupt-gpios:
    type: phandle-array
    description: |
      GPIO connections for DIAG0 and DIAG1 interrupt pins.
      - DIAG0: StallGuard event (motor stall detection)
      - DIAG1: Position reached event (target position achieved)

  interrupt-names:
    type: string-array
    enum:
      - "stallguard"
      - "pos-reached"
    description: |
      Names for the interrupt GPIOs. Must match the order of interrupt-gpios.

  # Motor Physical Parameters
  step-angle-millidegrees:
    type: int
    default: 1800
    description: |
      Motor step angle in millidegrees (1/1000 degree).
      Common values:
        1800 = 1.8° per step (200 steps/revolution) - NEMA standard
        900  = 0.9° per step (400 steps/revolution) - high precision

  # Global Chopper Mode Selection
  chopper-mode:
    type: string
    default: "spreadcycle"
    description: |
      High-level chopper mode selection (EN_PWM_MODE in GCONF register).
      - "spreadcycle": Current chopping mode (default)
      - "stealthchop": Voltage PWM mode (silent operation)
    enum:
      - "spreadcycle"
      - "stealthchop"

  chm-mode:
    type: string
    default: "spreadcycle"
    description: |
      CHM bit configuration in CHOPCONF register (only applies to spreadcycle).
      - "spreadcycle": SpreadCycle adaptive hysteresis mode (CHM=0, recommended)
      - "classic": Classic constant off-time mode (CHM=1)
    enum:
      - "spreadcycle"
      - "classic"
```

## dts/bindings/stepper/adi/adi,tmc522x-spi.yaml
```yaml
# SPDX-FileCopyrightText: Copyright (c) 2026 Cherrence Sarip <Cherrence.sarip@analog.com>
# SPDX-License-Identifier: Apache-2.0

description: Trinamic TMC522x stepper motor controller (SPI variant - TMC5221)

compatible: "adi,tmc522x"

include: [spi-device.yaml, "adi,tmc522x-base.yaml"]
```

## dts/bindings/stepper/adi/adi,tmc522x-stepper-driver.yaml
```yaml
# SPDX-FileCopyrightText: Copyright (c) 2026 Cherrence Sarip <Cherrence.sarip@analog.com>
# SPDX-License-Identifier: Apache-2.0

compatible: "adi,tmc522x-stepper-driver"

include:
  - name: stepper-driver.yaml
  - name: adi,trinamic-stallguard.yaml
    property-allowlist:
      - stallguard2-threshold

properties:
  idx:
    type: int
    required: true
    description: |
      Motor index (0-based). For TMC522x with single motor, use 0.

  # Current Control Settings
  ihold:
    type: int
    default: 0
    description: |
      Hold current (0=1/32...31=32/32).
      Standstill current. In combination with StealthChop mode, setting IHOLD=0
      allows to choose freewheeling or coil short circuit for motor stand still.

  irun:
    type: int
    default: 0
    description: |
      Motor run current (0=1/32...31=32/32).
      Hint: Choose sense resistors in a way, that normal IRUN is 16 to 31
      for best microstep performance.

  irundelay:
    type: int
    default: 4
    description: |
      IHOLD_IRUN register bits 27:24.
      Controls the number of clock cycles for motor power up before a motion
      is started. The smooth transition avoids a motor jerk upon power up.
      When powering up at standstill, IRUNDELAY will be used until IHOLD is
      reached in case IHOLDDELAY != 0.

      0:    Instant jump to IRUN on start of a motion
      1-15: Delay per current increase step = IRUNDELAY x 512 x t_clk

      Example at 16 MHz clock (t_clk = 62.5 ns):
        4 = 2048 x 62.5 ns = 128 us per current increment step

  iholddelay:
    type: int
    default: 3
    description: |
      IHOLD_IRUN register bits 19:16.
      Controls the number of clock cycles for motor power down after a motion
      as soon as standstill is detected (stst=1) and TPOWERDOWN has expired.
      The smooth transition avoids a motor jerk upon power down.

      0:    Instant reduction to IHOLD current after TPOWERDOWN has expired
      1-15: One current decrement every IHOLDDELAY x 2^18 x t_clk

      Example at 16 MHz clock (t_clk = 62.5 ns):
        3 = 3 x 262144 x 62.5 ns = ~49 ms per current decrement step

  tpowerdown:
    type: int
    default: 10
    description: |
      Delay before reducing to standby current after motor stops.
      Time since last step until current is reduced to hold value.
      Formula: tpowerdown * 2^18 / f_clk seconds.
      Default 10 ≈ 2.6 seconds @ 16 MHz clock. Range: 0-255.

  # Chopper Configuration
  toff:
    type: int
    default: 5
    description: |
      Chopper off-time (CRITICAL parameter - must be non-zero!).
      Duration of slow decay phase. Determines chopper frequency.
      0 = driver disabled
      1 = shortest off-time, highest frequency
      15 = longest off-time, lowest frequency
      Default: 5 (balanced performance)
      Chopper freq ≈ f_clk / (32 * toff)

  tbl:
    type: int
    default: 2
    description: |
      Comparator blank time (noise filter).
      Blanking time to prevent false current measurements due to switching noise.
      0 = 16 clocks (shortest)
      1 = 24 clocks
      2 = 36 clocks (default)
      3 = 54 clocks (longest)

  hstrt:
    type: int
    default: 4
    description: |
      Hysteresis start value (chopper tuning parameter).
      Controls the hysteresis start value for the current regulation.
      In standard mode (CHM=0): TFD[2:0] offset (0-7)
      Higher values = faster current regulation response
      Default: 4 (balanced performance)

  hend:
    type: int
    default: 0
    description: |
      Hysteresis end offset (chopper tuning parameter).
      Controls the width of the hysteresis window.
      Range: -3 to +12 (encoded as 0-15 in register)
      Lower values = narrower hysteresis, lower current ripple
      Higher values = wider hysteresis, higher current ripple
      Default: 0 (narrowest hysteresis)

  # Driver Configuration
  fs-gain:
    type: int
    default: 0
    description: |
      Full-scale current sense resistor gain setting.
      Adjusts the amplifier gain for current sensing.
      0 = normal gain (default)
      1-3 = increased gain settings

  fs-sense:
    type: int
    default: 0
    description: |
      Full-scale current sense resistor selection.
      Configures the reference resistor value for current measurement.
      0 = default setting
      1-3 = alternative settings

  global-scaler:
    type: int
    default: 231
    description: |
      Global current scaler (8-bit value: 0-255).
      Scales the motor current globally. Can be used for dynamic
      current adjustment without changing IRUN/IHOLD.
      0 = motor disabled, 255 = maximum current.
      Formula: I_actual = (global-scaler / 256) * I_configured
      Default 231 ≈ 90% of configured current.
```

## dts/bindings/stepper/adi/adi,tmc524x-base.yaml
```yaml
# SPDX-FileCopyrightText: Copyright (c) 2025 Prevas A/S
# SPDX-License-Identifier: Apache-2.0

description: |
  Common properties for the Analog Devices TMC524x Stepper Motor Controller
  family (TMC5240 and TMC5241, which share the same register map)

include:
  - name: adi,trinamic-gconf.yaml
    property-allowlist:
      - en-pwm-mode
      - test-mode

properties:
  shaft:
    type: boolean
    description: |
      Inverse motor direction

  clock-frequency:
    type: int
    required: true
    description: |
      The frequency of the clock signal provided to the TMC524X.
      This is used for real world conversion.

      Hint: µstep velocity v[Hz] µsteps / s v[Hz] = v[524x] * ( fCLK[Hz]/2 / 2^23 )
            where v[524x] is the value written to the TMC524X.
```

## dts/bindings/stepper/adi/adi,tmc524x-spi.yaml
```yaml
# SPDX-FileCopyrightText: Copyright (c) 2025 Dipak Shetty
# SPDX-License-Identifier: Apache-2.0

description: |
  Analog Devices TMC524X Stepper Motor Controller (SPI mode)

compatible: "adi,tmc524x"

include: [spi-device.yaml, "adi,tmc524x-base.yaml"]

properties:
  reg:
    required: true

  diag0-gpios:
    type: phandle-array
    description: |
      Diagnostics output DIAG0 pin. This pin enables interrupt-based
      rampstat handling, allowing the driver to respond to motor events
      like position reached or stall detection without polling.
      Should be configured as push-pull output (active high).

examples:
  - |
    &spi0 {
        tmc524x: tmc524x@0 {
            compatible = "adi,tmc524x";
            reg = <0>;
            spi-max-frequency = <DT_FREQ_M(8)>;
            diag0-gpios = <&gpio0 0 (GPIO_ACTIVE_HIGH | GPIO_PULL_UP)>; /* Diag0 pin */

            /* Common settings from base binding */
            clock-frequency = <DT_FREQ_M(16)>; /* Internal/External Clock frequency */
            en-pwm-mode, shaft; /* ADI TMC Global configuration flags */

            tmc524x_1_stepper_driver: stepper-driver-1 {
              compatible = "adi,tmc524x-stepper-driver";
              micro-step-res = <256>;
              /* ADI TMC stallguard settings specific to TMC524X */
              stallguard2-threshold=<9>;
            };

            tmc524x_1_motion_controller: motion-controller-1 {
              compatible = "adi,tmc524x-stepper-ctrl";

              /* ADI TMC stallguard settings specific to TMC524X */
              activate-stallguard2;
              stallguard-velocity-check-interval-ms = <100>;
              stallguard-threshold-velocity = <50000>;

              /* ADI TMC ramp generator as well as current settings */
              vstart = <10>;
              a1 = <20>;
              v1 = <30>;
              d1 = <40>;
              vmax = <50>;
              amax = <60>;
              dmax = <70>;
              tzerowait = <80>;
              thigh = <90>;
              tcoolthrs = <100>;
              tpwmthrs = <110>;
              tpowerdown = <120>;
              ihold = <1>;
              irun = <2>;
              iholddelay = <3>;
            };
        };
    };
```

## dts/bindings/stepper/adi/adi,tmc524x-uart.yaml
```yaml
# SPDX-FileCopyrightText: Copyright (c) 2025 Dipak Shetty
# SPDX-License-Identifier: Apache-2.0

description: |
  Analog Devices TMC524X Stepper Motor Controller (UART single-wire mode)

  This binding supports the single-wire UART mode where:
  - SWIOP is connected to the MCU's UART TX/RX pin
  - SWION should be connected to half the IO level voltage (1.65V for 3.3V systems)
  - SW_SEL must be HIGH (either via GPIO control or hardwired)

compatible: "adi,tmc524x"

include: [uart-device.yaml, "adi,tmc524x-base.yaml"]

properties:
  sw-sel-gpios:
    type: phandle-array
    description: |
      GPIO connected to the SW_SEL pin of TMC524X.
      Must be set HIGH for UART mode operation.
      If not provided, it's assumed SW_SEL is hardwired to VCC/HIGH.

  uart-device-addr:
    type: int
    description: |
        UART device address for TMC524X in UART mode.
    min: 0
    max: 253

examples:
  - |
    &uart2 {
        current-speed = <115200>;
        status = "okay";

        tmc524x: tmc524x {
            compatible = "adi,tmc524x";
            sw-sel-gpios = <&gpiob 0x01 GPIO_ACTIVE_HIGH>;

            /* Common settings from base binding */
            clock-frequency = <DT_FREQ_M(12)>;
            en-pwm-mode;
            invert-direction;

            tmc524x_stepper_driver: stepper-driver {
                compatible = "adi,tmc524x-stepper-driver";
                micro-step-res = <256>;

                /* ADI TMC stallguard settings specific to TMC524X */
                stallguard2-threshold=<9>;
            };

            /* common stepper controller settings */
            tmc524x_motion_controller: motion-controller {
              compatible = "adi,tmc524x-stepper-ctrl";

              /* ADI TMC stallguard settings specific to TMC524X */
              activate-stallguard2;
              stallguard-velocity-check-interval-ms = <100>;
              stallguard-threshold-velocity = <50000>;

              /* ADI TMC ramp generator as well as current settings */
              vstart = <10>;
              a1 = <20>;
              v1 = <30>;
              d1 = <40>;
              vmax = <50>;
              amax = <60>;
              dmax = <70>;
              tzerowait = <80>;
              thigh = <90>;
              tcoolthrs = <100>;
              tpwmthrs = <110>;
              tpowerdown = <120>;
              ihold = <1>;
              irun = <2>;
              iholddelay = <3>;
            };
        };
    };
```
