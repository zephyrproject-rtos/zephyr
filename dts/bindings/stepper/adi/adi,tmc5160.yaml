## dts/bindings/stepper/adi/adi,tmc5xxx_stepper_driver.yaml
```yaml
# SPDX-FileCopyrightText: Copyright (c) 2024 Carl Zeiss Meditec AG
# SPDX-License-Identifier: Apache-2.0

description: |
  Analog Devices TMC50XX Stepper Motor Driver

  Example:

    &spi0 {
        /* SPI bus options here, not shown */

        /* Dual controller/driver for up to two 2-phase bipolar stepper motors */
        tmc50xx: tmc50xx@0 {
            compatible = "adi,tmc50xx";
            reg = <0>;
            spi-max-frequency = <DT_FREQ_M(8)>; /* Maximum SPI bus frequency */

            #address-cells = <1>;
            #size-cells = <0>;

            poscmp-enable; test-mode; lock-gconf; /* ADI TMC Global configuration flags */
            clock-frequency = <DT_FREQ_M(16)>; /* Internal/External Clock frequency */

            motor: motor@0 {
                status = "okay";
                reg = <0>;

                /* common stepper controller settings */
                invert-direction;
                micro-step-res = <256>;

                /* ADI TMC stallguard settings specific to TMC50XX */
                activate-stallguard2;
                stallguard-velocity-check-interval-ms=<100>;
                stallguard2-threshold=<9>;
                stallguard-threshold-velocity=<500000>;

                /* ADI TMC ramp generator as well as current settings */
                vstart = <10>;
                a1 = <20>;
                v1 = <30>;
                d1 = <40>;
                vmax = <50>;
                amax = <60>;
                dmax = <70>;
                tzerowait = <80>;
                vhigh = <90>;
                vcoolthrs = <100>;
                ihold = <1>;
                irun = <2>;
                iholddelay = <3>;
            };
        };
    };


compatible: "adi,tmc5xxx_stepper_driver"

include:
  - name: stepper.yaml
  - name: adi,trinamic-stallguard.yaml
    property-allowlist:
      - activate-stallguard2
      - stallguard2-threshold
      - stallguard-threshold-velocity
      - stallguard-velocity-check-interval-ms
```

## dts/bindings/stepper/adi/adi,tmcm3216-stepper-ctrl.yaml
```yaml
# SPDX-FileCopyrightText: Copyright (c) 2025 Alexis Czezar C Torreno
# SPDX-License-Identifier: Apache-2.0

description: ADI TMCM-3216 stepper motor controller

compatible: "adi,tmcm3216-stepper-ctrl"

properties:
  idx:
    type: int
    required: true
    description: Motor index (0, 1, or 2)
```

## dts/bindings/stepper/adi/adi,tmcm3216-stepper-driver.yaml
```yaml
# SPDX-FileCopyrightText: Copyright (c) 2025 Alexis Czezar C Torreno
# SPDX-License-Identifier: Apache-2.0

description: ADI TMCM-3216 stepper motor driver

compatible: "adi,tmcm3216-stepper-driver"

properties:
  idx:
    type: int
    required: true
    description: Motor index (0, 1, or 2)

  micro-step-res:
    type: int
    required: true
    default: 16
    description: |
      Default microstep resolution. Valid values are:
      1, 2, 4, 8, 16, 32, 64, 128, 256
```

## dts/bindings/stepper/adi/adi,tmcm3216.yaml
```yaml
# SPDX-FileCopyrightText: Copyright (c) 2025 Alexis Czezar C Torreno
# SPDX-License-Identifier: Apache-2.0

description: |
  The TMCM-3216 is a compact, 3-axis bipolar stepper motor controller and
  standalone driver board.

compatible: "adi,tmcm3216"

include: [base.yaml, uart-device.yaml]

properties:
  reg:
    required: true

  de-gpios:
    type: phandle-array
    description: GPIO for RS485 Driver Enable (DE) pin

examples:
  - |
    #include <zephyr/dt-bindings/gpio/gpio.h>

    &usart2 {
        /* Bus options here, not shown */

        adi_tmcm3216 {
            #address-cells = <1>;
            #size-cells = <0>;

            tmcm3216: tmcm3216@1 {
                compatible = "adi,tmcm3216";
                status = "okay";
                reg = <0x1>;
                de-gpios = <&gpioa 3 GPIO_ACTIVE_HIGH>;

                stepper_driver_0: stepper-driver {
                    compatible = "adi,tmcm3216-stepper-driver";
                    status = "okay";
                    idx = <0>;
                    micro-step-res = <16>;
                };

                stepper_ctrl_0: stepper-ctrl {
                    compatible = "adi,tmcm3216-stepper-ctrl";
                    status = "okay";
                    idx = <0>;
                };
            };
        };
    };
```

## dts/bindings/stepper/adi/adi,trinamic-gconf.yaml
```yaml
# SPDX-FileCopyrightText: Copyright (c) 2024 Carl Zeiss Meditec AG
# SPDX-License-Identifier: Apache-2.0

description: Global configuration flags for Trinamic stepper controller.

properties:
  en_spreadcycle:
    type: boolean
    description: |
      A high level on the pin SPREAD inverts this flag to switch between both chopper modes.
      0: StealthChop mode
      1: SpreadCycle mode enabled

  i_scale_analog:
    type: boolean
    description: |
      0: Use internal reference derived from 5VOUT
      1: Use voltage supplied to VREF as current reference

  internal_rsense:
    type: boolean
    description: |
      0: Operation with external sense resistors
      1: Internal sense resistors. Use current supplied into VREF as reference for internal
         sense resistor. VREF pin internally is driven to GND in this mode.

  index_otpw:
    type: boolean
    description: |
      0: INDEX shows the first microstep position of sequencer
      1: INDEX output shows step pulses from internal pulse generator (toggle upon each step)

  index_step:
    type: boolean
    description: |
      0: INDEX output as selected by index_otpw
      1: INDEX pin shows the current step position of sequencer

  pdn_disable:
    type: boolean
    description: |
      0: Normal operation
      1: Power down mode

  mstep_reg_select:
    type: boolean
    description: |
      0: Microstep resolution selected by pins MS1, MS2
      1: Microstep resolution selected by MRES register

  poscmp_enable:
    type: boolean
    description: |
      Enable position compare feature
      0: Outputs INT and PP are tristated.
      1: Position compare pulse (PP) and interrupt output (INT) are available

      Attention – do not leave the outputs floating in tristate condition, provide an external
      pull-up or set poscmp_enable=1

  test_mode:
    type: boolean
    description: |
      Enable test mode
      0: Normal operation
      1: Enable analog test output on pin REFR2
      TEST_SEL selects the function of REFR2: 0…4: T120, DAC1, VDDH1, DAC2, VDDH2

      Attention: Not for user, set to 0 for normal operation!

  lock_gconf:
    type: boolean
    description: |
      1: GCONF is locked against further write access.
```

## dts/bindings/stepper/adi/adi,trinamic-ramp-generator.yaml
```yaml
# SPDX-FileCopyrightText: Copyright (c) 2024 Carl Zeiss Meditec AG
# SPDX-License-Identifier: Apache-2.0

description: Ramp Generator Motion Control Register-Set for Trinamic stepper controller.

properties:
  vstart:
    type: int
    default: 1
    description: |
      Motor start velocity in [µsteps/t](unsigned)

      Normally, set VSTOP ≥ VSTART! VSTART may be
      set to a higher value, when motion distance is
      sufficient to allow deceleration to VSTOP.

  a1:
    type: int
    default: 0
    description: |
      First acceleration between VSTART and V1 in [µsteps/ta²](unsigned)

  v1:
    type: int
    default: 0
    description: |
      First acceleration / deceleration phase threshold velocity in [µsteps/t] (unsigned)

      0: Disables A1 and D1 phase, use AMAX, DMAX only

  amax:
    type: int
    default: 0
    description: |
      Second acceleration between V1 and VMAX in [µsteps/ta²](unsigned)
      This is the acceleration and deceleration value
      for velocity mode.

  vmax:
    type: int
    default: 0
    description: |
      Motion ramp target velocity in [µsteps/t] (for positioning ensure VMAX ≥ VSTART) (unsigned)
      This is the target velocity in velocity mode. It can be changed any time during a motion.

  dmax:
    type: int
    default: 0
    description: |
      Deceleration between VMAX and V1 in [µsteps/ta²](unsigned)

  d1:
    type: int
    default: 1
    description: |
      Deceleration between V1 and VSTOP in [µsteps/ta²](unsigned)

      Attention: Do not set 0 in positioning mode,
      even if V1=0!

  vstop:
    type: int
    default: 10
    description: |
      Motor stop velocity in [µsteps/t] (unsigned)

      Attention: Set VSTOP ≥ VSTART!

      Attention: Do not set 0 in positioning mode,
      minimum 10 recommended!

  tzerowait:
    type: int
    default: 0
    description: |
      Waiting time after ramping down to zero velocity before next movement or direction
      inversion can start and before motor power down starts. Time range is about 0 to 2
      seconds. This setting avoids excess acceleration e.g. from VSTOP to -VSTART.

  ihold:
    type: int
    default: 0
    description: |
      Hold current in % of run current (0-100)
      Standstill current (0=1/32…31=32/32)
      In combination with StealthChop mode, setting IHOLD=0 allows to choose freewheeling or coil
      short circuit for motor stand still

  irun:
    type: int
    default: 0
    description: |
      Motor run current (0=1/32…31=32/32)
      Hint: Choose sense resistors in a way, that normal
      IRUN is 16 to 31 for best microstep performance.

  iholddelay:
    type: int
    default: 0
    description: |
      Controls the number of clock cycles for motor power down after a motion as soon as TZEROWAIT
      has expired. The smooth transition avoids a motor jerk upon power down.
      0: instant power down
      1..15: Delay per current reduction step in multiple of 2^18 clocks

  vcoolthrs:
    type: int
    default: 0
    description: |
      This is the lower threshold velocity for switching on smart energy CoolStep and StallGuard
      feature. Further it is the upper operation velocity for StealthChop. (unsigned)

      Set this parameter to disable CoolStep at low speeds, where it cannot work reliably.
      The stop on stall function (enable with sg_stop when using internal motion controller)
      becomes enabled when exceeding this velocity. It becomes disabled again once the velocity
      falls below this threshold. This allows for homing procedures with StallGuard by blanking out
      the StallGuard signal at low velocities (will not work in combination with StealthChop).
      VHIGH ≥ |VACT| ≥ VCOOLTHRS:
        - CoolStep and stop on stall are enabled, if configured
        - Voltage PWM mode StealthChop is switched off, if configured

  vhigh:
    type: int
    default: 0
    description: |
      This velocity setting allows velocity dependent switching into a different chopper mode and
      fullstepping to maximize torque.(unsigned)
      |VACT| ≥ VHIGH:
        - CoolStep is disabled (motor runs with normal current scale)
        - If vhighchm is set, the chopper switches to chm=1 with TFD=0
          (constant off time with slow decay, only).
        - If vhighfs is set, the motor operates in fullstep mode.
        - Voltage PWM mode StealthChop is switched off, if configured
```

## dts/bindings/stepper/adi/adi,trinamic-stallguard.yaml
```yaml
# SPDX-FileCopyrightText: Copyright (c) 2024 Carl Zeiss Meditec AG
# SPDX-License-Identifier: Apache-2.0

description: Stallguard bindings for Trinamic stepper controller.

properties:
  activate-stallguard2:
    type: boolean
    description: |
      Enable StallGuard2 feature, if the driver supports it.

  stallguard2-threshold:
    type: int
    default: 0
    description: |
      This signed value controls StallGuard2 level for stall  output and sets the
      optimum measurement range for readout. A lower value gives a higher sensitivity.
      Zero is the starting value working with most motors.

      -64 to +63: A higher value makes StallGuard2 less sensitive and requires more torque
      to indicate a stall.

  stallguard-threshold-velocity:
    type: int
    default: 1
    description: |
      Threshold velocity for StallGuard2 to detect a stall event.
      This value should be greater than zero.

  stallguard-velocity-check-interval-ms:
    type: int
    default: 100
    description: |
      Stallguard should not be enabled during motor spin-up.
      This delay is used to check if the actual stepper velocity is greater than
      stallguard-threshold-velocity before enabling stallguard.
```

## dts/bindings/stepper/adi/adi,trinamic-velocity-control.yaml
```yaml
# SPDX-FileCopyrightText: Copyright (c) 2025 Navimatix GmbH
# SPDX-License-Identifier: Apache-2.0

description: Velocity Control configuration options for Trinamic stepper controllers.

properties:
  ihold:
    type: int
    default: 0
    description: |
      Hold current in % of run current (0-100)
      Standstill current (0=1/32…31=32/32)
      In combination with StealthChop mode, setting IHOLD=0 allows to choose freewheeling or coil
      short circuit for motor stand still

  irun:
    type: int
    default: 0
    description: |
      Motor run current (0=1/32…31=32/32)
      Hint: Choose sense resistors in a way, that normal
      IRUN is 16 to 31 for best microstep performance.

  iholddelay:
    type: int
    default: 0
    description: |
      Controls the number of clock cycles for motor power down after a motion as soon as driver
      specific delays have expired. The smooth transition avoids a motor jerk upon power down.
      0: instant power down
      1..15: Delay per current reduction step in multiple of 2^18 clocks

  tcoolthrs:
    type: int
    default: 0
    description: |
      This is the lower threshold velocity for switching on smart
      energy CoolStep and StallGuard feature. (unsigned)
      Set this parameter to disable CoolStep at low speeds, where it
      cannot work reliably. The stop on stall function (enable with
      sg_stop when using internal motion controller) and the stall
      output signal become enabled when exceeding this velocity. In
      non-DcStep mode, it becomes disabled again once the velocity
      falls below this threshold.
      TCOOLTHRS ≥ TSTEP ≥ THIGH:
      - CoolStep is enabled, if configured
      - StealthChop voltage PWM mode is disabled
      TCOOLTHRS ≥ TSTEP
      - Stop on stall is enabled, if configured
      - Stall output signal (DIAG0/1) is enabled, if configured

  thigh:
    type: int
    default: 0
    description: |
      This velocity setting allows velocity dependent switching into
      a different chopper mode and fullstepping to maximize torque.
      (unsigned)
      The stall detection feature becomes switched off for 2-3
      electrical periods whenever passing THIGH threshold to
      compensate for the effect of switching modes.
      TSTEP ≤ THIGH:
      - CoolStep is disabled (motor runs with normal current
      scale)
      - StealthChop voltage PWM mode is disabled
      - If vhighchm is set, the chopper switches to chm=1
      with TFD=0 (constant off time with slow decay, only).
      - If vhighfs is set, the motor operates in fullstep mode,
      and the stall detection becomes switched over to
      DcStep stall detection.

  tpwmthrs:
    type: int
    default: 0
    description: |
      This is the upper velocity for StealthChop voltage PWM mode.
      TSTEP ≥ TPWMTHRS
      - StealthChop PWM mode is enabled, if configured
      - DcStep is disabled

  tpowerdown:
    type: int
    default: 10
    description: |
      TPOWERDOWN sets the delay time after stand still (stst) of the
      motor to motor current power down. Time range is about 0 to
      4 seconds.
      Attention: A minimum setting of 2 is required to allow
      automatic tuning of StealthChop PWM_OFS_AUTO.
      Reset Default = 10
      0…((2^8)-1) * 2^18 tCLK
```
