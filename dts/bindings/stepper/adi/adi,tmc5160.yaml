## dts/bindings/stepper/adi/adi,tmc5160.yaml
```yaml
# SPDX-FileCopyrightText: Copyright (c) 2024 Stefano Cottafavi
# SPDX-License-Identifier: Apache-2.0

description: |
  Analog Devices TMC5160 Stepper Motor Controller

  Example:

    &spi0 {
        /* SPI bus options here, not shown */

        tmc5160: tmc5160@0 {
            compatible = "adi,tmc5160";
            reg = <0>;
            spi-max-frequency = <DT_FREQ_M(24)>; /* Maximum SPI bus frequency */

            #address-cells = <1>;
            #size-cells = <0>;

            clock-frequency = <DT_FREQ_M(12)>; /* Internal/External Clock frequency */

            motor: motor@0 {
                status = "okay";
                reg = <0>;

                /* common stepper controller settings */
                invert-direction;
                micro-step-res = <256>;

                /* ADI TMC stallguard settings specific to TMC5041 */
                activate-stallguard2;
                stallguard-velocity-check-interval-ms=<100>;
                stallguard2-threshold=<9>;
                stallguard-threshold-velocity=<500000>;

                /* ADI TMC ramp generator as well as current settings */
                vstart = <10>;
                a1 = <20>;
                v1 = <30>;
                d1 = <40>;
                vmax = <50>;
                amax = <60>;
                dmax = <70>;
                tzerowait = <80>;
                vhigh = <90>;
                vcoolthrs = <100>;
                ihold = <1>;
                irun = <2>;
                iholddelay = <3>;
            };
        };
    };


compatible: "adi,tmc5160"

include:
  - name: spi-device.yaml
  - name: adi,trinamic-gconf.yaml
    property-allowlist:
      - shaft
      - test_mode

properties:
  "#address-cells":
    default: 1
    const: 1

  "#size-cells":
    default: 0
    const: 0

  clock-frequency:
    type: int
    required: true
    description: |
      The frequency of the clock signal provided to the TMC5160.
      This is used for real world conversion.

      Hint: µstep velocity v[Hz] µsteps / s v[Hz] = v[5160] * ( fCLK[Hz]/2 / 2^23 )
            where v[5160] is the value written to the TMC5160.

child-binding:
  include:
    - name: base.yaml
      property-allowlist:
        - reg
    - name: stepper-controller.yaml
      property-allowlist:
        - invert-direction
        - micro-step-res
    - name: adi,trinamic-ramp-generator.yaml
      property-allowlist:
        - vstart
        - a1
        - v1
        - amax
        - vmax
        - dmax
        - d1
        - vstop
        - tzerowait
        - vhigh
        - vcoolthrs
        - ihold
        - irun
        - iholddelay
    - name: adi,trinamic-stallguard.yaml
      property-allowlist:
        - activate-stallguard2
        - stallguard2-threshold
        - stallguard-threshold-velocity
        - stallguard-velocity-check-interval-ms
```

## dts/bindings/stepper/adi/adi,tmc51xx-base.yaml
```yaml
# SPDX-FileCopyrightText: Copyright (c) 2025 Prevas A/S
# SPDX-License-Identifier: Apache-2.0

description: |
  Common properties for Analog Devices TMC51XX Stepper Motor Controller

include:
  - name: adi,trinamic-gconf.yaml
    property-allowlist:
      - en-pwm-mode
      - test-mode

properties:
  shaft:
    type: boolean
    description: |
      Inverse motor direction

  clock-frequency:
    type: int
    required: true
    description: |
      The frequency of the clock signal provided to the TMC51XX.
      This is used for real world conversion.

      Hint: µstep velocity v[Hz] µsteps / s v[Hz] = v[51xx] * ( fCLK[Hz]/2 / 2^23 )
            where v[51xx] is the value written to the TMC51XX.
```

## dts/bindings/stepper/adi/adi,tmc51xx-motion-controller.yaml
```yaml
# SPDX-FileCopyrightText: Copyright (c) 2025 Jilay Sandeep Pandya
# SPDX-License-Identifier: Apache-2.0

compatible: "adi,tmc51xx-motion-controller"

include:
  - name: adi,trinamic-stallguard.yaml
    property-allowlist:
      - activate-stallguard2
      - stallguard-threshold-velocity
      - stallguard-velocity-check-interval-ms
  - name: adi,trinamic-ramp-generator.yaml
    property-allowlist:
      - vstart
      - a1
      - v1
      - amax
      - vmax
      - dmax
      - d1
      - vstop
      - tzerowait
      - thigh
      - tcoolthrs
      - tpwmthrs
      - tpowerdown
      - ihold
      - irun
      - iholddelay
```

## dts/bindings/stepper/adi/adi,tmc51xx-spi.yaml
```yaml
# SPDX-FileCopyrightText: Copyright (c) 2025 Dipak Shetty
# SPDX-License-Identifier: Apache-2.0

description: |
  Analog Devices TMC51XX Stepper Motor Controller (SPI mode)

compatible: "adi,tmc51xx"

include: [spi-device.yaml, "adi,tmc51xx-base.yaml"]

properties:
  reg:
    required: true

  diag0-gpios:
    type: phandle-array
    description: |
      Diagnostics output DIAG0 pin. This pin enables interrupt-based
      rampstat handling, allowing the driver to respond to motor events
      like position reached or stall detection without polling.
      Should be configured as push-pull output (active high).

examples:
  - |
    &spi0 {
        tmc51xx: tmc51xx@0 {
            compatible = "adi,tmc51xx";
            reg = <0>;
            spi-max-frequency = <DT_FREQ_M(8)>;
            diag0-gpios = <&gpio0 0 (GPIO_ACTIVE_HIGH | GPIO_PULL_UP)>; /* Diag0 pin */

            /* Common settings from base binding */
            clock-frequency = <DT_FREQ_M(16)>; /* Internal/External Clock frequency */
            en-pwm-mode, shaft; /* ADI TMC Global configuration flags */

            tmc51xx_1_stepper_driver: tmc51xx_1_stepper_driver {
              compatible = "adi,tmc51xx-stepper-drv";
              micro-step-res = <256>;
              /* ADI TMC stallguard settings specific to TMC51XX */
              stallguard2-threshold=<9>;
            };

            tmc51xx_1_motion_controller: tmc51xx_1_motion_controller {
              compatible = "adi,tmc51xx-stepper";

              /* ADI TMC stallguard settings specific to TMC5160 */
              activate-stallguard2;
              stallguard-velocity-check-interval-ms = <100>;
              stallguard-threshold-velocity = <50000>;

              /* ADI TMC ramp generator as well as current settings */
              vstart = <10>;
              a1 = <20>;
              v1 = <30>;
              d1 = <40>;
              vmax = <50>;
              amax = <60>;
              dmax = <70>;
              tzerowait = <80>;
              thigh = <90>;
              tcoolthrs = <100>;
              tpwmthrs = <110>;
              tpowerdown = <120>;
              ihold = <1>;
              irun = <2>;
              iholddelay = <3>;
            };
        };
    };
```

## dts/bindings/stepper/adi/adi,tmc51xx-stepper-driver.yaml
```yaml
# SPDX-FileCopyrightText: Copyright (c) 2025 Jilay Sandeep Pandya
# SPDX-License-Identifier: Apache-2.0

compatible: "adi,tmc51xx-stepper-driver"

include:
  - name: stepper-driver.yaml
  - name: adi,trinamic-stallguard.yaml
    property-allowlist:
      - stallguard2-threshold
```

## dts/bindings/stepper/adi/adi,tmc51xx-uart.yaml
```yaml
# SPDX-FileCopyrightText: Copyright (c) 2025 Dipak Shetty
# SPDX-License-Identifier: Apache-2.0

description: |
  Analog Devices TMC51XX Stepper Motor Controller (UART single-wire mode)

  This binding supports the single-wire UART mode where:
  - SWIOP is connected to the MCU's UART TX/RX pin
  - SWION should be connected to half the IO level voltage (1.65V for 3.3V systems)
  - SW_SEL must be HIGH (either via GPIO control or hardwired)

compatible: "adi,tmc51xx"

include: [uart-device.yaml, "adi,tmc51xx-base.yaml"]

properties:
  sw-sel-gpios:
    type: phandle-array
    description: |
      GPIO connected to the SW_SEL pin of TMC51XX.
      Must be set HIGH for UART mode operation.
      If not provided, it's assumed SW_SEL is hardwired to VCC/HIGH.

  uart-device-addr:
    type: int
    description: |
        UART device address for TMC51XX in UART mode.
        Valid range: 0 - 253

examples:
  - |
    &uart2 {
        current-speed = <115200>;
        status = "okay";

        tmc51xx: tmc51xx {
            compatible = "adi,tmc51xx";
            sw-sel-gpios = <&gpiob 0x01 GPIO_ACTIVE_HIGH>;

            /* Common settings from base binding */
            clock-frequency = <DT_FREQ_M(12)>;
            en-pwm-mode;
            invert-direction;

            tmc51xx_stepper_driver: stepper_driver {
                compatible = "adi,tmc51xx-stepper-drv";
                micro-step-res = <256>;

                /* ADI TMC stallguard settings specific to TMC51XX */
                stallguard2-threshold=<9>;
            };

            /* common stepper controller settings */
            tmc51xx_motion_controller: motion_controller {
              compatible = "adi,tmc51xx-stepper";

              /* ADI TMC stallguard settings specific to TMC5160 */
              activate-stallguard2;
              stallguard-velocity-check-interval-ms = <100>;
              stallguard-threshold-velocity = <50000>;

              /* ADI TMC ramp generator as well as current settings */
              vstart = <10>;
              a1 = <20>;
              v1 = <30>;
              d1 = <40>;
              vmax = <50>;
              amax = <60>;
              dmax = <70>;
              tzerowait = <80>;
              thigh = <90>;
              tcoolthrs = <100>;
              tpwmthrs = <110>;
              tpowerdown = <120>;
              ihold = <1>;
              irun = <2>;
              iholddelay = <3>;
            };
        };
    };
```

## dts/bindings/stepper/adi/adi,tmc51xx.yaml
```yaml
# SPDX-FileCopyrightText: Copyright (c) 2025 Prevas A/S
# SPDX-License-Identifier: Apache-2.0

description: |
  Analog Devices TMC51XX Stepper Motor Controller

  Example:

    &spi0 {
        /* SPI bus options here, not shown */

        /* Controller/driver for one 2-phase bipolar stepper motor */
        tmc51xx: tmc51xx@0 {
            compatible = "adi,tmc51xx";
            reg = <0>;
            spi-max-frequency = <DT_FREQ_M(8)>; /* Maximum SPI bus frequency */

            #address-cells = <1>;
            #size-cells = <0>;

            en-pwm-mode; test-mode; /* ADI TMC Global configuration flags */
            clock-frequency = <DT_FREQ_M(16)>; /* Internal/External Clock frequency */

            /* common stepper controller settings */
            invert-direction;
            micro-step-res = <256>;

            /* ADI TMC stallguard settings specific to TMC51XX */
            activate-stallguard2;
            stallguard-velocity-check-interval-ms=<100>;
            stallguard2-threshold=<9>;
            stallguard-threshold-velocity=<500000>;

            /* ADI TMC ramp generator as well as current settings */
            vstart = <10>;
            a1 = <20>;
            v1 = <30>;
            d1 = <40>;
            vmax = <50>;
            amax = <60>;
            dmax = <70>;
            tzerowait = <80>;
            thigh = <90>;
            tcoolthrs = <100>;
            tpwmthrs = <110>;
            tpowerdown = <120>;
            ihold = <1>;
            irun = <2>;
            iholddelay = <3>;
        };
    };


compatible: "adi,tmc51xx"

include:
  - name: spi-device.yaml
  - name: adi,trinamic-gconf.yaml
    property-allowlist:
      - en-pwm-mode
      - test-mode
  - name: stepper-controller.yaml
  - name: base.yaml
    property-allowlist:
      - reg
  - name: adi,trinamic-ramp-generator.yaml
    property-allowlist:
      - vstart
      - a1
      - v1
      - amax
      - vmax
      - dmax
      - d1
      - vstop
      - tzerowait
      - thigh
      - tcoolthrs
      - tpwmthrs
      - tpowerdown
      - ihold
      - irun
      - iholddelay
  - name: adi,trinamic-stallguard.yaml
    property-allowlist:
      - activate-stallguard2
      - stallguard2-threshold
      - stallguard-threshold-velocity
      - stallguard-velocity-check-interval-ms

properties:
  "#address-cells":
    default: 1
    const: 1

  "#size-cells":
    default: 0
    const: 0

  clock-frequency:
    type: int
    required: true
    description: |
      The frequency of the clock signal provided to the TMC51XX.
      This is used for real world conversion.

      Hint: µstep velocity v[Hz] µsteps / s v[Hz] = v[51xx] * ( fCLK[Hz]/2 / 2^23 )
            where v[51xx] is the value written to the TMC51XX.
```
