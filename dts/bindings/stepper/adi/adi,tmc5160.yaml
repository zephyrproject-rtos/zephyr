## dts/bindings/stepper/allegro,a4988.yml
```yaml
compatible: "allegro,a4988"

description: |
  The A4988 is a complete microstepping motor driver with
  built-in translator for easy operation. It is designed to operate
  bipolar stepper motors in full-, half-, quarter-, eighth-, and
  sixteenth-step modes.
include:
  - name: stepper-controller.yaml
    property-allowlist:
      - micro-step-res

properties:
  dir-gpios:
    type: phandle-array
    required: true
    description: |
      The gpio pin to control the direction of the stepper motor.

  step-gpios:
    type: phandle-array
    required: true
    description: |
      The gpio pin to trigger a step of the stepper motor.

  en-gpios:
    type: phandle-array
    description: |
      The gpio pin to trigger a step of the stepper motor.

  msx-gpios:
    type: phandle-array
    description: |
      An array of GPIO pins used to control the stepper motor. The order of the pins should be:
      - MS1 pin
      - MS2 pin
      - MS3 pin
```

## dts/bindings/stepper/allegro/allegro,a4979.yaml
```yaml
# SPDX-FileCopyrightText: Copyright (c) 2025 Carl Zeiss Meditec AG
# SPDX-License-Identifier: Apache-2.0

description: |
  Allegro A4979 microstepping stepper motor driver.
  A4979 is a flexible microstepping motor driver with built-in translator for easy operation.
  It is designed to operate bipolar stepper motors in full-, half-, quarter-, and sixteenth-step
  modes.

  Example:
  a4979: a4979 {
      status = "okay";
      compatible = "allegro,a4979";
      micro-step-res = <2>;
      reset-gpios = <&gpiod 10 GPIO_ACTIVE_HIGH>;
      dir-gpios = <&gpiod 14 GPIO_ACTIVE_HIGH>;
      step-gpios = <&gpiod 15 GPIO_ACTIVE_HIGH>;
      en-gpios = <&gpiod 11 GPIO_ACTIVE_HIGH>;
      m0-gpios = <&gpiod 13 0>;
      m1-gpios = <&gpiod 12 0>;
      counter = <&counter5>;
  };

compatible: "allegro,a4979"

include:
  - name: stepper-controller.yaml

properties:
  m0-gpios:
    required: true
    type: phandle-array
    description: Microstep configuration pin 0.

  m1-gpios:
    required: true
    type: phandle-array
    description: Microstep configuration pin 1.

  reset-gpios:
    type: phandle-array
    required: true
    description: Reset pin
```

## dts/bindings/stepper/allegro/allegro,a4988.yml
```yaml
description: |
  The A4988 is a complete microstepping motor driver with
  built-in translator for easy operation. It is designed to operate
  bipolar stepper motors in full-, half-, quarter-, eighth-, and
  sixteenth-step modes.

  Example:
  a4988: a4988 {
    status = "okay";
    compatible = "allegro,a4988";

    dir-gpios = <&gpio1 0 GPIO_ACTIVE_HIGH>;
    step-gpios = <&gpio1 1 GPIO_ACTIVE_HIGH>;
    en-gpios = <&gpio1 2 GPIO_ACTIVE_HIGH>;
    msx-gpios = <&gpio1 3 0>, <&gpio1 4 0>, <&gpio1 5 0>;
  };

compatible: "allegro,a4988"

include:
  - name: stepper-controller.yaml
    property-allowlist:
      - micro-step-res
      - step-gpios
      - dir-gpios
      - en-gpios
      - counter

properties:
  msx-gpios:
    type: phandle-array
    description: |
      An array of GPIO pins used to control the stepper motor. The order of the pins should be:
      - MS1 pin
      - MS2 pin
      - MS3 pin

  sleep-gpios:
    type: phandle-array
    description: Sleep pin
  
  reset-gpios:
    type: phandle-array
    description: Reset pin
```

## dts/bindings/stepper/gpio-stepper-controller.yaml
```yaml
# SPDX-FileCopyrightText: Copyright (c) 2024 Carl Zeiss Meditec AG
# SPDX-License-Identifier: Apache-2.0

description: GPIO Stepper controller for darlington transistor arrays or dual H-bridge

compatible: "gpio-stepper"

include: stepper-controller.yaml

properties:
  gpios:
    type: phandle-array
    required: true
    description: |
      The gpio pin array on which the stepper inputs are to be connected
      stepper {
              compatible = "gpio-stepper";
              status = "okay";
              gpios = <&gpioa 9 GPIO_ACTIVE_HIGH>,
                      <&gpioc 7 GPIO_ACTIVE_HIGH>,
                      <&gpiob 0 GPIO_ACTIVE_HIGH>,
                      <&gpioa 7 GPIO_ACTIVE_HIGH>;
      };
```
