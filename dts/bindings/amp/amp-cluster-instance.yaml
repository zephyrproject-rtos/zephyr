## dts/bindings/amp/amp-cluster-instance.yaml
```yaml
# SPDX-FileCopyrightText: Copyright The Zephyr Project Contributors
# SPDX-FileCopyrightText: Copyright (c) 2026 Siemens Mobility GmbH
# SPDX-License-Identifier: Apache-2.0
title: Generic AMP cluster instance

description: |
  A cluster consistent of one or multiple CPU cores, e.g. two Cortex-R cores. A
  cluster can have a single core, if there are multiple cluster types inside the
  SoC.

compatible: "amp-cluster-instance"

include: base.yaml
```

## dts/bindings/amp/amp-core.yaml
```yaml
# SPDX-FileCopyrightText: Copyright The Zephyr Project Contributors
# SPDX-FileCopyrightText: Copyright (c) 2026 Siemens Mobility GmbH
# SPDX-License-Identifier: Apache-2.0
title: Generic CPU core

description: |
  A single CPU core

include: base.yaml

properties:
  self-cpu:
    type: boolean
    required: false
    description: |
      Set this, if this is the core the currently built Zephyr firmware will run
      on. As of now this doesn't do anything.

  stop-on-init:
    type: boolean
    description: |
      Add this property in case the driver should ensure the core is powered off
      during startup.
```

## dts/bindings/amp/ti,amp-k3-cortex-r-core.yaml
```yaml
# SPDX-FileCopyrightText: Copyright The Zephyr Project Contributors
# SPDX-FileCopyrightText: Copyright (c) 2026 Siemens Mobility GmbH
# SPDX-License-Identifier: Apache-2.0
description: Texas Instruments Keystone 3 Cortex-R core

compatible: "ti,amp-k3-cortex-r-core"

include: ti,amp-k3-tisci-controlled-core.yaml

properties:
  atcm-address:
    type: int
    required: true
    description: |
      External address of the ATCM interface so other cores can load into the ATCM memory

  btcm-address:
    type: int
    required: true
    description: |
      External address of the BTCM interface so other cores can load into the ATCM memory

  config-set-flags:
    type: int
    required: false
    description: |
      Config flags that should be set. When combined with config_clear_flags
      must contain all possible flags for the target core

  config-clear-flags:
    type: int
    required: false
    description: |
      Config flags that should be set. When combined with config_set_flags
      must contain all possible flags for the target core

  boot-vec:
    type: int
    required: false
    description: |
      Boot address where the core starts to boot. Can be omitted and will default to 0.
```

## dts/bindings/amp/ti,amp-k3-tisci-controlled-core.yaml
```yaml
# SPDX-FileCopyrightText: Copyright The Zephyr Project Contributors
# SPDX-FileCopyrightText: Copyright (c) 2026 Siemens Mobility GmbH
# SPDX-License-Identifier: Apache-2.0
description: Texas Instruments Keystone 3 core controlled by TISCI

include: amp-core.yaml

properties:
  ti,tisci-core-id:
    type: int
    required: true
    description: |
      Core ID according to the TISCI documentation (see the "Processor
      Descriptions" for your SoC under
      https://software-dl.ti.com/tisci/esd/latest/5_soc_doc/index.html)
```

## dts/bindings/amp/ti,amp-k3.yaml
```yaml
# SPDX-FileCopyrightText: Copyright The Zephyr Project Contributors
# SPDX-FileCopyrightText: Copyright (c) 2026 Siemens Mobility GmbH
# SPDX-License-Identifier: Apache-2.0
description: Texas Instruments Keystone 3 AMP root node

compatible: "ti,amp-k3"

include: base.yaml

properties:
  reg:
    required: false

  dmsc:
    type: phandle
    required: true
    description: Phandle to the device DMSC-L node
```

## dts/bindings/arm/arm,armv8-pmu.yaml
```yaml
# Copyright (c) 2026 Advanced Micro Devices, Inc.
# SPDX-License-Identifier: Apache-2.0

title: ARMv8 PMU

description: |
  ARMv8 PMUv3 performance monitors (programmed via EL1 system registers).

  The hardware has no MMIO; this node exists to describe the GIC interrupt
  that fires on PMU counter overflow when PMINTENSET_EL1 is used.

compatible: "arm,armv8-pmu"

include: base.yaml

properties:
  interrupts:
    required: true
```

## dts/bindings/arm/arm,dtcm-ecc.yaml
```yaml
# SPDX-License-Identifier: Apache-2.0

description: Cortex-M DTCM (Data Tightly Coupled Memory) with ECC

compatible: "arm,dtcm-ecc"

include: arm,dtcm.yaml
```

## dts/bindings/arm/arm,itcm-ecc.yaml
```yaml
# SPDX-License-Identifier: Apache-2.0

description: Cortex-M ITCM (Instruction Tightly Coupled Memory) with ECC

compatible: "arm,itcm-ecc"

include: arm,itcm.yaml
```

## dts/bindings/arm/arm,sse-200-spctrl.yaml
```yaml
# SPDX-FileCopyrightText: Copyright (c) 2026 Infineon Technologies AG,
# SPDX-FileCopyrightText: or an affiliate of Infineon Technologies AG. All rights reserved.
#
# SPDX-License-Identifier: Apache-2.0

description: |
  ARM SSE-200 Secure Privilege Control Register block (SPCTRL).

  SPCTRL is only accessible from Secure state.  It configures the
  SSE-200's IDAU and Peripheral Protection Controllers.

  The nsccfg property sets bits in the NSCCFG register (offset 0x14),
  which tells the IDAU which SRAM banks are Non-Secure Callable.  Setting
  CODENSC (bit 0) marks the code SRAM bank as NSC-capable, which is
  required for SG veneers placed in that bank to work correctly.

  Example board overlay (mps2-an521):

    spctrl: spctrl@50080000 {
        compatible = "arm,sse-200-spctrl";
        reg = <0x50080000 0x1000>;
        nsccfg = <0x1>;
        apbnsppcexp1-ns-mask = <0xFFFFFFFF>;
        status = "okay";
    };

compatible: "arm,sse-200-spctrl"

include: base.yaml

properties:
  reg:
    required: true

  nsccfg:
    type: int
    default: 0
    description: |
      Bitmask to OR into the NSCCFG register (offset 0x14).
      Bit 0 (CODENSC): marks code SRAM as NSC-capable in the IDAU.
      Bit 1 (DATASECCFG): marks data SRAM as NSC-capable.
      Leave at 0 if the IDAU does not need adjustment.

  apbnsppcexp1-ns-mask:
    type: int
    default: 0
    description: |
      Bitmask to write into the APBNSPPCEXP1 register (offset 0x84).
      Each bit grants Non-Secure access to the corresponding APB expansion
      PPC1 port and simultaneously BLOCKS Secure access to that port.
      This write must occur after all Secure-world I/O (e.g. UART printk)
      is complete; call arm_sse200_spctrl_ppc_configure() explicitly just
      before branching to the Non-Secure image.
```

## dts/bindings/arm/nordic,nrf-mutex.yaml
```yaml
# Copyright (c) 2022 Nordic Semiconductor ASA
# SPDX-License-Identifier: Apache-2.0

description: Nordic nRF family MUTEX (Mutual Exclusive Peripheral)

compatible: "nordic,nrf-mutex"

include: base.yaml

properties:
  reg:
    required: true

  "#mutex-cells":
    type: int
    const: 1
    description: |
      Number of cells in a "nordic,mutex" specifier. The single cell is the
      index of the hardware mutex within this MUTEX instance.

  nordic,mutex-count:
    type: int
    description: |
      Number of hardware mutexes provided by this MUTEX instance. Used to
      statically verify that a claimed mutex index is within range.

mutex-cells:
  - index
```

## dts/bindings/arm/nordic,nrf71-antsw.yaml
```yaml
# Copyright (c) 2026 Nordic Semiconductor ASA
# SPDX-License-Identifier: Apache-2.0

description: |
  nRF71 antenna switch (ANTSW) select pin, shared between Wi-Fi and BLE.

  A single SoC pin is wired to the antenna switch. Early boot code routes it
  to the ANTSWC peripheral (GPIO PIN_CNF CTRLSEL = 5) via
  nrf_gpio_pin_control_select() from soc_early_init_hook(). ANTSWC then
  drives the line for Wi-Fi/BLE coexistence; the application core does not
  bit-bang the switch in GPIO mode. Only the port and pin from sel-gpios are
  used; GPIO flags are not interpreted.

  Because this runs before the GPIO driver is initialized, the pin is
  configured through the nrf_gpio HAL using the PSEL derived from this
  property. The pin is SoC specific and is not meant to be changed at a board
  level.

  Powering the antenna switch is a separate concern handled by the pwr_antswc
  node (nordic,nrf-pwr-antswc).

compatible: "nordic,nrf71-antsw"

include: base.yaml

properties:
  sel-gpios:
    type: phandle-array
    required: true
    description: |
      Antenna switch select line (port and pin only). Routed to ANTSWC at boot.
```

## dts/bindings/arm/nordic,nrf71-wifi-antsw.yaml
```yaml
# Copyright (c) 2026 Nordic Semiconductor ASA
# SPDX-License-Identifier: Apache-2.0

description: |
  nRF71 Wi-Fi antenna switch (ANTSW) steering.

  Steers the antenna switch towards WLAN before the Wi-Fi core is started,
  from soc_early_init_hook(). Because that runs before the GPIO driver is
  initialized, the pin is configured directly through the nrf_gpio HAL using
  the PSEL derived from this property, rather than through the GPIO driver or
  GPIO hogs. The pin is SoC specific and is not meant to be changed at a board
  level.

  Powering the antenna switch is a separate concern handled by the pwr_antswc
  node (nordic,nrf-pwr-antswc).

compatible: "nordic,nrf71-wifi-antsw"

include: base.yaml

properties:
  wlan-gpios:
    type: phandle-array
    required: true
    description: |
      Steers the antenna switch towards WLAN.
```

## dts/bindings/arm/nxp,nbu.yaml
```yaml
# Copyright 2024, 2026 NXP
# SPDX-License-Identifier: Apache-2.0

description: NXP NBU interruption information

include: [base.yaml, pinctrl-device.yaml, wuc-device.yaml, nvmem-consumer.yaml]

compatible: "nxp,nbu"

properties:
  nvmem-cells:
    description: |
      Optional single NVMEM cell holding the factory 32 MHz crystal trim
      (one byte). Bit 7 flags the trim as valid and bits 5:0 hold the CDAC
      value (0 to 63), so a CDAC of 0x3F is stored as 0xBF. Once the NVMEM
      provider is available, a valid trim is applied. A blank cell (0xFF), a
      byte with bit 7 clear, an out of range value or a read failure keeps
      rfmc-xo-cdac, which is always used as the early boot default.
  interrupts:
    required: true
  nbu-name:
    default: "NBU NXP"
    type: string
    description: Name of the Narrow Band Unit interruption initialization
  rfmc-xo-cdac:
    type: int
    description: |
      XTAL CDAC trim value.
      This value is usually used to fine-tune the 32MHz crystal oscillator frequency.
  rfmc-xo-isel:
    type: int
    description: |
      XTAL ISEL (Current Selection) value.
  max-tx-power-support:
    type: array
    description: |
      List of supported Max TX power values in dBm.
  max-tx-power-dbm:
    type: int
    description: |
      Selected Max TX power in dBm.
```

## dts/bindings/audio/atmel,sam-dac-audio.yaml
```yaml
# SPDX-FileCopyrightText: Copyright (c) 2026 Ugo Marchand
# SPDX-License-Identifier: Apache-2.0

description: |
  PCM audio playback on an Atmel SAM DACC channel.

  A Timer Counter (TC) channel paces the conversions through its TIOA output
  and the DMA feeds the DACC conversion data register, so the CPU only has to
  refill a block per completion callback. Only the outputs of the first TC
  module can reach the DACC, so this node must sit under that module.

  The driver programs the TC channel itself and owns it for as long as the
  output runs, which is why it takes the registers and the clocks from its
  parent rather than from a phandle. The parent TC node must stay disabled,
  otherwise the counter driver binds to the same registers and the two fight
  over the mode and compare registers.

  The DACC node keeps ownership of its clock, pins and prescaler, so it must be
  enabled and pin-muxed separately, as must the DMA controller.

  Example DTS:

    &tc0 {
      audio_dac0: dac-audio {
        compatible = "atmel,sam-dac-audio";
        status = "okay";
        channel = <0>;
        io-channels = <&dacc 1>;
        dmas = <&xdmac 0 DMA_PERID_DACC1_TX>;
        dma-names = "tx";
      };
    };

compatible: "atmel,sam-dac-audio"

include: base.yaml

properties:
  channel:
    type: int
    required: true
    enum: [0, 1, 2]
    description: |
      Channel of the parent TC module that paces the conversions.

  io-channels:
    required: true
    description: |
      DACC controller and channel the samples are converted on.

  dmas:
    required: true

  dma-names:
    required: true
```

## dts/bindings/audio/cirrus,cs35l56-spi.yaml
```yaml
# Copyright (c) 2026 Cirrus Logic, Inc.
# SPDX-License-Identifier: Apache-2.0

description: Cirrus Logic CS35L56 Smart Amplifier on an SPI bus

compatible: "cirrus,cs35l56"

include: ["spi-device.yaml", "cirrus,cs35l56-common.yaml"]
```

## dts/bindings/audio/cirrus,cs35l57-spi.yaml
```yaml
# Copyright (c) 2026 Cirrus Logic, Inc.
# SPDX-License-Identifier: Apache-2.0

description: Cirrus Logic CS35L57 Smart Amplifier on an SPI bus

compatible: "cirrus,cs35l57"

include: ["spi-device.yaml", "cirrus,cs35l56-common.yaml"]
```

## dts/bindings/audio/cirrus,cs35l5x-common.yaml
```yaml
# Copyright 2026 Cirrus Logic, Inc.
# SPDX-License-Identifier: Apache-2.0

properties:
  reset-gpios:
    type: phandle-array
    description: |
      Active low signal used to reset the device to default state.

  vdd-p-supply:
    type: phandle
    description: VDD_P low-voltage supply regulator.

  vdd-io-supply:
    type: phandle
    description: VDD_IO digital interface supply regulator.

  vdd-a-supply:
    type: phandle
    description: VDD_A analog supply regulator.

  vdd-b-supply:
    type: phandle
    description: VDD_B speaker boost supply regulator.

  vdd-amp-supply:
    type: phandle
    description: VDD_AMP amplifier output stage supply regulator.
```

## dts/bindings/audio/cirrus,cs42l51.yaml
```yaml
# Copyright (c) 2026 ZAL Zentrum für Angewandte Luftfahrtforschung GmbH
# SPDX-License-Identifier: Apache-2.0

description: Cirrus CS42L51 Audio Codec

include: [i2c-device.yaml]

compatible: "cirrus,cs42l51"

properties:
  reg:
    required: true

  reset-gpios:
    required: true
    type: phandle-array
    description: |
      RESET pin

  input-channel:
    type: int
    enum:
      - 1
      - 2
      - 3
    description: |
      Analog input pair that feeds the ADC, applied to both the A and B
      channels:
        1 = AIN1
        2 = AIN2
        3 = the MICIN1/MICIN2 pins, wired directly to the ADC without
            the mic preamp
```
