## dts/bindings/audio/cirrus,cs47l63.yaml
```yaml
# Copyright (c) 2023 Nordic Semiconductor ASA
# SPDX-License-Identifier: Apache-2.0

description: Cirrus Logic CS47L63 Low-Power Audio DSP

compatible: "cirrus,cs47l63"

include: spi-device.yaml

properties:
  reg:
    required: true

  irq-gpios:
    type: phandle-array
    description:
      Interrupt request (IRQ) output.

  reset-gpios:
    type: phandle-array
    required: true
    description:
      Digital reset input.

  cirrus,asp:
    type: int
    enum: [1, 2]
    default: 1
    description: |
      Audio serial port the host's I2S is wired to. ASP1 on the
      nRF5340 Audio DK.

  cirrus,input:
    type: string
    default: "line"
    enum:
      - "line"
      - "pdm"
    description: |
      Input this serial port captures from: line is IN2L/IN2R, the analog
      line pair; pdm is IN1L/IN1R in digital mode, a PDM microphone.

  cirrus,fll-ref:
    type: string
    enum:
      - "mclk1"
    description: |
      Reference clock of FLL1, which SYSCLK runs from. The driver refuses
      to configure the codec without it. The part also accepts MCLK2, its
      internal oscillator and either serial port's BCLK; the driver does
      not support them yet.

  gpio1-gpios:
    type: phandle-array
    description:
      GPIO1 input with bus-keeper

  gpio2-gpios:
    type: phandle-array
    description:
      GPIO2 input with bus-keeper

  gpio3-gpios:
    type: phandle-array
    description:
      GPIO3 input with bus-keeper

  gpio4-gpios:
    type: phandle-array
    description:
      GPIO4 input with bus-keeper

  gpio5-gpios:
    type: phandle-array
    description:
      GPIO5 input with bus-keeper

  gpio6-gpios:
    type: phandle-array
    description:
      GPIO6 input with bus-keeper

  gpio7-gpios:
    type: phandle-array
    description:
      GPIO7 input with bus-keeper

  gpio8-gpios:
    type: phandle-array
    description:
      GPIO8 input with bus-keeper

  gpio9-gpios:
    type: phandle-array
    description:
      GPIO9 input with bus-keeper

  gpio10-gpios:
    type: phandle-array
    description:
      GPIO10 input with bus-keeper

  gpio11-gpios:
    type: phandle-array
    description:
      GPIO11 input with bus-keeper

  gpio12-gpios:
    type: phandle-array
    description:
      GPIO12 input with bus-keeper

child-binding:
  description: |
    Second audio serial port of the same CS47L63. Output and input volume
    and mute belong to the parent; both ports share one MCLK and frame rate.
  properties:
    cirrus,asp:
      type: int
      required: true
      enum: [1, 2]
      description: Serial port of this node; must differ from the parent's.
    cirrus,input:
      type: string
      default: "line"
      enum:
        - "line"
        - "pdm"
      description: |
        Input this serial port captures from: line is IN2L/IN2R, the analog
        line pair; pdm is IN1L/IN1R in digital mode, a PDM microphone.
```

## dts/bindings/audio/everest,es7210.yaml
```yaml
# SPDX-FileCopyrightText: Copyright The Zephyr Project Contributors
# SPDX-License-Identifier: Apache-2.0

description: |
  Everest Semiconductor ES7210 four-channel microphone ADC.
  Supports analog or digital microphone inputs, stereo through either
  output, and four-channel TDM through SDOUT1. MCLK is supplied externally;
  BCLK and LRCK can be supplied by either the host or the ADC.

compatible: "everest,es7210"

include: i2c-device.yaml

properties:
  everest,sdout:
    type: int
    required: true
    enum: [1, 2]
    description: |
      Serial data output connected to the I2S receiver. SDOUT1 carries
      MIC1 (left) and MIC2 (right); SDOUT2 carries MIC3 (left) and MIC4
      (right). Four-channel TDM requires SDOUT1.

  everest,micbias-millivolt:
    type: int
    required: true
    enum: [2180, 2260, 2360, 2450, 2550, 2660, 2780, 2870]
    description: Microphone bias voltage for MIC1/2 and MIC3/4 with VDDM at 3.3 V.

  everest,micbias34-millivolt:
    type: int
    enum: [2180, 2260, 2360, 2450, 2550, 2660, 2780, 2870]
    description: |
      Optional separate MIC3/4 bias voltage with VDDM at 3.3 V. When omitted,
      MIC3/4 uses the everest,micbias-millivolt setting.

  everest,vdda-millivolt:
    type: int
    required: true
    enum: [1800, 3300]
    description: Analog supply voltage. Analog PGA gain must be at least 21 dB at 1.8 V.

  everest,vddd-millivolt:
    type: int
    required: true
    enum: [1800, 3300]
    description: Digital supply voltage. Rates above 24 kHz require 3.3 V in this driver.
```

## dts/bindings/audio/everest,es8311.yaml
```yaml
# Copyright (c) 2026 Hsiu-Chi Tsai
# SPDX-License-Identifier: Apache-2.0

title: Everest Semiconductor ES8311 Audio Codec

description: |
  Mono ADC/DAC with an I2C control interface and an I2S/PCM audio interface.
  The CE pin selects the 7-bit I2C address, 0x18 or 0x19. The microphone
  input is differential MIC1P/MIC1N; the output is OUTP/OUTN.

compatible: "everest,es8311"

include:
  - name: i2c-device.yaml
    property-blocklist:
      - supply-gpios
      - vin-supply

properties:
  everest,mono-dac-source:
    type: string
    enum:
      - "left"
      - "right"
    default: "left"
    description: |
      Stereo I2S slot used by the mono DAC. The default supports mono
      streams carried in the first slot. Select "right" when the wanted
      samples are in the second slot.

  everest,mic-pga-gain-db:
    type: int
    enum: [0, 3, 6, 9, 12, 15, 18, 21, 24, 27, 30]
    default: 0
    description: |
      Analog microphone PGA gain in dB, before ADC conversion. The default
      adds no PGA gain, reducing clipping risk with an unknown microphone
      level. Increase the gain when the board's microphone output needs
      amplification. Digital volume cannot recover a signal clipped here.
```

## dts/bindings/audio/maxim,max98091.yaml
```yaml
# Copyright (c) 2025 Silicon Signals Pvt. Ltd.
# SPDX-License-Identifier: Apache-2.0

description: MAX98091 I2S Audio Codec

compatible: "maxim,max98091"

include: [i2c-device.yaml]

properties:
  reg:
    required: true
  mclk-frequency:
    type: int
    required: true
    description: External MCLK frequency in Hz
  dmic-clk-frequency:
    type: int
    enum: [1536000, 2048000, 2457600, 3072000, 4096000, 6144000]
    description: Digital microphone clock frequency in Hz
```

## dts/bindings/audio/maxim,max98357a.yaml
```yaml
# SPDX-FileCopyrightText: 2026 Muhammad Waleed Badar
# SPDX-License-Identifier: Apache-2.0

description: |
  Maxim MAX98357A PCM input class D mono audio amplifier.

  The amplifier has no control bus. It is a child node of the I2S controller
  that feeds it and accepts I2S or left justified data of 16, 24 or 32 bits
  at sample rates from 8 kHz to 96 kHz. No MCLK is needed.

  The SD_MODE pin selects shutdown (below 0.16 V), the (left + right) / 2 mix
  (0.16 V to 0.77 V), the right channel (0.77 V to 1.4 V) or the left channel
  (above 1.4 V). When the pin is driven by a GPIO, a logic high therefore
  plays the left channel only. Leave sdmode-gpios out and set the voltage
  with a resistor divider to play the mix or the right channel.

  The GAIN pin selects 12 dB when tied to GND, 9 dB when unconnected and
  6 dB when tied to VDD. When it is driven by a GPIO, the driver selects
  these three gains by driving the pin low, leaving it as an input or
  driving it high. The 15 dB and 3 dB settings need a 100 kiloohm resistor
  to GND or VDD and are not available through the GPIO.

  Example:

    &i2s0 {
        max98357a: max98357a@0 {
            compatible = "maxim,max98357a";
            reg = <0>;
            sdmode-gpios = <&gpio0 4 GPIO_ACTIVE_HIGH>;
            gain-gpios = <&gpio0 5 GPIO_ACTIVE_HIGH>;
        };
    };

compatible: "maxim,max98357a"

include: i2s-device.yaml

properties:
  sdmode-gpios:
    type: phandle-array
    description: |
      GPIO connected to the SD_MODE pin. The active level enables the
      amplifier and selects the left channel, the inactive level shuts it
      down. Without this property the output is always enabled and mute
      is not supported.

  gain-gpios:
    type: phandle-array
    description: |
      GPIO connected to the GAIN pin. The pin is driven at its physical
      level: low selects 12 dB, high selects 6 dB and the GPIO configured
      as an input selects 9 dB, which is also the gain set at
      initialization. Without this property the gain is fixed by the
      board wiring and setting the output volume is not supported.
```

## dts/bindings/audio/nuvoton,nau8540.yaml
```yaml
# Copyright (c) 2026 RAKwireless Technology Limited
# SPDX-License-Identifier: Apache-2.0

description: |
  Nuvoton NAU85L40 / NAU85L40B 4-channel analog microphone ADC.

  Control is over I2C (16-bit register address and 16-bit value). PCM audio
  is produced on I2S. The default I2C address is 0x1c when CSB is low, or
  0x1d when CSB is high.

  https://www.nuvoton.com/products/smart-home-audio/audio-converters/audio-adcs/nau85l40b/

compatible: "nuvoton,nau8540"

include: [i2c-device.yaml, power.yaml]

properties:
  reg:
    required: true

  csb-gpios:
    type: phandle-array
    description: |
      Optional CSB / GPIO strap that selects the I2C address LSB. The driver
      drives this pin to match the reg property (low = 0x1c, high = 0x1d)
      before the first I2C access. On RAK18040 this is MIC_CTR (WisBlock IO1)
      and must stay high for analog microphone bias.

  clock-source:
    type: string
    default: "FLL-FS"
    enum:
      - "FLL-FS"
      - "INTERNAL"
    description: |
      SYSCLK source after configure().
      - "FLL-FS": on-chip FLL locked to the I2S frame clock (host I2S master).
      - "INTERNAL": free-running DCO, no I2S clock required for analog bring-up.
      The default is FLL-FS because the typical use is a host I2S master that
      supplies FS; INTERNAL is for boards that have no I2S clocks wired.

  adc-channels:
    type: int
    default: 3
    description: |
      Bit mask of analog ADC channels to enable (bit0 = CH1 ... bit3 = CH4).
      The default enables CH1 and CH2, which matches a stereo analog
      microphone module such as RAK18040 + RAK18041.
```

## dts/bindings/audio/nuvoton,nau88c10.yaml
```yaml
# SPDX-FileCopyrightText: Copyright The Zephyr Project Contributors
#
# SPDX-License-Identifier: Apache-2.0

title: Nuvoton NAU88C10 mono audio codec

description: |
  The codec has a single ADC and a single DAC channel and only uses the left
  slot of the audio interface, whatever the number of channels the controller
  sends.

compatible: "nuvoton,nau88c10"

include: [i2c-device.yaml]

properties:
  reg:
    required: true

  mic-single-ended:
    type: boolean
    description: |
      The microphone is wired to MIC+ only and MIC- is left unconnected. By
      default the microphone is assumed to be wired differentially across MIC+
      and MIC-.
```
