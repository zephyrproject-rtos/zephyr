## dts/bindings/display/ftdi,ft800.yaml
```yaml
# Copyright (c) 2020 Hubert Miś <hubert.mis@gmail.com>
# SPDX-License-Identifier: Apache-2.0

description: FTDI FT800 graphic controller

compatible: "ftdi,ft800"

include: spi-device.yaml

properties:
  irq-gpios:
    type: phandle-array
    description: Optional IRQ line of FT800 controller

  pclk:
    type: int
    required: true
    description: |
      The value to divide the main clock by for PCLK. If the
      typical main clock was 48MHz and this value is 5, the PCLK
      will be 9.6 MHz. Must be positive value to enable the screen

  pclk-pol:
    type: int
    required: true
    description: |
      Polarity of PCLK. If it is set to zero, PCLK polarity is on
      the rising edge. If it is set to one, PCLK polarity is on
      the falling edge.

  cspread:
    type: int
    required: true
    description: |
      Controls the transition of RGB signals with PCLK active clock
      edge. When set to 0, R[7:2],G[7:2] and B[7:2] signals change
      following the active edge of PCLK. When set to 1, R[7:2]
      changes a PCLK clock early and B[7:2] a PCLK clock later,
      which helps reduce the system noise.

  swizzle:
    type: int
    required: true
    description: |
      Controls the arrangement of output RGB pins, which may help
      support different LCD panel. Please check FT800 Programmers
      Guide for details.

  vsize:
    type: int
    required: true
    description: Number of visible lines of pixels in one frame

  voffset:
    type: int
    required: true
    description: Number of invisible lines at the beginning of a new frame

  vcycle:
    type: int
    required: true
    description: |
      Number of all lines in a frame. It includes all visible and
      invisible lines at the beginning and at the end of a frame.

  vsync0:
    type: int
    required: true
    description: |
      Number of lines for the high state of signal VSYNC at
      the start of new frame.

  vsync1:
    type: int
    required: true
    description: |
      Number of lines for signal VSYNC toggle takes at the start
      of new frame.

  hsize:
    type: int
    required: true
    description: Number of PCLK cycles per visible part of horizontal line

  hoffset:
    type: int
    required: true
    description: |
      Number of PCLK cycles before pixels are scanned out for
      given line

  hcycle:
    type: int
    required: true
    description: Number of total PCLK cycles per horizontal line scan.

  hsync0:
    type: int
    required: true
    description: Number of PCLK cycles of HSYNC high state during start of
      line

  hsync1:
    type: int
    required: true
    description: Number of PCLK cycles for HSYNC toggle during start of line.
```

## dts/bindings/display/galaxycore,gc9x01x.yaml
```yaml
# Copyright (c) 2023 Mr Beam Lasers GmbH.
# Copyright (c) 2023 Amrith Venkat Kesavamoorthi <amrith@mr-beam.org>
# Copyright (c) 2023 Martin Kiepfer <mrmarteng@teleschirm.org>
# SPDX-License-Identifier: Apache-2.0

description: |
  GC9X01X display driver.

  This driver implements support for various GC9X01X graphics
  controllers and different display sizes. It has been validated
  for following controllers:
   - GC9101A: (Waveshare 240x240, 1.28inch round lcd display 240x240)

  Here is an example to define a display interface:

  &spi2 {
    gc9a01a_lcd: gc9a01a_lcd@0 {
      compatible = "galaxycore,gc9x01x";
      reg = <0>;
      spi-max-frequency = <100000000>;
      cmd-data-gpios = <&gpio0 4 GPIO_ACTIVE_HIGH>;
      reset-gpios = <&gpio0 8 GPIO_ACTIVE_LOW>;
      pixel-format = <PANEL_PIXEL_FORMAT_RGB_565>;

      width = <240>;
      height = <240>;
      pixel-format = <GC9X01X_PIXEL_FORMAT_RGB565>;
    };
  };


compatible: "galaxycore,gc9x01x"

include: [spi-device.yaml, display-controller.yaml, lcd-controller.yaml]

properties:
  reset-gpios:
    type: phandle-array
    required: true
    description: |
      RESET pin of the GC9X01X.
      If connected directly the MCU pin should be configured
      as active low.

  cmd-data-gpios:
    type: phandle-array
    required: true
    description: |
      Data/Command pin of the GC9X01X is to be configured
      high(1) for data, low(0) for command.

  orientation:
    type: string
    default: "normal"
    enum:
      - "normal"
      - "90"
      - "180"
      - "270"
    description: Display orientation (CW) in degrees.

  display-inversion:
    type: boolean
    description: |
      Display inversion mode. Every bit is inverted from the frame memory to
      the display.

  pwrctrl1:
    type: uint8-array
    default: [
      0x00
    ]
    description: Power-control 1 register value

  pwrctrl2:
    type: uint8-array
    default: [
      0x13
    ]
    description: Power-control 2 register value

  pwrctrl3:
    type: uint8-array
    default: [
      0x13
    ]
    description: Power-control 3 register value

  pwrctrl4:
    type: uint8-array
    default: [
      0x22
    ]
    description: Power-control 4 register value

  gamma1:
    type: uint8-array
    default: [
      0x45,
      0x09,
      0x08,
      0x08,
      0x26,
      0x2A
    ]
    description: Gamma correction 1 register values (negative polarity)

  gamma2:
    type: uint8-array
    default: [
      0x43,
      0x70,
      0x72,
      0x36,
      0x37,
      0x6F
    ]
    description: Gamma correction 3 register values

  gamma3:
    type: uint8-array
    default: [
      0x45,
      0x09,
      0x08,
      0x08,
      0x26,
      0x2A
    ]
    description: Gamma correction 3 register values (positive polarity)

  gamma4:
    type: uint8-array
    default: [
      0x43,
      0x70,
      0x72,
      0x36,
      0x37,
      0x6F
    ]
    description: Gamma correction 4 register values

  framerate:
    type: uint8-array
    default: [
      0x34
    ]
    description: Framerate register value
```

## dts/bindings/display/gooddisplay,ek79652.yaml
```yaml
# Copyright (c) 2021, Linumiz
# SPDX-License-Identifier: Apache-2.0

description: EK79652 EPD display controller

compatible: "gooddisplay,ek79652"

include: spi-device.yaml

properties:
    height:
      type: int
      required: true
      description: Height in pixel of the panel driven by the controller

    width:
      type: int
      required: true
      description: Width in pixel of the panel driven by the controller

    reset-gpios:
      type: phandle-array
      required: true
      description: |
        RESET pin.

        The RESET pin of EK79652 is active low.
        If connected directly the MCU pin should be configured
        as active low.

    dc-gpios:
      type: phandle-array
      required: true
      description: |
        DC pin.

        The DC pin of EK79652 is active low (transmission command byte).
        If connected directly the MCU pin should be configured
        as active low.

    busy-gpios:
      type: phandle-array
      required: true
      description: |
        BUSY pin.

        The BUSY pin of EK79652 is active low.
        If connected directly the MCU pin should be configured
        as active low.

    pwr:
      type: uint8-array
      required: true
      description: Power Setting (PWR) values

    softstart:
      type: uint8-array
      required: true
      description: Booster Soft Start (BTST) values

    cdi:
      type: int
      required: true
      description: VCOM and data interval value

    pwropt:
      type: uint8-array
      required: false
      description: Power optimization value
```

## dts/bindings/display/gooddisplay,gd7965.yaml
```yaml
# Copyright (c) 2020, Phytec Messtechnik GmbH
# SPDX-License-Identifier: Apache-2.0

description: GD7965 EPD display controller

compatible: "gooddisplay,gd7965"

include: [spi-device.yaml, display-controller.yaml]

properties:
    reset-gpios:
      type: phandle-array
      required: true
      description: RESET pin.

        The RESET pin of GD7965 is active low.
        If connected directly the MCU pin should be configured
        as active low.

    dc-gpios:
      type: phandle-array
      required: true
      description: DC pin.

        The DC pin of GD7965 is active low (transmission command byte).
        If connected directly the MCU pin should be configured
        as active low.

    busy-gpios:
      type: phandle-array
      required: true
      description: BUSY pin.

        The BUSY pin of GD7965 is active low.
        If connected directly the MCU pin should be configured
        as active low.

    pwr:
      type: uint8-array
      required: true
      description: Power Setting (PWR) values

    softstart:
      type: uint8-array
      required: true
      description: Booster Soft Start (BTST) values

    cdi:
      type: int
      required: true
      description: VCOM and data interval value

    tcon:
      type: int
      required: true
      description: TCON setting value
```
