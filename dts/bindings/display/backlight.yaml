## dts/bindings/display/backlight.yaml
```yaml
# Copyright (c) 2024, Martin Kiepfer
# SPDX-License-Identifier: Apache-2.0

include: [base.yaml]

properties:
  init-level:
    type: int
    default: 80
    description: Initial value of the Backlight.

  disable-init-on-boot:
    type: boolean
    description: |
      Disable the initial value during bootup of the device. By default the
      init-level is applied on boot. This option can prevent from this default
      behaviour. Backlight needs to be enabled manually later in this case.

  label:
    type: string
    description: |
      Human readable string describing the Backlight. It can be used by an
      application to identify this Backlight or to retrieve its
      number/index (i.e. child node number) on the parent device.
```

## dts/bindings/display/charlieplex-led-matrix.yaml
```yaml
# Copyright (c) 2026 Qualcomm Innovation Center, Inc.
# SPDX-License-Identifier: Apache-2.0

description: |
  Monochrome / grayscale LED matrix driven by charlieplexed GPIOs.

  N GPIO lines drive up to N*(N-1) LEDs. Each pixel is lit by driving one of
  the GPIO lines high and one low while all the other lines are held at high
  impedance (input / disconnected). A timer (counter device) ISR scans the
  pixels one at a time, fast enough that persistence of vision makes the whole
  matrix appear lit. Grayscale is produced by modulating, per pixel, the
  fraction of scan cycles in which that pixel is driven.

  The framebuffer is laid out row-major (pixel index = y * width + x); the
  pixel-pairs property maps each framebuffer pixel to the pair of GPIO lines
  that light it.

compatible: "charlieplex-led-matrix"

include: display-controller.yaml

properties:
  gpios:
    type: phandle-array
    required: true
    description: |
      The bank of charlieplexed GPIO lines that pixel-pairs indexes into. All
      lines must be on GPIO controllers that support configuring a pin as
      disconnected/high-impedance (the default for any standard Zephyr GPIO
      controller).

      The per-line GPIO polarity flag (e.g. GPIO_ACTIVE_LOW) is ignored: the
      driver drives each line at physical levels, and every line is driven both
      high and low across a scan depending on which pixel is lit, so polarity
      has no meaning here. Use flags 0 (GPIO_ACTIVE_HIGH); a stray polarity
      flag is harmless.

  counter:
    type: phandle
    required: true
    description: Timer instance used as the scan time source.

  refresh-frequency:
    type: int
    required: true
    description: Target whole-matrix refresh rate in Hz (e.g. 100).

  pixel-pairs:
    type: array
    required: true
    description: |
      One entry per pixel, in framebuffer (row-major) order; length must equal
      width * height. Each entry encodes the pair of GPIO lines that light that
      pixel as (high_index << 8) | low_index, where the indices are positions
      in the gpios list. The pixel is lit by driving gpios[high_index] high and
      gpios[low_index] low.

  grayscale-bits:
    type: int
    required: true
    enum:
      - 1
      - 2
      - 3
      - 4
    description: |
      Number of brightness bits per pixel. 1 = monochrome (on/off). Higher
      values trade refresh headroom for brightness levels (2^bits levels).

examples:
  - |
    /* 2x2 matrix on 3 charlieplexed lines */
    / {
        matrix: charlieplex-led-matrix {
            compatible = "charlieplex-led-matrix";
            gpios = <&gpioa 0 0>, <&gpioa 1 0>, <&gpioa 2 0>;
            counter = <&timer0>;
            refresh-frequency = <100>;
            width = <2>;
            height = <2>;
            grayscale-bits = <1>;
            /* (high << 8) | low, framebuffer order */
            /* pixel-pairs[0] = 0x0001 -> (0,0) lit by gpios[0] high, gpios[1] low */
            pixel-pairs = <0x0001 0x0100 0x0002 0x0200>;
        };
    };
```

## dts/bindings/display/chipone,co5300.yaml
```yaml
# Copyright 2025 NXP
# SPDX-License-Identifier: Apache-2.0

title: CO5300 display controller

description: The Chipone CO5300 is a Circular Display Controller

compatible: "chipone,co5300"

include: [mipi-dsi-device.yaml, display-controller.yaml]

properties:
  reset-gpios:
    type: phandle-array
    description: |
      The RESETn pin is asserted to disable the controller causing a hard
      reset.  The controller receives this as an active-low signal.

  backlight-gpios:
    type: phandle-array
    description: |
      The BLn pin is asserted to control the backlight of the panel.
      The controller receives this as an active-high signal.

  tear-effect-gpios:
    type: phandle-array
    description: |
      The tearing effect pin is asserted by the controller at a display
      VSYNC interval. This permits the controller to send new display
      data during a VSYNC interval, removing tearing.

  pitch-align:
    type: int
    default: 1
    description: |
      The CO5300 driver maintains an internal frame buffer. This property
      serves for defining a pitch for it that's compliant with the SoC's
      display controller's requirements.

  addr-align:
    type: int
    default: 1
    description: |
      The CO5300 driver maintains an internal frame buffer. This property
      serves for defining an alignment for its address that's compliant
      with the SoC's display controller's requirements.

  ext-ram:
    type: phandle
    description: |
      Secondary RAM in which the panel controller's frame buffer will
      be stored. If not defined, the 'zephyr,ram' chosen memory will be used.
```

## dts/bindings/display/chipwealth,ch1115-i2c.yaml
```yaml
# Copyright (c) 2026 MASSDRIVER EI (massdriver.space)
# SPDX-License-Identifier: Apache-2.0

title: CH1115 128x64 dot-matrix display controller on I2C bus

description: |
    The Chipwealth CH1115 is a monochrome OLED controller with a maximum 128x64 resolution.

compatible: "chipwealth,ch1115"

include: ["solomon,ssd1306-common.yaml", "i2c-device.yaml"]
```

## dts/bindings/display/chipwealth,ch1115-spi.yaml
```yaml
# Copyright (c) 2026 MASSDRIVER EI (massdriver.space)
# SPDX-License-Identifier: Apache-2.0

title: CH1115 128x64 dot-matrix display controller on SPI bus

description: |
    The Chipwealth CH1115 is a monochrome OLED controller with a maximum 128x64 resolution.

compatible: "chipwealth,ch1115"

include: ["solomon,ssd1306-common.yaml", "spi-device.yaml"]

properties:
  data-cmd-gpios:
    type: phandle-array
    required: true
    description: D/C# pin.
```

## dts/bindings/display/chipwealth,ch1116-i2c.yaml
```yaml
# Copyright (c) 2026 MASSDRIVER EI (massdriver.space)
# SPDX-License-Identifier: Apache-2.0

title: CH1116 132x64 dot-matrix display controller on I2C bus

description: |
    The Chipwealth CH1116 is a monochrome OLED controller with a maximum 132x64 resolution.

compatible: "chipwealth,ch1116"

include: ["solomon,ssd1306-common.yaml", "i2c-device.yaml"]
```

## dts/bindings/display/chipwealth,ch1116-spi.yaml
```yaml
# Copyright (c) 2026 MASSDRIVER EI (massdriver.space)
# SPDX-License-Identifier: Apache-2.0

title: CH1116 132x64 dot-matrix display controller on SPI bus

description: |
    The Chipwealth CH1116 is a monochrome OLED controller with a maximum 132x64 resolution.

compatible: "chipwealth,ch1116"

include: ["solomon,ssd1306-common.yaml", "spi-device.yaml"]

properties:
  data-cmd-gpios:
    type: phandle-array
    required: true
    description: D/C# pin.
```

## dts/bindings/display/display,zc143ac72mipi.yaml
```yaml
# Copyright 2025 NXP
# SPDX-License-Identifier: Apache-2.0

description: NXP ---

compatible: "display,zc143ac72mipi"
```

## dts/bindings/display/display-backlight-common.yaml
```yaml
# Copyright (c) 2024 Fabian Blatz <fabianblatz@gmail.com>
# Common fields for display backlights

include: base.yaml

properties:
  default-brightness:
    type: int
    description: |
      Brightness applied on display initialization in the range 0-255.
      If not specified, the default value is 0.

  backlight-enable-gpios:
    type: phandle-array
    description: |
      External GPIO handles for enabling the backlight.
      The backlight is enabled when the GPIO is set to the active state.

  backlight-pwms:
    type: phandle-array
    description: |
      External PWM handles for controlling the backlight.
```

## dts/bindings/display/display/Kconfig.intel_multibootfb
```kconfig
# Copyright (c) 2017 Intel Corporation
# SPDX-License-Identifier: Apache-2.0

config INTEL_MULTIBOOTFB_DISPLAY
	bool "Intel Multiboot Framebuffer"
	default y
	depends on MULTIBOOT && MULTIBOOT_INFO && \
		   DT_HAS_INTEL_MULTIBOOT_FRAMEBUFFER_ENABLED
	help
	  Enable Intel Multiboot framebuffer-based display driver.
```

## dts/bindings/display/display/Kconfig.otm8009a
```kconfig
# Copyright (c) 2023 bytes at work AG
# SPDX-License-Identifier: Apache-2.0

config OTM8009A
	bool "OTM8009A display driver"
	default y
	depends on DT_HAS_ORISETECH_OTM8009A_ENABLED
	select MIPI_DSI
	help
	  Enable driver for OTM8009A display driver.

if OTM8009A

config DISPLAY_OTM8009A_INIT_PRIORITY
	int "Initialization priority"
	default DISPLAY_INIT_PRIORITY
	help
	  OTM8009A display driver initialization priority.

endif
```

## dts/bindings/display/display/Kconfig.rm68200
```kconfig
# Copyright 2022, NXP
# SPDX-License-Identifier: Apache-2.0

config RM68200
	bool "RM68200 display driver"
	default y
	depends on MIPI_DSI
	depends on DT_HAS_RAYDIUM_RM68200_ENABLED
	help
	  Enable driver for RM68200 display driver.
```

## dts/bindings/display/display_mipi_dbi.yaml
```yaml
#
# Copyright 2023, NXP
#
# SPDX-License-Identifier: Apache-2.0
#

description: Display DBI driver

compatible: "display_mipi_dbi"

include: [display-controller.yaml]

properties:
  bl-gpios:
    type: phandle-array
    description: |
      The BLn pin is asserted to control the backlight of the panel.
      The sensor receives this as an active-high signal.

  te-gpios:
    type: phandle-array
    description: |
      The tearing effect pin is asserted by the controller at a display
      VSYNC interval. This permits the controller to send new display
      data during a VSYNC interval, removing tearing.

  current-pixel-format:
    type: int
    required: true
    description:
      Pixel format. Available formats in display_pixel_format in inclu/zephyr/drivers/display.h.
```

## dts/bindings/display/ea,eadogs164.yaml
```yaml
# Copyright (c) 2020
# SPDX-License-Identifier: Apache-2.0

description: Electronics Assembly Display

compatible: "ea,eadogs164"

include: i2c-device.yaml
```

## dts/bindings/display/eink,ac057tc1.yaml
```yaml
# Copyright (c) 2026 Fabian Blatz <fabianblatz@gmail.com>
# SPDX-License-Identifier: Apache-2.0

title: E-Ink AC057TC1 Display Controller

description: |
  Controller of E-Ink AC057TC1 (or (AB1024-EGA) 5.7-inch seven-color electrophoretic display.

compatible: "eink,ac057tc1"

include:
  - display-controller.yaml
  - name: mipi-dbi-spi-device.yaml
    property-blocklist:
      - te-delay

properties:
  busy-gpios:
    type: phandle-array
    description: Busy/status GPIO
```

## dts/bindings/display/eink,ed2208-doa.yaml
```yaml
# Copyright (c) 2026 The Zephyr Project Contributors
# SPDX-License-Identifier: Apache-2.0

title: E-Ink ED2208-DOA (EL040EF1) Display Controller

description: |
  Controller of the E-Ink ED2208-DOA (EL040EF1) Spectra 6 e-ink display.

compatible: "eink,ed2208-doa"

include: eink,ed2208-gca.yaml
```

## dts/bindings/display/eink,ed2208-gca.yaml
```yaml
# Copyright (c) 2026 The Zephyr Project Contributors
# SPDX-License-Identifier: Apache-2.0

title: E-Ink ED2208-GCA (EL073TF1) Display Controller

description: |
  Controller of the E-Ink ED2208-GCA (EL073TF1) Spectra 6 e-ink displays.

compatible: "eink,ed2208-gca"

include:
  - display-controller.yaml
  - name: mipi-dbi-spi-device.yaml
    property-blocklist:
      - te-delay

properties:
  busy-gpios:
    type: phandle-array
    required: true
    description: |
      BUSY_N status GPIO.

      The BUSY_N pin is active low. If connected directly the MCU pin
      should be configured as active low.
```

## dts/bindings/display/espressif,esp32-lcd.yaml
```yaml
# Copyright (c) 2026 NotioNext LTD.
# SPDX-License-Identifier: Apache-2.0

description: ESP32-S3 LCD display driver

compatible: "espressif,esp32-lcd"

include: [display-controller.yaml, spi-device.yaml]

properties:
  width:
    type: int
    required: true
    description: Display width in pixels

  height:
    type: int
    required: true
    description: Display height in pixels

  pixel-format:
    type: int
    default: 0
    enum:
      - 0  # RGB565
    description: Display pixel format (only RGB565 supported)

  rotation:
    type: int
    default: 0
    enum:
      - 0
      - 90
      - 180
      - 270
    description: Display rotation in degrees

  dc-gpios:
    type: phandle-array
    required: true
    description: Data/Command GPIO

  reset-gpios:
    type: phandle-array
    required: true
    description: Reset GPIO
```

## dts/bindings/display/frida,nt35510.yaml
```yaml
# Copyright (c) 2024 Erik Andersson <erian747@gmail.com>
# SPDX-License-Identifier: Apache-2.0

title: Novatek NT35510 Display Driver

description: |
    The Novatek NT35510 is a 16.7M colors TFT-LCD controller
    with a maximum 480RGBx864 resolution.

    It supports display panels such as Shenzhen Frida LCD FRD397B2509.

compatible: "frida,nt35510"

include: [mipi-dsi-device.yaml, display-controller.yaml]

properties:
  reset-gpios:
    type: phandle-array
    description: |
      Hardware based reset gpio pin
      Setting a low level will hold NT35510 in reset

  bl-gpios:
    type: phandle-array
    description: |
      The BLn pin is asserted to turn on the backlight of the panel.
      Note that some boards may use software control instead
      and don't have this pin connected

  rotation:
    type: int
    default: 0
    enum:
      - 0
      - 90
      - 180
      - 270
    description: |
      Display rotation clockwise in degrees. Defaults to 0, display default.
```

## dts/bindings/display/fsl,imx6sx-lcdif.yaml
```yaml
# Copyright (c) 2019, NXP
# SPDX-License-Identifier: Apache-2.0

description: NXP i.MX eLCDIF (Enhanced LCD Interface) controller

compatible: "fsl,imx6sx-lcdif"

include: base.yaml

properties:
    reg:
      required: true

    interrupts:
      required: true

    label:
      required: true

    lcd:
      type: phandle
      required: false
      description: phandle of the lcd device connected to eLCDIF
```
