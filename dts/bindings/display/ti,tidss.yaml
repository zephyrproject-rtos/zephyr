## dts/bindings/display/ti,tidss.yaml
```yaml
# Copyright (c) 2024 Texas Instruments Incorporated
# SPDX-License-Identifier: Apache-2.0

description: |
  TI K3 family Display Sub-System (DSS) controller — generic binding.

  Supports any TI DSS variant regardless of how many VP/OVR/VID/VIDL
  blocks exist in hardware.  The DT node always describes exactly ONE
  pipeline triple that the driver shall use:

    DDR framebuffer  →  one video plane (VID or VIDL)
    →  one Overlay (OVR)  →  one Video Port (VP)
    →  OLDI TX or DPI pad

  The DSS register space must be split into four named MMIO regions:
    "common"  — top-level control, interrupt routing, MFLAG
    "vid"     — the video plane registers to use (vid, vidl1, vid2 …)
    "ovr"     — the overlay registers to use (ovr1, ovr2 …)
    "vp"      — the video port registers to use (vp1, vp2 …)

  These are LOGICAL names — the physical addresses in 'reg' select
  which actual hardware block is used.  This lets the same driver work
  on AM62L (1 VP, 1 VIDL), AM62P51/52 (2 VPs, 1 VID + 1 VIDL), or
  any future variant without driver changes.

  Panel timing must be provided via a child node named display-timings
  with compatible "zephyr,panel-timing".  Example::

    display-timings {
      compatible = "zephyr,panel-timing";
      clock-frequency  = <148500000>;
      hfront-porch     = <88>;
      hback-porch      = <148>;
      hsync-len        = <44>;
      vfront-porch     = <4>;
      vback-porch      = <36>;
      vsync-len        = <5>;
      hsync-active     = <1>;
      vsync-active     = <1>;
      de-active        = <1>;
      pixelclk-active  = <0>;
    };

  Supported SoC variants and their typical wiring
  ────────────────────────────────────────────────
  AM62L (single DSS):
    reg-names = "common", "vid", "ovr", "vp"
    physical  =  common(0x30200000), vidl1(0x30202000),
                 ovr1(0x30207000),   vp1(0x3020a000)
    ti,vp-index   = <0>   (VP1 = index 0)
    ti,vid-channel = <1>   (VIDL1)

  AM62P51 DSS0 — using VP2 (DPI):
    reg-names = "common", "vid", "ovr", "vp"
    physical  =  common(0x30200000), vidl1(0x30202000),
                 ovr2(0x30208000),   vp2(0x3020b000)
    ti,vp-index   = <1>   (VP2 = index 1)
    ti,vid-channel = <1>   (VIDL1)

compatible: "ti,tidss"

include: [display-controller.yaml, pinctrl-device.yaml]

properties:
  reg:
    required: true
    description: |
      Four MMIO register regions, always in the order:
        common, vid, ovr, vp
      "vid", "ovr", and "vp" hold the physical base addresses of
      whichever hardware blocks are selected for this output pipeline.

  reg-names:
    required: true
    type: string-array
    description: |
      Names for each entry in 'reg'.  Must be exactly:
        "common", "vid", "ovr", "vp"

  ti,vp-index:
    type: int
    required: true
    description: |
      0-based index of the Video Port used by this pipeline.
        0 = VP1 (first hardware VP)
        1 = VP2 (second hardware VP)

  ti,vid-channel:
    type: int
    required: true
    enum:
      - 0   # full VID plane  (vid)
      - 1   # lite VID plane  (vidl1)
    description: |
      CHANNELIN value written to DSS_OVR_ATTRIBUTES[4:1].
        0 = full VID plane connected to the overlay input
        1 = VIDL1 (lite) plane connected to the overlay input
      Use 0 when the 'vid' region points to a full VID plane,
      use 1 when it points to a VIDL (lite) plane such as vidl1.

  clocks:
    required: true
    description: |
      Phandle(s) to the clock controller(s).  Must have entries named
      "vp" (VP pixel clock) and "fclk" (DSS functional clock).
      "vp" is a logical name — map it to whichever physical VP pixel
      clock (vp1, vp2 …) is used by this pipeline.

  clock-names:
    required: true
    type: string-array
    description: Clock names.  Must include "vp" and "fclk".

  interrupts:
    required: true
    description: DSS interrupt line.

  interrupt-names:
    type: string-array
    description: Optional label for the interrupt (e.g. "vp0", "vp1").

  data-width:
    type: int
    required: true
    enum:
      - 12
      - 16
      - 18
      - 24
      - 30
      - 36
    description: |
      Output data bus width in bits.  Encoded into DSS_VP_CONTROL[10:8].
      Typical values are 18 (18-bit DPI) or 24 (24-bit DPI / OLDI JEIDA-24).
```

## dts/bindings/display/ultrachip,uc8151d.yaml
```yaml
# Copyright (c) 2025 Cactus Engineering S.L
# SPDX-License-Identifier: Apache-2.0

description: |
  UltraChip UC8151D EPD controller with native 160x296 monochrome (1bpp)
  display support.

compatible: "ultrachip,uc8151d"

include: ultrachip,uc81xx-common.yaml
```

## dts/bindings/display/ultrachip,uc8175.yaml
```yaml
# Copyright (c) 2022 Andreas Sandberg
# SPDX-License-Identifier: Apache-2.0

description: UltraChip UC8175 EPD controller

compatible: "ultrachip,uc8175"

include: ultrachip,uc81xx-common.yaml
```

## dts/bindings/display/ultrachip,uc8176.yaml
```yaml
# Copyright (c) 2022 Andreas Sandberg
# SPDX-License-Identifier: Apache-2.0

description: UltraChip UC8176 EPD controller

compatible: "ultrachip,uc8176"

include: ultrachip,uc81xx-common.yaml
```

## dts/bindings/display/ultrachip,uc8179.yaml
```yaml
# Copyright (c) 2022 Andreas Sandberg
# SPDX-License-Identifier: Apache-2.0

description: UltraChip UC8179 EPD controller

compatible: "ultrachip,uc8179"

include: ultrachip,uc81xx-common.yaml
```

## dts/bindings/display/ultrachip,uc81xx-common.yaml
```yaml
# Copyright (c) 2022 Andreas Sandberg
# Copyright (c) 2020, Phytec Messtechnik GmbH
# SPDX-License-Identifier: Apache-2.0

description: UltraChip UC81xx EPD display controller common properties

include: [spi-device.yaml, display-controller.yaml]

properties:
    reset-gpios:
      type: phandle-array
      required: true
      description: RESET pin.

        The RESET pin of UC81xx is active low.
        If connected directly the MCU pin should be configured
        as active low.

    dc-gpios:
      type: phandle-array
      required: true
      description: DC pin.

        The DC pin of UC81xx is active low (transmission command byte).
        If connected directly the MCU pin should be configured
        as active low.

    busy-gpios:
      type: phandle-array
      required: true
      description: BUSY pin.

        The BUSY pin of UC81xx is active low.
        If connected directly the MCU pin should be configured
        as active low.

    softstart:
      type: uint8-array
      required: false
      description: Booster Soft Start (BTST) values

child-binding:
  description: |
    Child nodes describe refresh profiles. Each refresh profile
    specifies a set of voltages used to drive the refresh
    cycle. Refresh nodes are optional and are used to override
    defaults loaded from the controllers OTP memory.

    The driver typically looks for the following child nodes:

      - 'full' - Normal / full refresh.

  properties:
    pwr:
      type: uint8-array
      required: false
      description: Power Setting (PWR) values

    cdi:
      type: int
      required: false
      description: |
        VCOM and data interval value. This value is optional but must
        be provided to enable border refresh control.

    tcon:
      type: int
      required: false
      description: TCON setting value
```

## dts/bindings/display/waveshare,7.yaml
```yaml
# Copyright (c) 2026 Infineon Technologies AG,
# or an affiliate of Infineon Technologies AG.
#
# SPDX-License-Identifier: Apache-2.0

title: Waveshare 7" Display Driver

description: |
    Waveshare display shields consist of a DPI panel and a controller board.
    The controller board consists of ICN6211 DSI-to-RGB bridge and an MCU, to
    convert DSI to DPI and control the backlight.
    This binding treats the controller board as a whole unit.

compatible: "waveshare,7"

include: [base.yaml, display-controller.yaml]

on-bus: i2c

properties:
  reg:
    required: true

  pixel-format:
    type: int
    required: true
    description:
      Pixel format. Available formats in include/zephyr/dt-bindings/display/panel.h
```

## dts/bindings/display/waveshare,7inch-dsi-lcd-c.yaml
```yaml
#
# Copyright 2025 NXP
#
# SPDX-License-Identifier: Apache-2.0
#

description: Waveshare 7INCH DSI LCD(C)

compatible: "waveshare,7inch-dsi-lcd-c"

include: base.yaml

properties:
  reg:
    required: true

  data-lanes:
    type: array
    required: true
    description:
      Number of data lanes.

  pixel-format:
    type: int
    required: true
    description:
      Pixel format. Available formats in dt-bindings/mipi_dsi/mipi_dsi.h.

  mipi-dsi:
    type: phandle
    required: true
    description:
      Instance of the MIPI DSI peripheral.
```

## dts/bindings/display/waveshare,dsi2dpi.yaml
```yaml
#
# Copyright 2025 NXP
#
# SPDX-License-Identifier: Apache-2.0
#

title: Waveshare DSI-to-DPI display bridge

description: |
    Waveshare display shields consist of a DPI panel and a controller board.
    The controller board consists of ICN6211 DSI-to-RGB bridge and an MCU, to
    convert DSI to DPI and control the backlight.
    This binding treats the controller board as a whole unit.

compatible: "waveshare,dsi2dpi"

include: base.yaml

on-bus: i2c

properties:
  reg:
    required: true

  data-lanes:
    type: array
    required: true
    description:
      Number of data lanes.

  pixel-format:
    type: int
    required: true
    description:
      Pixel format. Available formats in dt-bindings/mipi_dsi/mipi_dsi.h.

  mipi-dsi:
    type: phandle
    required: true
    description:
      Instance of the MIPI DSI peripheral.
```

## dts/bindings/display/waveshare,gc9a01a.yaml
```yaml
# Copyright (c) 2018, Jan Van Winkel <jan.van_winkel@dxplore.eu>
# Copyright (c) 2020, Teslabs Engineering S.L.
# Copyright (c) 2023 Mr Beam Lasers GmbH.
# Copyright (c) 2023 Amrith Venkat Kesavamoorthi <amrith@mr-beam.org> 
# SPDX-License-Identifier: Apache-2.0

description: GC9A01A 240x240 circular display controller

compatible: "waveshare,gc9a01a"

include: [spi-device.yaml, display-controller.yaml]

properties:
    reset-gpios:
      type: phandle-array
      required: true
      description: RESET pin

        The RESET pin of the GC9A01A is active low.
        If connected directly the MCU pin should be configured
        as active low.
    
    cmd-data-gpios:
      type: phandle-array
      required: true
      description: Command/Data pin
        The Data/Command pin of the GC9A01A is to be configured
        high(1) for data, low(0) for command.

    pixel-format:
      type: int
      default: 0
      enum:
        - 0 # RGB565
        - 1 # RGB888
      description:
        Display pixel format. Note that when RGB888 pixel format is selected
        only 6 color bits are actually used being in practice equivalent to
        RGB666.

    rotation:
      type: int
      default: 0
      enum:
        - 0
        - 90
        - 180
        - 270
      description:
        Display rotation (CW) in degrees.
    
    display-inversion:
      type: boolean
      description:
        Display inversion mode. Every bit is inverted from the frame memory to
        the display.

    backlight-gpios:
      type: phandle
      required: true
      description: Display Backlight PWM setting
```

## dts/bindings/display/zephyr,displays.yaml
```yaml
# Copyright (c) 2025 Abderrahmane JARMOUNI
# SPDX-License-Identifier: Apache-2.0

description: |
  Display controllers to pass to graphical libraries like LVGL.
  Only one node with this compatible is allowed in the DeviceTree

compatible: "zephyr,displays"

properties:
  displays:
    type: phandles
    required: true
    description: |
      Nodes of display controllers for graphical libraries to use
```

## dts/bindings/display/zephyr,downsampling-dither-proxy.yaml
```yaml
# Copyright (c) 2026 MASSDRIVER EI (massdriver.space)
# SPDX-License-Identifier: Apache-2.0

title: Display proxy for downsampled dithering

description: |
  Provide a mock display exposing the desired downsampling resolution and input format to APIs
  that consume display peripherals.

compatible: "zephyr,downsampling-dither-proxy"

include: display-controller.yaml

properties:
  display-device:
    type: phandle
    required: true
    description: |
      The real display this proxies.

  pixel-format:
    type: int
    required: true
    enum:
      - 1 # PANEL_PIXEL_FORMAT_RGB_888
      - 16 # PANEL_PIXEL_FORMAT_RGB_565
      - 64 # PANEL_PIXEL_FORMAT_L_8
    description: |
      The pixel format exposed.

  target-pixel-format:
    type: int
    required: true
    enum:
      - 2 # PANEL_PIXEL_FORMAT_MONO01
      - 4 # PANEL_PIXEL_FORMAT_MONO10
    description: |
      The pixel format to convert to.

  algorithm:
    type: string
    default: "NONE"
    enum:
      - "NONE"
      - "MINIMAL_ERROR"
      - "MINIMAL_ERROR_DISTRIBUTED"
    description: |
      The algorithm used to dither the buffers.
      - NONE: Simply copy and scale data without dithering
      - MINIMAL_ERROR: Naive but fastest error-propagation dithering, it is sensible to
          spatial specificities of the displays but often more appropriate for small displays.
      - MINIMAL_ERROR_DISTRIBUTED: Pull error from neighboring pixels similarly to
        atkinson dithering to reduce spatial artefacts.

      By default, do not do any dithering.
```

## dts/bindings/display/zephyr,dummy-dc.yaml
```yaml
# Copyright (c) 2021 Nordic Semiconductor ASA
# SPDX-License-Identifier: Apache-2.0

description: Dummy display controller

compatible: "zephyr,dummy-dc"

include: display-controller.yaml

properties:
  pixel-format:
    type: int
    default: 1
    enum:
      - 1  # PIXEL_FORMAT_RGB_888
      - 2  # PIXEL_FORMAT_MONO01
      - 4  # PIXEL_FORMAT_MONO10
      - 8  # PIXEL_FORMAT_ARGB_8888
      - 16 # PIXEL_FORMAT_RGB_565
      - 32 # PIXEL_FORMAT_BGR_565
    description:
      Display pixel format. Defaults to RGB888 since its the most common
      format of any native application.
```

## dts/bindings/display/zephyr,efi-gop-display.yaml
```yaml
# Copyright (c) 2025 rede97
# SPDX-License-Identifier: Apache-2.0

description: EFI GOP framebuffer display (runtime size from bootloader)

compatible: "zephyr,efi-gop-display"

include: display-controller.yaml

properties:
  width:
    type: int
    description: |
      Width in pixels (for LVGL static buffer sizing; driver uses EFI value at runtime).
    default: 1024
  height:
    type: int
    description: |
      Height in pixels (for LVGL static buffer sizing; driver uses EFI value at runtime).
    default: 768
```
