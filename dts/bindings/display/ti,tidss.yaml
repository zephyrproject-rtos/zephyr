## dts/bindings/display/zephyr,hub12.yaml
```yaml
# Copyright (c) 2025 Siratul Islam <sirat4757@gmail.com>
# SPDX-License-Identifier: Apache-2.0

description: |
  HUB12 interface monochrome LED matrix display controller.

  HUB12 is a standard interface for controlling monochrome LED matrix panels
  using shift registers. It works with any panel implementing the HUB12 protocol.

  This driver uses SPI for serial data transfer to the shift registers,
  plus additional GPIO pins for row address selection (PA, PB),
  output enable (PE), and data latching (PLAT).

  See:
  - https://www.auselectronicsdirect.com.au/assets/files/TA0094%20and%20TA0095%20user%20manual.pdf
  - https://www.researchgate.net/publication/377952697_Light_Emitting_Diode_LED_Matrix_Display_Board#pf7
  - https://buildcircuits.com/blogs/scoreduino-modules/exploring-led-display-interfaces-from-hub75-to-spi-and-beyond
  - https://www.iled.com/class/INNOVAEditor/assets/YeniDatasheets/2120-2124p10tekrenk.pdf

compatible: "zephyr,hub12"

include: [spi-device.yaml, display-controller.yaml]

properties:
  pa-gpios:
    type: phandle-array
    required: true
    description: Row address bit 0

  pb-gpios:
    type: phandle-array
    required: true
    description: Row address bit 1

  pe-gpios:
    type: phandle-array
    required: true
    description: Output enable control

  plat-gpios:
    type: phandle-array
    required: true
    description: Shift register latch

  width:
    type: int
    required: true
    enum:
      - 32
    description: |
      Display width in pixels. Must match the physical hardware panel.
      Currently only single 32-pixel wide panels are supported.

  height:
    type: int
    required: true
    enum:
      - 16
    description: |
      Display height in pixels. Must match the physical hardware panel.
      Standard HUB12 P10 panels are 16 pixels tall.
```

## dts/bindings/dma/adi,max32-dma.yaml
```yaml
# Copyright (c) 2023 Analog Devices, Inc.
# SPDX-License-Identifier: Apache-2.0

description: ADI MAX32 DMA

compatible: "adi,max32-dma"

include: dma-controller.yaml

properties:
  reg:
    required: true

  "#dma-cells":
    const: 2

# Parameter syntax
dma-cells:
  - channel
  - slot
```

## dts/bindings/dma/altr,msgdma.yaml
```yaml
# Copyright (c) 2021 Linaro Limited
# SPDX-License-Identifier: Apache-2.0

description: Altera mSGDMA (Modular Scatter-Gather DMA)

compatible: "altr,msgdma"

include: dma-controller.yaml

properties:
  reg:
    required: true

  interrupts:
    required: true

  "#dma-cells":
    const: 0
```

## dts/bindings/dma/amd,acp-sdw-dma.yaml
```yaml
# SPDX-FileCopyrightText: Copyright The Zephyr Project Contributors
# Copyright (c) 2026 AMD
# SPDX-License-Identifier: Apache-2.0

description: AMD SOF SoundWire DMA node

compatible: "amd,acp-sdw-dma"
properties:
  reg:
    type: array
    description: Register address and size of the DMA controller

  interrupts:
    type: array
    description: Interrupt specifier for the DMA controller

  dma-channels:
    type: int
    description: Number of DMA channels supported

  dma-requests:
    type: int
    description: Number of DMA requests supported

  clocks:
    type: phandle-array
    description: Clock(s) for the DMA controller
```

## dts/bindings/dma/amd,acp-tdm-dma.yaml
```yaml
# SPDX-FileCopyrightText: Copyright (c) 2026 AMD
# SPDX-License-Identifier: Apache-2.0

description: AMD ACP Unified TDM DMA (HS/SP/BT)

compatible: "amd,acp-tdm-dma"

include: dma-controller.yaml

"#dma-cells":
  - channel

properties:
  dma-channels:
    type: int
    description: Number of DMA channels supported
  dma-requests:
    type: int
    description: Number of DMA requests supported
```

## dts/bindings/dma/andestech,atcdmacx00.yaml
```yaml
#
#  Copyright (c) 2021 Andes Technology Corporation.
#
#  SPDX-License-Identifier: Apache-2.0

compatible: "andestech,atcdmacx00"

include: dma-controller.yaml

properties:
  reg:
    required: true

  interrupts:
    required: true

  chain-transfer:
    type: int

  max-data-width:
    type: int

  "#dma-cells":
    const: 3

dma-cells:
  - channel
  - slot
  - channel-config

description: |
  Andes DMA controller
  channel: a phandle to the DMA controller plus the following four integer cells:
    1. channel: the dma channel
    2. slot: DMA peripheral request ID
    3. channel-config: A 32bit mask specifying the DMA channel configuration
    which is device dependent:
        -bit 0-1 : Direction  (see dma.h)
                0x0: MEM to MEM
                0x1: MEM to PERIPH
                0x2: PERIPH to MEM
                0x3: reserved for PERIPH to PERIPH
        -bit 2 : Peripheral Increment Address
                0x0: no address increment between transfers
                0x1: increment address between transfers
        -bit 3 : Memory Increment Address
                0x0: no address increment between transfers
                0x1: increment address between transfers
        -bit 4-6 : Peripheral data size
                0x0: Byte (8 bits)
                0x1: Half-word (16 bits)
                0x2: Word (32 bits)
                0x3: Double word (64 bits)
                0x4: Quad word (128 bits)
                0x5: Eight word (256 bits)
                0x6-0x7: reserved
        -bit 7-9 : Memory data size
                0x0: Byte (8 bits)
                0x1: Half-word (16 bits)
                0x2: Word (32 bits)
                0x3: Double word (64 bits)
                0x4: Quad word (128 bits)
                0x5: Eight word (256 bits)
                0x6-0x7: reserved
        -bit 10 : Priority level
                0x0: lower priority
                0x1: higher priority

    examples for andes_v5_ae350 DMA instance
    dma0: dma0@f0c00000 {
         compatible = "andestech,atcdmac300";
         ...
         dma-channels = <8>;
         dma-requests = <16>;
         status = "disabled";
         label = "DMA_0";
    };

    For the client part, example for andes_ae350 DMA instance
    Tx using channel 2, slot 0
    Rx using channel 3, slot 1
    spi1: spi@f0f00000 {
         compatible = "andestech,atcspi200"
         dmas = <&dma0 2 0 0x0129>,
                <&dma0 3 1 0x012A>;
         dma-names = "tx", "rx";
    };
```

## dts/bindings/dma/arm,dma-pl330.yaml
```yaml
# Copyright 2020 Broadcom
# SPDX-License-Identifier: Apache-2.0

description: |
  PL330 DMA Controller

  A phandle to the DMA controller plus "channel" integer cell specifying
  channel to be used for data transfer

  Example for pl330 DMA Controller
     pl330: pl330@48300000 {
                  compatible = "arm,dma-pl330";
                  ...
                  dma-channels = <8>;
                  #dma-cells = <1>;
            };

  If PCIe EP client uses channel 0 for Tx DMA and channel 1 for Rx DMA
     pcie0_ep: pcie@4e100000 {
                  compatible = "brcm,iproc-pcie-ep";
                  ...
                  dmas = <&pl330 0>, <&pl330 1>;
                  dma-names = "txdma", "rxdma";
            };
compatible: "arm,dma-pl330"

include: dma-controller.yaml

properties:
  reg:
    required: true
  microcode:
    type: array
    required: true
    description: microcode's physical memory address
  "#dma-cells":
    const: 1

# Parameter syntax
dma-cells:
  - channel
```

## dts/bindings/dma/atmel,sam-xdmac.yaml
```yaml
# Copyright (c) 2020, Linaro Limited
# SPDX-License-Identifier: Apache-2.0

description: Atmel SAM XDMAC controller

compatible: "atmel,sam-xdmac"

include: dma-controller.yaml

properties:
    reg:
      required: true

    interrupts:
      required: true

    peripheral-id:
      type: int
      description: peripheral ID
      required: true

    "#dma-cells":
      const: 2

dma-cells:
  - channel
  - perid
```

## dts/bindings/dma/atmel,sam0-dmac.yaml
```yaml
description: Atmel SAM0 DMA controller

compatible: "atmel,sam0-dmac"

include: dma-controller.yaml

properties:
    reg:
      required: true

    interrupts:
      required: true

    "#dma-cells":
      const: 2

dma-cells:
  - channel
  - trigsrc
```

## dts/bindings/dma/bflb,dma.yaml
```yaml
# Copyright (c) 2025 MASSDRIVER EI <massdriver.space>
# SPDX-License-Identifier: Apache-2.0

description: |
  Bouffalo Lab DMA

  BFLB platforms support 4 (BL60x and BL61x) to 8 (BL70x) independent DMA channels.
  Every channel is capable of memory-to-memory, memory-to-peripheral, peripheral-to-memory and
  peripheral-to-peripheral access.
  All channels support 8, 16, and 32 bit width memory access.
  Each channel can be triggered by independent peripheral hardware or software.

compatible: "bflb,dma"

include: dma-controller.yaml

properties:
  reg:
    required: true

  interrupts:
    required: true

  dma-channels:
    required: true

  "#dma-cells":
    const: 1

dma-cells:
  - channel
```

## dts/bindings/dma/brcm,iproc-pax-dma-v1.yaml
```yaml
# Copyright 2020 Broadcom
# SPDX-License-Identifier: Apache-2.0

description: Broadcom iProc PAX(PCIE<->AXI) DMA controller version 1

include: dma-controller.yaml

compatible: brcm,iproc-pax-dma-v1

properties:
    reg:
      description: |
        Register space for the memory mapped PAX DMA controller registers,
        It includes data mover engine(dme), ring manager, ring manager common
        registers.
      required: true
    bd-memory:
      type: array
      description: Uncached memory address to populate dma buffer descriptors
      required: true
    scr-addr-loc:
      type: int
      description: Location where address of the scratch buffer host has populated
      required: true
    scr-size-loc:
      type: int
      description: Location where size of the scratch buffer host has populated
      required: true
    interrupts:
      type: array
      description: Ring manager line interrupt number
      required: false
    pcie-ep:
      type: phandle
      description: Pcie endpoint handle
      required: true
```
