## dts/bindings/display/sitronix,st7796s.yaml
```yaml
# Copyright 2023 NXP
# SPDX-License-Identifier: Apache-2.0

description: ST7796S Display controller

compatible: "sitronix,st7796s"

include: [mipi-dbi-spi-device.yaml, display-controller.yaml]

properties:
  frmctl1:
    type: uint8-array
    default: [0xA0, 0x10]
    description: |
      Frame rate control (partial mode / full colors). The default value should
      result in a framerate of ~41 FPS.

  frmctl2:
    type: uint8-array
    default: [0x00, 0x10]
    description: |
      Frame rate control (idle mode / 8 colors). This property sets the
      division ratio for internal clocks in idle mode

  frmctl3:
    type: uint8-array
    default: [0x00, 0x10]
    description: |
      Frame rate control (partial mode / full colors). This property sets the
      division ratio for internal clocks in partial mode

  bpc:
    type: uint8-array
    default: [0x02, 0x02, 0x00, 0x04]
    description: |
      Blanking porch control. This sets the vertical and horizontal
      front/back porch values

  dfc:
    type: uint8-array
    default: [0x80, 0x02, 0x3B]
    description: |
      Display function control. Sets display graphical ram mode, as well as
      gate scan mode

  pwr1:
    type: uint8-array
    default: [0x80, 0x25]
    description: Power control parameter 1. Sets AVDDS, AVLCS, and VGHS

  pwr2:
    type: int
    default: 0x13
    description: Power control parameter 2. Sets VAP

  pwr3:
    type: int
    default: 0xA
    description: Power control parameter 3. Sets source and gamma current levels

  vcmpctl:
    type: int
    default: 0x1C
    description: |
      VCOM control setting. Value starts at 0.300V, and moves upwards in
      increments of 0.025V. Maximum of 1.875V

  doca:
    type: uint8-array
    default: [0x40, 0x8A, 0x00, 0x00, 0x25, 0x0A, 0x38, 0x33]
    description: |
      Display output control adjust. Sets display timing controls

  pgc:
    type: uint8-array
    required: true
    description: |
      Positive gamma control settings. No default is provided by controller,
      as this setting is panel specific.
  ngc:
    type: uint8-array
    required: true
    description: |
      Negative gamma control settings. No default is provided by controller,
      as this setting is panel specific.

  madctl:
    type: int
    default: 0x0
    description: |
       Memory data access control value. This controls the panel color format,
       as well as rotation settings.

  color-invert:
    type: boolean
    description: When present, inverts display colors

  invert-mode:
    type: string
    default: "1-dot"
    enum:
      - "column"
      - "1-dot"
      - "2-dot"
    description: |
      Display inversion control mode.

  rgb-is-inverted:
    type: boolean
    description: |
      Inverting color format order (RGB->BGR or BGR->RGB)
      In the case of enabling this option, API reports pixel-format in capabilities
      as the inverted value of the RGB pixel-format specified in MADCTL.
      This option is convenient for supporting displays with bugs
      where the actual color is different from the pixel format of MADCTL.
```

## dts/bindings/display/socionext,dpu.yaml
```yaml
# Copyright (c) 2025 NXP
# SPDX-License-Identifier: Apache-2.0

description: socionext DPU display controller for DSI panels

compatible: "socionext,dpu"

include: [base.yaml, lcd-controller.yaml]

properties:
  reg:
    required: true

  interrupts:
    required: true
```

## dts/bindings/display/solomon,ssd1305-i2c.yaml
```yaml
# Copyright (c) 2026 MASSDRIVER EI (massdriver.space)
# SPDX-License-Identifier: Apache-2.0

title: Solomon SSD1305 display controller on I2C bus

description: |
    The Solomon SSD1305 is a monochrome OLED controller
    with a maximum 132x64 resolution.

compatible: "solomon,ssd1305"

include: ["solomon,ssd1306-common.yaml", "i2c-device.yaml"]
```

## dts/bindings/display/solomon,ssd1305-spi.yaml
```yaml
# Copyright (c) 2026 MASSDRIVER EI (massdriver.space)
# SPDX-License-Identifier: Apache-2.0

title: Solomon SSD1305 display controller on SPI bus

description: |
    The Solomon SSD1305 is a monochrome OLED controller
    with a maximum 132x64 resolution.

compatible: "solomon,ssd1305"

include: ["solomon,ssd1306-common.yaml", "spi-device.yaml"]

properties:
  data-cmd-gpios:
    type: phandle-array
    required: true
    description: D/C# pin.
```

## dts/bindings/display/solomon,ssd1306-common.yaml
```yaml
# Copyright (c) 2018, Phytec Messtechnik GmbH
# SPDX-License-Identifier: Apache-2.0

include: display-controller.yaml

properties:
  segment-offset:
    type: int
    required: true
    description: 8-bit column start address for Page Addressing Mode

  page-offset:
    type: int
    required: true
    description: Start address for Page Addressing Mode

  display-offset:
    type: int
    required: true
    description: mapping of the display start line to one of COM0 .. COM63

  multiplex-ratio:
    type: int
    required: true
    description: Multiplex Ratio

  segment-remap:
    type: boolean
    description: Last column address is mapped to first segment

  com-invdir:
    type: boolean
    description: Scan direction is from last COM output to first COM output

  com-sequential:
    type: boolean
    description: Sequential COM pin configuration

  prechargep:
    type: int
    required: true
    description: Duration of the pre-charge periods. Typically 0x22 at reset.

  reset-gpios:
    type: phandle-array
    description: RESET pin.

      The RESET pin of SSD1306 is active low.
      If connected directly the MCU pin should be configured
      as active low.

  inversion-on:
    type: boolean
    description: Turn on display color inverting

  ready-time-ms:
    type: int
    default: 10
    description: |
      Time it takes for the device from power up to become responsive and
      accepting commands. Defaults to 10ms (found by trial and error) if not
      provided.

  use-internal-iref:
    type: boolean
    description: |
      Use internal Iref, not common but sometime used to save component cost.

  softreset-on:
    type: boolean
    description: |
      Send a reset command on startup, if no reset GPIO pin is connected.

  oscillator-freq:
    type: int
    default: 0x80
    description: Front clock divider (3:0) / oscillator frequency (7:4). It can be set to 0x0.
      The default is the SSD1306 reset value, which is compatible with most displays.
      However sinowealth and chipwealth compatibles prefer a 0x50 default.
```

## dts/bindings/display/solomon,ssd1306b-i2c.yaml
```yaml
# Copyright (c) 2026 MASSDRIVER EI (massdriver.space)
# SPDX-License-Identifier: Apache-2.0

title: Solomon SSD1306B display controller on I2C bus

description: |
    The Solomon SSD1306B is a monochrome OLED controller
    with a maximum 128x64 resolution. It is a newer variant of SSD1306 with IRef controls.

compatible: "solomon,ssd1306b"

include: ["solomon,ssd1306-common.yaml", "i2c-device.yaml"]
```

## dts/bindings/display/solomon,ssd1306fb-common.yaml
```yaml
# Copyright (c) 2018, Phytec Messtechnik GmbH
# SPDX-License-Identifier: Apache-2.0

include: display-controller.yaml

properties:
  segment-offset:
    type: int
    required: true
    description: 8-bit column start address for Page Addressing Mode

  page-offset:
    type: int
    required: true
    description: Start address for Page Addressing Mode

  display-offset:
    type: int
    required: true
    description: mapping of the display start line to one of COM0 .. COM63

  multiplex-ratio:
    type: int
    required: true
    description: Multiplex Ratio

  segment-remap:
    type: boolean
    description: Last column address is mapped to first segment

  com-invdir:
    type: boolean
    description: Scan direction is from last COM output to first COM output

  com-sequential:
    type: boolean
    description: Sequential COM pin configuration

  prechargep:
    type: int
    required: true
    description: Duration of the pre-charge period

  reset-gpios:
    type: phandle-array
    description: RESET pin.

      The RESET pin of SSD1306 is active low.
      If connected directly the MCU pin should be configured
      as active low.

  inversion-on:
    type: boolean
    description: Turn on display color inverting

  ready-time-ms:
    type: int
    default: 10
    description: |
      Time it takes for the device from power up to become responsive and
      accepting commands. Defaults to 10ms (found by trial and error) if not
      provided.
```

## dts/bindings/display/solomon,ssd1306fb-i2c.yaml
```yaml
# Copyright (c) 2020, Marco Peter
# SPDX-License-Identifier: Apache-2.0

title: Solomon SSD1306 display controller on I2C bus

description: |
    The Solomon SSD1306 is a monochrome OLED controller
    with a maximum 128x64 resolution.

compatible: "solomon,ssd1306fb"

include: ["solomon,ssd1306fb-common.yaml", "i2c-device.yaml"]
```

## dts/bindings/display/solomon,ssd1306fb-spi.yaml
```yaml
# Copyright (c) 2020, Marco Peter
# SPDX-License-Identifier: Apache-2.0

title: Solomon SSD1306 display controller on SPI bus

description: |
    The Solomon SSD1306 is a monochrome OLED controller
    with a maximum 128x64 resolution.

compatible: "solomon,ssd1306fb"

include: ["solomon,ssd1306fb-common.yaml", "spi-device.yaml"]

properties:
  data-cmd-gpios:
    type: phandle-array
    required: true
    description: D/C# pin.
```

## dts/bindings/display/solomon,ssd1306fb.yaml
```yaml
#
# Copyright (c) 2018, Phytec Messtechnik GmbH
#
# SPDX-License-Identifier: Apache-2.0
#

title: SSD1306 128x64 Dot Matrix Display Controller
version: 0.1

description: >
    This is a representation of the SSD1306 128x64 Dot Matrix Display Controller

inherits:
    !include i2c-device.yaml

properties:
    compatible:
      constraint: "solomon,ssd1306fb"

    height:
      type: int
      category: required
      description: Height in pixel of the panel driven by the controller

    width:
      type: int
      category: required
      description: Width in pixel of the panel driven by the controller

    segment-offset:
      type: int
      category: required
      description: 8-bit column start address for Page Addressing Mode

    page-offset:
      type: int
      category: required
      description: Start address for Page Addressing Mode

    display-offset:
      type: int
      category: required
      description: mapping of the display start line to one of COM0 .. COM63

    segment-remap:
      type: boolean
      category: optional
      description: Last column address is mapped to first segment

    com-invdir:
      type: boolean
      category: optional
      description: Scan direction is from last COM output to first COM output

    prechargep:
      type: int
      category: required
      description: Duration of the pre-charge period

    reset-gpios:
      type: compound
      category: optional
```

## dts/bindings/display/solomon,ssd1309fb-i2c.yaml
```yaml
# Copyright (c) 2025, Marcio Ribeiro
# SPDX-License-Identifier: Apache-2.0

title: Solomon SSD1309 display controller on I2C bus

description: |
    The Solomon SSD1309 is a monochrome OLED controller
    with a maximum 128x64 resolution.

compatible: "solomon,ssd1309fb"

include: ["solomon,ssd1306fb-common.yaml", "i2c-device.yaml"]
```

## dts/bindings/display/solomon,ssd1309fb-spi.yaml
```yaml
# Copyright (c) 2025, Marcio Ribeiro
# SPDX-License-Identifier: Apache-2.0

title: Solomon SSD1309 display controller on SPI bus

description: |
    The Solomon SSD1309 is a monochrome OLED controller
    with a maximum 128x64 resolution.

compatible: "solomon,ssd1309fb"

include: ["solomon,ssd1306fb-common.yaml", "spi-device.yaml"]

properties:
  data-cmd-gpios:
    type: phandle-array
    required: true
    description: D/C# pin.
```

## dts/bindings/display/solomon,ssd1315-i2c.yaml
```yaml
# Copyright (c) 2026 MASSDRIVER EI (massdriver.space)
# SPDX-License-Identifier: Apache-2.0

title: Solomon SSD1315 display controller on I2C bus

description: |
    The Solomon SSD1315 is a monochrome OLED controller with a maximum 128x64 resolution.

compatible: "solomon,ssd1315"

include: ["solomon,ssd1306-common.yaml", "i2c-device.yaml"]
```

## dts/bindings/display/solomon,ssd1315-spi.yaml
```yaml
# Copyright (c) 2026 MASSDRIVER EI (massdriver.space)
# SPDX-License-Identifier: Apache-2.0

title: Solomon SSD1315 display controller on SPI bus

description: |
    The Solomon SSD1315 is a monochrome OLED controller with a maximum 128x64 resolution.

compatible: "solomon,ssd1315"

include: ["solomon,ssd1306-common.yaml", "spi-device.yaml"]

properties:
  data-cmd-gpios:
    type: phandle-array
    required: true
    description: D/C# pin.
```

## dts/bindings/display/solomon,ssd1320-common.yaml
```yaml
# Copyright (c) 2025 MASSDRIVER EI (massdriver.space)
# SPDX-License-Identifier: Apache-2.0

include: display-controller.yaml

properties:
  oscillator-freq:
    type: int
    required: true
    description: Front clock divider (3:0) / oscillator frequency (7:4). It can be set to 0x0.
      If you get weird scanlines, increase oscillator frequency and play with phase length values,
      for example set this to 0x70. Note this increases power consumption.

  display-offset:
    type: int
    required: true
    description: Vertical offset by com from 0 ~ 159. Typically 160 - height.

  start-line:
    type: int
    required: true
    description: Start line of display RAM to be displayed by selecting a value from 0 to 159.
      Typically 0.

  multiplex-ratio:
    type: int
    required: true
    description: Multiplex ratio from 15MUX to 159MUX. Typically same value as height - 1.

  remap-value:
    type: int
    required: true
    description: Remap register

      Has multiple configurations (see each bit setting in the datasheet)
      - A[1] must be 1
      - Sequential (0) or Alternative (Odd/Even) SEGs (A[4])
      - Disable or Enable SEG left/right remap (A[5])

      A[4] is needed when display has striping.

  phase-length:
    type: int
    required: true
    description: Phase Length for segment charging (7:4) and discharging (3:0).
      Good values to try first are 0x1f and 0xf1.

  internal-iref:
    type: int
    default: 0x10
    description: Internal or external iref. 0x0 is External, 0x10 Internal.
      Most displays use Internal.

  precharge-voltage:
    type: int
    default: 0x1E
    description: Set precharge voltage (4:0) from 0.10 x VCC to 0.5113 x VCC (0x1F).
      0x1E is the reset default.

  vcomh-voltage:
    type: int
    default: 0x20
    description: Set COM deselect voltage (5:3) from 0.72 x VCC (0x0) to 0.84 x VCC (0x30)
      0x20 is the reset default.

  inversion-on:
    type: boolean
    description: Turn on display color inverting

  greyscale-enhancement:
    type: boolean
    description: Enable low greyscale enhancement, partially undocumented.

  inv-seg:
    type: boolean
    description: Invert segment order

  inv-com:
    type: boolean
    description: Invert COM order
```

## dts/bindings/display/solomon,ssd1320-i2c.yaml
```yaml
# Copyright (c) 2025 MASSDRIVER EI (massdriver.space)
# SPDX-License-Identifier: Apache-2.0

description: SSD1320 160x160 dot-matrix display controller on I2C bus

include: ["solomon,ssd1320-common.yaml", "i2c-device.yaml"]

compatible: "solomon,ssd1320"
```
