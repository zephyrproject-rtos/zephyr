## dts/bindings/display/sitronix,st7735.yaml
```yaml
# Copyright (c) 2019, Marc Reilly <marc@cpdesign.com.au>
# Copyright (c) 2019, PHYTEC Messtechnik GmbH
# SPDX-License-Identifier: Apache-2.0

description: ST7735 320x240 display controller

compatible: "sitronix,st7735"

include: spi-device.yaml

properties:
    reset-gpios:
      type: phandle-array
      required: true
      description: RESET pin.

        The RESET pin of ST7789V is active low.
        If connected directly the MCU pin should be configured
        as active low.

    cmd-data-gpios:
      type: phandle-array
      required: true
      description: D/CX pin.

        The D/CX pin of ST7789V is active low (transmission command byte).
        If connected directly the MCU pin should be configured
        as active low.
      
    height:
      type: int
      required: true
      description: Height in pixels of the panel driven by the controller

    width:
      type: int
      required: true
      description: Width in pixels of the panel driven by the controller
```

## dts/bindings/display/sitronix,st7735r.yaml
```yaml
# Copyright (c) 2020, Kim Bøndergaard <kim@fam-boendergaard.dk>
# SPDX-License-Identifier: Apache-2.0

description: ST7735R/ST7735S 160x128 (max) display controller

compatible: "sitronix,st7735r"

include: [spi-device.yaml, display-controller.yaml]

properties:
  reset-gpios:
    type: phandle-array
    description: RESET pin.

      The RESET pin of ST7735R is active low.
      If connected directly the MCU pin should be configured
      as active low.

  cmd-data-gpios:
    type: phandle-array
    required: true
    description: D/CX pin.

      The D/CX pin of ST7735R is active low (transmission command byte).
      If connected directly the MCU pin should be configured
      as active low.

  x-offset:
    type: int
    required: true
    description: The column offset in pixels of the LCD to the controller memory

  y-offset:
    type: int
    required: true
    description: The row offset in pixels of the LCD to the controller memory

  madctl:
    type: int
    default: 0x00
    description: Memory Data Access Control

  colmod:
    type: int
    default: 0x06
    description: Interface Pixel Format

  pwctr1:
    type: uint8-array
    default: [0xb4, 0x14, 0x04]
    description: Power Control 1 Parameter

  pwctr2:
    type: uint8-array
    default: [0xc0]
    description: Power Control 2 Parameter

  pwctr3:
    type: uint8-array
    default: [0x0a, 0x00]
    description: Power Control 3 Parameter

  pwctr4:
    type: uint8-array
    default: [0x8a, 0x26]
    description: Power Control 4 Parameter

  pwctr5:
    type: uint8-array
    default: [0x8a, 0xee]
    description: Power Control 5 Parameter

  gamctrp1:
    type: uint8-array
    required: true
    description: Positive Voltage Gamma Control Parameter

  gamctrn1:
    type: uint8-array
    required: true
    description: Negative Voltage Gamma Control Parameter

  frmctr1:
    type: uint8-array
    default: [0x05, 0x3a, 0x3a]
    description: Frame rate control (normal mode / full colors)

  frmctr2:
    type: uint8-array
    default: [0x05, 0x3a, 0x3a]
    description: Frame rate control (idle mode / 8 colors)

  frmctr3:
    type: uint8-array
    default: [0x05, 0x3a, 0x3a, 0x05, 0x3a, 0x3a]
    description: Frame rate control (partial mode / full colors)

  caset:
    type: uint8-array
    default: [0x00, 0x00, 0x00, 0x7f]
    description: Column Address Set

  raset:
    type: uint8-array
    default: [0x00, 0x00, 0x00, 0x9f]
    description: Row Address Set

  vmctr1:
    type: int
    default: 0x0a
    description: VCOM Control 1

  invctr:
    type: int
    default: 0x07
    description: |
      Display Inversion Control
      Set dot inversion or line inversion for each normal/idle/partial mode.

  inversion-on:
    type: boolean
    description: |
      Enable Display Inversion
      Make a drawing with the inverted color of the frame memory.

  rgb-is-inverted:
    type: boolean
    description: |
      Inverting color format order (RGB->BGR or BGR->RGB)
      In the case of enabling this option, API reports pixel-format in capabilities
      as the inverted value of the RGB pixel-format specified in MADCTL.
      This option is convenient for supporting displays with bugs
      where the actual color is different from the pixel format of MADCTL.
```

## dts/bindings/display/sitronix,st7789h2-gpio.yaml
```yaml
# Copyright (c) 2021, Jeremy LOCHE
# SPDX-License-Identifier: Apache-2.0

description: |
  ST7789H2 320x240 display controller

  Using the GPIOs as bitbanging parallel bus interface for the
  read/write operations to the display.

compatible: "sitronix,st7789h2-gpio"

include: display-controller.yaml

properties:

    data-gpios:
      type: phandle-array
      required: true
      description: 16 bits, Data bus pins in order from d0 to d15

    cmd-data-gpio:
      type: phandle-array
      specifier-space: gpio
      required: true
      description: |
        D/CX pin.

        The D/CX pin of ST7789V is active low (transmission command byte).
        If connected directly the MCU pin should be configured
        as active low.

    cs-gpio:
      type: phandle-array
      specifier-space: gpio
      required: true
      description: Chip select pin active low

    wrn-gpio:
      type: phandle-array
      specifier-space: gpio
      required: true
      description: nWrite pin, active-low

    rdn-gpio:
      type: phandle-array
      specifier-space: gpio
      required: false
      description: nRead pin, active-low

    backlight-gpio:
      type: phandle-array
      specifier-space: gpio
      required: false
      description: BACKLIGHT pin

    reset-gpio:
      type: phandle-array
      specifier-space: gpio
      required: false
      description: |
        RESET pin.

        The RESET pin of ST7789H2 is active low.
        If connected directly the MCU pin should be configured
        as active low.

    te-gpio:
      type: phandle-array
      specifier-space: gpio
      required: false
      description: |
        Tearing effect line pin

        The TE pin of ST7789H2 is used as VSYNC line

    x-offset:
      type: int
      required: true
      description: The column offset in pixels of the LCD to the controller memory

    y-offset:
      type: int
      required: true
      description: The row offset in pixels of the LCD to the controller memory

    vcom:
      type: int
      required: true
      description: VCOM Setting

    gctrl:
      type: int
      required: true
      description: Gate Control

    vrhs:
      type: int
      required: false
      description: VRH Setting

    vdvs:
      type: int
      required: false
      description: VDV Setting

    mdac:
      type: int
      required: true
      description: Memory Data Access Control

    lcm:
      type: int
      required: true
      description: LCM Setting

    colmod:
      type: int
      required: true
      description: Interface Pixel Format

    gamma:
      type: int
      required: true
      description: Gamma Setting

    porch-param:
      type: uint8-array
      required: true
      description: Porch Setting

    cmd2en-param:
      type: uint8-array
      required: true
      description: Command 2 Enable Parameter

    pwctrl1-param:
      type: uint8-array
      required: true
      description: Power Control 1 Parameter

    pvgam-param:
      type: uint8-array
      required: true
      description: Positive Voltage Gamma Control Parameter

    nvgam-param:
      type: uint8-array
      required: true
      description: Negative Voltage Gamma Control Parameter

    ram-param:
      type: uint8-array
      required: true
      description: RAM Control Parameter

    rgb-param:
      type: uint8-array
      required: true
      description: RGB Interface Control Parameter
```

## dts/bindings/display/sitronix,st7789h2-st-fmc.yaml
```yaml
# Copyright (c) 2022, Jeremy LOCHE
# SPDX-License-Identifier: Apache-2.0

description: |
  ST7789H2 320x240 display controller

  Using the FMC peripheral of STM32 microcontrollers parallel bus
  interface for the read/write operations to the display.

  You need to configure the FMC peripheral as an SRAM controller
  with correct bank access timing and configuration.

  This drivers only needs 2 address to work and defined in "reg = <>":
    Register/Command address:
      Used to write the LCD controller registers
    Data address:
      Used to write LCD RAM display data

  Example configuration:

  &fmc {
    status = "okay";
    /* ST7789H2 FMC pinout based on your boards layout */
    pinctrl-0 = <...>;
    pinctrl-names = "default";

    /* ST7789H2 FMC SRAM interface*/
    lcd_fmc_sram: sram {
      compatible = "st,stm32-fmc-nor-psram";
      #address-cells = <1>;
      #size-cells = <0>;
      label = "STM32_FMC_NOR_PSRAM";
      status = "okay";

      lcd_data_bus: sram@0 {
        #address-cells = <1>;
        #size-cells = <0>;

        reg = <0>;

        /* Configure the FMC bus */
        st,control = <STM32_FMC_DATA_ADDRESS_MUX_DISABLE
                      STM32_FMC_MEMORY_TYPE_SRAM
                      STM32_FMC_NORSRAM_MEM_BUS_WIDTH_16
                      STM32_FMC_BURST_ACCESS_MODE_DISABLE
                      STM32_FMC_WAIT_SIGNAL_POLARITY_LOW
                      STM32_FMC_WAIT_TIMING_BEFORE_WS
                      STM32_FMC_WRITE_OPERATION_ENABLE
                      STM32_FMC_WAIT_SIGNAL_DISABLE
                      STM32_FMC_EXTENDED_MODE_DISABLE
                      STM32_FMC_ASYNCHRONOUS_WAIT_DISABLE
                      STM32_FMC_WRITE_BURST_DISABLE
                      STM32_FMC_CONTINUOUS_CLOCK_SYNC_ONLY
                      STM32_FMC_WRITE_FIFO_DISABLE
                      STM32_FMC_PAGE_SIZE_NONE>;

        st,timing = <1 1 32 0 2 2 STM32_FMC_ACCESS_MODE_A>;
        st,timing-ext = <5 1 3 2 STM32_FMC_ACCESS_MODE_A>;
      };
    };
  };

  &lcd_data_bus {
    st7789h2: st7789h2@0 {
      /* CMD reg */
      /* DATA reg */
      reg = <0x60000000
            0x60000002>;

      compatible = "sitronix,st7789h2-st-fmc";
      label = "DISPLAY";
      status = "okay";

      backlight-gpio = <&gpioe 1 GPIO_ACTIVE_HIGH>;
      reset-gpio = <&gpiof 14 GPIO_ACTIVE_LOW>;
      te-gpio = <&gpioa 8 GPIO_ACTIVE_HIGH>;
      height = <240>;
      width = <240>;
      x-offset = <0>;
      y-offset = <0>;
      vcom = <0x1f>;
      gctrl = <0x35>;
      vrhs = <0x12>;
      vdvs = <0x20>;
      mdac = <0>;
      lcm = <0x2c>;
      colmod = <0x55>;
      gamma = <0x1>;
      porch-param = [0C 0C 00 33 33];
      cmd2en-param = [5a 69 02 01];
      pwctrl1-param = [a4 a1];
      pvgam-param = [D0 08 11 08 0C 15 39 33 50 36 13 14 29 2D];
      nvgam-param = [D0 07 10 08 06 06 39 44 51 0B 16 14 2F 31];
      ram-param = [00 F0];
      rgb-param = [CD 08 14];
    };
  };




compatible: "sitronix,st7789h2-st-fmc"

include: display-controller.yaml

properties:

    backlight-gpio:
      type: phandle-array
      specifier-space: gpio
      required: false
      description: BACKLIGHT pin

    reset-gpio:
      type: phandle-array
      specifier-space: gpio
      required: false
      description: |
        RESET pin.

        The RESET pin of ST7789H2 is active low.
        If connected directly the MCU pin should be configured
        as active low.

    te-gpio:
      type: phandle-array
      specifier-space: gpio
      required: false
      description: |
        Tearing effect line pin

        The TE pin of ST7789H2 is used as VSYNC line

    x-offset:
      type: int
      required: true
      description: The column offset in pixels of the LCD to the controller memory

    y-offset:
      type: int
      required: true
      description: The row offset in pixels of the LCD to the controller memory

    vcom:
      type: int
      required: true
      description: VCOM Setting

    gctrl:
      type: int
      required: true
      description: Gate Control

    vrhs:
      type: int
      required: false
      description: VRH Setting

    vdvs:
      type: int
      required: false
      description: VDV Setting

    mdac:
      type: int
      required: true
      description: Memory Data Access Control

    lcm:
      type: int
      required: true
      description: LCM Setting

    colmod:
      type: int
      required: true
      description: Interface Pixel Format

    gamma:
      type: int
      required: true
      description: Gamma Setting

    porch-param:
      type: uint8-array
      required: true
      description: Porch Setting

    cmd2en-param:
      type: uint8-array
      required: true
      description: Command 2 Enable Parameter

    pwctrl1-param:
      type: uint8-array
      required: true
      description: Power Control 1 Parameter

    pvgam-param:
      type: uint8-array
      required: true
      description: Positive Voltage Gamma Control Parameter

    nvgam-param:
      type: uint8-array
      required: true
      description: Negative Voltage Gamma Control Parameter

    ram-param:
      type: uint8-array
      required: true
      description: RAM Control Parameter

    rgb-param:
      type: uint8-array
      required: true
      description: RGB Interface Control Parameter
```

## dts/bindings/display/sitronix,st7789v.yaml
```yaml
# Copyright (c) 2019, Marc Reilly <marc@cpdesign.com.au>
# Copyright (c) 2019, PHYTEC Messtechnik GmbH
# SPDX-License-Identifier: Apache-2.0

description: ST7789V 320x240 display controller

compatible: "sitronix,st7789v"

include: [mipi-dbi-spi-device.yaml, display-controller.yaml]

properties:
  x-offset:
    type: int
    required: true
    description: The column offset in pixels of the LCD to the controller memory

  y-offset:
    type: int
    required: true
    description: The row offset in pixels of the LCD to the controller memory

  vcom:
    type: int
    required: true
    description: VCOM Setting

  gctrl:
    type: int
    required: true
    description: Gate Control

  vrhs:
    type: int
    description: VRH Setting

  vdvs:
    type: int
    description: VDV Setting

  mdac:
    type: int
    required: true
    description: Memory Data Access Control

  lcm:
    type: int
    required: true
    description: LCM Setting

  colmod:
    type: int
    required: true
    description: Interface Pixel Format

  gamma:
    type: int
    required: true
    description: Gamma Setting

  inversion-off:
    type: boolean
    description: Inversion Off

  porch-param:
    type: uint8-array
    required: true
    description: Porch Setting

  cmd2en-param:
    type: uint8-array
    required: true
    description: Command 2 Enable Parameter

  pwctrl1-param:
    type: uint8-array
    required: true
    description: Power Control 1 Parameter

  pvgam-param:
    type: uint8-array
    required: true
    description: Positive Voltage Gamma Control Parameter

  nvgam-param:
    type: uint8-array
    required: true
    description: Negative Voltage Gamma Control Parameter

  ram-param:
    type: uint8-array
    required: true
    description: RAM Control Parameter

  rgb-param:
    type: uint8-array
    required: true
    description: RGB Interface Control Parameter

  mipi-mode:
    required: true
```
