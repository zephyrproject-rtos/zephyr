## dts/bindings/display/solomon,ssd1322.yaml
```yaml
title: Solomon SSD1322 display controller

description: |
    The Solomon SSD1322 is a monochrome OLED controller
    with a maximum 480x128 resolution.

compatible: "solomon,ssd1322"

include: [mipi-dbi-spi-device.yaml, display-controller.yaml]

properties:
  column-offset:
    type: int
    required: true
    description: First visible column number. Number used is unintuitive,
      try aligning driver display sample to figure it out.

  oscillator-freq:
    type: int
    required: true
    description: Front clock divider (3:0) / oscillator frequency (7:4). It can be set to 0x0.
      If you get weird scanlines, increase oscillator frequency and play with phase length values,
      for example set this to 0x90. Note this increases power consumption. A good starting value
      for SSD1322 is 0x91.

  precharge-voltage:
    type: int
    required: true
    description: Set precharge voltage, from 0 (0.2 x VCC) to 0x1F (0.6x VCC).
      Try highest value then go down.

  vcomh-voltage:
    type: int
    required: true
    description: Set COM deselect voltage, from 0 (0.72 x VCC) to 0x7 (0.86 x VCC).
      Try highest value then go down.

  mux-ratio:
    type: int
    required: true
    description: COM Pin Multiplex ratio from 15-127. Typically height - 1.

  phase-length:
    type: int
    required: true
    description: Phase Length for segment charging (7:4) and discharging (3:0).
      On SSD1322, 0xE2 is a good start value.

  row-offset:
    type: int
    default: 0
    description: |
      COM pin used as first row, mapped to the line set by start-line.
      The default corresponds to the reset value of the register.

  start-line:
    type: int
    default: 0
    description: |
      Starting line address of display ram (0-127).
      The default corresponds to the reset value of the register.

  precharge-period:
    type: int
    default: 8
    description: Second precharge period, from 0 (0 dclk) to 0xF (15 dclks).
      8 is the reset value.

  remap-row-first:
    type: boolean
    description: Set scan direction to vertical first (swap rows/columns).

  remap-columns:
    type: boolean
    description: Reverse the column order (flip horizontally).

  remap-rows:
    type: boolean
    description: Reverse the row order (flip vertically).

  remap-nibble:
    type: boolean
    description: Reverse every group of 4 nibbles.

  remap-com-odd-even-split:
    type: boolean
    description: Odd even split of COM pins.

  remap-com-dual:
    type: boolean
    description: Dual COM mode.

  grayscale-enhancement:
    type: boolean
    description: Enable grayscale enhancement on some displays, partially undocumented.

  inversion-on:
    type: boolean
    description: Turn on display color inverting

  segments-per-pixel:
    type: int
    default: 1
    enum:
      - 1
      - 2
    description: |
      Map multiple adjacent segments to one pixel.
      Some displays (such as the Newhaven Display NHD-2.7-12864WDW3) connect
      two adjacent pixel drivers to each physical pixel. By setting this to 2,
      the driver will repeat each pixel. The default disables this functionality,
      as it only applies to very specific display models.
```

## dts/bindings/display/solomon,ssd1325-i2c.yaml
```yaml
# Copyright (c) 2026 MASSDRIVER EI (massdriver.space)
# SPDX-License-Identifier: Apache-2.0

title: Solomon SSD1325 display controller on I2C bus

description: |
    The Solomon SSD1325 is a 4-bit greyscale OLED controller
    with a maximum 128x80 resolution.

include: ["solomon,ssd1327_5-common.yaml", "i2c-device.yaml"]

compatible: "solomon,ssd1325"
```

## dts/bindings/display/solomon,ssd1325-mipi-dbi.yaml
```yaml
# Copyright (c) 2026 MASSDRIVER EI (massdriver.space)
# SPDX-License-Identifier: Apache-2.0

title: Solomon SSD1325 display controller on MIPI_DBI or SPI bus

description: |
    The Solomon SSD1325 is a 4-bit greyscale OLED controller
    with a maximum 128x80 resolution.

include: ["solomon,ssd1327_5-common.yaml", "mipi-dbi-spi-device.yaml"]

compatible: "solomon,ssd1325"
```

## dts/bindings/display/solomon,ssd1327-common.yaml
```yaml
# Copyright (c) 2026 MASSDRIVER EI (massdriver.space)
# SPDX-License-Identifier: Apache-2.0

include: "solomon,ssd1327_5-common.yaml"

properties:
  prechargep:
    type: int
    required: true
    description: Pre-charge period ranging from 0 to 15 DCLK's.

  function-selection-b:
    type: int
    default: 0x62
    description: Enables second precharge (A[1]), and external Voltage Segment Level (A[0])
      The value can either be 0x61, 0x62, or 0x63. Most displays use 0x62.
```
