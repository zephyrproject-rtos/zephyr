## dts/bindings/display/solomon,ssd1673fb.yaml
```yaml
# Copyright (c) 2018, Phytec Messtechnik GmbH
# SPDX-License-Identifier: Apache-2.0

title: SSD16XX 250x150 EPD Display Controller

description: |
    This is a representation of the SSD16XX 250x150 EPD Display Controller

compatible: "solomon,ssd16xxfb"

include: spi-device.yaml

properties:
    height:
      type: int
      required: true
      description: Height in pixel of the panel driven by the controller

    width:
      type: int
      required: true
      description: Width in pixel of the panel driven by the controller

    pp-height-bits:
      type: int
      required: true
      description: Number of bits used for the height parameters

    pp-width-bits:
      type: int
      required: true
      description: Number of bits used for the width parameters

    gdv:
      type: uint8-array
      required: true
      description: Gate driving voltage values

    sdv:
      type: uint8-array
      required: true
      description: Source driving voltage values

    vcom:
      type: int
      required: true
      description: VCOM voltage

    border-waveform:
      type: int
      required: true
      description: Border waveform

    softstart:
      type: uint8-array
      required: false
      description: Booster soft start values

    orientation-flipped:
      type: boolean
      required: false
      description: Last column address is mapped to first segment

    reset-gpios:
      type: phandle-array
      required: true

    dc-gpios:
      type: phandle-array
      required: true

    busy-gpios:
      type: phandle-array
      required: true

    lut-initial:
      type: uint8-array
      required: true

    lut-default:
      type: uint8-array
      required: true
```

## dts/bindings/display/solomon,ssd1675a.yaml
```yaml
# Copyright (c) 2022 Andreas Sandberg
# SPDX-License-Identifier: Apache-2.0

description: Solomon Systech SSD1675A 296x160 EPD display controller

compatible: "solomon,ssd1675a"

include: solomon,ssd16xx-common.yaml
```

## dts/bindings/display/solomon,ssd1677.yaml
```yaml
# Copyright (c) 2022 Andreas Sandberg
# SPDX-License-Identifier: Apache-2.0

description: Solomon Systech SSD1677 960x680 EPD display controller

compatible: "solomon,ssd1677"

include: solomon,ssd16xx-common.yaml
```

## dts/bindings/display/solomon,ssd1680.yaml
```yaml
# Copyright (c) 2022 Andreas Sandberg
# SPDX-License-Identifier: Apache-2.0

description: Solomon Systech SSD1680 296x176 EPD display controller

compatible: "solomon,ssd1680"

include: solomon,ssd16xx-common.yaml

properties:
  ram-ping-pong-mode2:
    type: boolean
    description:
      Enable RAM ping-pong for display mode 2 by setting F[6] in the
      display option register.
```

## dts/bindings/display/solomon,ssd1681.yaml
```yaml
# Copyright (c) 2022 Andreas Sandberg
# SPDX-License-Identifier: Apache-2.0

description: Solomon Systech SSD1681 200x200 EPD display controller

compatible: "solomon,ssd1681"

include: solomon,ssd16xx-common.yaml
```

## dts/bindings/display/solomon,ssd1683.yaml
```yaml
# Copyright (c) 2026 Marcus Voß
# SPDX-License-Identifier: Apache-2.0

description: Solomon Systech SSD1683 400x300 EPD display controller

compatible: "solomon,ssd1683"

include: solomon,ssd16xx-common.yaml
```

## dts/bindings/display/solomon,ssd16xx-common.yaml
```yaml
# Copyright (c) 2018, Phytec Messtechnik GmbH
# SPDX-License-Identifier: Apache-2.0

description: SSD16XX EPD display controller

include: [mipi-dbi-spi-device.yaml, display-controller.yaml]

properties:
  softstart:
    type: uint8-array
    description: Booster soft start values

  busy-gpios:
    type: phandle-array
    required: true
    description: BUSY pin.

      The BUSY pin of SSD16XX is active high.
      If connected directly the MCU pin should be configured
      as active high.

  tssv:
    type: int
    description: Temperature Sensor Selection Value

      Display controller can have integrated temperature sensor or
      an external temperature sensor is connected to the controller.
      The value selects which sensor should be used.

  rotation:
    type: int
    default: 0
    enum:
      - 0
      - 90
      - 180
      - 270
    description:
      Display rotation (CW) in degrees.
      If not defined, rotation is off by default.

  scan-y-reverse:
    type: boolean
    description: Reverse the scan direction along Y axis for the display.

      Some displays have the scan direction reversed along the Y axis.

  gdo-flags:
    type: int
    description: Gate scanning sequence and direction

      Additional flags passed into Driver Output control command to
      determine the how the output pin layout for the panel is and
      what should be scanning sequence and the direction.

child-binding:
  description: |
    Child nodes describe refresh profiles. Each refresh profile
    specifies a set of voltages used to drive the refresh
    cycle. Refresh profiles are optional and are used to override
    defaults loaded from the controllers OTP memory.

    Partial refresh will be disabled unless a partial refresh profile
    has been specified. That profile may be empty to use the defaults
    loaded from OTP if supported by the device.

    The driver typically looks for the following child nodes:

      - 'full' - Normal / full refresh.
      - 'partial' - Partial refresh.

  properties:
    lut:
      type: uint8-array
      description: LUT associated with this profile.

    gdv:
      type: uint8-array
      description: Gate driving voltage values

    sdv:
      type: uint8-array
      description: Source driving voltage values

    vcom:
      type: int
      description: VCOM voltage

    border-waveform:
      type: int
      description: Border waveform

    dummy-line:
      type: int
      description: Dummy line period override.

    gate-line-width:
      type: int
      description: Gate line width override.
```

## dts/bindings/display/solomon,ssd16xxfb.yaml
```yaml
# Copyright (c) 2018, Phytec Messtechnik GmbH
# SPDX-License-Identifier: Apache-2.0

description: SSD16XX 250x150 EPD display controller

compatible: "solomon,ssd16xxfb"

include: [spi-device.yaml, display-controller.yaml]

properties:
    pp-height-bits:
      type: int
      required: true
      description: Number of bits used for the height parameters

    pp-width-bits:
      type: int
      required: true
      description: Number of bits used for the width parameters

    gdv:
      type: uint8-array
      required: false
      description: Gate driving voltage values

    sdv:
      type: uint8-array
      required: false
      description: Source driving voltage values

    vcom:
      type: int
      required: false
      description: VCOM voltage

    border-waveform:
      type: int
      required: false
      description: Border waveform

    softstart:
      type: uint8-array
      required: false
      description: Booster soft start values

    orientation-flipped:
      type: boolean
      required: false
      description: Last column address is mapped to first segment

    reset-gpios:
      type: phandle-array
      required: true
      description: RESET pin.

        The RESET pin of SSD16XX is active low.
        If connected directly the MCU pin should be configured
        as active low.

    dc-gpios:
      type: phandle-array
      required: true
      description: DC pin.

        The DC pin of SSD16XX is active low (transmission command byte).
        If connected directly the MCU pin should be configured
        as active low.

    busy-gpios:
      type: phandle-array
      required: true
      description: BUSY pin.

        The BUSY pin of SSD16XX is active high.
        If connected directly the MCU pin should be configured
        as active high.

    lut-initial:
      type: uint8-array
      required: false
      description: |
        Initial LUT used when initializing the device and performing
        clearing the screen using a full refresh operation. The
        default LUT will be loaded from OTP if this property isn't
        defined.

    lut-default:
      type: uint8-array
      required: false

    tssv:
      type: int
      required: false
      description: Temperature Sensor Selection Value

        Display controller can have integrated temperature sensor or
        an external temperature sensor is connected to the controller.
        The value selects which sensor should be used.

    dummy-line:
      type: int
      required: false
      description: Dummy line period override.

    gate-line-width:
      type: int
      required: false
      description: Gate line width override.
```

## dts/bindings/display/st,neochrom-gpu2d.yaml
```yaml
# Copyright (c) 2026 Silicon Signals Pvt. Ltd.
#
# SPDX-License-Identifier: Apache-2.0

description: STM32 NeoChrom-GPU2D accelerator

compatible: "st,neochrom-gpu2d"

include: [reset-device.yaml, base.yaml]

properties:
  reg:
    required: true

  clocks:
    required: true

  interrupts:
    required: true

  resets:
    required: true
```

## dts/bindings/display/st,stm32-dma2d.yaml
```yaml
#
# Copyright (c) 2026 STMicroelectronics.
#
# SPDX-License-Identifier: Apache-2.0
#

title: STM32 Chrom-ART Accelerator (DMA2D)

description: |
    The Chrom-ART Accelerator (DMA2D) is a specialized DMA dedicated to
    image manipulation such as fill, copy, format conversion, blending.

compatible: "st,stm32-dma2d"

include: [base.yaml]

properties:
  reg:
    required: true

  interrupts:
    required: true
```

## dts/bindings/display/st,stm32-ltdc.yaml
```yaml
# Copyright (c) 2022, Byte-Lab d.o.o. <dev@byte-lab.com>
# SPDX-License-Identifier: Apache-2.0

description: STM32 LCD-TFT display controller

compatible: "st,stm32-ltdc"

include: [lcd-controller.yaml, pinctrl-device.yaml]

properties:
  disp-on-gpios:
    type: phandle-array
    description: |
      Display on/off GPIO pin.
      Configure the GPIO polarity (active high/active low) according to LCD datasheet.

  bl-ctrl-gpios:
    type: phandle-array
    description: |
      Backlight on/off GPIO pin.
      Configure the GPIO polarity (active high/active low) according to LCD datasheet.

  ext-sdram:
    type: phandle
    description: |
      External SDRAM in which frame buffer will be stored.
      If not defined, internal RAM will be used.

  clocks:
    required: true

  interrupts:
    required: true

  pinctrl-0:
    description: |
      Provide a pin configuration for using parallel pixel output. In combination with DSI HOST
      the pin configuration is not necessary due to dedicated (MIPI D-PHY) pins.

  def-back-color-red:
    type: int
    description: Default display background color - red

  def-back-color-green:
    type: int
    description: Default display background color - green

  def-back-color-blue:
    type: int
    description: Default display background color - blue

  window0-x0:
    type: int
    description: First pixel in x direction on layer 0. Defaults to 0.

  window0-x1:
    type: int
    description: Last pixel in x direction on layer 0. Defaults to width.

  window0-y0:
    type: int
    description: First pixel in y direction on layer 0. Defaults to 0.

  window0-y1:
    type: int
    description: Last pixel in y direction on layer 0. Defaults to height.
```
