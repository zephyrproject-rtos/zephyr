## dts/bindings/display/solomon,ssd1327-i2c.yaml
```yaml
# Copyright (c) 2025-2026 MASSDRIVER EI (massdriver.space)
# SPDX-License-Identifier: Apache-2.0

title: Solomon SSD1327 display controller on I2C bus

description: |
    The Solomon SSD1327 is a 4-bit greyscale OLED controller
    with a maximum 128x128 resolution.

include: ["solomon,ssd1327-common.yaml", "i2c-device.yaml"]

compatible: "solomon,ssd1327"
```

## dts/bindings/display/solomon,ssd1327fb-common.yaml
```yaml
# Copyright (c) 2024, Savoir-faire Linux
# SPDX-License-Identifier: Apache-2.0

include: display-controller.yaml

properties:
  oscillator-freq:
    type: int
    required: true
    description: Front clock divider (3:0) / oscillator frequency (7:4). It can be set to 0x0.
      If you get weird scanlines, increase oscillator frequency and play with phase length values,
      for example set this to 0x70. Note this increases power consumption.

  display-offset:
    type: int
    required: true
    description: Vertical offset by com from 0 ~ 127. Typically 128 - height.

  start-line:
    type: int
    required: true
    description: Start line of display RAM to be displayed by selecting a value from 0 to 127.
      Typically 0.

  multiplex-ratio:
    type: int
    required: true
    description: Multiplex ratio from 15MUX to 127MUX. Typically same value as height - 1.

  prechargep:
    type: int
    required: true
    description: Pre-charge period ranging from 0 to 15 DCLK's

  remap-value:
    type: int
    required: true
    description: Remap register

      Has multiple configurations (see each bit setting in the datasheet)
      - Column Address Remapping (A[0])
      - Nibble Remapping (A[1])
      - Address increment mode (A[2]), off is horizontal, on is vertical.
      - COM Remapping (A[4])
      - Undocumented related to a monochrome mode, not supported by all displays (A[5])
      - Splitting of Odd / Even COM Signals (A[6])

      A[0], A[1], and A[4], define flipping of the display.
      A[6] is needed when display has striping.
      A[2] and A[5] must be off for this driver.

  phase-length:
    type: int
    required: true
    description: Phase Length for segment charging (7:4) and discharging (3:0).
      Good values to try first are 0x1f and 0xf1.

  function-selection-b:
    type: int
    default: 0x62
    description: Enables second precharge (A[1]), and external Voltage Segment Level (A[0])
      The value can either be 0x61, 0x62, or 0x63. Most displays use 0x62.

  precharge-voltage:
    type: int
    default: 0x8
    description: Set precharge voltage (0:4) from 0.20 x VCC to 0.613 x VCC (0x7) and VCOMH (0x8+).
      Most displays support 0x8.

  vcomh-voltage:
    type: int
    default: 0x7
    description: Set precharge voltage (0:3) from 0.72 x VCC to 0.86 x VCC
      Most displays support 0x7.

  inversion-on:
    type: boolean
    description: Turn on display color inverting

  grayscale-table:
    type: uint8-array
    description: 15 elements array defines gamma settings for each brightness levels.
```

## dts/bindings/display/solomon,ssd1327fb-i2c.yaml
```yaml
# Copyright (c) 2025 MASSDRIVER EI (massdriver.space)
# SPDX-License-Identifier: Apache-2.0

title: Solomon SSD1327 display controller on I2C bus

description: |
    The Solomon SSD1327 is a 4-bit greyscale OLED controller
    with a maximum 128x128 resolution.

include: ["solomon,ssd1327fb-common.yaml", "i2c-device.yaml"]

compatible: "solomon,ssd1327fb"
```

## dts/bindings/display/solomon,ssd1327fb-mipi.yaml
```yaml
# Copyright (c) 2025 MASSDRIVER EI (massdriver.space)
# SPDX-License-Identifier: Apache-2.0

title: Solomon SSD1327 display controller on MIPI_DBI or SPI bus

description: |
    The Solomon SSD1327 is a 4-bit greyscale OLED controller
    with a maximum 128x128 resolution.

include: ["solomon,ssd1327fb-common.yaml", "mipi-dbi-spi-device.yaml"]

compatible: "solomon,ssd1327fb"
```

## dts/bindings/display/solomon,ssd1327fb.yaml
```yaml
# Copyright (c) 2024, Savoir-faire Linux
# SPDX-License-Identifier: Apache-2.0

description: SSD1327 128x128 dot-matrix display controller on MIPI_DBI bus

include: [mipi-dbi-spi-device.yaml, display-controller.yaml]

compatible: "solomon,ssd1327fb"

properties:
  oscillator-freq:
    type: int
    required: true
    description: Front clock divider / oscillator frequency

  display-offset:
    type: int
    required: true
    description: Vertical offset by com from 0 ~ 127

  start-line:
    type: int
    required: true
    description: Start line of display RAM to be displayed by selecting a value from 0 to 127

  multiplex-ratio:
    type: int
    required: true
    description: Multiplex ratio from 16MUX to 128MUX

  prechargep:
    type: int
    required: true
    description: Pre-charge period ranging from 0 to 15 DCLK's

  remap-value:
    type: int
    required: true
    description: Remap register

      Has multiple configurations (see each bit setting in the datasheet)
      - Column Address Remapping (A[0])
      - Nibble Remapping (A[1])
      - Address increment mode (A[2])
      - COM Remapping (A[4])
      - Splitting of Odd / Even COM Signals (A[6])

  inversion-on:
    type: boolean
    description: Turn on display color inverting
```

## dts/bindings/display/solomon,ssd1331.yaml
```yaml
# Copyright (c) 2025 MASSDRIVER EI (massdriver.space)
# SPDX-License-Identifier: Apache-2.0

description: SSD1331 display controller

compatible: "solomon,ssd1331"

include: [mipi-dbi-spi-device.yaml, display-controller.yaml]

properties:
  display-offset:
    type: int
    required: true
    description: Vertical offset by com from 0 ~ 63. Typically 64 - height.

  start-line:
    type: int
    required: true
    description: Start line of display RAM to be displayed by selecting a value from 0 to 63.
      Typically 0.

  multiplex-ratio:
    type: int
    required: true
    description: Multiplex ratio from 16MUX to 64MUX, ranges from 15 to 63.
      Typically same value as height - 1.

  phase-length:
    type: int
    required: true
    description: Phase 2 Period (7:4) and Phase 1 Period (3:0).

  oscillator-freq:
    type: int
    required: true
    description: Front clock divider (3:0) / oscillator frequency (7:4).
      If you get weird scanlines, increase oscillator frequency and play with phase length values,
      for example set this to 0xF0. Note this increases power consumption.

  precharge-time-a:
    type: int
    required: true
    description: Set precharge time for segments A. Typically around 0x70.

  precharge-time-b:
    type: int
    required: true
    description: Set precharge time for segments B. Typically around 0x70.

  precharge-time-c:
    type: int
    required: true
    description: Set precharge time for segments C. Typically around 0x70.

  precharge-voltage:
    type: int
    required: true
    description: Set precharge voltage. A[5:1], from 0 (0.10 x VCC) to 0x3E (0.5 x VCC)

  vcomh-voltage:
    type: int
    required: true
    enum:
      - 0x0
      - 0x10
      - 0x20
      - 0x30
      - 0x3E
    description: Set COM deselect voltage. A[5:1]. 0.44, 0.52, 0.61, 0.71, 0.83 x VCC.

  current-att:
    type: int
    required: true
    description: Set Master current attenuation. A[3:0], from 1/16 to 16/16.

  remap-value:
    type: int
    required: true
    description: Remap register

      Has multiple configurations (see each bit setting in the datasheet)
      - A[0] HTiled or VTiled. Must be 0 for this driver.
      - A[1] Invert segment order
      - A[2] Invert ABC segment order
      - A[3] Left-Right Swap COMs
      - A[4] Invert COM order
      - A[5] Stripped odd/even display
      - A[7:6] Set color format. Must be 0x1 for this driver.

  power-save:
    type: boolean
    description: Enable Power Save mode

  inversion-on:
    type: boolean
    description: Turn on display color inverting
```

## dts/bindings/display/solomon,ssd1351.yaml
```yaml
# Copyright (c) 2025 MASSDRIVER EI (massdriver.space)
# SPDX-License-Identifier: Apache-2.0

description: SSD1351 display controller

compatible: "solomon,ssd1351"

include: ["solomon,ssd135x-common.yaml"]
```

## dts/bindings/display/solomon,ssd1357.yaml
```yaml
# Copyright (c) 2025 MASSDRIVER EI (massdriver.space)
# SPDX-License-Identifier: Apache-2.0

description: SSD1357 display controller

compatible: "solomon,ssd1357"

include: ["solomon,ssd135x-common.yaml"]
```

## dts/bindings/display/solomon,ssd135x-common.yaml
```yaml
# Copyright (c) 2025 MASSDRIVER EI (massdriver.space)
# SPDX-License-Identifier: Apache-2.0

description: SSD135x type display controller

include: [mipi-dbi-spi-device.yaml, display-controller.yaml]

properties:
  display-offset:
    type: int
    required: true
    description: Vertical offset by com from 0 ~ 127. Typically 128 - height.

  start-line:
    type: int
    required: true
    description: Start line of display RAM to be displayed by selecting a value from 0 to 127.
      Typically 0.

  multiplex-ratio:
    type: int
    required: true
    description: Multiplex ratio from 16MUX to 128MUX, ranges from 15 to 127.
      Typically same value as height - 1.

  phase-length:
    type: int
    required: true
    description: Phase 2 Period (7:4) and Phase 1 Period (3:0).

  oscillator-freq:
    type: int
    required: true
    description: Front clock divider (3:0) / oscillator frequency (7:4).
      If you get weird scanlines, increase oscillator frequency and play with phase length values,
      for example set this to 0xF1. Note this increases power consumption.

  precharge-time:
    type: int
    required: true
    description: Set 2nd precharge time for segments from 0 DCLK to 15 DCLK, 0 is invalid. A[3:0].
      Typically 0x8.

  precharge-voltage:
    type: int
    required: true
    description: Set precharge voltage. A[4:0], from 0 (0.20 x VCC) to 0x1F (0.6 x VCC)

  vcomh-voltage:
    type: int
    required: true
    description: Set COM deselect voltage. A[2:0]. From 0.72xVCC to 0.86xVCC.

  current-att:
    type: int
    required: true
    description: Set Master current attenuation. A[3:0], from 1/16 to 16/16.

  remap-value:
    type: int
    required: true
    description: Remap register

      Has multiple configurations (see each bit setting in the datasheet)
      - A[0] HTiled or VTiled. Must be 0 for this driver.
      - A[1] Invert segment order
      - A[2] Invert ABC segment order
      - A[4] Invert COM order
      - A[5] Stripped odd/even display
      - A[7:6] Set color format. Must be 0x1 for this driver. 0x0 Also works for SSD1351.

  inversion-on:
    type: boolean
    description: Turn on display color inverting

  column-offset:
    type: int
    default: 0
    description: Some vertical displays may need a column address offset to work properly.
```

## dts/bindings/display/solomon,ssd1363-common.yaml
```yaml
# Copyright (c) 2025 MASSDRIVER EI (massdriver.space)
# SPDX-License-Identifier: Apache-2.0

include: display-controller.yaml

properties:
  oscillator-freq:
    type: int
    required: true
    description: Front clock divider (3:0) / oscillator frequency (7:4). It can be set to 0x0.
      If you get weird scanlines, increase oscillator frequency and play with phase length values,
      for example set this to 0x70. Note this increases power consumption.

  display-offset:
    type: int
    required: true
    description: Vertical offset by com from 0 ~ 159. Typically 160 - height.

  start-line:
    type: int
    required: true
    description: Start line of display RAM to be displayed by selecting a value from 0 to 159.
      Typically 0.

  multiplex-ratio:
    type: int
    required: true
    description: Multiplex ratio from 3MUX to 159MUX. Typically same value as height - 1.

  remap-value:
    type: int
    required: true
    description: Remap register of 16-bits length

      Has multiple configurations (see each bit setting in the datasheet)
      first byte [15:8]
      - A[0] 0 is htiled, 1 is vtiled
      - A[1] invert SEG mapping
      - A[3] reserved
      - A[4] Invert COM
      - A[5] Sequential (0) or Alternative (Odd/Even) COMs
      second byte [7:0]
      - B[0] reserved
      - B[4] Dual COM mode (mux <= 79)

      A[5] is needed when display has striping.

  phase-length:
    type: int
    required: true
    description: Phase Length for segment charging (7:4) and discharging (3:0).
      Good values to try first are 0x1f and 0xf1.

  column-offset:
    type: int
    required: true
    description: Offset in columns. Typically (320 - width) / 2.
      This is done in software as SSD1363 lacks hardware tooling for this.

  precharge-period:
    type: int
    required: true
    description: Second pre-charge period ranging from 0 to 15 DCLK's.

  internal-iref:
    type: int
    default: 0x90
    description: Internal or external iref. 0x80 is External, 0x90 Internal.
      Most displays use Internal.

  precharge-config:
    type: int
    default: 0x3
    description: Vp pin floating (0x2) or linked to external capacitance (0x3).
      Most displays use a external capacitor.

  precharge-voltage:
    type: int
    default: 0x7
    description: Set precharge voltage (4:0) from 0.10 x VCC to 0.513 x VCC (0x1F).
      0x7 is the reset default.

  vcomh-voltage:
    type: int
    default: 0x4
    description: Set COM deselect voltage (3:0) from 0.72 x VCC (0x0) to 0.86 x VCC (0x7)
      0x4 is the reset default.

  inversion-on:
    type: boolean
    description: Turn on display color inverting

  grayscale-enhancement:
    type: boolean
    description: Enable grayscale enhancement, undocumented.

  grayscale-table:
    type: uint8-array
    description: 15 elements array defines gamma settings for each brightness levels.
      It seems last element must always be 60/0x3C.
```

## dts/bindings/display/solomon,ssd1363-i2c.yaml
```yaml
# Copyright (c) 2025 MASSDRIVER EI (massdriver.space)
# SPDX-License-Identifier: Apache-2.0

description: SSD1363 320x160 dot-matrix display controller on I2C bus

include: ["solomon,ssd1363-common.yaml", "i2c-device.yaml"]

compatible: "solomon,ssd1363"
```

## dts/bindings/display/solomon,ssd1363-mipi.yaml
```yaml
# Copyright (c) 2025 MASSDRIVER EI (massdriver.space)
# SPDX-License-Identifier: Apache-2.0

description: SSD1363 320x160 dot-matrix display controller on MIPI DBI bus

include: ["solomon,ssd1363-common.yaml", "mipi-dbi-spi-device.yaml"]

compatible: "solomon,ssd1363"
```

## dts/bindings/display/solomon,ssd1608.yaml
```yaml
# Copyright (c) 2022 Andreas Sandberg
# SPDX-License-Identifier: Apache-2.0

description: Solomon Systech SSD1608 320x240 EPD display controller

compatible: "solomon,ssd1608"

include: solomon,ssd16xx-common.yaml
```

## dts/bindings/display/solomon,ssd1673.yaml
```yaml
# Copyright (c) 2022 Andreas Sandberg
# SPDX-License-Identifier: Apache-2.0

description: Solomon Systech SSD1673 250x150 EPD display controller

compatible: "solomon,ssd1673"

include: solomon,ssd16xx-common.yaml
```
