## dts/bindings/display/tdo,tr230s.yaml
```yaml
# SPDX-License-Identifier: Apache-2.0

title: TR230S display bridge/controller

description: |
  Shanghai Top Display Optoelectronics TR230S is a display bridge/controller
  that accepts RGB565 pixel data from a host and drives an attached RGB display
  panel.

  This binding and driver support the MIPI DBI Type C four-wire SPI host
  interface. The TR230S also supports other host interfaces outside the scope
  of this binding. WAIT is controller-ready flow control and is checked before
  each controller transaction.

compatible: "tdo,tr230s"

include: [mipi-dbi-spi-device.yaml, display-controller.yaml]

properties:
  width:
    min: 1
    max: 65535

  height:
    min: 1
    max: 65535

  mipi-max-frequency:
    default: 100000000
    min: 1
    max: 100000000
    description: |
      Maximum SPI clock frequency, in Hz. The default of 100 MHz is the
      manufacturer's maximum specified SPI interface frequency; a board may
      select a lower frequency.

  mipi-mode:
    default: "MIPI_DBI_MODE_SPI_4WIRE"
    enum:
      - "MIPI_DBI_MODE_SPI_4WIRE"
    description: |
      MIPI DBI Type C mode used by this binding and driver. Four-wire SPI is
      the supported and validated mode for this Zephyr integration.

  wait-gpios:
    type: phandle-array
    required: true
    description: |
      Controller-ready input. The active logical state means that the TR230S
      can accept a new controller transaction.

  ready-timeout-ms:
    type: int
    min: 0
    description: |
      Maximum time to wait for controller readiness, in milliseconds. If the
      property is omitted or set to zero, the driver waits indefinitely,
      matching the manufacturer's STM32 example polling behavior.

  reset-pre-delay-ms:
    type: int
    default: 10
    min: 0
    description: |
      Delay before asserting hardware reset, in milliseconds. The 10 ms
      default follows the manufacturer's STM32 example and was validated on
      hardware; shorter timing did not initialize the tested module reliably.

  reset-pulse-ms:
    type: int
    default: 10
    min: 1
    description: |
      Hardware-reset pulse width, in milliseconds. The 10 ms default follows
      the manufacturer's STM32 example and was validated on hardware; shorter
      timing did not initialize the tested module reliably.

  post-reset-delay-ms:
    type: int
    default: 2000
    min: 0
    description: |
      Minimum time after releasing hardware reset before the first controller
      transaction, in milliseconds. The 2000 ms default follows the
      manufacturer's STM32 example and was validated on hardware; shorter
      timing did not initialize the tested module reliably.

  initial-brightness:
    type: int
    min: 0
    max: 255
    required: true
    description: |
      Initial non-blanked brightness.
```

## dts/bindings/display/ultrachip,uc8253.yaml
```yaml
# Copyright (c) 2026 RASNA
# Copyright (c) 2026 Łukasz Grabowski
# SPDX-License-Identifier: Apache-2.0

description: |
  UltraChip UC8253 EPD controller with optional four-level grayscale.

compatible: "ultrachip,uc8253"

include: ultrachip,uc81xx-common.yaml

properties:
  grayscale:
    type: boolean
    description: |
      Enables four-level PIXEL_FORMAT_L_8 output using two buffered planes.
      Requires a compatible panel OTP waveform, such as the Good Display
      GDEY037T03, and a ``gray`` child profile.

  gray-level-planes:
    type: array
    default: [0, 2, 1, 3]
    description: |
      DTM plane code for each grayscale level, darkest first. Each code is
      (DTM1 << 1) | DTM2. Values must be a permutation of 0 through 3. The
      default is for the Good Display GDEY037T03 panel.

child-binding:
  properties:
    ccset:
      type: int
      description: CCSET value for this refresh profile.

    tsset:
      type: int
      description: TSSET value for this refresh profile.
```

## dts/bindings/display/zephyr,sdl-dc.yaml
```yaml
# Copyright (c) 2021 Nordic Semiconductor ASA
# Copyright (c) 2025 Abderrahmane JARMOUNI
# SPDX-License-Identifier: Apache-2.0

description: SDL based emulated display controller

compatible: "zephyr,sdl-dc"

include: display-controller.yaml

properties:
  title:
    type: string
    description: |
      Name of graphical window

  pixel-format:
    type: string
    required: true
    description: |
      Initial Pixel format of this controller's output data.
    enum:
      - PANEL_PIXEL_FORMAT_RGB_888
      - PANEL_PIXEL_FORMAT_MONO01
      - PANEL_PIXEL_FORMAT_MONO10
      - PANEL_PIXEL_FORMAT_ARGB_8888
      - PANEL_PIXEL_FORMAT_RGB_565
      - PANEL_PIXEL_FORMAT_RGB_565X
      - PANEL_PIXEL_FORMAT_L_8
      - PANEL_PIXEL_FORMAT_AL_88
      - PANEL_PIXEL_FORMAT_XRGB_8888
      - PANEL_PIXEL_FORMAT_BGR_888
      - PANEL_PIXEL_FORMAT_ABGR_8888
      - PANEL_PIXEL_FORMAT_RGBA_8888
      - PANEL_PIXEL_FORMAT_BGRA_8888
      - PANEL_PIXEL_FORMAT_I_4

examples:
  - |
    #include <zephyr/dt-bindings/display/panel.h>

    sdl_dc: sdl_dc {
      /* ... */

      pixel-format = <PANEL_PIXEL_FORMAT_ABGR_8888>;
    };
```

## dts/bindings/dma/adi,axi-dmac.yaml
```yaml
# Copyright (c) 2026 Analog Devices, Inc.
# SPDX-License-Identifier: Apache-2.0

description: Analog Devices AXI DMAC (DMA Controller) core

compatible: "adi,axi-dmac"

include: [base.yaml, dma-controller.yaml]

properties:
  reg:
    required: true
  "#dma-cells":
    const: 1

dma-cells:
  - channel
```

## dts/bindings/dma/amd,acp-dmic-dma.yaml
```yaml
# SPDX-FileCopyrightText: Copyright (c) 2026 AMD
# SPDX-License-Identifier: Apache-2.0

description: AMD ACP DMIC (PDM) DMA (DMIC0/DMIC1)

compatible: "amd,acp-dmic-dma"

include: dma-controller.yaml

"#dma-cells":
  - channel

properties:
  dma-channels:
    type: int
    description: Number of DMA channels supported
  dma-requests:
    type: int
    description: Number of DMA requests supported
```

## dts/bindings/dma/brcm,bcm2835-dma.yaml
```yaml
# Copyright (c) 2026 Jonathan Elliot Peace <jep@alphabetiq.com>
# SPDX-License-Identifier: Apache-2.0

description: |
  Broadcom BCM2835 / BCM2710 / BCM2837 DMA controller.

  A control-block (linked-list descriptor) DMA engine with up to 16
  channels. The VideoCore firmware reserves some channels and a few
  have special hardware functionality; brcm,dma-channel-mask marks the
  channels this driver may use.

  The single #dma-cells value is the peripheral DREQ number, used to
  pace memory<->peripheral transfers.

compatible: "brcm,bcm2835-dma"

include: [dma-controller.yaml]

properties:
  reg:
    required: true

  interrupts:
    required: true

  dma-channels:
    required: true

  brcm,dma-channel-mask:
    type: int
    required: true
    description: |
      Bitmask of the channels the driver may use, bit N for channel N.
      The other channels are reserved by the VideoCore firmware or have
      special functions.

dma-cells:
  - dreq
```

## dts/bindings/dma/infineon,dmac.yaml
```yaml
# SPDX-FileCopyrightText: Copyright (c) 2026 Infineon Technologies AG,
# SPDX-FileCopyrightText: or an affiliate of Infineon Technologies AG. All rights reserved.
#
# SPDX-License-Identifier: Apache-2.0

title: Infineon DMAC

description: |
  DMAC for Infineon devices

compatible: "infineon,dmac"

include: [dma-controller.yaml, "infineon,system-interrupts.yaml"]

properties:
  reg:
    required: true

  interrupts:
    required: true

  "#dma-cells":
    const: 1

dma-cells:
  - channel
```

## dts/bindings/dma/infineon,dw-dma.yaml
```yaml
# SPDX-FileCopyrightText: Copyright (c) 2026 Infineon Technologies AG,
# SPDX-FileCopyrightText: or an affiliate of Infineon Technologies AG. All rights reserved.
# SPDX-FileCopyrightText: Copyright (c) 2026 Linumiz
#
# SPDX-License-Identifier: Apache-2.0

title: Infineon DataWire (P-DMA) controller

description: |
  Infineon DataWire (P-DMA) DMA controller. Each channel has its own
  interrupt, listed in channel order in the interrupts property.

  Example:

    dma0: dma-controller@40280000 {
      compatible = "infineon,dw-dma";
      reg = <0x40280000 0x10000>;
      #dma-cells = <1>;
      dma-channels = <76>;
      interrupt-parent = <&intmux_ch4>;
      interrupts = <296 0>, <297 0>;
    };

compatible: "infineon,dw-dma"

include: dma-controller.yaml

properties:
  reg:
    required: true

  interrupts:
    required: true

  "#dma-cells":
    const: 1

  enable-chaining:
    type: boolean
    description: |
      Make the last descriptor of a channel point to itself instead of
      ending the descriptor list.

dma-cells:
  - channel
```

## dts/bindings/dma/nxp,mcux-edma.yaml
```yaml
# Copyright (c) 2020,2024 NXP
# SPDX-License-Identifier: Apache-2.0

description: NXP MCUX EDMA controller

compatible: "nxp,mcux-edma"

include: [dma-controller.yaml, reset-device.yaml]

properties:
  clocks:
    type: phandle-array

  reg:
    required: true
    description: |
      Specifies base physical address(s) and size of DMA and respective DMAMUX register(s)
      that routes DMA sources

  interrupts:
    required: true

  dma-channels:
    required: true
    description: |
      Specifies the number of DMA channels supported by the controller.
      This value is used to validate the channel number provided in the
      DMA specifier.

  dma-requests:
    required: true
    description: |
      Indicates the maximum value of the DMA request sources (slots) index supported by
      DMAMUX. This value is used to validate the request source index provided in the
      DMA specifier.

  has-dmamux:
    type: boolean
    description: |
      Indicates whether the DMA controller has an integrated DMAMUX.
      If present, the controller includes DMAMUX functionality.

  dmamux-reg-offset:
    type: int
    default: 0
    description:
      The offset value for obtaining DMAMUX register index from DMAMUX channel.
      Default value means DMAMUX channel is identical with DMAMUX register index

  channel-gap:
    type: array
    description: |
      On some platforms, there may be a gap in the channels and
      this array specifies the start and end of a single gap

  nxp,mem2mem:
    type: boolean
    description: If the DMA controller supports memory to memory transfer

  nxp,a-on:
    type: boolean
    description: If the DMA controller supports always on

  irq-shared-offset:
    type: int
    default: 0
    description: |
      Describes an offset between two channels share the same interrupt entry.
      Default value means each channel has separate interrupt entry.

  no-error-irq:
    type: boolean
    description: |
      If the SoCs don't have a separate interrupt id for error IRQ.

  nxp,version:
    type: int
    enum:
      - 2
      - 3
      - 4
      - 5
    description: |
      eDMA IP revision number.

  nxp,channel-preemption:
    type: boolean
    description: |
      Let a higher priority channel suspend a running lower priority channel
      after its current read/write sequence. The driver sets DCHPRIn[ECP] on
      all channels at init. Without this property, a channel that requests
      service waits until the running channel completes its minor loop.
      The hardware has one preemption level: a channel that preempts another
      one cannot be preempted. Preemption needs fixed priority arbitration,
      which is what the driver uses.
      Only eDMA version 2 (nxp,version = <2>) supports this property.

  nxp,channel-priorities:
    type: array
    description: |
      List of <channel priority> pairs that the driver applies at init.
      With fixed priority arbitration, the channel with the higher priority
      value is served first. The channels are arbitrated in groups that have
      one channel for each priority value (for example, two groups of 16 on
      a 32-channel eDMA), and the priorities in a group must be unique. To
      keep them unique, the channel that has the requested priority gets the
      old priority of the listed channel. All other channels keep the reset
      priority, which is the channel number in its group.
      A channel can occur only one time, and two channels of the same group
      cannot request the same priority.
      Example: nxp,channel-priorities = <0 15>, <20 0>;
      Only eDMA version 2 (nxp,version = <2>) supports this property.

  channels-shared-irq-mask:
    type: array
    description: |
      Describes channel enabled mask value on every IRQ.
      The channel number is mapped to the bit value of array element value.
      If the interrupt is shared on one channel number, the correspongding
      bit is set to 1.
      Please note each element of the array must be 32-bit. If there are more
      than 32 channels, add one or more 32-bit elements in array(elements
      should be contiguous). The software will determine the mask value of
      several elements corresponding to the same interrupt according to the
      number of channels.

  "#dma-cells":
    type: int
    required: true
    description: Number of items to expect in a DMAMUX specifier

# - #dma-cells : Must be <2>.
#  The 1st cell specifies the DMA channel which will be used
#  The 2nd cell specifies the request source (slot) ID.
#    See the SoC's reference manual for all the supported request sources.

dma-cells:
  - mux
  - source
```

## dts/bindings/dma/ti,cc23x0-cc27xx-dma.yaml
```yaml
# Copyright (c) 2024 BayLibre, SAS
# SPDX-License-Identifier: Apache-2.0

description: |
  TI CC23X0_CC27XX uDMA controller

  channel: Select channel for data transmitting. Channels are either
    Dedicated uDMA channels (DCH) for peripherals or Event Publisher Channels
    (ECH) that can be connected to any EVTSVT publishers.

  slot: For ECH channels, the slot should be an EVTSVT event publisher ID.
    For DCH channels, it should be an EVTSVT IP ID.

  In the driver, setting the source_chaning_en enables the uDMA auto mode, and
  deselecting enables basic mode. Setting source_handshake selects software
  triggered transfers and deselecting it enables hardware triggered transfers.


compatible: "ti,cc23x0-cc27xx-dma"

include: dma-controller.yaml

properties:
  reg:
    required: true

  interrupts:
    required: true

  "#dma-cells":
    const: 2
    description: |
      The 1st cell specifies the DMA channel to be used for the data transfer.
      This channel should be unique between all peripherals that are using the
      DMA instance.
      The 2nd cell defines the peripheral trigger which is the source of the transfer.
      See the SoC's reference manual for all the supported request sources.

      Example of devicetree DMA channel configuration for the client part:

      &uart0 {
          dmas = <&dma 0 7>, <&dma 1 6>;
          dma-names = "rx", "tx";
      };

      Above, fragment 0 and 1 represent the different channels used to transfer
      data between peripheral and RAM. The numbers 7/6 are uart0 rx/tx triggers.

dma-cells:
  - channel
  - trigsrc
```
