## dts/bindings/dma/ti,cc35xx-dma.yaml
```yaml
# Copyright (c) 2025-2026 Conclusive Engineering Sp. z o.o.
#
# SPDX-License-Identifier: Apache-2.0
#

description: |
  TI Simplelink DMA controller for the cc35xx chip family.


  The TI CC35xx SoC has a general-purpose direct memory access controller
  capable of supporting 12independent DMA channels. DMA clients connected
  to the DMA controller must use three-cell specifier  for each channel:
    a phandle to the DMA controller plus the following two integer cells:
      1. channel: the DMA stream from 0 to 11 (max 12 channels).
         Note that channel 11 is reserved for the BT/WIFI subsystem, and cannot
         be used directly in the DTS
      2. channel-config: A 32bit mask specifying the DMA channel configuration
         which is device and peripheral dependent:
           -bit 0-3 Peripheral index

  Example of devicetree configuration

   Client side:
     uart0 {
         dmas = <&dma1 3 CC35XX_DMA_SET_CONFIG(CC35xx_DMA_PERIPH_UARTLIN_0)>,
                <&dma1 2 CC35XX_DMA_SET_CONFIG(CC35xx_DMA_PERIPH_UARTLIN_0)>
         dma-names = "tx", "rx";
     }

compatible: "ti,cc35xx-dma"

include: dma-controller.yaml

properties:
  "#dma-cells":
    const: 2

dma-cells:
  - channel
  - channel-config
```

## dts/bindings/dma/ti,mspm0-dma.yaml
```yaml
#
#  Copyright (c) 2026 Linumiz
#
#  SPDX-License-Identifier: Apache-2.0

title: TI MSPM0 DMA

description: Texas Instruments MSPM0 Series DMA

compatible: "ti,mspm0-dma"

include: dma-controller.yaml

properties:
  reg:
    required: true

  interrupts:
    required: true

  "#dma-cells":
    const: 2

  ti,num-full-channels:
    type: int
    default: 0
    description: |
      Number of FULL-featured DMA channels on this instance, counted from channel 0.

dma-cells:
  - channel
  - trigger
```

## dts/bindings/dsa/dsa.yaml
```yaml
# Copyright 2025 NXP
# SPDX-License-Identifier: Apache-2.0

title: DSA Switch

description: Distributed Switch Architecture (DSA) Network Switch

child-binding:
  include: base.yaml

  properties:
    compatible:
      const: "zephyr,dsa-port"
```

## dts/bindings/dsa/microchip,ksz8463.yaml
```yaml
# Copyright (c) 2026 Vilhelm Engström
#
# SPDX-License-Identifier: Apache-2.0

description: Microchip KSZ8463 3-Port Ethernet Switch

compatible: "microchip,ksz8463"

include:
  - name: base.yaml
    property-allowlist:
      - reg
  - name: dsa.yaml
    child-binding:
      property-allowlist:
        - zephyr,random-mac-address
        - zephyr,mac-address-prefix
        - local-mac-address
        - phy-connection-type
        - ptp-clock
        - ethernet
        - port
        - reg
        - dsa-tag-protocol
  - name: pinctrl-device.yaml
  - name: spi-device.yaml

properties:
  reset-gpios:
    type: phandle-array
    description: |
      Optional reset GPIO. If provided, the pin is asserted 10ms during initialization. If omitted,
      the chip subjected to a software reset instead.

      If provided, the phandle array should specify exactly one GPIO.

  int-gpios:
    type: phandle-array
    description: |
      Optional GPIO to monitor for chip interrupts.

      If provided, the phandle array should contain exactly one GPIO.

  microchip,legal-packet-size-check-en:
    type: boolean
    description: |
      Enable legal maximum packet size check.

  microchip,igmp-snoop-en:
    type: boolean
    description: |
      Enable IGMP snooping.

  microchip,mld-snoop-en:
    type: boolean
    description: |
      Enable MLD snooping.

  microchip,spi-operational-timeout:
    type: int
    default: 100
    min: 10
    description: |
      Number of milliseconds to wait for the chip to respond over SPI during initialization.

  microchip,port-led-mode:
    type: string
    default: "LED1: Activity, LED0: Link"
    description: |
      Configure behavior of the two LEDs
    enum:
      - "LED1: Speed, LED0: Link And Activity"
      - "LED1: Activity, LED0: Link"
      - "LED1: Full-Duplex, LED0: Link And Activity"
      - "LED1: FUll-Duplex, LED0: Link"

  microchip,link-state-poll-interval:
    type: int
    default: 1000
    min: 10
    description: |
      Interval at which the link state is polled should no int-gpios property be provided.
      Given in ms.

child-binding:

  properties:
    reg:
      description: |
        Single-cell reg specifying the zero-indexed port number. Physical port 1 should have value
        0, physical port 2 value 1 and so on.

    ethernet:
      description: |
        A phandle referring to the Ethernet node to which the CPU port, i.e. physical port 3, is
        connected. Should be set for only the node with reg value 2.

    dsa-tag-protocol:
      description: |
        An integer identifying which DSA tag protocol to use. Must be either DSA_TAG_PROTO_NOTAG or
        DSA_TAG_PROTO_KSZ8463. The former disables packet tagging, the latter uses the
        KSZ8463-specific tagging scheme.

        The property should be set for the CPU port. The default is DSA_TAG_PROTO_NOTAG.

    microchip,disable-eee:
      type: boolean
      description: |
        Permanently disable Energy-Efficient Ethernet.

        Note that even should this property not be set, the driver disables EEE while disabling
        auto-negotiation as a workaround for errata 4 in KSZ8463MLI_FMLI_Prod_0.3_errata.

  child-binding:

    description: |
      User port integrated PHY. Note that the node must be named "phy" to allow the driver to find
      it.

    compatible: "microchip,ksz8463-phy"

    properties:
      microchip,fixed-link:
        type: boolean
        description: |
          Disable auto-negotiation. The speed used is determiend by the microchip,fixed-link-speed
          property.

          This property may be altered at runtime by calling phy_configure_link.

      microchip,fixed-link-speed:
        type: string
        default: "10BASE Half-Duplex"
        description: |
          Speed to fall back on if link partner does not support auto-negotiation or when the latter
          is disabled.
        enum:
          - "10BASE Half-Duplex"
          - "10BASE Full-Duplex"
          - "100BASE Half-Duplex"
          - "100BASE Full-Duplex"

      microchip,autoneg-poll-interval:
        type: int
        default: 100
        description: |
          Interval at which the PHY should be polled for auto-negotiation completion. In ms.

      microchip,autoneg-timeout:
        type: int
        default: 5000
        description: |
          Number of milliseconds after which auto-negotiation is assumed to have failed. On failure,
          the PHY falls back on whatever is configured via microchip,fixed-link-speed.

          The value must be greater than microchip,autoneg-poll-interval.

examples: |
  &mac {
    /* For MII-based products */
    phy-connection-type = "mii";

    status = "okay";
  };

  &spi1 {
    /* ... */

    sw1: ethernet-switch@0 {
      compatible = "microchip,ksz8463";

      reg = <0>;

      spi-max-frequency = <DT_FREQ_M(50)>;

      #address-cells = <1>;
      #address-cells = <0>;

      /* Enable IGMP and MLD snooping */
      microchip,igmp-snoop-en;
      microchip,mld-snoop-en;

      status = "okay";

      /* User port 1 */
      port1: port@0 {
        compatible = zephyr,dsa-port";

        /* Physical port 1 has address 0 */
        reg = <0>;

        /* Use random MAC */
        zephyr,random-mac-address;

        phy-connection-type = "internal";

        status = "okay";

        /* Internal PHY */
        phy {
          compatible = "microchip,ksz8463-phy";

          /* Poll twice a second, give up after 5s */
          microchip,autoneg-poll-interval = <500>;
          microchip,autoneg-timeout = <5000>;

          /* Fall back on 100BASE Full-Duplex on auto-negotiation failure */
          microchip,fixed-link-speed = "100BASE Full-Duplex";

          status = "okay";
        };
      };

      /* User port 2 */
      port2: port@1 {
        compatible = zephyr,dsa-port";

        /* Physical port 2 has address 1 */
        reg = <1>;

        /* Use random MAC */
        zephyr,random-mac-address;

        phy-connection-type = "internal";

        status = "okay";

        /* Internal PHY */
        phy {
          compatible = "microchip,ksz8463-phy";

          /* Poll every 400ms , give up after 8s */
          microchip,autoneg-poll-interval = <400>;
          microchip,autoneg-timeout = <8000>;

          /* Fall back on 10BASE Half-Duplex on auto-negotiation failure */
          microchip,fixed-link-speed = "10BASE Half-Duplex";

          status = "okay";
        };
      };

      /* CPU port */
      port3: port@2 {
        compatible = "zephyr,dsa-port";

        reg = <2>;

        /* Connected to the MAC */
        ethernet = <&mac>;
        /* Should match both the switch model and the MAC */
        phy-connection-type = "mii";

        /* No PHY node required on the CPU port */

        /* Use KSZ8463 tag protocol */
        dsa-tag-protocol = <DSA_TAG_PROTO_KSZ8463>;

        status = "okay";
      };
    };
  };
```

## dts/bindings/energy-meter/microchip,atm90e26-common.yaml
```yaml
# Copyright (c) 2025 Pedro Ramos
# SPDX-License-Identifier: Apache-2.0

description: |
  Microchip ATM90E26 single-phase energy metering IC (formerly Atmel M90E26).

  Calibration and configuration values are written to the chip at
  initialization, followed by the CS1 and CS2 checksums, which the driver
  computes. Every register property defaults to the power-on value from the
  datasheet. All register values are 16-bit.

properties:
  meter-constant:
    type: int
    default: 3200
    description: |
      Meter constant (MC) in pulses per kWh. One CF pulse corresponds to
      1 kWh / MC. Used to convert the energy registers to watt-hours; it
      must match the value pl-constant was derived from.

  current-scale:
    type: array
    default: [1, 1]
    description: |
      Ratio <numerator denominator> of the actual current to the current
      the chip is calibrated to read. Each value is from 1 to 65535.

      The RMS current registers stop at 65.535 A and the power registers
      at 32.767 kW. To measure more, calibrate the chip (i-gain-l,
      i-gain-n, l-gain, n-gain) to read a fraction of the actual current
      and set this property to the inverse of that fraction. The driver
      multiplies current, power and energy by the ratio; voltage, power
      factor, phase angle and frequency are not affected. Keep
      meter-constant and pl-constant as calibrated, so that energy scales
      with power.

      For example, a meter calibrated to read one tenth of the load
      current uses <10 1>.

  irq-gpios:
    type: phandle-array
    description: IRQ interrupt output, reported as alarm event 0.

  wrn-out-gpios:
    type: phandle-array
    description: WarnOut fatal error warning output, reported as fault event 0.

  cf1-gpios:
    type: phandle-array
    description: CF1 active energy pulse output, reported as pulse event 0.

  cf2-gpios:
    type: phandle-array
    description: CF2 reactive energy pulse output, reported as pulse event 1.

  func-en:
    type: int
    default: 0x000c
    description: FuncEn (02h), function enable.

  sag-th:
    type: int
    default: 0x1d6a
    description: SagTh (03h), voltage sag threshold.

  pl-constant:
    type: int
    default: 0x0015d174
    description: PL_Constant, written to PLconstH (21h) and PLconstL (22h).

  l-gain:
    type: int
    default: 0x0000
    description: Lgain (23h), L line calibration gain.

  l-phi:
    type: int
    default: 0x0000
    description: Lphi (24h), L line calibration angle.

  n-gain:
    type: int
    default: 0x0000
    description: Ngain (25h), N line calibration gain.

  n-phi:
    type: int
    default: 0x0000
    description: Nphi (26h), N line calibration angle.

  p-start-th:
    type: int
    default: 0x08bd
    description: PStartTh (27h), active startup power threshold.

  p-nol-th:
    type: int
    default: 0x0000
    description: PNolTh (28h), active no-load power threshold.

  q-start-th:
    type: int
    default: 0x0aec
    description: QStartTh (29h), reactive startup power threshold.

  q-nol-th:
    type: int
    default: 0x0000
    description: QNolTh (2Ah), reactive no-load power threshold.

  mmode:
    type: int
    default: 0x9422
    description: MMode (2Bh), metering mode configuration.

  u-gain:
    type: int
    default: 0x6720
    description: Ugain (31h), voltage RMS gain.

  i-gain-l:
    type: int
    default: 0x7a13
    description: IgainL (32h), L line current RMS gain.

  i-gain-n:
    type: int
    default: 0x7530
    description: IgainN (33h), N line current RMS gain.

  u-offset:
    type: int
    default: 0x0000
    description: Uoffset (34h), voltage offset.

  i-offset-l:
    type: int
    default: 0x0000
    description: IoffsetL (35h), L line current offset.

  i-offset-n:
    type: int
    default: 0x0000
    description: IoffsetN (36h), N line current offset.

  p-offset-l:
    type: int
    default: 0x0000
    description: PoffsetL (37h), L line active power offset.

  q-offset-l:
    type: int
    default: 0x0000
    description: QoffsetL (38h), L line reactive power offset.

  p-offset-n:
    type: int
    default: 0x0000
    description: PoffsetN (39h), N line active power offset.

  q-offset-n:
    type: int
    default: 0x0000
    description: QoffsetN (3Ah), N line reactive power offset.
```

## dts/bindings/energy-meter/microchip,atm90e26-spi.yaml
```yaml
# Copyright (c) 2025 Pedro Ramos
# SPDX-License-Identifier: Apache-2.0

description: |
  Microchip ATM90E26 single-phase energy metering IC on a 4-wire SPI bus,
  mode 3 (CPOL=1, CPHA=1). The USEL pin must select SPI.

compatible: "microchip,atm90e26"

include: [spi-device.yaml, "microchip,atm90e26-common.yaml"]
```
