## dts/bindings/display/nxp,dcif.yaml
```yaml
# Copyright 2026 NXP
# SPDX-License-Identifier: Apache-2.0

description: NXP DCIF (Display Controller Interface)

compatible: "nxp,dcif"

include: [lcd-controller.yaml, pinctrl-device.yaml, reset-device.yaml]

properties:
  reg:
    required: true

  interrupts:
    required: true

  backlight-gpios:
    type: phandle-array
    required: true
    description:
      LCD backlight control gpio. Driver will initialize this GPIO to active high

  power-gpios:
    type: phandle-array
    description:
      Panel power-enable gpio, driven active high once at init and left on.
      Left blank for a panel whose power rail is not gpio-controlled.

  data-bus-width:
    type: string
    default: "RGB565"
    enum:
      - "RGB888" # 24-bit
      - "RBG888" # 24-bit
      - "GBR888" # 24-bit
      - "GRB888" # 24-bit
      - "BRG888" # 24-bit
      - "BGR888" # 24-bit
      - "RGB555" # 15-bit XRRRRRGG_GGGBBBBB
      - "RGB565" # 16-bit RRRRRGGG_GGGBBBBB
      - "RGB666" # 18-bit XXXXXXRR_RRRRGGGG_GGBBBBBB
    description:
      DPI output data format of the controller sent to the panel. The default is
      set to the reset value of RGB565. The enumerator order matches the DCIF HAL
      dcif_dpi_output_format_t enumeration.

  ext-ram:
    type: phandle
    description: |
      Secondary RAM in which the controller's frame buffer(s) will
      be stored. If not defined, the 'zephyr,ram' chosen memory will be used.
```

## dts/bindings/display/philips,pcd8544.yaml
```yaml
# Copyright (c) 2025 LACOMBE Quentin <quentlace2g@gmail.com>
# Copyright (c) 2026 Eyitope Adelowo <adeyitope.io@gmail.com>
# SPDX-License-Identifier: Apache-2.0

title: PCD8544 LCD display controller

description: |
   Philips PCD8544 is LCD display controller that support LCD monochrome display
   with a resolution of 84x48 pixels. Used in old Nokia 5110 phone.

compatible: "philips,pcd8544"

include: [mipi-dbi-spi-device.yaml, display-controller.yaml]

properties:
  bias:
    type: int
    description: |
      Sets the LCD bias system i.e. bits BS2:BS0 . Values range 0 to 7.
      This controls the LCD bias voltage. See datasheet for more info.

  vop:
    type: int
    default: 63
    description: |
      Sets the LCD operation voltage (VOP), i.e. bits VOP6:VOP0 in the
      "Set VOP" command. Value range 0 to 127.

      VLCD = 3.06 + (vop * 0.06) [V], giving a program range of
      3.00 to 10.68 V at room temperature.
```

## dts/bindings/display/raspberrypi,bcm2711-framebuffer.yaml
```yaml
# Copyright (c) 2026 Muhammad Waleed Badar
# SPDX-License-Identifier: Apache-2.0

description: |
    Raspberry Pi BCM2711 framebuffer display device.

    Note:
      For HDMI output configuration and related framebuffer settings, see:
      https://www.raspberrypi.com/documentation/computers/legacy_config_txt.html

compatible: "raspberrypi,bcm2711-framebuffer"

include: display-controller.yaml

properties:
  pixel-format:
    type: int
    required: true
    description: |
      Initial Pixel format of this controller's output data.
    enum:
      - 8 # PANEL_PIXEL_FORMAT_ARGB_8888
      - 1024 # PANEL_PIXEL_FORMAT_ABGR_8888

examples:
  - |
    #include <zephyr/dt-bindings/display/panel.h>

    fb0: framebuffer {
      /* ... */

      pixel-format = <PANEL_PIXEL_FORMAT_ABGR_8888>;
    };
```

## dts/bindings/display/raydium,rm67162-common.yaml
```yaml
# SPDX-FileCopyrightText: Copyright The Zephyr Project Contributors
# SPDX-License-Identifier: Apache-2.0

title: Raydium RM67162 display controller common properties

include: display-controller.yaml

properties:
  init-sequence:
    type: string
    default: "g1120b0mipi"
    enum:
      - "g1120b0mipi"
      - "lilygo-t-display-s3-amoled"
    description: |
      Manufacturer settings written to the controller at initialization.
      They come from the panel vendor and differ between panels.

      - g1120b0mipi: 400x392 panel of the G1120B0MIPI module
      - lilygo-t-display-s3-amoled: 1.91" 240x536 panel of the LilyGO
        T-Display S3 AMOLED boards

  rotation:
    type: int
    default: 0
    enum:
      - 0
      - 90
      - 180
      - 270
    description: |
      Initial display rotation (clockwise) in degrees. The width and height
      properties describe the panel before this rotation is applied.
```

## dts/bindings/display/raydium,rm67162-mipi-dbi.yaml
```yaml
# SPDX-FileCopyrightText: Copyright The Zephyr Project Contributors
# SPDX-License-Identifier: Apache-2.0

title: Raydium RM67162 display controller on MIPI DBI bus

description: |
  The Raydium RM67162 is a 16.7M colors OLED controller.

compatible: "raydium,rm67162"

include: [mipi-dbi-spi-device.yaml, "raydium,rm67162-common.yaml"]

properties:
  mipi-mode:
    required: true
    description: |
      MIPI DBI mode in use. The RM67162 has 3-wire and 4-wire SPI and an
      8-bit 8080 bus interface. These definitions should match those in
      dt-bindings/mipi_dbi/mipi_dbi.h

  pixel-format:
    type: int
    default: 32
    enum:
      - 1 # PANEL_PIXEL_FORMAT_RGB_888
      - 32 # PANEL_PIXEL_FORMAT_RGB_565X
    description: |
      Initial pixel format. The MIPI DBI interfaces of the controller are
      byte wide and receive 16-bit pixels most significant byte first.
```

## dts/bindings/display/shtdo,tr230s.yaml
```yaml
# SPDX-License-Identifier: Apache-2.0

compatible: "shtdo,tr230s"

description: |
  Shanghai Top Display Optoelectronics TR230S SPI-to-RGB display bridge.

  This binding describes the four-wire SPI host interface. The host uses a
  data/command GPIO to distinguish commands from payload bytes. The WAIT
  signal is active when the controller can accept a new transaction.

include:
  - name: spi-device.yaml
  - name: display-controller.yaml

properties:
  dc-gpios:
    type: phandle-array
    required: true
    description: |
      Data/command selection GPIO. The inactive logical state selects command
      bytes and the active logical state selects parameters or pixel data.

  reset-gpios:
    type: phandle-array
    required: true
    description: Hardware reset GPIO. The active logical state resets TR230S.

  wait-gpios:
    type: phandle-array
    required: true
    description: |
      Controller-ready input. The active logical state means that a new
      transaction may be transmitted.

  ready-timeout-ms:
    type: int
    default: 500
    description: |
      Maximum time to wait for the controller-ready signal. A value of zero
      waits indefinitely.

  reset-pre-delay-ms:
    type: int
    default: 0
    description: Delay before asserting hardware reset.

  reset-pulse-ms:
    type: int
    default: 10
    description: Duration of the active hardware-reset pulse.

  post-reset-delay-ms:
    type: int
    default: 0
    description: Delay after releasing hardware reset.

  default-brightness:
    type: int
    default: 50
    description: Backlight duty percentage restored when blanking is disabled.
```

## dts/bindings/display/simple-framebuffer.yaml
```yaml
# Copyright (c) 2026 Muhammad Waleed Badar
# SPDX-License-Identifier: Apache-2.0

description: |
  Common fields for a simple firmware-provided framebuffer.

  Describes a framebuffer that has already been allocated and configured
  by firmware or the bootloader, under the assumption that the display
  hardware is already scanning out from the given memory region.

include: display-controller.yaml

properties:
  firmware:
    type: phandle
    description: |
      Phandle to the firmware/mailbox device used to query or reconfigure
      the framebuffer at runtime.
```

## dts/bindings/display/sitronix,st7701-rgb.yaml
```yaml
# Copyright (c) 2026 Kim Bøndergaard <kim@fam-boendergaard.dk>
# SPDX-License-Identifier: Apache-2.0

title: Sitronix ST7701 RGB panel with DBI command channel

description: |
  ST7701 panel driven over a parallel RGB interface, with panel control
  commands sent over a MIPI-DBI SPI command channel.
  The RGB host controller owns the framebuffer and the pixel timing, and
  refers to this node through its display-controller property.

compatible: "sitronix,st7701-rgb"

include: [mipi-dbi-spi-device.yaml, display-controller.yaml]

properties:
  pvgamctrl:
    type: uint8-array
    required: true
    description: Positive voltage gamma control payload, including command byte (0xB0).

  nvgamctrl:
    type: uint8-array
    required: true
    description: Negative voltage gamma control payload, including command byte (0xB1).

  gip-e0:
    type: uint8-array
    required: true
    description: GIP setting at address 0xE0, including command byte.

  gip-e1:
    type: uint8-array
    required: true
    description: GIP setting at address 0xE1, including command byte.

  gip-e2:
    type: uint8-array
    required: true
    description: GIP setting at address 0xE2, including command byte.

  gip-e3:
    type: uint8-array
    required: true
    description: GIP setting at address 0xE3, including command byte.

  gip-e4:
    type: uint8-array
    required: true
    description: GIP setting at address 0xE4, including command byte.

  gip-e5:
    type: uint8-array
    required: true
    description: GIP setting at address 0xE5, including command byte.

  gip-e6:
    type: uint8-array
    required: true
    description: GIP setting at address 0xE6, including command byte.

  gip-e7:
    type: uint8-array
    required: true
    description: GIP setting at address 0xE7, including command byte.

  gip-e8:
    type: uint8-array
    required: true
    description: GIP setting at address 0xE8, including command byte.

  gip-eb:
    type: uint8-array
    required: true
    description: GIP setting at address 0xEB, including command byte.

  gip-ec:
    type: uint8-array
    required: true
    description: GIP setting at address 0xEC, including command byte.

  gip-ed:
    type: uint8-array
    required: true
    description: GIP setting at address 0xED, including command byte.

  reset-gpios:
    type: phandle-array
    description: GPIO controlling ST7701 reset line.

  reset-delay-ms:
    type: int
    required: true
    description: Delay in milliseconds while reset is asserted.

  inversion-on:
    type: boolean
    description: Enable display inversion mode during initialization.
```

## dts/bindings/display/sitronix,st7701.yaml
```yaml
# Copyright (c) 2025 Arduino SA
# SPDX-License-Identifier: Apache-2.0

title: Sitronix ST7701 display controller

description: |
    The Sitronix ST7701 is a 16.7M colors TFT-LCD controller
    with a maximum 480RGBx864 resolution.

compatible: "sitronix,st7701"

include: [mipi-dsi-device.yaml, display-controller.yaml]

properties:
  reset-gpios:
    type: phandle-array
    description: |
      The RESETn pin is asserted to disable the sensor causing a hard
      reset.  The sensor receives this as an active-low signal.

  bl-gpios:
    type: phandle-array
    description: |
      The BLn pin is asserted to control the backlight of the panel.
      The sensor receives this as an active-high signal.

  rotation:
    type: int
    default: 0
    enum:
      - 0
      - 90
      - 180
      - 270
    description: |
      Display rotation (CW) in degrees. Defaults to 0, display default.

  inversion-on:
    type: boolean
    description: |
      Enable display inversion mode (DCS INVON). The inversion state is
      always programmed explicitly (INVON when present, INVOFF when
      absent), as the power-on state of some panels is not deterministic.

  bk3-ef:
    type: uint8-array
    description: |
      Command2 BK3 setting at address 0xEF, including the command byte.
      Written (preceded by the BK3 selection) at the start of the init
      sequence when present.

  lneset:
    type: uint8-array
    description: |
      Display line setting at address 0xC0, including the command byte.
      Overrides the value computed from the panel height when present.

  porctrl:
    type: uint8-array
    description: |
      Porch control setting at address 0xC1, including the command byte.
      Overrides the value derived from the display timings when present.

  cc-control:
    type: uint8-array
    description: |
      Setting at address 0xCC, including the command byte. Defaults to
      [CC 18] when absent.

  invsel:
    type: uint8-array
    description: |
      Inversion selection and minimum line period setting at address 0xC2,
      including the command byte. Defaults to [C2 01 08] when absent.

  vrhs:
    type: int
    default: 0x65
    description: Vop amplitude setting (Command2 BK1, 0xB0).

  vcom:
    type: int
    default: 0x34
    description: VCOM amplitude setting (Command2 BK1, 0xB1).

  vghss:
    type: int
    default: 0x87
    description: VGH voltage setting (Command2 BK1, 0xB2).

  vgls:
    type: int
    default: 0x49
    description: VGL voltage setting (Command2 BK1, 0xB5).

  pwctlr1:
    type: int
    default: 0x85
    description: Power control 1 (Command2 BK1, 0xB7).

  pwctlr2:
    type: int
    default: 0x20
    description: Power control 2 (Command2 BK1, 0xB8).

  spd1:
    type: int
    default: 0x78
    description: Source pre-drive timing set 1 (Command2 BK1, 0xC1).

  spd2:
    type: int
    default: 0x78
    description: Source EQ2 setting (Command2 BK1, 0xC2).

  mipiset1:
    type: int
    default: 0x88
    description: MIPI setting 1 (Command2 BK1, 0xD0).

  b9:
    type: int
    description: |
      Command2 BK1 setting at address 0xB9. Written only when present.

  gip-e0:
    type: uint8-array
    description: GIP setting at address 0xE0.

  gip-e1:
    type: uint8-array
    description: GIP setting at address 0xE1.

  gip-e2:
    type: uint8-array
    description: GIP setting at address 0xE2.

  gip-e3:
    type: uint8-array
    description: GIP setting at address 0xE3.

  gip-e4:
    type: uint8-array
    description: GIP setting at address 0xE4.

  gip-e5:
    type: uint8-array
    description: GIP setting at address 0xE5.

  gip-e6:
    type: uint8-array
    description: GIP setting at address 0xE6.

  gip-e7:
    type: uint8-array
    description: GIP setting at address 0xE7.

  gip-e8:
    type: uint8-array
    description: GIP setting at address 0xE8.

  gip-e9:
    type: uint8-array
    description: GIP setting at address 0xE9.

  gip-eb:
    type: uint8-array
    description: GIP setting at address 0xEB.

  gip-ec:
    type: uint8-array
    description: GIP setting at address 0xEC.

  gip-ed:
    type: uint8-array
    description: GIP setting at address 0xED.

  gip-ef:
    type: uint8-array
    description: Command2 BK1 setting at address 0xEF.

  pvgamctrl:
    type: uint8-array
    description: Positive voltage gamma control.

  nvgamctrl:
    type: uint8-array
    description: Negative voltage gamma control.
```
