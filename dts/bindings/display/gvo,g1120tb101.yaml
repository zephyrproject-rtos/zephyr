## dts/bindings/display/gvo,g1120tb101.yaml
```yaml
# Copyright (c) 2025 STMicroelectronics
# SPDX-License-Identifier: Apache-2.0

description: GVO G1120TB101 Panel

compatible: "gvo,g1120tb101"

include: [mipi-dsi-device.yaml, display-controller.yaml]

properties:
  reset-gpios:
    type: phandle-array
    description: |
      The RESETn pin is asserted to disable the sensor causing a hard
      reset.  The sensor receives this as an active-low signal.
```

## dts/bindings/display/himax,hx8347.yaml
```yaml
# Copyright (c) 2022 Alexander Wachter
# SPDX-License-Identifier: Apache-2.0

description: Himax HX8347D display controller bindings.

include: spi-device.yaml

compatible: "himax,hx8347d"

properties:
    pixel-format:
      type: int
      default: 0
      enum:
        - 0 # RGB565
        - 1 # RGB888
      description:
        Display pixel format. Note that when RGB888 pixel format is selected
        only 6 color bits are actually used being in practice equivalent to
        RGB666.

    rotation:
      type: int
      default: 0
      enum:
        - 0
        - 90
        - 180
        - 270
      description:
        Display rotation (CW) in degrees.

    display-inversion:
      type: boolean
      description:
        Display inversion mode. Every bit is inverted from the frame memory to
        the display.

    gamma-offset-positive:
      type: uint8-array
      description: register values for the gamma correction offset positive (6 values)
    gamma-offset-negative:
      type: uint8-array
      description: register values for the gamma correction offset negative (6 values)
    gamma-center-positive:
      type: uint8-array
      description: register values for the gamma correction center positive (2 values)
    gamma-center-negative:
      type: uint8-array
      description: register values for the gamma correction center negative (2 values)
    gamma-macro-positive:
      type: uint8-array
      description: register values for the gamma correction macro positive (5 values)
    gamma-macro-negative:
      type: uint8-array
      description: register values for the gamma correction macro negative (5 values)

    vcom-high:
      type: int
      description: vcom high register value
    vcom-low:
      type: int
      description: vcom low register value
    vcom-offset:
      type: int
      description: vcom offset register value
```

## dts/bindings/display/himax,hx8353e.yaml
```yaml
# Copyright (c) 2026 Andrew Yong <me@ndoo.sg>
# SPDX-License-Identifier: Apache-2.0

description: |
  Himax HX8353-E 132RGB×162 dot TFT Mobile Single Chip controller.

  Driven via the MIPI DBI Type B (Intel 8080) parallel interface.

compatible: "himax,hx8353e"

include: ["mipi-dbi-device.yaml", "display-controller.yaml"]

properties:
  rotation:
    type: int
    default: 0
    description: Initial display rotation in degrees (0, 90, 180, 270).
    enum:
      - 0
      - 90
      - 180
      - 270

  bit-inversion:
    type: boolean
    description: |
      Invert the display output. Every pixel color value is bitwise complemented
      before display; white appears black and vice versa (INVON). Omit for normal
      output (INVOFF).

  backlight-gpios:
    type: phandle-array
    description: |
      GPIO pin that enables the LCD backlight. Used for binary on/off control.
      Omit if backlight is managed externally or via PWM only.

  pwms:
    type: phandle-array
    description: |
      PWM channel for backlight brightness control. Duty cycle is scaled
      linearly from 0 (off) to period (full brightness).
```

## dts/bindings/display/himax,hx8379c.yaml
```yaml
#
# Copyright 2025 Charles Dias
#
# SPDX-License-Identifier: Apache-2.0
#

title: Himax HX8379C display controller

description: |
    The Himax HX8379C is a 16.7M colors TFT-LCD controller
    with a maximum 480RGBx864 resolution.

compatible: "himax,hx8379c"

include: [mipi-dsi-device.yaml, display-controller.yaml]

properties:
  reset-gpios:
    type: phandle-array
    description: |
      The RESX pin is asserted to disable the controller, causing a hard
      reset. The controller receives this as an active-low signal.
```

## dts/bindings/display/himax,hx8394.yaml
```yaml
#
# Copyright 2023 NXP
#
# SPDX-License-Identifier: Apache-2.0
#

title: Himax HX8394 display controller

description: |
    The Himax HX8394 is a 16.7M colors TFT-LCD controller
    with a maximum 800RGBx1280 resolution.

compatible: "himax,hx8394"

include: [mipi-dsi-device.yaml, display-controller.yaml]

properties:
  reset-gpios:
    type: phandle-array
    description: |
      The RESX pin is asserted to disable the sensor causing a hard
      reset.  The sensor receives this as an active-low signal.

  bl-gpios:
    type: phandle-array
    description: |
      The BLn pin is asserted to control the backlight of the panel.
      The sensor receives this as an active-high signal.
```

## dts/bindings/display/ilitek,ili9163.yaml
```yaml
# Copyright (c) 2022, Tavish Naruka <tavishnaruka@gmail.com>
# SPDX-License-Identifier: Apache-2.0

description: ILI9163 132x162 display controller

compatible: "ilitek,ili9163"

include: ilitek,ili9xxx-common.yaml

properties:
    gamset:
      type: uint8-array
      default: [0x04]
      description:
        Gamma set (GAMSET) register value.

    frmctr1:
      type: uint8-array
      default: [0x08, 0x08]
      description:
        Frame rate control (in normal mode / full colors) (FRMCTR1) register value.

    pgamctrl:
      type: uint8-array
      default: [0x3F, 0x25, 0x1C, 0x1E, 0x20, 0x12, 0x2A, 0x90, 0x24, 0x11, 0x00, 0x00, 0x00, 0x00, 0x00]
      description:
        Positive gamma correction (PGAMCTRL) register values.

    ngamctrl:
      type: uint8-array
      default: [0x20, 0x20, 0x20, 0x20, 0x05, 0x00, 0x15, 0xA7, 0x3D, 0x18, 0x25, 0x2A, 0x2B, 0x2B, 0x3A]
      description:
        Negative gamma correction (NGAMCTRL) register values.

    pwctrl1:
      type: uint8-array
      default: [0x0A, 0x02]
      description:
        Power control 1 (PWCTRL1) register values.

    pwctrl2:
      type: uint8-array
      default: [0x02]
      description:
        Power control 2 (PWCTRL2) register values.

    vmctrl1:
      type: uint8-array
      default: [0x50, 0x5B]
      description:
        VCOM control 1 (VMCTRL1) register values.

    vmctrl2:
      type: uint8-array
      default: [0x40]
      description:
        VCOM control 2 (VMCTRL2) register values.

    gamadj:
      type: uint8-array
      default: [0x01]
      description:
        Gamma adjust value.

    dispinv:
      type: uint8-array
      default: [0x07]
      description:
        Display inversion.
```

## dts/bindings/display/ilitek,ili9163c.yaml
```yaml
# Copyright (c) 2025 CATIE
# SPDX-License-Identifier: Apache-2.0

title: Ilitek ILI9163C display controller

description: |
  The Ilitek ILI9163C is a 262K colors TFT-LCD controller
  with a maximum 240RGBx320 resolution.

compatible: "ilitek,ili9163c"

include: ilitek,ili9xxx-common.yaml

properties:
  gamset:
    type: uint8-array
    default: [0x01]
    description: |
      Select the desired Gamma curve for the current display.
      A maximum of 4 fixed gamma curves can be selected.
      - 0x01: Gamma curve 1 (default)
      - 0x02: Gamma curve 2
      - 0x04: Gamma curve 3
      - 0x08: Gamma curve 4

  frmctr1:
    type: uint8-array
    default: [0x0E, 0x14]
    description: |
      Frame rate control (in normal mode / full colors) (FRMCTR1) register value.
      The driver default pair provides a balanced refresh configuration
      that avoids visible flicker.

  gamarsel:
    type: uint8-array
    default: [0x00]
    description: |
      Gamma adjustment register value.
      - 0x00: No gamma adjustment (default)
      - 0x01: Apply positive and negative gamma adjustments (pgamctrl and ngamctrl).

  pgamctrl:
    type: uint8-array
    default: [
      0x00,
      0x00,
      0x00,
      0x00,
      0x00,
      0x00,
      0x00,
      0x00,
      0x00,
      0x00,
      0x00,
      0x00,
      0x00,
      0x00,
      0x00
    ]
    description: |
      Positive gamma correction (PGAMCTRL) register values.
      The driver default values are set to zero to provide a neutral starting
      point for the positive gamma curve.

  ngamctrl:
    type: uint8-array
    default: [
      0x00,
      0x00,
      0x00,
      0x00,
      0x00,
      0x00,
      0x00,
      0x00,
      0x00,
      0x00,
      0x00,
      0x00,
      0x00,
      0x00,
      0x00
    ]
    description: |
      Negative gamma correction (NGAMCTRL) register values.
      The driver default values are set to zero to provide a neutral starting
      point for the negative gamma curve.

  pwctrl1:
    type: uint8-array
    default: [0x0A, 0x05]
    description: |
      Power control 1 - GVDD and voltage.
      Default values: 0x0A sets GVDD to 4.8V, and 0x05 sets the voltage to 2.5V.

  pwctrl2:
    type: uint8-array
    default: [0x05]
    description: |
      Power control 2 - AVDD, VCL, VGH and VGL supply power level.
      Default value: 0x05 sets VGH to 3×AVDD and VGL to -3×AVDD.

  pwctrl3:
    type: string
    default: "Least"
    description: |
      Power control 3 - amount of current in Operation amplifier.
      The driver default `Least` is set to reduce power
      consumption while remaining sufficient for typical operation.
    enum:
      - "Least"
      - "Small"
      - "Medium Low"
      - "Medium"
      - "Medium High"
      - "Large"

  pwctrl4:
    type: string
    default: "Least"
    description: |
      Power control 4 - amount of current in Operational amplifier in Idle.
      The driver default `Least` is set to reduce power
      consumption while remaining sufficient for typical operation.
    enum:
      - "Least"
      - "Small"
      - "Medium Low"
      - "Medium"
      - "Medium High"
      - "Large"

  pwctrl5:
    type: string
    default: "Small"
    description: |
      Power control 5 - amount of current in Operational amplifier in Partial mode.
      The driver default `Small` keeps partial-mode consumption low while still
      supporting normal partial refresh behavior.
    enum:
      - "Least"
      - "Small"
      - "Medium Low"
      - "Medium"
      - "Medium High"
      - "Large"

  vmctrl1:
    type: uint8-array
    default: [0x43, 0x4D]
    description: |
      VCOM control 1 - Set VCOMH Voltage.
      The driver default values are set to provide a VCOMH voltage that is
      compatible with a wide range of panels.

  vmctrl2:
    type: uint8-array
    default: [0x40]
    description: |
      VCOM control 2 - Set VCOMH Voltage.
      The driver default values are set to keep VCOM tuning centered around
      a stable, broadly compatible setting.
```

## dts/bindings/display/ilitek,ili9340.yaml
```yaml
# Copyright (c) 2018, Jan Van Winkel <jan.van_winkel@dxplore.eu>
# Copyright (c) 2020, Teslabs Engineering S.L.
# SPDX-License-Identifier: Apache-2.0

description: ILI9340 320x240 display controller

compatible: "ilitek,ili9340"

include: ilitek,ili9xxx-common.yaml

properties:
  gamset:
    type: uint8-array
    default: [0x01]
    description:
      Gamma set (GAMSET) register value.

  frmctr1:
    type: uint8-array
    default: [0x00, 0x1b]
    description:
      Frame rate control (in normal mode / full colors) (FRMCTR1) register value.

  disctrl:
    type: uint8-array
    default: [0x0a, 0x82, 0x27]
    description:
      Display function control (DISCTRL) register value. Note that changing
      default SS bit value (0) may interfere with display rotation.

  pwctrl1:
    type: uint8-array
    default: [0x26, 0x00]
    description:
      Power control 1 (PWCTRL1) register values.

  pwctrl2:
    type: uint8-array
    default: [0x00]
    description:
      Power control 2 (PWCTRL2) register values.

  vmctrl1:
    type: uint8-array
    default: [0x31, 0x3c]
    description:
      VCOM control 1 (VMCTRL1) register values.

  vmctrl2:
    type: uint8-array
    default: [0xc0]
    description:
      VCOM control 2 (VMCTRL2) register values.

  pgamctrl:
    type: uint8-array
    default: [
      0x0f,
      0x22,
      0x1f,
      0x0a,
      0x0e,
      0x06,
      0x4d,
      0x76,
      0x3b,
      0x03,
      0x0e,
      0x04,
      0x13,
      0x0e,
      0x0c
    ]
    description:
      Positive gamma correction (PGAMCTRL) register values.

  ngamctrl:
    type: uint8-array
    default: [
      0x0c,
      0x23,
      0x26,
      0x04,
      0x10,
      0x04,
      0x39,
      0x24,
      0x4b,
      0x03,
      0x0b,
      0x0b,
      0x33,
      0x37,
      0x0f
    ]
    description:
      Negative gamma correction (NGAMCTRL) register values.
```
