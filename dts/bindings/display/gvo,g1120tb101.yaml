## dts/bindings/display/infineon,display-controller.yaml
```yaml
# Copyright (c) 2026 Infineon Technologies AG,
# or an affiliate of Infineon Technologies AG.
#
# SPDX-License-Identifier: Apache-2.0

title: Infineon Display Controller Driver

description: |
    The Infineon Display Controller consumes a frame buffer and drives a DSI display in video mode.

compatible: "infineon,display-controller"

include: [base.yaml, display-controller.yaml]

properties:
  reg:
    required: true

  interrupts:
    type: array
    required: true

  panel:
    type: phandle
    required: true
    description:
      Panel driven by the controller.

  input-pixel-format:
    type: int
    required: true
    description:
      Pixel format. Available formats in include/zephyr/dt-bindings/display/panel.h

  data-lanes:
    type: int
    required: true
    description:
      Number of data lanes.

  pixel-clock-khz:
    type: int
    required: true
    description:
      Pixel clock frequency in KHz.
      Pixel clock = ((hsync_width + hfp + hbp + display_width) *
      (vsync_width + vfp + vbp + display_height) * fps / 1000)

  hsync-width:
    type: int
    required: true
    description:
      Horizontal sync width in pixel clock cycles.

  hfp:
    type: int
    required: true
    description:
      Horizontal front porch in pixel clock cycles.

  hbp:
    type: int
    required: true
    description:
      Horizontal back porch in pixel clock cycles.

  vsync-width:
    type: int
    required: true
    description:
      Vertical sync width in lines.

  vfp:
    type: int
    required: true
    description:
      Vertical front porch in lines.

  vbp:
    type: int
    required: true
    description:
      Vertical back porch in lines.

  polarity-flags:
    type: int
    default: 0
    description:
      Display sync signal polarity flags.

  virtual-channel:
    type: int
    default: 0
    description:
      DSI virtual channel number.

  per-lane-mbps:
    type: int
    required: true
    description:
      DSI per-lane data rate in Mbps.
```

## dts/bindings/display/istech,ist3931.yaml
```yaml
# Copyright (c) 2024 XuYang Shen  <shenxuyang@shlinyuantech.com>
# SPDX-License-Identifier: Apache-2.0

description: IST3931 65x132 display controller

compatible: "istech,ist3931"

include: [i2c-device.yaml, display-controller.yaml]

properties:
  reset-gpios:
    type: phandle-array
    required: true
    description: |
      RESET pin.

      The RESET pin of IST3931 is active low.
      If connected directly the MCU pin should be configured
      as active low.

  x-offset:
    type: int
    required: true
    description: The column offset in pixels of the LCD to the controller memory

  y-offset:
    type: int
    required: true
    description: The row offset in pixels of the LCD to the controller memory

  voltage-converter:
    type: boolean
    description: Internal voltage converter circuits will be enabled if true

  voltage-follower:
    type: boolean
    description: Internal voltage follower circuits will be enabled if true

  lcd-bias:
    type: int
    required: true
    description: LCD bias ratio of the voltage required for driving the LCD

  lcd-ct:
    type: int
    required: true
    description: reference voltage V0= [0.7+CT*0.005]/Bias at 24 degree Celsius

  duty-ratio:
    type: int
    required: true
    description: Com_1~COM_N is select, N=Duty-ratio.

  frame-control:
    type: int
    required: true
    description: Frame-control of row frequency and frame frequency.
      Row frequency = 3X10^6/ Frame-control
      Frame frequency = Row frequency / Duty-ratio

  reverse-com-output:
    type: boolean
    description: Common Output Mode Select, the output mode will be COM_1->COM_N if set to 0

  reverse-seg-driver:
    type: boolean
    description:
      Defines the relationship between RAM column address and segment driver.
      the mapping will be SEG1->SEG132 if set to 0

  e-force-on:
    type: boolean
    description: turn on whole LCD points regardless of display RAM

  reverse-ram-lcd:
    type: boolean
    description: Reverse the lit and unlit display relation between RAM bit data and LCD cell
```

## dts/bindings/display/ite,it8951.yaml
```yaml
# Copyright (c) 2026 The Zephyr Project Contributors
# SPDX-License-Identifier: Apache-2.0

title: ITE IT8951 E-Paper TCON

description: |
  IT8951 timing controller for SPI-connected electrophoretic displays.

compatible: "ite,it8951"

include: [display-controller.yaml, spi-device.yaml]

properties:
  busy-gpios:
    type: phandle-array
    required: true
    description: |
      Host-ready/busy GPIO.

      The IT8951 HRDY/BUSY signal is active low. If connected directly the MCU pin should be
      configured as active low.

  reset-gpios:
    type: phandle-array
    required: true
    description: Reset GPIO.

  enable-gpios:
    type: phandle-array
    description: Optional display power-enable GPIO.

  ite-enable-gpios:
    type: phandle-array
    description: Optional IT8951/controller power-enable GPIO.

  vcom-mv:
    type: int
    required: true
    description: |
      Panel VCOM voltage in millivolts, encoded as the positive millivolt magnitude expected by the
      IT8951 VCOM command.

      This is intentionally required instead of defaulted: VCOM is panel-lot specific and an
      incorrect value can cause poor image quality or panel damage.

  initial-refresh-waveform:
    type: int
    required: true
    description: |
      Waveform index for the first full-panel refresh issued after boot.

      Interpretation is panel- and firmware-specific (LUT indexing); boards must set the value
      required for proper panel bring-up on their EPD.

  refresh-waveform:
    type: int
    required: true
    description: |
      Waveform index used for subsequent panel refreshes.

  h-mirror:
    type: boolean
    description: |
      Enable horizontal mirroring correction.

  reset-delay-ms:
    type: int
    default: 20
    description: |
      Reset pulse width in milliseconds.

  reset-wait-ms:
    type: int
    default: 150
    description: |
      Delay after reset release in milliseconds.

  ready-timeout-ms:
    type: int
    default: 5000
    description: |
      Timeout for command-ready waits in milliseconds.

      Default value of 5 seconds leaves margin for the IT8951 to become ready after reset.

  refresh-timeout-ms:
    type: int
    default: 40000
    description: |
      Timeout for display refresh completion in milliseconds.

      Default value of 40 seconds matches (very) worst-case full-refresh timeouts.

  panel-temp-c:
    type: int
    description: |
      Optional fixed panel temperature in degrees Celsius.
```

## dts/bindings/display/jdi,lpm013m126.yaml
```yaml
# Copyright (c) 2025 Silicon Signals Pvt. Ltd.
# SPDX-License-Identifier: Apache-2.0

description: JDI LPM013M126 176x176 Color Memory LCD

compatible: "jdi,lpm013m126"

include: [spi-device.yaml, display-controller.yaml]

properties:
  disp-gpios:
    type: phandle-array
    description: |
      DISPLAY enable pin.
      Determines whether the LCD shows its memory content or a blank (white) screen.
      When defined, this pin is driven high during initialization.
      Blanking operations provided by the API can toggle this pin as needed.

  extcomin-gpios:
    type: phandle-array
    description: |
      EXTCOMIN pin
      Provides a square wave on the EXTCOMIN pin to toggle VCOM (common electrode voltage)
      level.

  extcomin-frequency:
    type: int
    description: |
      Frequency (Hz) to toggle the EXTCOMIN pin.
```

## dts/bindings/display/jdi,lpm013m126a.yaml
```yaml
# Copyright (c) 2025 Silicon Signals Pvt. Ltd.
# SPDX-License-Identifier: Apache-2.0

description: JDI LPM013M126A 176x176 Color Memory LCD

compatible: "jdi,lpm013m126a"

include: spi-device.yaml

properties:
  disp-gpios:
    type: phandle-array
    description: |
      DISPLAY enable pin.
      Determines whether the LCD shows its memory content or a blank (white) screen.
      When defined, this pin is driven high during initialization.
      Blanking operations provided by the API can toggle this pin as needed.

  extcomin-gpios:
    type: phandle-array
    description: |
      EXTCOMIN pin
      Provides a square wave on the EXTCOMIN pin to toggle the VCOM level
      of the display.

  extcomin-frequency:
    type: int
    description: |
      Frequency (Hz) to toggle the EXTCOMIN pin.

  height:
    type: int
    required: true
    default: 176
    description: Display height in pixels

  width:
    type: int
    required: true
    default: 176
    description: Display width in pixels
```

## dts/bindings/display/jdi,ls013b7dh03.yaml
```yaml
# Copyright (c) 2026 Qingsong Gou <gouqs@hotmail.com>
# SPDX-License-Identifier: Apache-2.0

description: JDI LS013B7DH03 Memory LCD display

compatible: "jdi,ls013b7dh03"

include: display-controller.yaml

properties:
  vcom-gpios:
    type: phandle-array
    required: false
    description: GPIO for VCOM signal control (optional, for hardware VCOM toggling)

  disp-en-gpios:
    type: phandle-array
    required: false
    description: GPIO for display enable control (optional)

  vlcd-gpios:
    type: phandle-array
    required: false
    description: |
      GPIO for VLCD (LCD power rail) control.
      Active level is determined by the GPIO flags in the phandle.
      Power-on: VLCD enabled first; power-off: VLCD disabled last.

  vddp-gpios:
    type: phandle-array
    required: false
    description: |
      GPIO for VDDP (logic power rail) control.
      Active level is determined by the GPIO flags in the phandle.
      Power-on: VDDP enabled after VLCD; power-off: VDDP disabled before VLCD.

  power-seq-delay-ms:
    type: int
    required: false
    default: 11
    description: Delay in milliseconds between power sequencing steps (VLCD/VDDP).

  serial-vcom-inversion:
    type: boolean
    required: false
    description: Enable VCOM inversion for serial interface mode

  bank-col-head:
    type: int
    required: false
    default: 0
    description: |
      Number of dummy columns at the start of each line.
      Used for JDI display timing configuration.

  valid-columns:
    type: int
    required: false
    default: 0
    description: |
      Number of valid/active columns in the display.

  bank-col-tail:
    type: int
    required: false
    default: 0
    description: |
      Number of dummy columns at the end of each line.

  bank-row-head:
    type: int
    required: false
    default: 0
    description: |
      Number of dummy rows at the start of the frame.

  valid-rows:
    type: int
    required: false
    default: 0
    description: |
      Number of valid/active rows in the display.

  bank-row-tail:
    type: int
    required: false
    default: 0
    description: |
      Number of dummy rows at the end of the frame.

  enb-start-col:
    type: int
    required: false
    default: 0
    description: |
      Enable signal start column position.

  enb-end-col:
    type: int
    required: false
    default: 0
    description: |
      Enable signal end column position.

  enb-pol-invert:
    type: boolean
    required: false
    description: |
      Invert the polarity of the ENB (enable) signal.

  hck-pol-invert:
    type: boolean
    required: false
    description: |
      Invert the polarity of the HCK (horizontal clock) signal.

  hst-pol-invert:
    type: boolean
    required: false
    description: |
      Invert the polarity of the HST (horizontal start) signal.

  vck-pol-invert:
    type: boolean
    required: false
    description: |
      Invert the polarity of the VCK (vertical clock) signal.

  vst-pol-invert:
    type: boolean
    required: false
    description: |
      Invert the polarity of the VST (vertical start) signal.
```

## dts/bindings/display/kyo,tn0xxx.yaml
```yaml
# Copyright (c) 2023, Alen Daniel
# SPDX-License-Identifier: Apache-2.0

description: Kyocera Memory In Pixel TFT display

compatible: "kyo,tn0xxx"

include: [spi-device.yaml, display-controller.yaml]
```

## dts/bindings/display/lcd-controller.yaml
```yaml
# Copyright 2023 NXP
# SPDX-License-Identifier: Apache-2.0

# Common fields for LCD controllers driving a panel.

include: display-controller.yaml

properties:
  pixel-format:
    type: int
    required: true
    description: |
      Initial Pixel format of this controller's output data, which is sent
      to a panel directly or to an adapter.
      See dt-bindings/display/panel.h for a list of pixel format.
```
