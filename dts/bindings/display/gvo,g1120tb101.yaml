## dts/bindings/display/ilitek,ili9341_driver.yaml
```yaml
# Copyright (c) 2018, Jan Van Winkel <jan.van_winkel@dxplore.eu>
# Copyright (c) 2020, Teslabs Engineering S.L.
# Copyright (c) 2021, Krivorot Oleg <krivorot.oleg@gmail.com>
# Copyright (c) 2022, Konstantinos Papadopulos <kostas.papadopulos@gmail.com>
# SPDX-License-Identifier: Apache-2.0

description: ILI9341 320x240 display controller

compatible: "ilitek,ili9341_driver"

include: ilitek,ili9xxx-common.yaml

properties:
  height:
    type: int
    description: 
      Height of the panel driven by the controller, with the units in pixels.

  width:
    type: int
    description: 
      Width of the panel driven by the controller, with the units in pixels.
      
properties:
  ifmode:
    type: uint8-array
    default: [0x40]
    description:
      RGB interface signal control (IFMOD) register value.

  ifctl:
    type: uint8-array
    default: [0x01, 0x00, 0x00]
    description:
      Interface control (IFCTL) register value.

  pwctrla:
    type: uint8-array
    default: [0x39, 0x2c, 0x00, 0x34, 0x02]
    description:
      Power control A (PWCTRLA) register value.

  pwctrlb:
    type: uint8-array
    default: [0x00, 0x8b, 0x30]
    description:
      Power control B (PWCTRLB) register value.

  pwseqctrl:
    type: uint8-array
    default: [0x55, 0x01, 0x23, 0x01]
    description:
      Power on sequence control (PWSEQCTRL) register value.

  timctrla:
    type: uint8-array
    default: [0x84, 0x11, 0x7a]
    description:
      Driver timing control A (TIMCTRLA) register value.

  timctrlb:
    type: uint8-array
    default: [0x00, 0x00]
    description:
      Driver timing control B (TIMCTRLB) register value.

  pumpratioctrl:
    type: uint8-array
    default: [0x10]
    description:
      Pump ratio control (PUMPRATIOCTRL) register value.

  enable3g:
    type: uint8-array
    default: [0x02]
    description:
      Enable 3G (ENABLE3G) register value.

  etmod:
    type: uint8-array
    default: [0x06]
    description:
      Entry Mode Set (ETMOD) register value.

  gamset:
    type: uint8-array
    default: [0x01]
    description:
      Gamma set (GAMSET) register value.

  frmctr1:
    type: uint8-array
    default: [0x00, 0x1b]
    description:
      Frame rate control (in normal mode / full colors) (FRMCTR1) register value.

  disctrl:
    type: uint8-array
    default: [0x0a, 0x82, 0x27, 0x04]
    description:
      Display function control (DISCTRL) register value. Note that changing
      default SS bit value (0) may interfere with display rotation.

  pwctrl1:
    type: uint8-array
    default: [0x21]
    description:
      Power control 1 (PWCTRL1) register values.

  pwctrl2:
    type: uint8-array
    default: [0x10]
    description:
      Power control 2 (PWCTRL2) register values.

  vmctrl1:
    type: uint8-array
    default: [0x31, 0x3c]
    description:
      VCOM control 1 (VMCTRL1) register values.

  vmctrl2:
    type: uint8-array
    default: [0xc0]
    description:
      VCOM control 2 (VMCTRL2) register values.

  madctrl:
    type: uint8-array
    description:
      VCOM control 2 (VMCTRL2) register values.
  
  pixset:
    type: uint8-array
    description:
      VCOM control 2 (VMCTRL2) register values.

  pgamctrl:
    type: uint8-array
    default: [
      0x0f,
      0x22,
      0x1f,
      0x0a,
      0x0e,
      0x06,
      0x4d,
      0x76,
      0x3b,
      0x03,
      0x0e,
      0x04,
      0x13,
      0x0e,
      0x0c
    ]
    description:
      Positive gamma correction (PGAMCTRL) register values.

  ngamctrl:
    type: uint8-array
    default: [
      0x0c,
      0x23,
      0x26,
      0x04,
      0x10,
      0x04,
      0x39,
      0x24,
      0x4b,
      0x03,
      0x0b,
      0x0b,
      0x33,
      0x37,
      0x0f
    ]
    description:
      Negative gamma correction (NGAMCTRL) register values.

  cmd-data-gpios:
    type: phandle-array
    required: true
    description: |
      Data/Command pin of the ILI9341 is to be configured
      high(1) for data, low(0) for command.

  reset-gpios:
    type: phandle-array
    description: |
      RESET pin of the ILI9341.
      If connected directly the MCU pin should be configured
      as active low.
```

## dts/bindings/display/ilitek,ili9342c.yaml
```yaml
# Copyright (c) 2018, Jan Van Winkel <jan.van_winkel@dxplore.eu>
# Copyright (c) 2020, Teslabs Engineering S.L.
# Copyright (c) 2021, Krivorot Oleg <krivorot.oleg@gmail.com>
# Copyright (c) 2022, Konstantinos Papadopulos <kostas.papadopulos@gmail.com>
# SPDX-License-Identifier: Apache-2.0

description: ILI9342C 320x240 display controller

compatible: "ilitek,ili9342c"

include: ilitek,ili9xxx-common.yaml

properties:
  gamset:
    type: uint8-array
    default: [0x01]
    description:
      select the desired Gamma curve for the current display.
      A maximum of 4 fixed gamma curves canbe selected.

  ifmode:
    type: uint8-array
    default: [0x40]
    description:
      RGB interface signal control (IFMOD) register value.

  invtr:
    type: uint8-array
    default: [0x00]
    description:
      Display Inversion Control (INVTR) register value.

  frmctr1:
    type: uint8-array
    default: [0x00, 0x1c]
    description:
      Frame rate control (in normal mode / full colors) (FRMCTR1) register value.

  disctrl:
    type: uint8-array
    default: [0x0a, 0x80, 0x1d, 0x04]
    description:
      Display function control (DISCTRL) register value. Note that changing
      default SS bit value (0) may interfere with display rotation.

  etmod:
    type: uint8-array
    default: [0x07]
    description:
      Entry Mode set (ETMOD)

  pwctrl1:
    type: uint8-array
    default: [0x9, 0x9]
    description:
      Power control 1 (PWCTRL1) register values.

  pwctrl2:
    type: uint8-array
    default: [0x00]
    description:
      Power control 2 (PWCTRL2) register values.

  pwctrl3:
    type: uint8-array
    default: [0xB2]
    description:
      Power control 3 (PWCTRL3) register values.

  vmctrl1:
    type: uint8-array
    default: [0xf2]
    description:
      VCOM control 1 (VMCTRL1) register values.

  pgamctrl:
    type: uint8-array
    default: [
      0x00,
      0x05,
      0x08,
      0x04,
      0x13,
      0x0A,
      0x34,
      0x8A,
      0x46,
      0x07,
      0x0E,
      0x0A,
      0x1B,
      0x1D,
      0x0F
    ]
    description:
      Positive gamma correction (PGAMCTRL) register values.

  ngamctrl:
    type: uint8-array
    default: [
      0x00,
      0x22,
      0x25,
      0x04,
      0x0F,
      0x06,
      0x38,
      0x56,
      0x4B,
      0x05,
      0x0C,
      0x0A,
      0x37,
      0x3A,
      0x0F
    ]
    description:
      Negative gamma correction (NGAMCTRL) register values.

  ifctl:
    type: uint8-array
    default: [0x01, 0x00, 0x00]
    description:
      Interface control (IFCTL) register value.
```

## dts/bindings/display/ilitek,ili9488-intel8080.yaml
```yaml
# Copyright (c) 2024, Kim Bøndergaard <kim@fam-boendergaard.dk>
# SPDX-License-Identifier: Apache-2.0

description: ILI9488 320x480 display controller - mipi-dbi, mode A (intel8080)

compatible: "ilitek,ili9488-intel8080"

include: ["ilitek,ili9488-common.yaml", "mipi-dbi-device.yaml"]
```

## dts/bindings/display/ilitek,ili9488-parallel.yaml
```yaml
# Copyright (c) 2020, Teslabs Engineering S.L.
# SPDX-License-Identifier: Apache-2.0

description: ILI9488 320x480 display controller - 8bit parallel mode

compatible: "ilitek,ili9488"

include: ["ilitek,ili9488-common.yaml"]

properties:
  rd-gpios:
    type: phandle-array
    description: RD pin

      For now reading from the display is not support. The pin can be permanently
      set to 3.3V - or as output always being high

  wr-gpios:
    type: phandle-array
    required: true
    description: WR pin

      The WR pin is active low. On low to high transmission device will latch
      data pins

  cs-gpios:
    type: phandle-array
    required: true
    description: CS pin

      The CS (Chip Select) pin is active low
      Display only reacts on RD, WR, D/CX when CS is asserted

  data-gpios:
    type: phandle-array
    required: true
    description: Data pins

      The 8 pins used for data in and out
```

## dts/bindings/display/ilitek,ili9488.yaml
```yaml
# Copyright (c) 2020, Teslabs Engineering S.L.
# SPDX-License-Identifier: Apache-2.0

description: ILI9488 320x480 display controller - mipi-dbi, mode C (spi)

compatible: "ilitek,ili9488"

include: ["ilitek,ili9488-common.yaml", "mipi-dbi-spi-device.yaml"]
```

## dts/bindings/display/ilitek,ili9806e.yaml
```yaml
# Copyright (c) 2024 Renesas Electronics Corporation
# SPDX-License-Identifier: Apache-2.0

title: Ilitek ILI9806E display controller

description: |
   The Ilitek ILI9806E is a 16.7M colors TFT-LCD controller
   with a maximum 480RGBx864 resolution.

compatible: "ilitek,ili9806e-dsi"

include: [mipi-dsi-device.yaml, display-controller.yaml]

properties:
  reset-gpios:
    type: phandle-array
    description: |
      The RESETn pin is asserted to disable the sensor causing a hard
      reset.  The sensor receives this as an active-low signal.

  bl-gpios:
    type: phandle-array
    description: |
      The BLn pin is asserted to control the backlight of the panel.
      The sensor receives this as an active-high signal.
```

## dts/bindings/display/ilitek,ili9xxx-common.yaml
```yaml
# Copyright (c) 2018, Jan Van Winkel <jan.van_winkel@dxplore.eu>
# Copyright (c) 2020, Teslabs Engineering S.L.
# SPDX-License-Identifier: Apache-2.0

title: ILI9XXX display controllers common properties.

description: |
    Ilitek ILI9XXX is a color TFT-LCD controller series.

include:
  - lcd-controller.yaml
  - name: mipi-dbi-spi-device.yaml
    property-blocklist:
      - te-delay

properties:
  rotation:
    type: int
    default: 0
    enum:
      - 0
      - 90
      - 180
      - 270
    description:
      Display rotation (CW) in degrees.
      If not defined, rotation is off by default.

  display-inversion:
    type: boolean
    description:
      Display inversion mode. Every bit is inverted from the frame memory to
      the display.

  red-blue-swap:
    type: boolean
    description: |
      Panel controller expects RGB color channel order (not byte-order) instead of BGR.

  h-mirror:
    type: boolean
    description: |
      Enable horizontal mirroring correction.
      Used when display appears left-right flipped despite correct rotation value.

  v-mirror:
    type: boolean
    description: |
      Enable vertical mirroring correction.
      Used when display appears upside-down despite correct rotation value.

  bottom-top-refresh:
    type: boolean
    description: |
      Controls whether panel vertical scanning goes bottom->top, instead of default top->bottom.
      Only for special refresh scenarios (rarely needed).

  right-left-refresh:
    type: boolean
    description: |
      Controls whether panel horizontal scanning goes right->left, instead of default left->right.
      Only for special refresh scenarios (rarely needed).
```

## dts/bindings/display/ilitek,ili9xxx.yaml
```yaml
# Copyright (c) 2018, Jan Van Winkel <jan.van_winkel@dxplore.eu>
# SPDX-License-Identifier: Apache-2.0

description: ILI9xxx 320x240 display controller

compatible: "ilitek,ili9xxx"

include: spi-device.yaml

properties:
    reset-gpios:
      type: phandle-array
      required: false
      description: RESET pin.

        The RESET pin of ILI9xxx is active low.
        If connected directly the MCU pin should be configured
        as active low.

    cmd-data-gpios:
      type: phandle-array
      required: true
      description: D/CX pin.

        The D/CX pin of ILI9xxx is active low (transmission command byte).
        If connected directly the MCU pin should be configured
        as active low.

    pixel-format:
      type: string
      required: false
      description: pixel data format. Enum corresponds to `enum display_pixel_format`
      enum:
        - "RGB_888"
        - "MONO01"
        - "MONO10"
        - "ARGB_8888"
        - "RGB_565"
        - "BGR_565"
      default: "RGB_888"

    height:
      type: int
      required: true
      description: Height in pixels of the panel driven by the controller

    width:
      type: int
      required: true
      description: Width in pixels of the panel driven by the controller

    x-offset:
      type: int
      required: false
      description: The column offset in pixels of the LCD to the controller memory
      default: 0

    y-offset:
      type: int
      required: false
      description: The row offset in pixels of the LCD to the controller memory
      default: 0

    power-ctrl-1:
      type: uint8-array
      required: false
      description: power control 1
      default: []

    power-ctrl-2:
      type: uint8-array
      required: false
      description: power control 2
      default: []

    power-ctrl-a:
      type: uint8-array
      required: false
      description: Power control A
      default: []

    power-ctrl-b:
      type: uint8-array
      required: false
      description: Power control B
      default: []

    vcom-ctrl-1:
      type: uint8-array
      required: false
      description: vcom control 1
      default: []

    vcom-ctrl-2:
      type: uint8-array
      required: false
      description: vcom control 2
      default: []

    power-on-seq-ctrl:
      type: uint8-array
      required: false
      description: PowerOn sequence control
      default: []

    drvr-timing-ctrl-a-i:
      type: uint8-array
      required: false
      description: Driver timing
      default: []

    drvr-timing-ctrl-b:
      type: uint8-array
      required: false
      description: Driver timing
      default: []

    pump-ratio-ctrl:
      type: uint8-array
      required: false
      description: Pump ratio control
      default: []

    mem-access-ctrl:
      type: uint8-array
      required: false
      description: Memory Access Data Control
      default: []

    frame-ctrl-normal-mode:
      type: uint8-array
      required: false
      description: Frame Rate
      default: []

    display-function-ctrl:
      type: uint8-array
      required: false
      description: Display Function Control
      default: []

    enable-3g:
      type: uint8-array
      required: false
      description: 3Gamma Function
      default: []

    gamma-set:
      type: uint8-array
      required: false
      description: Gamma curve selected
      default: []

    positive-gamma-correction:
      type: uint8-array
      required: false
      description: Positive Gamma Correction
      default: []

    negative-gamma-correction:
      type: uint8-array
      required: false
      description: Negative Gamma Correction
      default: []
```
