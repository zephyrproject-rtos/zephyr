## dts/bindings/display/panel/panel-timing.yaml
```yaml
# Copyright 2023 NXP
# SPDX-License-Identifier: Apache-2.0

# Common fields for panel timings
# inherited from Linux panel bindings.

description: |
  Common timing settings for display panels. These timings can be added to
  a panel under display-timings node. For example:

  &lcdif {
    display-timings {
      compatible = "zephyr,panel-timing";
      hsync-len = <8>;
      hfront-porch = <32>;
      hback-porch = <32>;
      vsync-len = <2>;
      vfront-porch = <16>;
      vback-porch = <14>;
      hsync-active = <0>;
      vsync-active = <0>;
      de-active = <1>;
      pixelclk-active = <0>;
      clock-frequency = <62346240>;
    };
  };

compatible: "zephyr,panel-timing"

properties:
  clock-frequency:
    type: int
    description: |
      Pixel clock for display controller in Hz. Must be at least as large as:
      (height + vsync-len + vfront-porch + vback-porch) *
      (width + hsync-len + hfront-porch + hback-porch) *
      desired frame rate

  hsync-len:
    type: int
    required: true
    description: |
      Horizontal synchronization pulse duration of panel driven by this
      controller, in pixels

  vsync-len:
    type: int
    required: true
    description: |
      Vertical synchronization pulse duration of panel driven by this
      controller, in lines

  hback-porch:
    type: int
    required: true
    description: |
      Horizontal back porch duration of panel driven by this controller,
      in pixels

  vback-porch:
    type: int
    required: true
    description: |
      Vertical back porch duration of panel driven by this controller, in lines

  hfront-porch:
    type: int
    required: true
    description: |
      Horizontal front porch duration of panel driven by this controller,
      in pixels

  vfront-porch:
    type: int
    required: true
    description: |
      Vertical front porch duration of panel driven by this controller, in lines

  hsync-active:
    type: int
    required: true
    enum:
      - 0
      - 1
    description: |
      Polarity of horizontal sync pulse
      0 selects active low
      1 selects active high

  vsync-active:
    type: int
    required: true
    enum:
      - 0
      - 1
    description: |
      Polarity of vertical sync pulse
      0 selects active low
      1 selects active high

  de-active:
    type: int
    required: true
    enum:
      - 0
      - 1
    description: |
      Polarity of data enable, sent with each horizontal interval.
      0 selects active low
      1 selects active high.

  pixelclk-active:
    type: int
    required: true
    enum:
      - 0
      - 1
    description: |
      Polarity of pixel clock. Selects which edge to drive data to display on.
      0 drives pixel data on falling edge, and samples on rising edge.
      1 drives pixel data on rising edge, and samples data on falling edge

  syncclk-active:
    type: int
    enum:
      - 0
      - 1
    description: |
      Drive sync on rising or sample sync on falling edge. If not specified
      then the controller uses the setup specified by pixelclk-active.
      Use 0 to drive sync on falling edge
      and sample sync on rising edge of pixel clock.
      Use 1 to drive sync on rising edge
      and sample sync on falling edge of pixel clock.
```

## dts/bindings/display/panel/zephyr,panel-color-palette.yaml
```yaml
# Copyright (c) 2026 Fabian Blatz <fabianblatz@gmail.com>
# SPDX-License-Identifier: Apache-2.0

description: |
  Common color palette settings for display panels.

compatible: "zephyr,panel-color-palette"

properties:
  colors:
    type: array
    description: |
      List of 32-bit ARGB8888 colors.

      Each value corresponds to ARGB8888(r, g, b, a)
      with A in the most significant byte.

examples:
  - |
    color-palette {
      compatible = "zephyr,panel-color-palette";
      colors = <ARGB8888(255, 0, 0, 255)   /* red */
                ARGB8888(0, 255, 0, 128)   /* green, 50% alpha */
                PANEL_COLOR_PALETTE_NULL   /* Empty entry */
                ARGB8888(0, 0, 255, 255)>; /* blue */
    };
```

## dts/bindings/display/qemu,ramfb.yaml
```yaml
# Copyright (c) 2026 Maximilian Zimmermann
# SPDX-License-Identifier: Apache-2.0

description: |
    QEMU RAM framebuffer display device.

    Note:
      The QEMU binary bundled with current Zephyr SDK 1.0.0 does not
      provide usable RAMFB display support. Use an external QEMU build with
      ``ramfb`` and a GUI display backend (for example ``sdl``) enabled.
      You can select the external QEMU binary by setting ``QEMU_BIN_PATH``
      when running west.

compatible: "qemu,ramfb"

include: display-controller.yaml

properties:
  fwcfg:
    type: phandle
    required: true
    description: fw_cfg device used to configure the ramfb endpoint.

  memory-region:
    type: phandle
    required: true
    description: Reserved memory node used as the framebuffer backing store.
```

## dts/bindings/display/raydium,rm67162.yaml
```yaml
#
# Copyright 2023, NXP
#
# SPDX-License-Identifier: Apache-2.0
#

title: Raydium RM67162 display controller

description: |
    The Raydium RM67162 is a 16.7M colors OLED controller
    with a maximum 480RGBx480 resolution.

compatible: "raydium,rm67162"

include: [mipi-dsi-device.yaml, display-controller.yaml]

properties:
  reset-gpios:
    type: phandle-array
    description: |
      The RESETn pin is asserted to disable the sensor causing a hard
      reset.  The sensor receives this as an active-low signal.

  bl-gpios:
    type: phandle-array
    description: |
      The BLn pin is asserted to control the backlight of the panel.
      The sensor receives this as an active-high signal.

  te-gpios:
    type: phandle-array
    description: |
      The tearing effect pin is asserted by the controller at a display
      VSYNC interval. This permits the controller to send new display
      data during a VSYNC interval, removing tearing.
```

## dts/bindings/display/raydium,rm67199.yaml
```yaml
#
# Copyright 2025 NXP
#
# SPDX-License-Identifier: Apache-2.0
#

description: Raydium RM67199 Panel

compatible: "raydium,rm67199"

include: [mipi-dsi-device.yaml]

properties:
  reset-gpios:
    type: phandle-array
    description: |
      The RESETn pin is asserted to disable the sensor causing a hard
      reset. The sensor receives this as an active-low signal.

  bl-gpios:
    type: phandle-array
    description: |
      The BLn pin is asserted to control the backlight of the panel.
      The sensor receives this as an active-high signal.

  te-gpios:
    type: phandle-array
    description: |
      The tearing effect pin is asserted by the controller at a display
      VSYNC interval. This permits the controller to send new display
      data during a VSYNC interval, removing tearing.

  data-lanes:
    type: array
    required: true
    description:
      Number of data lanes.

  pixel-format:
    type: int
    required: true
    description:
      Pixel format. Available formats in dt-bindings/mipi_dsi/mipi_dsi.h.
```

## dts/bindings/display/raydium,rm68200.yaml
```yaml
#
# Copyright 2022, NXP
#
# SPDX-License-Identifier: Apache-2.0
#

title: Raydium RM68200 display controller

description: |
    The Raydium RM68200 is a 16.7M colors TFT-LCD controller
    with a maximum 480RGBx864 resolution.

compatible: "raydium,rm68200"

include: [mipi-dsi-device.yaml, display-controller.yaml]

properties:
  reset-gpios:
    type: phandle-array
    description: |
      The RESETn pin is asserted to disable the sensor causing a hard
      reset.  The sensor receives this as an active-low signal.

  bl-gpios:
    type: phandle-array
    description: |
      The BLn pin is asserted to control the backlight of the panel.
      The sensor receives this as an active-high signal.
```

## dts/bindings/display/renesas,ra-glcdc.yaml
```yaml
# Copyright (c) 2024 Renesas Electronics Corporation
# SPDX-License-Identifier: Apache-2.0

description: Renesas Graphic LCD controller

compatible: "renesas,ra-glcdc"

include: [display-controller.yaml, pinctrl-device.yaml]

properties:
  reg:
    required: true

  clocks:
    required: true

  pinctrl-0:
    required: true

  pinctrl-names:
    required: true

  interrupts:
    required: true

  interrupt-names:
    type: string-array
    required: true
    description: name of each interrupt

  backlight-gpios:
    type: phandle-array
    required: true
    description: |
      The BLn pin is asserted to control the backlight of the panel.
      The sensor receives this as an active-high signal.

  input-pixel-format:
    type: int
    required: true
    description: |
      Initial input Pixel format for Graphic LCD controller.

  output-pixel-format:
    type: int
    required: true
    description: |
      Initial output Pixel format for Graphic LCD controller.
```

## dts/bindings/display/renesas,rz-lcdc.yaml
```yaml
# Copyright (c) 2025 Renesas Electronics Corporation
# SPDX-License-Identifier: Apache-2.0

description: Renesas LCD controller

compatible: "renesas,rz-lcdc"

include: [display-controller.yaml, pinctrl-device.yaml]

properties:
  reg:
    required: true

  pinctrl-0:
    description: |
      Provide a pin configuration for using parallel pixel output. In combination with DSI HOST
      the pin configuration is not necessary due to dedicated (MIPI D-PHY) pins.

  interrupts:
    required: true

  interrupt-names:
    type: string-array
    required: true
    description: name of each interrupt

  backlight-gpios:
    type: phandle-array
    description: |
      The BLn pin is asserted to control the backlight of the panel.
      The sensor receives this as an active-high signal.

  output-data-signal-polarity:
    type: string
    enum:
      - "LOACTIVE"
      - "HIACTIVE"
    default: "HIACTIVE"
    description: Select the output data enable signal polarity. Default is high active.

  output-signal-sync-edge:
    type: string
    enum:
      - "RISING"
      - "FALLING"
    default: "FALLING"
    description: Select the output signal synchronization edge. Default is falling edge.

  input-pixel-format:
    type: int
    required: true
    description: |
      Initial input Pixel format for LCD controller.

  output-pixel-format:
    type: int
    required: true
    description: |
      Initial output Pixel format for LCD controller.

  background-color-alpha:
    type: int
    default: 0
    description: Alpha component of the background color.

  background-color-red:
    type: int
    default: 0
    description: Red component of the background color.

  background-color-green:
    type: int
    default: 0
    description: Green component of the background color.

  background-color-blue:
    type: int
    default: 0
    description: Blue component of the background color.
```

## dts/bindings/display/renesas,smartbond-display.yaml
```yaml
# Copyright (c) 2023 Renesas Electronics Corporation
# SPDX-License-Identifier: Apache-2.0

include: [display-controller.yaml, lcd-controller.yaml, pinctrl-device.yaml]

description: Renesas Smartbond(tm) display controller

compatible: "renesas,smartbond-display"

properties:
  reg:
    required: true

  interrupts:
    required: true

  disp-gpios:
    type: phandle-array
    description: |
      Display ON/OFF port control.

  dma-prefetch:
    type: string
    enum:
      - "no-prefetch"
      - "prefetch-44-bytes"
      - "prefetch-84-bytes"
      - "prefetch-116-bytes"
      - "prefetch-108-bytes"
    description: |
      Host controller will wait for at least the specified number of bytes before triggering
      a single frame update. The prefetch mechanism should be enabled when frame buffer(s)
      is stored into external storage mediums, e.g. PSRAM, that introduce comparable delays.
      In such a case it might case that the controller runs into underrun conditions which
      results in correpting the whole frame update. It's user's responsibility to ensure that
      the selected value does not exceed frame's total size as otherwise the controller will
      not be able to trigger the frame update.
```

## dts/bindings/display/rocktech,rk043fn02h-ct.yaml
```yaml
# Copyright (c) 2019, NXP
# SPDX-License-Identifier: Apache-2.0

description: Rocktech LCD module with LED backlight and capacitive touch panel

compatible: "rocktech,rk043fn02h-ct"

include: base.yaml
```
