## dts/bindings/display/maxim,max7219.yaml
```yaml
# Copyright (c) 2022 Jimmy Ou <yanagiis@gmail.com>
# SPDX-License-Identifier: Apache-2.0

description: |
  Maxim MAX7219 LED display driver

compatible: "maxim,max7219"

include: spi-device.yaml

properties:
    scan-limit:
      type: int
      required: false
      default: 7
      enum:
        - 0
        - 1
        - 2
        - 3
        - 4
        - 5
        - 6
        - 7
      description: |
        Number of scanned digits for MAX7219.
        Display digit 0 only when scan-limit is 0, digits 0 & 1 when
        scan-limit is 1, and so on.
    intensity:
      type: int
      required: false
      default: 0
      enum:
        - 0
        - 1
        - 2
        - 3
        - 4
        - 5
        - 6
        - 7
        - 8
        - 9
        - 10
        - 11
        - 12
        - 13
        - 14
        - 15
      description: Intensity for MAX7219.
    num-cascading:
      type: int
      required: false
      default: 1
      description: Number of cascading MAX7219.
```

## dts/bindings/display/microbit,matrixled.yaml
```yaml
# Copyright (c) 2021 Alexander Chudov <chudov@gmail.com>
# SPDX-License-Identifier: Apache-2.0

description: |
    BBC Micro:Bit 5x5 LED display.


compatible: "microbit,matrixled"

properties:
    col-gpios-used:
        type: phandles
        required: true
        description:
            So far there is no better way found to specify how many different ports are used by LED columns.
            For the moment V1 uses gpio0, V2 uses gpio0 and gpio1
    row-gpios:
        type: phandle-array
        required: true
    col-gpios:
        type: phandle-array
        required: true
    led-mapping:
        type: array
        required: true
```

## dts/bindings/display/mipi,zc143ac72.yml
```yaml
# Copyright 2025 NXP
# SPDX-License-Identifier: Apache-2.0

include: display-controller.yaml

#properties:
#
#
#
#
#
#
```

## dts/bindings/display/nordic,nrf-led-matrix.yaml
```yaml
# Copyright (c) 2021, Nordic Semiconductor ASA
# SPDX-License-Identifier: Apache-2.0

description: Generic LED matrix driven by nRF SoC GPIOs

compatible: "nordic,nrf-led-matrix"

include: display-controller.yaml

properties:
    row-gpios:
      type: phandle-array
      required: true
      description: |
        Array of GPIOs to be used as rows of the matrix.

    col-gpios:
      type: phandle-array
      required: true
      description: |
        Array of GPIOs to be used as columns of the matrix.

    pixel-mapping:
      type: uint8-array
      required: true
      description: |
        Array of bytes that specify which rows and columns of the matrix
        control its particular pixels, line by line. Each byte in this
        array corresponds to one pixel of the matrix and specifies the row
        index in the high nibble and the column index in the low nibble.

        For example, the following snippet (from the bbc_microbit board DTS):

          width = <5>;
          height = <5>;
          pixel-mapping = [00 13 01 14 02
                           23 24 25 26 27
                           ...

        specifies that:
        - pixel (0,0) is controlled by row 0 and column 0
        - pixel (1,0) is controlled by row 1 and column 3
        - pixel (0,1) is controlled by row 2 and column 3
        - pixel (1,1) is controlled by row 2 and column 4
        and so on.

    refresh-frequency:
      type: int
      required: true
      description: |
        Frequency of refreshing the matrix, in Hz.

    timer:
      type: phandle
      required: true
      description: |
        Reference to a TIMER instance for controlling refreshing of the matrix.

    pwm:
      type: phandle
      required: false
      description: |
        Reference to a PWM instance for generating pulse signals on column
        GPIOs. If not provided, GPIOTE and PPI channels are allocated and
        used instead for generating those pulses.

    pixel-group-size:
      type: int
      required: true
      description: |
        This value specifies the maximum number of LEDs in one row that can
        be lit simultaneously.
        If set to 1, only a single LED is turned on in a particular time slot.
        Bigger values increase the maximum achievable brightness of the LEDs
        and lower the CPU load by decreasing the frequency of execution of
        the timer interrupt handler.
        In case GPIOTE and PPI channels are used for generating the pixel pulse
        signals, the number of channels that need to be allocated is equal to
        this value.
        If GPIOTE and PPI channels are used, the upper limit for the value is
        defined by the number of CC channels in the used timer minus one.
        If PWM is used, the upper limit is the number of PWM channels.
```

## dts/bindings/display/novatek,nt35510.yaml
```yaml
# Copyright (c) 2025 Ambiq Micro Inc.
#
# SPDX-License-Identifier: Apache-2.0

description: |
  Novatek NT35510 display controller with MIPI DBI Type-B (Intel 8080) interface support.

compatible: "novatek,nt35510"

include: ["mipi-dbi-device.yaml", "display-controller.yaml"]

properties:
  reset-gpios:
    type: phandle-array
    description: |
      Reset GPIO pin. Set high to reset the display.

  bl-gpios:
    type: phandle-array
    description: |
      Backlight control GPIO pin.

  rotation:
    type: int
    description: |
      Display rotation in degrees. Valid values are 0, 90, 180, 270.

  pixel-format:
    type: int
    description: |
      Pixel format. Zephyr/dt-bindings/display/panel.h
```

## dts/bindings/display/nxp,dcnano-lcdif.yaml
```yaml
# Copyright 2023,2024 NXP
# SPDX-License-Identifier: Apache-2.0

description: NXP DCNano LCDIF (LCD Interface) controller

compatible: "nxp,dcnano-lcdif"

include: [lcd-controller.yaml, pinctrl-device.yaml]

properties:
  reg:
    required: true

  interrupts:
    required: true

  backlight-gpios:
    type: phandle-array
    required: true
    description:
      LCB backlight control gpio. Driver will initialize this GPIO to active high

  data-bus-width:
    type: string
    default: "24-bit"
    enum:
      - "16-bit-config1" # 16 bit configuration 1. RGB565: XXXXXXXX_RRRRRGGG_GGGBBBBB
      - "16-bit-config2" # 16 bit configuration 2. RGB565: XXXRRRRR_XXGGGGGG_XXXBBBBB
      - "16-bit-config3" # 16-bit configuration 3. RGB565: XXRRRRRX_XXGGGGGG_XXBBBBBX
      - "18-bit-config1" # 18-bit configuration 1. RGB666: XXXXXXRR_RRRRGGGG_GGBBBBBB
      - "18-bit-config2" # 18-bit configuration 2. RGB666: XXRRRRRR_XXGGGGGG_XXBBBBBB
      - "24-bit" # 24 Bit
    description:
      LCD data bus width. The default is set to the reset value of 24-bit

  version:
    type: string
    description:
      The version of the ip
    enum:
      - "DCnano"
      - "DC8000"
```

## dts/bindings/display/nxp,dpu.yaml
```yaml
# Copyright (c) 2025, NXP
# SPDX-License-Identifier: Apache-2.0

description: NXP i.MX DPU controller

compatible: "nxp,dpu"

include: [base.yaml, display-controller.yaml]

properties:
  reg:
    required: true

  hsw:
    type: int
    description: HSYNC pulse width in display clock cycles

  hfp:
    type: int
    description: Horizontal front porch in display clock cycles

  hbp:
    type: int
    description: Horizontal back porch in display clock cycles

  vsw:
    type: int
    description: VSYNC pulse width in display clock cycles

  vfp:
    type: int
    description: Vertical front porch in display clock cycles

  vbp:
    type: int
    description: Vertical back porch in display clock cycles
```

## dts/bindings/display/nxp,flexio-jdi.yaml
```yaml
# Copyright (c) 2022, NXP
# SPDX-License-Identifier: Apache-2.0

description: NXP  (FLEXIO Interface) JDI display controller

compatible: "nxp,flexio-jdi"

include: [display-controller.yaml, pinctrl-device.yaml]

properties:
    reg:
      required: true

    clocks:
      required: true

    clock-names:
      required: true
      # There are the following names to choose
      # "input_clock" use to transmit jdi data
      # "vcom" use to generate VCOM/FRP/XFRP signal

    timers:
      required: false
      type: phandle-array
      description: timers specifiers

    timer-names:
      required: false
      type: string-array
      description: Provided names of timers specifiers. There are "pixel", "xrst", "enb".

    gpios:
      type: phandle-array
      required: true
      description:
        GPIO pins used by JDI.

    gpio-names:
      required: true
      type: string-array
      description: Provided names of gpio specifiers. There are "vst", "xrst".
```

## dts/bindings/display/nxp,imx-elcdif.yaml
```yaml
# Copyright 2022-2023 NXP
# SPDX-License-Identifier: Apache-2.0

description: NXP i.MX eLCDIF (Enhanced LCD Interface) controller

compatible: "nxp,imx-elcdif"

include: [lcd-controller.yaml, pinctrl-device.yaml]

properties:
  reg:
    required: true

  interrupts:
    required: true

  data-bus-width:
    type: string
    default: "16-bit"
    enum:
      - "16-bit"
      - "8-bit"
      - "18-bit"
      - "24-bit"
    description:
      LCD data bus width. The default is set to the reset value of 16-bit

  backlight-gpios:
    type: phandle-array
    description:
      LCB backlight control gpio. Driver will initialize this GPIO to active high

  nxp,pxp:
    type: phandle
    description:
      NXP PXP device phandle. The LCDIF can utilize the PXP for accelerated
      display rotation via the DMA API, when present and enabled.
```

## dts/bindings/display/nxp,imx-lcdifv2.yaml
```yaml
# Copyright 2026 NXP
# SPDX-License-Identifier: Apache-2.0

description: NXP i.MX LCDIFV2 (LCD Interface v2) controller

compatible: "nxp,imx-lcdifv2"

include: [lcd-controller.yaml, pinctrl-device.yaml]

properties:
  reg:
    required: true

  interrupts:
    required: true

  backlight-gpios:
    type: phandle-array
    description:
      Backlight GPIO specifier
```

## dts/bindings/display/nxp,imx-lcdifv3.yaml
```yaml
# Copyright 2025-2026 NXP
# SPDX-License-Identifier: Apache-2.0

description: NXP i.MX LCDIFV3 (LCD Interface v3) controller

compatible: "nxp,imx-lcdifv3"

include: [base.yaml, lcd-controller.yaml]

properties:
  reg:
    required: true

  interrupts:
    required: true

  media-axi-clk-rate:
    type: int
    required: true

  media-apb-clk-rate:
    type: int
    required: true
```

## dts/bindings/display/nxp,imx-mipi-dsi.yaml
```yaml
#
# Copyright (c) 2019, Linaro Limited
#
# SPDX-License-Identifier: Apache-2.0
#

description: NXP MCUX MIPI DSI

compatible: "nxp,imx-mipi-dsi"

include: base.yaml

bus: mipi-dsi

properties:
    interrupts:
      required: true

    label:
      required: true

    virtualchannel:
      required: true
      type: int
      description: the virtual channel of the mipi dsi
```

## dts/bindings/display/nxp,lpc-lcdc.yaml
```yaml
# Private Porting
# by David Hor - Xtooltech 2025
# david.hor@xtooltech.com

# Copyright (c) 2024 VCI Development
# SPDX-License-Identifier: Apache-2.0

description: NXP LPC LCD Controller (LCDC)

compatible: "nxp,lpc-lcdc"

include: [display-controller.yaml, pinctrl-device.yaml]

properties:
  reg:
    required: true

  interrupts:
    required: true

  clocks:
    required: true

  width:
    type: int
    required: true
    description: Display width in pixels

  height:
    type: int
    required: true
    description: Display height in pixels

  bits-per-pixel:
    type: int
    default: 16
    enum: [1, 2, 4, 8, 16, 24]
    description: |
      Number of bits per pixel.
      16 = RGB565 format
      24 = RGB888 format

  display-type:
    type: string
    default: "TFT"
    enum: ["TFT", "STN"]
    description: Display panel type

  framebuffer:
    type: phandle
    description: |
      phandle to framebuffer memory region. If not specified,
      driver will allocate framebuffer from heap.

  panel-timings:
    type: phandle
    required: true
    description: |
      phandle to panel timing configuration node containing:
      - hsync-len: Horizontal sync pulse width
      - hfront-porch: Horizontal front porch
      - hback-porch: Horizontal back porch
      - vsync-len: Vertical sync pulse width
      - vfront-porch: Vertical front porch
      - vback-porch: Vertical back porch
      - hsync-active: Horizontal sync polarity (0=active low, 1=active high)
      - vsync-active: Vertical sync polarity (0=active low, 1=active high)
      - de-active: Data enable polarity (0=active low, 1=active high)
      - pixelclk-active: Pixel clock polarity (0=falling edge, 1=rising edge)

  backlight-gpios:
    type: phandle-array
    description: GPIO for backlight control

  power-gpios:
    type: phandle-array
    description: GPIO for LCD power control

  reset-gpios:
    type: phandle-array
    description: GPIO for LCD reset control

  swap-red-blue:
    type: boolean
    description: Swap red and blue color channels

  st7701s-spi-init:
    type: boolean
    description: |
      Enable ST7701S controller initialization via bit-bang SPI.
      Requires cs-gpios, sck-gpios, and mosi-gpios to be defined.

  cs-gpios:
    type: phandle-array
    description: GPIO for ST7701S SPI chip select

  sck-gpios:
    type: phandle-array
    description: GPIO for ST7701S SPI clock

  mosi-gpios:
    type: phandle-array
    description: GPIO for ST7701S SPI MOSI data
```

## dts/bindings/display/orisetech,otm8009a.yaml
```yaml
# Copyright (c) 2023 bytes at work AG
# Copyright (c) 2020 Teslabs Engineering S.L.
# SPDX-License-Identifier: Apache-2.0

description: Orise Tech OTM8009A Panel

compatible: "orisetech,otm8009a"

include: [mipi-dsi-device.yaml, display-controller.yaml]

properties:
  reset-gpios:
    type: phandle-array
    description: |
      The RESETn pin is asserted to disable the sensor causing a hard
      reset.  The sensor receives this as an active-low signal.

  bl-gpios:
    type: phandle-array
    description: |
      The BLn pin is asserted to control the backlight of the panel.
      The sensor receives this as an active-high signal.

  rotation:
    type: int
    default: 0
    enum:
      - 0
      - 90
      - 180
      - 270
    description: |
      Display rotation (CW) in degrees. Defaults to 0, display default.
```

## dts/bindings/display/panel-timing.yaml
```yaml
# Private Porting
# by David Hor - Xtooltech 2025
# david.hor@xtooltech.com

# Copyright (c) 2024 VCI Development
# SPDX-License-Identifier: Apache-2.0

description: Display panel timing parameters

compatible: "panel-timing"

properties:
  clock-frequency:
    type: int
    required: true
    description: Pixel clock frequency in Hz

  hactive:
    type: int
    required: true
    description: Horizontal active pixels (width)

  vactive:
    type: int
    required: true
    description: Vertical active lines (height)

  hsync-len:
    type: int
    required: true
    description: Horizontal sync pulse width in pixels

  hfront-porch:
    type: int
    required: true
    description: Horizontal front porch in pixels

  hback-porch:
    type: int
    required: true
    description: Horizontal back porch in pixels

  vsync-len:
    type: int
    required: true
    description: Vertical sync pulse width in lines

  vfront-porch:
    type: int
    required: true
    description: Vertical front porch in lines

  vback-porch:
    type: int
    required: true
    description: Vertical back porch in lines

  hsync-active:
    type: int
    default: 0
    enum: [0, 1]
    description: |
      0 = active low (inverted)
      1 = active high

  vsync-active:
    type: int
    default: 0
    enum: [0, 1]
    description: |
      0 = active low (inverted)
      1 = active high

  de-active:
    type: int
    default: 1
    enum: [0, 1]
    description: |
      0 = active low
      1 = active high

  pixelclk-active:
    type: int
    default: 0
    enum: [0, 1]
    description: |
      0 = data driven on falling edge
      1 = data driven on rising edge
```
