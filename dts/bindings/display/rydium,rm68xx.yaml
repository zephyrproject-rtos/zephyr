## dts/bindings/display/rydium,rm68xx.yaml
```yaml
#
# Copyright (c) 2019, Linaro Limited
#
# SPDX-License-Identifier: Apache-2.0
#

description: rydium rm68xx panel

compatible: "rydium,rm68xx"

include: base.yaml

on-bus: mipi-dsi

properties:
    label:
      required: true

    reset-gpios:
      type: phandle-array
      required: false
      description: |
        The RESETn pin is asserted to disable the sensor causing a hard
        reset.  The sensor receives this as an active-low signal.

    pwr-gpios:
      type: phandle-array
      required: false
      description: |
        The PWRn pin is asserted to do a power on for the panel.
        The panel receives this as an active-high signal.

    bl-gpios:
      type: phandle-array
      required: false
      description: |
        The BLn pin is asserted to control the backlight of the panel.
        The sensor receives this as an active-high signal.
```

## dts/bindings/display/samsung,ks0108.yaml
```yaml
description: KS0108 128x64 display controller

compatible: "samsung,ks0108"

properties:
    db0-gpios:
      type: phandle-array
      required: true
      description: DB0 pin.

    db1-gpios:
      type: phandle-array
      required: true
      description: DB1 pin.

    db2-gpios:
      type: phandle-array
      required: true
      description: DB2 pin.

    db3-gpios:
      type: phandle-array
      required: true
      description: DB3 pin.

    db4-gpios:
      type: phandle-array
      required: true
      description: DB4 pin.

    db5-gpios:
      type: phandle-array
      required: true
      description: DB5 pin.

    db6-gpios:
      type: phandle-array
      required: true
      description: DB6 pin.

    db7-gpios:
      type: phandle-array
      required: true
      description: DB7 pin.

    cs1-gpios:
      type: phandle-array
      required: true
      description: CS1 pin.

    cs2-gpios:
      type: phandle-array
      required: true
      description: CS2 pin .

    rw-gpios:
      type: phandle-array
      required: true
      description: RW pin.

    rs-gpios:
      type: phandle-array
      required: true
      description: RS pin.

    rst-gpios:
      type: phandle-array
      required: true
      description: RST pin.

    en-gpios:
      type: phandle-array
      required: true
      description: EN pin.

    height:
      type: int
      required: true
      description: Height in pixels of the panel driven by the controller

    width:
      type: int
      required: true
      description: Width in pixels of the panel driven by the controller
```

## dts/bindings/display/sharp,ls014b7dd01.yaml
```yaml
# Copyright (c) 2025 Ambiq Micro Inc.
# SPDX-License-Identifier: Apache-2.0

description: Sharp LS014B7DD01 display

compatible: "sharp,ls014b7dd01"

include: ["display-controller.yaml", "pinctrl-device.yaml", "jdi-device.yaml"]

properties:
  pwms:
    type: phandle-array
    description: |
      PWM specifiers for VA and VCOM signals. Two PWM channels are required:
      - VA (voltage A) signal
      - VCOM (common voltage) signal

  pwm-names:
    type: string-array
    description: |
      PWM signal names. Must contain "va" and "vcom" in that order.
```

## dts/bindings/display/sharp,ls0xx.yaml
```yaml
# Copyright (c) 2020, Rohit Gujarathi
# SPDX-License-Identifier: Apache-2.0

title: Sharp LS0XX memory display controller

description: |
    Sharp LS0XX series has an eclectic range of TFT-LCD controllers,
    mostly monochrome TFT-LCD controller up to 400x240 resolution.

    Example supported references:
    LS012B7DD01
    LS013B7DH03
    LS013B7DH05
    LS027B7DH01A
    LS032B7DD02
    LS044Q7DH01

    Adafruit 1.3" SHARP Memory LCD display is a breakout board for
    LS013B4DN04, and 2.7" for LS027B7DH01.

compatible: "sharp,ls0xx"

include: [spi-device.yaml, display-controller.yaml]

properties:
  extcomin-gpios:
    type: phandle-array
    description: EXTCOMIN pin

      The EXTCOMIN pin is where a square pulse for toggling VCOM will
      be given

  extcomin-frequency:
    type: int
    description: EXTCOMIN pin toggle frequency

      The frequency with which the EXTCOMIN pin should be toggled. See
      datasheet of particular display. Higher frequency gives better
      contrast while low frequency saves power.

  disp-en-gpios:
    type: phandle-array
    description: DISPLAY pin

      The DISPLAY pin controls if the LCD displays memory contents or
      white screen. If defined, the pin will be set high during driver
      initialization. display blanking apis can be used to control it.

  serial-vcom-inversion:
    type: boolean
    description: Send serial VCOM inversion commands

      Enable when EXTCOMIN is not configured and VCOM inversion is not
      application-managed.

  serial-vcom-interval:
    type: int
    default: 1000
    description: Serial VCOM inversion interval

      VCOM inversion interval in milliseconds. This value is used when
      there is no EXTCOMIN configured and serial-vcom inversion is set.
      If not configured, 1000ms will be used which is the minimum some
      sources recommend, though the panel datasheet may specify a more
      frequent interval and 1000ms will also be visible.
```

## dts/bindings/display/shenghe,sh8501a.yaml
```yaml
# SPDX-FileCopyrightText: Copyright (c) 2026 Tom Waldron <tom@baremetal.dev>
# SPDX-License-Identifier: Apache-2.0

description: SH8501A 240x320 display controller

compatible: "shenghe,sh8501a"

include: [mspi-device.yaml, display-controller.yaml]

properties:
  te-gpios:
    type: phandle-array
    description: |
      Tearing Effect GPIO pin. Set to high when the display is blanking
      (i.e., not actively reading pixels from its RAM).

  reset-gpios:
    type: phandle-array
    description: |
      Reset GPIO pin. Set high to reset the display

  mspi-cpp-mode:
    default: "MSPI_CPP_MODE_0"

  te-mode:
    type: string
    default: "MIPI_DBI_TE_RISING_EDGE"
    description: |
      Tearing enable signal mode, mirroring mipi-dbi setup. Defaults to rising-edge.
    enum:
      - "MIPI_DBI_TE_NO_EDGE"
      - "MIPI_DBI_TE_RISING_EDGE"
      - "MIPI_DBI_TE_FALLING_EDGE"

  te-scanline:
    type: int
    default: 10
    description: |
      Sets the display's tear-scan-line setting, which affects the signal timing.
```

## dts/bindings/display/sifli,sf32lb-lcdc.yaml
```yaml
# Copyright (c) 2025, Qingsong Gou <gouqs@hotmail.com>
# SPDX-License-Identifier: Apache-2.0

description: Sifli SF32LB LCDC display controller

compatible: "sifli,sf32lb-lcdc"

include: base.yaml

properties:
  reg:
    required: true

  clocks:
    required: true
```

## dts/bindings/display/sil,sii9022a.yaml
```yaml
# Copyright (c) 2026 Texas Instruments Incorporated
# SPDX-License-Identifier: Apache-2.0

description: |
  Silicon Image SII9022A HDMI/DVI transmitter bridge (I2C).

  The SII9022A accepts a parallel DPI/RGB input with separate DE,
  HSYNC and VSYNC signals ("external sync" mode) and converts it to HDMI or
  DVI output.

  Example DT node (on I2C bus main_i2c1 at address 0x3B):

    &main_i2c1 {
        sii9022a: sii9022a@3b {
            compatible = "sil,sii9022a";
            reg = <0x3b>;
            output-format = <0>;   /* HDMI RGB */
            display-controller = <&dss>;
            clk-falling;
        };
    };

compatible: "sil,sii9022a"

include: i2c-device.yaml

properties:
  output-format:
    type: int
    required: true
    enum:
      - 0   # HDMI RGB
      - 1   # HDMI YUV 4:4:4
      - 2   # HDMI YUV 4:2:2
      - 3   # DVI RGB
    description: |
      Output format selection.
        0 = HDMI, RGB colour space
        1 = HDMI, YUV 4:4:4 colour space
        2 = HDMI, YUV 4:2:2 colour space
        3 = DVI,  RGB colour space

  clk-falling:
    type: boolean
    description: |
      When present, input pixel data is latched on the falling edge of the
      pixel clock.  When absent (default), data is latched on the rising edge.

  display-controller:
    type: phandle
    required: true
    description: |
      Phandle to the upstream display controller DT node (e.g. ti,tidss).
      The bridge driver reads the video timing properties (pixel-clock-hz,
      width, height, hfront-porch, hback-porch, hsync-len, vfront-porch,
      vback-porch, vsync-len) directly from that node at build time, so no
      runtime API call from the display controller to the bridge is needed.
```

## dts/bindings/display/sinowealth,sh1106-i2c.yaml
```yaml
# Copyright (c) 2023, TOKITA Hiroshi
# SPDX-License-Identifier: Apache-2.0

title: SH1106 132x64 dot-matrix display controller on I2C bus

description: |
    The Sinowealth SH1106 is a monochrome OLED controller with a maximum 132x64 resolution.

compatible: "sinowealth,sh1106"

include: ["solomon,ssd1306-common.yaml", "i2c-device.yaml"]
```

## dts/bindings/display/sinowealth,sh1106-spi.yaml
```yaml
# Copyright (c) 2023, TOKITA Hiroshi
# SPDX-License-Identifier: Apache-2.0

title: SH1106 132x64 dot-matrix display controller on SPI bus

description: |
    The Sinowealth SH1106 is a monochrome OLED controller with a maximum 132x64 resolution.

compatible: "sinowealth,sh1106"

include: ["solomon,ssd1306-common.yaml", "spi-device.yaml"]

properties:
  data-cmd-gpios:
    type: phandle-array
    required: true
    description: D/C# pin.
```

## dts/bindings/display/sinowealth,sh1107-i2c.yaml
```yaml
# Copyright (c) 2026 MASSDRIVER EI (massdriver.space)
# SPDX-License-Identifier: Apache-2.0

title: SH1107 128x128 dot-matrix display controller on I2C bus

description: |
    The Sinowealth SH1107 is a monochrome OLED controller with a maximum 128x128 resolution.

compatible: "sinowealth,sh1107"

include: ["solomon,ssd1306-common.yaml", "i2c-device.yaml"]
```

## dts/bindings/display/sinowealth,sh1107-spi.yaml
```yaml
# Copyright (c) 2026 MASSDRIVER EI (massdriver.space)
# SPDX-License-Identifier: Apache-2.0

title: SH1107 128x128 dot-matrix display controller on SPI bus

description: |
    The Sinowealth SH1107 is a monochrome OLED controller with a maximum 128x128 resolution.

compatible: "sinowealth,sh1107"

include: ["solomon,ssd1306-common.yaml", "spi-device.yaml"]

properties:
  data-cmd-gpios:
    type: phandle-array
    required: true
    description: D/C# pin.
```

## dts/bindings/display/sinowealth,sh1122-common.yaml
```yaml
# Copyright (c) 2025 MASSDRIVER EI (massdriver.space)
# SPDX-License-Identifier: Apache-2.0

include: display-controller.yaml

properties:
  oscillator-freq:
    type: int
    required: true
    description: Front clock divider (3:0) / oscillator frequency (7:4). It can be set to 0x0.
      If you get weird scanlines, increase oscillator frequency and play with phase length values,
      for example set this to 0x90. Note this increases power consumption.

  display-offset:
    type: int
    required: true
    description: Vertical offset by com from 0 ~ 63. Typically 64 - height.

  start-line:
    type: int
    required: true
    description: Start line of display RAM to be displayed by selecting a value from 0 to 63.
      Typically 0.

  multiplex-ratio:
    type: int
    required: true
    description: Multiplex ratio from 0MUX to 63MUX. Typically same value as height - 1.

  phase-length:
    type: int
    required: true
    description: Phase Length for segment charging (7:4) and discharging (3:0).

  vcomh-voltage:
    type: int
    required: true
    description: Set COM deselect voltage

  precharge-voltage:
    type: int
    required: true
    description: Set precharge voltage VSEGM. refer to datasheet for formula

  dc-dc:
    type: int
    required: true
    description: Internal DC-DC enable and set frequency.

  low-voltage:
    type: int
    default: 0x0
    description: set discharge VSL level. 0x0 (0V) is the reset value

  inversion-on:
    type: boolean
    description: Turn on display color inverting

  inv-seg:
    type: boolean
    description: Invert segment order

  inv-com:
    type: boolean
    description: Invert COM order
```

## dts/bindings/display/sinowealth,sh1122-i2c.yaml
```yaml
# Copyright (c) 2025 MASSDRIVER EI (massdriver.space)
# SPDX-License-Identifier: Apache-2.0

description: SH1122 256x64 dot-matrix display controller on I2C bus

include: ["sinowealth,sh1122-common.yaml", "i2c-device.yaml"]

compatible: "sinowealth,sh1122"
```

## dts/bindings/display/sinowealth,sh1122-mipi-dbi.yaml
```yaml
# Copyright (c) 2025 MASSDRIVER EI (massdriver.space)
# SPDX-License-Identifier: Apache-2.0

description: SH1122 256x64 dot-matrix display controller on MIPI DBI bus

include: ["sinowealth,sh1122-common.yaml", "mipi-dbi-spi-device.yaml"]

compatible: "sinowealth,sh1122"
```

## dts/bindings/display/sitronix,st7305.yaml
```yaml
# Copyright (c) 2025 MASSDRIVER EI (massdriver.space)
# SPDX-License-Identifier: Apache-2.0

title: ST7305 display controller

description: Sitronix ST7305 monochrome 264x320 display controller

compatible: "sitronix,st7305"

include: sitronix,st730x-common.yaml
```

## dts/bindings/display/sitronix,st7306.yaml
```yaml
# Copyright (c) 2025 MASSDRIVER EI (massdriver.space)
# SPDX-License-Identifier: Apache-2.0

title: ST7306 display controller

description: Sitronix ST7306 multi-mode 720x480 display controller

compatible: "sitronix,st7306"

include: sitronix,st730x-common.yaml

properties:
  color-mode:
    type: string
    enum:
      - "MONO"
      - "RBW"
    description: |
      What type of display this is.
      MONO: Monochrome display, 1 bit per pixel.
      RBW: Red Black White (and Off) display, with 2 bits per pixel.
      Other color modes are not supported at the moment.

      If the display is not monochrome, provide a palette.

  mono-color:
    type: int
    default: 3
    description: |
      The color to use for MONO mode on multicolor displays.
      The default is black for Red Black White displays.
```
