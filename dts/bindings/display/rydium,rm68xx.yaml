## dts/bindings/display/sitronix,st7586s.yaml
```yaml
description: |
  Sitronix ST7586S is a 4-bit greyscale LCD Display Controller
  with a maximum resolution of 384x160.

compatible: "sitronix,st7586s"

include: [mipi-dbi-spi-device.yaml, display-controller.yaml]

properties:
  start-line:
    type: int
    required: true
    description: Start line of display RAM to be displayed by selecting a value from 0 to 159.
      Typically 0.

  display-offset:
    type: int
    required: true
    description: Vertical offset by com from 0 ~ 159.

  bias-ratio:
    type: int
    required: true
    enum:
      - 0
      - 1
      - 2
      - 3
      - 4
      - 5
    description: Sets bias (0:1/14, 1:1/13, 2:1/12, 3:1/11, 4:1/10, 5:1/9).

  flip-configuration:
    type: int
    required: true
    enum:
      - 0xC8
      - 0x80
      - 0x48
      - 0x0
    description: 3 bits, MX[6][3] (0 or 3), MY[7].

  duty:
    type: int
    required: true
    description: Typically height-1.

  framerate:
    type: int
    required: true
    description: 5-bit value describing framerate. 0 = 38.5Hz, 31 = 153 Hz.

  booster-level:
    type: int
    default: 7
    enum:
      - 0
      - 1
      - 2
      - 3
      - 4
      - 5
      - 6
      - 7
    description: Sets booster level, 0-7, x1 to x8. Default is reset value.

  inversion-on:
    type: boolean
    description: Turn on display color inverting
```
