## dts/bindings/display/sitronix,st730x-common.yaml
```yaml
# Copyright (c) 2025 MASSDRIVER EI (massdriver.space)
# SPDX-License-Identifier: Apache-2.0

title: Sitronix ST730x display controllers common properties

description: |
    The ST730x display controllers are mostly monochrome low power LCD controllers.
    These displays have extreme clarity and contrast, and refresh rate up to 51 Hz.
    They use a unusual data format that requires conversion from standard ones, and
    necessitate rounding X axis values to 12, including width which sometimes need
    to be rounded to the next multiple of 12 to fill the display.

include: [mipi-dbi-spi-device.yaml, display-controller.yaml]

properties:
  start-line:
    type: int
    required: true
    description: Start line (first gate) of display RAM to be displayed.

  start-column:
    type: int
    required: true
    description: Start column of display RAM to be displayed. Must be multiple of 12.

  nvm-load:
    type: uint8-array
    required: true
    description: NVM Load settings, 2 bytes.

  gate-voltages:
    type: uint8-array
    required: true
    description: Gate Voltages, 5 bits each, 2 bytes.

  vsh:
    type: uint8-array
    required: true
    description: High positive voltage in different modes. 4 bytes.
      On LCDs the high and low voltages affect contrast.

  vsl:
    type: uint8-array
    required: true
    description: Low positive voltage in different modes. 4 bytes.
      On LCDs the high and low voltages affect contrast.

  vshn:
    type: uint8-array
    required: true
    description: High negative voltage in different modes. 4 bytes.
      On LCDs the high and low voltages affect contrast.

  vsln:
    type: uint8-array
    required: true
    description: Low negative voltage in different modes. 4 bytes.
      On LCDs the high and low voltages affect contrast.

  osc-settings:
    type: int
    required: true
    description: |
      Oscillator settings, 1 byte such as:
      - [7]: enabled or disabled
      - [5][2-1]: Max framerate: 000 = 51Hz, 111 = 32Hz
      - [6][4-3][0]: 0

  framerate:
    type: int
    required: true
    description: |
      Framerate settings, 1 byte such as:
      - [4]: High power mode framerate, max framerate is 000, 0=25.5Hz, 1=51Hz, else 0=16Hz, 1=32Hz.
      - [2-0]: Low power mode framerate, 0:0.25Hz, 1:0.5Hz, 2:1Hz, 3:2hz, 4:4Hz, 5:8Hz.

  multiplex-ratio:
    type: int
    required: true
    description: Specify how many gate lines the display uses times 4, so typically y-size / 4;

  source-voltage:
    type: int
    required: true
    description: |
      Source voltage selection [1-0]:
      - 00: VSHPA1/ VSLPA1/ VSHNA1/ VSLNA1
      - 01: VSHPA2/ VSLPA2/ VSHNA2/ VSLNA2
      - 10: VSHPA3/ VSLPA3/ VSHNA3/ VSLNA3
      - 11: VSHPA4/ VSLPA4/ VSHNA4/ VSLNA4

  remap-value:
    type: int
    required: true
    description: |
      Remap memory data access and so flip the display:
      - [7]: Page address order flip
      - [6]: Column address order flip
      - [5]: Page/Column order flip
      - [3]: Data output order flip
      - [2]: Gate scan order flip

  panel-settings:
    type: int
    required: true
    description: |
      Set panel and gate layout:
      - [7][4]: 0
      - [6-5]: Column dot inversion: 00: Column inversion, 01: 1-Dot inversion, 10: 2-Dot inversion
      - [3-2]: Gate scan mode: 00: 2 line interval, 01: 1 line interval, 10: frame interval
      - [1-0]: Panel layout: 00: 2 line interlace, 01: 1 line interlace, 10: no interlacing

  hpm-gate-waveform:
    type: uint8-array
    default: [0xE5, 0xF6, 0x05, 0x46, 0x77, 0x77, 0x77, 0x77, 0x76, 0x45]
    description: |
      Waveform used to drive LCD in high power mode. 10 bytes total:
      - 1 byte: 0xA5 (disable) or 0xE5 (enable), tells if waveform is enabled or disabled
      - 1 byte: 0xF6
      - 8 bytes: [7][3]: 0, [6-4]: GPCHPUx, [2-0]: GPCHPUx+1. Please See datasheet.
      The default is the default values of the controller.

  lpm-gate-waveform:
    type: uint8-array
    default: [0x05, 0x46, 0x77, 0x77, 0x77, 0x77, 0x76, 0x45]
    description: |
      Waveform used to drive LCD in low power mode. 8 bytes total:
      - 8 bytes: [7][3]: 0, [6-4]: GPCLPUx, [2-0]: GPCLPUx+1. Please See datasheet.
      The default is the default values of the controller.

  inversion-on:
    type: boolean
    description: Turn on display color inverting
```

## dts/bindings/display/sitronix,st75256.yaml
```yaml
description: ST75256 Display Controller

compatible: "sitronix,st75256"

include: [mipi-dbi-spi-device.yaml, display-controller.yaml]

properties:
  booster-frequency:
    type: int
    required: true
    description: Sets frequency of booster, 0 or 1 (6 Khz)

  bias-ratio:
    type: int
    required: true
    description: Sets bias (0:1/14, 1:1/13, 2:1/12, 3:1/11, 4:1/10, 5:1/9)

  flip-configuration:
    type: int
    required: true
    description: 3 bits, MV[2], MX[1], MY[0]

  duty:
    type: int
    required: true
    description: 31, 62, 79, 127, 159, 161. Typically height-1

  light-grey:
    type: int
    required: true
    description: 5-bit value describing light grey (0x01) pixel. Heavily affected by contrast.

  dark-grey:
    type: int
    required: true
    description: 5-bit value describing dark grey (0x10) pixel. Heavily affected by contrast.

  power-control:
    type: int
    default: 0xb
    description: Power control register (x[0] = VR, x[1] = VF, x[3] = VB).
      Most displays have all turned on.

  fi-settings:
    type: int
    default: 0
    description: Frame inversion settings. LF4, FI, LF3, LF2, LF1, LF0 (5:0). Most displays use 0

  lsb-invdir:
    type: boolean
    description: Inverse vertically tiled Byte scan direction.
      Use when display has locally inverted Y patterns or when flipping display.

  external-power:
    type: boolean
    description: Use external power instead of internal power

  inversion-on:
    type: boolean
    description: Turn on display color inverting
```

## dts/bindings/display/sitronix,st7528i.yaml
```yaml
# Copyright (c) 2022-2023, SILA Embedded Solutions GmbH
# SPDX-License-Identifier: Apache-2.0

# Voltage regulator calculation
# ===============================
#
# Short forms are given in the descriptions of the `regulator-resistor` and `electronic-volume`
# properties below.
#
# From ST7528 datasheet Ver2.3 2007/1/3, page 40:
#
#    v0 = r*(1-(63-α)/210)*2.1
#    v0/2.1*210 = r*(210-(63-α))
# I) v0*100 = r*(147+α)
#
# Approximating regulator resistor
# ================================
#
# Assuming the electronic volume α at its midpoint of 32:
#
# From I):
#
#     v0*100/179 = r
# II) r = 100/179 * v0
#
# Converting the 1+(Rb/Ra) value to a register value, using the table one page 60:
#
# III) r_reg = (r - 2.3)/0.7               # substitute II)
#      r_reg = 100/179/0.7 * v0 - 2.3/0.7
#      r_reg ~= 0.8 * v0 - 3.3
#      ~~~~~~~~~~~~~~~~~~~~~~~
#
# Calculating "electronic volume" for fine-tuning
# ===============================================
#
# Rearrange III) for r:
#
# IV) r = r_reg * 0.7 + 2.3
#
# From I):
#
# v0*100/r-147 = α
# α = 100 * v0/r - 147                     # substitute IV)
# α = 100 * v0/(0.7 * r_reg + 2.3) - 147
# α = 100/0.7 * v0/(r_reg + 3.3) - 147
# α = 143 * v0/(r_reg + 3.3) - 147
# ~~~~~~~~~~~~~~~~~~~~~~~~~~~~~~~~


description: ST7528i 160x100 grayscale LCD controller on I2C bus

compatible: "sitronix,st7528i"

include: ["display-controller.yaml", "i2c-device.yaml"]

properties:
  com-partial-display:
    type: int
    default: 100
    description: Number of rows to display, can be combined with `com-offset` to draw only a
      vertical portion of the screen. By default, all rows are drawn.

  com-offset:
    type: int
    default: 0
    description: The row/COM output to start drawing at. By default, drawing starts at the first
      row.

  invert-com:
    type: boolean
    description: If enabled, scan direction is from last COM output to first COM output.

  invert-segments:
    type: boolean
    description: If enabled, last column address is mapped to first segment.

  lcd-bias:
    type: int
    required: true
    description: 1/n bias value for the LCD (from 5 to 12).

  framerate:
    type: int
    required: true
    description: Framerate of the display (register value from 0 to 15), see table "Frame
      frequency" on page 49 of ST7528 datasheet.

  regulator-resistor:
    type: int
    required: true
    description: Internal voltage regulator resistor selection (from 0 to 7).
      Approximate using `0.8 * V_LCD - 3.3`, then fine-tune using `electronic-volume`.

  electronic-volume:
    type: int
    required: true
    description: Internal voltage regulator adjustment (from 0 to 63).
      Calculate using `143 * V_LCD/(regulator_resistor+3.3) - 147`.

  boost:
    type: int
    required: true
    description: VOUT DC-DC converter multiplier (from 3 to 6).
      Calculate using `V_LCD / VDD2`, rounding up.

  reset-gpios:
    type: phandle-array
    description: The active-low RESET input of the ST7528i.

      If connected directly the MCU pin should be configured as active low.

  chip-select-gpios:
    type: phandle-array
    description: The active-low CSB input of the ST7528i. Asserted constantly by the driver.

      If connected directly the MCU pin should be configured as active low.

  height:
    type: int
    required: true
    const: 100
    description: |
      Height of the panel driven by the controller, with the units in pixels.

  width:
    type: int
    required: true
    const: 160
    description: |
      Width of the panel driven by the controller, with the units in pixels.
```

## dts/bindings/display/sitronix,st7565r.yaml
```yaml
# Copyright (c) 2025, Giyora Haroon
# SPDX-License-Identifier: Apache-2.0

title: Sitronix ST7565R dot matrix LCD controller (SPI)

description: |
  Sitronix ST7565R dot matrix LCD controller on SPI bus.

compatible: "sitronix,st7565r"

include: spi-device.yaml

properties:
  reset-gpios:
    type: phandle-array
    description: |
      Reset pin. The driver requires this for hardware reset.
      The pin is active low.

  data-cmd-gpios:
    type: phandle-array
    required: true
    description: |
      Data/Command pin (D/C). Controls whether SPI data is interpreted
      as data (high) or command (low).

  width:
    type: int
    required: true
    description: Display width in pixels.

  height:
    type: int
    required: true
    description: Display height in pixels.

  segment-offset:
    type: int
    default: 0
    description: |
      Offset for the first segment (column) line.

  segment-remap:
    type: boolean
    description: |
      Reverse the segment (column) mapping direction.
      Maps SEG131..SEG0 instead of SEG0..SEG131.
      Corresponds to ADC command (0xA0/0xA1).
      Set based on display module wiring.

  com-invdir:
    type: boolean
    description: |
      Reverse the COM scan direction.
      Scans COM63..COM0 instead of COM0..COM63.
      Corresponds to COM output scan direction command (0xC0/0xC8).
      Set based on display module wiring.

  lcd-bias:
    type: int
    required: true
    description: |
      LCD bias setting.
    enum:
      - 7 # 1/7 Bias (0xA3)
      - 9 # 1/9 Bias (0xA2)

  power-control-val:
    type: int
    default: 7
    description: |
      Controls which internal power circuits (Voltage Booster, Regulator,
      Follower) are enabled.

      The default value enables all internal power circuits. In this configuration,
      the voltage levels required for the LCD drivers are generated internally.

      Bit 0: Voltage Follower (VF)
      Bit 1: Voltage Regulator (VR)
      Bit 2: Voltage Booster (VB)

  resistor-ratio:
    type: int
    default: 4
    description: |
      Selects the internal resistor ratio, which sets the main LCD driver
      voltage (Vo).

      The default value selects a physical ratio of 5.0, which provides a
      versatile Vo voltage range.

      This property is tightly coupled with 'booster-ratio'. If either
      property is changed from its default, the other must be re-evaluated
      to ensure a consistent and working power configuration for the
      specific LCD module.

      Corresponds to the lower 3 bits of the Resistor Ratio Set command
      (0x20 | value). Valid values are 0-7.

  booster-ratio:
    type: int
    default: 0
    description: |
      Selects the voltage booster step-up ratio.

      The default value selects the mode supporting 2x, 3x, or 4x boost.
      In this mode, the specific ratio is determined by the hardware
      module's capacitor wiring, making this the most flexible default
      for common hardware designs.

      This property must be overridden for modules requiring 5x or 6x boost.
      As this property is tightly coupled with 'resistor-ratio', ensure
      both are set appropriately for your hardware.

      Corresponds to the second byte of the Booster Ratio Set command (0xF8 + value).

    enum:
      - 0 # 2x, 3x, 4x
      - 1 # 5x
      - 3 # 6x

  inversion-on:
    type: boolean
    description: |
      Sets the display mode to inverted (pixel on when RAM=0).
      Corresponds to Display Normal/Reverse command (0xA6/0xA7).

  ready-time-ms:
    type: int
    default: 10
    description: |
      Time in milliseconds to wait before initializing the controller
      after power-on. Defaults to 10ms (found by trial and error) if not
      provided.
```

## dts/bindings/display/sitronix,st7567-common.yaml
```yaml
# Copyright (c) 2025 MASSDRIVER EI (massdriver.space)
# SPDX-License-Identifier: Apache-2.0

include: display-controller.yaml

properties:
  column-offset:
    type: int
    required: true
    description: 8-bits start column address

  line-offset:
    type: int
    required: true
    description: 6-bits start line offset

  regulation-ratio:
    type: int
    required: true
    description: Regulation resistor ratio (3-bits RR2 RR1 RR0)

  segment-invdir:
    type: boolean
    description: Scan direction is from last SEG output to first SEG output

  com-invdir:
    type: boolean
    description: Scan direction is from last COM output to first COM output

  inversion-on:
    type: boolean
    description: Invert display

  bias:
    type: boolean
    description: Bias setting (0 for 1/9, or 1 for 1/7)

  reset-gpios:
    type: phandle-array
    description: RESET pin.

      The RESET pin of ST7567 is active low.
      If connected directly, the MCU pin should be configured
      as active low.
```

## dts/bindings/display/sitronix,st7567-i2c.yaml
```yaml
# Copyright (c) 2025 MASSDRIVER EI (massdriver.space)
# SPDX-License-Identifier: Apache-2.0

description: ST7567 132x65 dot-matrix LCD controller on I2C bus

compatible: "sitronix,st7567"

include: ["sitronix,st7567-common.yaml", "i2c-device.yaml"]
```

## dts/bindings/display/sitronix,st7567-mipi-dbi.yaml
```yaml
# Copyright (c) 2025 MASSDRIVER EI (massdriver.space)
# SPDX-License-Identifier: Apache-2.0

title: Sitronix ST7567 dot-matrix LCD controller on MIPI-DBI bus

description: |
    The Sitronix ST7567 is a monochrome Dot-Matrix LCD controller
    with a maximum 132x65 resolution.

compatible: "sitronix,st7567"

include: ["sitronix,st7567-common.yaml", "mipi-dbi-spi-device.yaml"]
```

## dts/bindings/display/sitronix,st7567-spi.yaml
```yaml
# Copyright (c) 2025 MASSDRIVER EI (massdriver.space)
# SPDX-License-Identifier: Apache-2.0

title: Sitronix ST7567 dot-matrix LCD controller on SPI bus

description: |
    The Sitronix ST7567 is a monochrome Dot-Matrix LCD controller
    with a maximum 132x65 resolution.

compatible: "sitronix,st7567"

include: ["sitronix,st7567-common.yaml", "spi-device.yaml"]

properties:
  data-cmd-gpios:
    type: phandle-array
    required: true
    description: D/C# pin.
```
