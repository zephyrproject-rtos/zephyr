## dts/bindings/clock-management/clock-device.yaml
```yaml
# Copyright 2024 NXP
# Copyright (c) 2026 Analog Devices, Inc.
# SPDX-License-Identifier: Apache-2.0

description: |
  This file needs to be included by devices that need to specify clock
  controller requests. The maximum number of requests currently defined is 5
  (clock-request-0...clock-request-4) but can be incremented if required.
  Request indices must be contiguous and start from zero, and the
  clock-request-names property must provide one name per request.
  Each clock request is a list of clock domain phandles, each followed by a
  bitmask of the clock states within that domain that are suitable for the
  request. Bit n of the mask selects the nth clock-state child of the domain,
  counted in the order the children are declared in devicetree (the rank
  property does not affect this numbering). The CLK_STATE_n macros from
  zephyr/dt-bindings/clock-management/clock-management.h can be used to
  build the mask, for example:

    clock-request-0 = <&uart_domain CLK_STATE_0>;
    clock-request-1 = <&uart_domain (CLK_STATE_0 | CLK_STATE_2)
                       &pll_domain CLK_STATE_1>;

  If multiple clock states are allowed for a given clock domain,
  the lowest rank state will be selected. If other clock consumers
  have outstanding requests on a given clock domain, these requests
  will be considered when selecting the best clock state for that domain.
properties:
  clock-outputs:
    type: phandles
    description: Output clock sources

  clock-output-names:
    type: string-array
    description: |
      Names for clock outputs. The number of names needs to match the number
      of output clock sources.

  clock-request-0:
    type: phandle-array
    specifier-space: clock-state
    description: |
      Clock request/s for the first state. Each entry is a clock domain
      phandle followed by a bitmask of the clock states within that domain
      that are suitable for this request.

  clock-request-0-locking:
    type: boolean
    description: |
       Set if the clock request for the first state should "lock" the clocks
       it affects. If set, the clock domains referenced by this request, and
       the clock nodes configured by the states selected within those domains,
       will deny reconfiguration attempts from other consumers until this
       consumer switches to a different request.

  clock-request-1:
    type: phandle-array
    specifier-space: clock-state
    description: |
      Clock configuration/s for the second state. See clock-request-0.

  clock-request-1-locking:
    type: boolean
    description: |
      Clock lock setting for the second state. See clock-request-0-locking.

  clock-request-2:
    type: phandle-array
    specifier-space: clock-state
    description: |
      Clock configuration/s for the third state. See clock-request-0.

  clock-request-2-locking:
    type: boolean
    description: |
      Clock lock setting for the third state. See clock-request-0-locking.

  clock-request-3:
    type: phandle-array
    specifier-space: clock-state
    description: |
      Clock configuration/s for the fourth state. See clock-request-0.

  clock-request-3-locking:
    type: boolean
    description: |
      Clock lock setting for the fourth state. See clock-request-0-locking.

  clock-request-4:
    type: phandle-array
    specifier-space: clock-state
    description: |
      Clock configuration/s for the fifth state. See clock-request-0.

  clock-request-4-locking:
    type: boolean
    description: |
      Clock lock setting for the fifth state. See clock-request-0-locking.

  clock-request-names:
    type: string-array
    description: |
      Names for the clock requests, one per clock-request-<i> property, in
      index order. Each name is converted to a C identifier named
      CLOCK_MANAGEMENT_STATE_<NAME>, where <NAME> is the uppercased name with
      non-alphanumeric characters replaced by underscores. Drivers pass this
      identifier to clock_management_request_state(). The names "default"
      and "sleep" map to the standard identifiers
      CLOCK_MANAGEMENT_STATE_DEFAULT and CLOCK_MANAGEMENT_STATE_SLEEP; any
      other name requires the driver to define the matching identifier,
      starting from CLOCK_MANAGEMENT_STATE_PRIV_START.
```

## dts/bindings/clock-management/clock-domain.yaml
```yaml
# Copyright 2026 Analog Devices, Inc.
# SPDX-License-Identifier: Apache-2.0

description: |
  Clock domain node. This node describes a clock domain. Clock domains define
  a set of static clock states as children of these nodes, and can be requested
  by consumers.

  Consumers reference a clock domain in their clock-request-<n> properties,
  followed by a bitmask selecting the allowed clock states of the domain. Bit
  n of the mask refers to the nth clock-state child of the domain, counted in
  declaration order.

compatible: "clock-domain"

properties:
  "#clock-state-cells":
    type: int
    const: 1
    required: true
    description: |
      Number of cells following a clock domain phandle in a clock-request-<n>
      property. Always 1: the bitmask of allowed clock states.

clock-state-cells:
  - mask
```

## dts/bindings/clock-management/clock-state.yaml
```yaml
# Copyright 2024 NXP
# SPDX-License-Identifier: Apache-2.0

compatible: "clock-state"

description: |
  Statically defined clock configuration within a clock domain. Each
  configuration should define settings for the clock nodes in the clock tree
  that this clock domain configures. Clock states must be defined as children
  of a clock-domain node.

properties:
  clocks:
    type: phandle-array
    required: true
    description: |
      Settings for clock nodes to apply when this state is selected.
  rank:
    type: int
    default: 0
    description: |
      Rank of this configuration. Lower rank values are preferred over higher
      rank values when the user requests a clock state with the best ranking.
      Defaults to 0, the highest possible rank.
```

## dts/bindings/clock-monitor/ti,k3-dcc.yaml
```yaml
# Copyright (c) 2026 BeagleBoard.org Foundation
# SPDX-License-Identifier: Apache-2.0

description: |
  Texas Instruments K3 Dual Clock Comparator (DCC).

  Compares a target clock against a reference clock using dual down-counters.
  Exposed through the Zephyr clock_monitor API:

    - MEASURE: one-shot frequency measurement completed by the DONE interrupt
    - WINDOW:  continuous ratio check; out-of-window conditions raise
      FREQ_HIGH / FREQ_LOW (ERR flag; typically also routed to an ESM)

  Selectable clock sources are declared with two container child nodes,
  "reference-sources" and "target-sources". Each child pairs a CLKSRC mux
  cookie (ti,dcc-clk-src) with a frequency provider. The child marked
  "default-source" is the power-on selection. clock_monitor_set_source()
  switches between the declared sources at runtime.

  A source's frequency is either "clock-frequency" (fixed Hz) or "clocks"
  (queried through clock_control_get_rate()). When both are present
  "clock-frequency" wins. Reference sources must resolve to a nonzero rate;
  target sources only need one for WINDOW auto-derive (expected_hz == 0).

  The driver does not enable the selected source clocks. ERR interrupts are
  typically wired to an ESM rather than the CPU VIM; WINDOW mode therefore
  polls the ERR status flag. DONE is a CPU interrupt and drives MEASURE.

  Use the K3_DCC_CLK0_* / K3_DCC_CLK1_* macros from
  <zephyr/dt-bindings/clock-monitor/ti-k3-dcc.h>.

compatible: "ti,k3-dcc"

include: [base.yaml]

properties:
  reg:
    required: true

  interrupts:
    required: true
    description: |
      VIM (or other CPU) interrupt for the DCC DONE signal.

  interrupt-names:
    type: string-array
    description: |
      Optional names. When present, the DONE line should be named "done".

child-binding:
  description: |
    Container for selectable DCC clock sources. Instantiated twice per DCC
    node, as "reference-sources" (CLKSRC0) and "target-sources" (CLKSRC1).

  child-binding:
    description: |
      One selectable DCC clock source: a CLKSRC mux value paired with a
      frequency provider.

    properties:
      ti,dcc-clk-src:
        type: int
        required: true
        description: |
          CLKSRC mux cookie from
          <zephyr/dt-bindings/clock-monitor/ti-k3-dcc.h>. Also the runtime
          clock_monitor_set_source() selector for this source.

      clocks:
        type: phandle-array
        description: |
          Frequency provider queried through clock_control_get_rate().
          Ignored when clock-frequency is present.

      clock-frequency:
        type: int
        description: |
          Fixed frequency provider in Hz. Takes precedence over clocks.

      default-source:
        type: boolean
        description: |
          Marks this source as the power-on selection for its container.
          Exactly one child of each container must set it.
```

## dts/bindings/clock/infineon,clk-hf.yaml
```yaml
# SPDX-FileCopyrightText: Copyright (c) 2026 Infineon Technologies AG,
# SPDX-FileCopyrightText: or an affiliate of Infineon Technologies AG. All rights reserved.
# SPDX-FileCopyrightText: Copyright (c) 2026 Linumiz
#
# SPDX-License-Identifier: Apache-2.0

title: Infineon SRSS high frequency root clock

description: |
  CLK_HF root. reg is the root number.

  clocks is an FLL or PLL node, or the IMO (MXS22SRSS: IHO) node to
  use the direct mux. An okay root is configured at init and is not
  changed afterwards.

  clock-div is 1, 2, 4 or 8 on MXS40SRSS and 1 to 16 on MXS40SSRSS and
  MXS22SRSS.

compatible: "infineon,clk-hf"

include: [base.yaml, fixed-factor-clock.yaml]

properties:
  reg:
    required: true

  clocks:
    required: true

  infineon,max-frequency:
    type: int
    description: Datasheet limit in Hz.
```

## dts/bindings/clock/infineon,clk-osc.yaml
```yaml
# SPDX-FileCopyrightText: Copyright (c) 2026 Linumiz
#
# SPDX-License-Identifier: Apache-2.0

title: Infineon SRSS oscillator

description: |
  Clock source of the SRSS path muxes. reg is the CLK_PATH_SELECT
  source code of the oscillator; codes 0x100 and up are low frequency
  oscillators that are not used as a path source.

    code   MXS40SRSS  MXS40SSRSS  MXS22SRSS
    0      IMO        IMO         IHO
    1      EXT        EXT         EXT
    2      ECO        ECO         ECO
    3      -          -           IMO
    5      LPECO      -           -
    6      -          IHO         -
    0x111  -          WCO         -
    0x113  -          -           PILO

  IMO and IHO always run. An okay ECO is enabled at init with trims
  calculated from the eco-* properties. The ECO node is named eco@2.

  An okay PILO or WCO that is not running is enabled at init. A PILO
  enabled at init is waited on until PILO_OK. The WCO registers are in
  the backup register region, and get_rate reports the WCO as 0 until
  WCO_OK is set.

compatible: "infineon,clk-osc"

include: fixed-clock.yaml

properties:
  reg:
    required: true

  eco-load-capacitance-pf:
    type: int
    description: ECO only. Crystal load capacitance in picofarads.

  eco-esr-ohms:
    type: int
    description: ECO only. Crystal equivalent series resistance in ohms.

  eco-drive-level-uw:
    type: int
    description: ECO only. Crystal maximum drive level in microwatts.
```

## dts/bindings/clock/microchip,sam-pmc.yaml
```yaml
# Copyright (C) 2025 Microchip Technology Inc. and its subsidiaries
#
# SPDX-License-Identifier: Apache-2.0
#

description: |
  Microchip Power Management Controller (PMC)

compatible: "microchip,sam-pmc"

include: [clock-controller.yaml, base.yaml]

properties:
  reg:
    required: true

  "#clock-cells":
    const: 2

  microchip,plla-mul:
    type: int
    description: |
      PLLA multiplier (CKGR_PLLAR.MULA + 1). Used by SoCs whose clocks are
      configured at boot by Zephyr, such as PIC32CZ CA70. PLLA output is
      main clock * microchip,plla-mul / microchip,plla-div.

  microchip,plla-div:
    type: int
    description: |
      PLLA divider (CKGR_PLLAR.DIVA). See microchip,plla-mul.

  microchip,mck-prescaler:
    type: int
    enum: [1, 2, 3, 4, 8, 16, 32, 64]
    description: |
      Master clock prescaler (PMC_MCKR.PRES) applied to the PLLA output. The
      prescaler output is the processor clock.

  microchip,mck-divider:
    type: int
    enum: [1, 2, 3, 4]
    description: |
      Master clock divider (PMC_MCKR.MDIV) applied to the processor clock to
      produce MCK.

clock-cells:
  - clock-type
  - peripheral-id
```

## dts/bindings/clock/microchip/pic32cz_ca/microchip,pic32cz-ca-clock.yaml
```yaml
# Copyright (c) 2025-2026 Microchip Technology Inc.
# SPDX-License-Identifier: Apache-2.0

title: Microchip PIC32CZ_CA SOC family clock

description: |
  Microchip PIC32CZ_CA SOC family clock (OSCCTRL, OSC32KCTRL, GCLK, MCLK)

include:
  - name: base.yaml
  - name: pinctrl-device.yaml

compatible: "microchip,pic32cz-ca-clock"

properties:
  on-timeout-ms:
    type: int
    default: 65
    description: |
      Timeout in milliseconds for clock to be on.

      Driver waits in clock on API to check if the clock is actually on,
      so that the waiting time is not indefinite. (XOSC32K startup 62.6ms)

  flash-auto-wait-state-en:
    type: int
    enum:
      - 0
      - 1
    default: 1
    description: |
      Automatic wait state enable (FCR.CTRLA.AUTOWS), enabled at reset

      0: disable, total flash wait states are ADRWS + FWS (flash-wait-states)
      1: enable, total flash wait states are ADRWS + Taws, where
         Taws = Tacc + 5ns + 2 clocks. flash-wait-states is not used.

  flash-wait-states:
    type: int
    default: 0
    description: |
      Number of wait states for a flash read operation.

      Change this value based on the NVM access time and the AHB clock
      frequency.

      Used only when flash-auto-wait-state-en is 0 (disabled). To set the
      wait states manually, disable auto wait state first; if it is enabled,
      this value is discarded.

      Maximum AHB clock frequency per wait state:

        Wait states (FWS)   Max AHB frequency
        0                   50 MHz
        1                   90 MHz
        2                   130 MHz
        3                   140 MHz
        4                   145 MHz
        5                   150 MHz

  flash-address-wait-state-en:
    type: int
    enum:
      - 0
      - 1
    default: 0
    description: |
      Address wait state enable for a flash read operation.
      0: no extra address wait state, for higher performance at lower clock
         frequencies
      1: add one address wait state, for higher clock frequencies
```

## dts/bindings/clock/rockchip,rk3588-cru-clk.yaml
```yaml
# SPDX-FileCopyrightText: Copyright (c) 2026 KylinSoft Corporation
# SPDX-License-Identifier: Apache-2.0

title: Rockchip RK3588 CRU Clock Controller

description: |
  Clock controller for the Rockchip RK3588 CRU. Clock IDs are defined
  in include/zephyr/dt-bindings/clock/rk3588-cru.h.

compatible: "rockchip,rk3588-cru-clk"

include: [clock-controller.yaml, base.yaml]

properties:
  "#clock-cells":
    const: 1

  clocks:
    description: |
      Optional external input clocks wired to CRU mux inputs (for example,
      fixed-clock nodes providing external GMAC PTP reference clocks).

  clock-names:
    description: |
      Names of optional external input clocks. Supported names are
      "clk_gmac0_ptpref_io" and "clk_gmac1_ptpref_io".

clock-cells:
  - clkid
```

## dts/bindings/clock/wch,ch32x035-hsi-clock.yaml
```yaml
# Copyright (c) 2026 Chen Ren
# SPDX-License-Identifier: Apache-2.0

description: WCH CH32X035 HSI Clock

compatible: "wch,ch32x035-hsi-clock"

include: [fixed-clock.yaml]
```
