## dts/bindings/comparator/adc-comparator.yaml
```yaml
# Copyright 2026 Google LLC
# SPDX-License-Identifier: Apache-2.0

description: ADC-backed voltage comparator

compatible: "adc-comparator"

include: base.yaml

properties:
  io-channels:
    required: true
    description:
      ADC channel used to measure the input voltage.

  threshold-mv:
    type: int
    default: 0
    description:
      Voltage threshold in millivolts above which the comparator output is high.
```

## dts/bindings/comparator/espressif,esp32-ana-cmpr-zd.yaml
```yaml
# Copyright (c) 2026 Espressif Systems (Shanghai) Co., Ltd.
# SPDX-License-Identifier: Apache-2.0

description: |
  Espressif zero-detector analog comparator.

  One comparator is time-multiplexed across up to three input pads. Each
  enabled child node is a comparator device. The reference, the hysteresis,
  the clock and the scan timing are shared by every child.

  The GPIO selected by each pad index is SoC-specific. A pad cannot be both
  an input and the external reference, and two children cannot select the
  same pad. Hysteresis is applied only for the internal reference, so
  hysteresis-mv must be 0 when ref-source is "external".

  An armed trigger starts a periodic full scan of every enabled input. The
  scan period has to be longer than one pass over those inputs.

  Pad index to GPIO:
    ESP32-S31 unit 0: pad 0 GPIO37, pad 1 GPIO38, pad 2 GPIO39, pad 3 GPIO40

  Example (internal reference at 50% of VDD, pad 0):

    &ana_cmpr0 {
            status = "okay";
            ref-source = "internal";
            ref-voltage = <50>;
            hysteresis-mv = <40>;

            channel@0 {
                    reg = <0>;
                    source-pad = <0>;
                    status = "okay";
            };
    };

compatible: "espressif,esp32-ana-cmpr-zd"

include: [base.yaml]

properties:
  reg:
    required: true

  interrupts:
    required: true

  ref-source:
    type: string
    default: "internal"
    enum:
      - "internal"
      - "external"
    description: |
      Reference source. "internal" uses the fraction of VDD set by
      ref-voltage. "external" uses the voltage on ext-ref-pad.

  ext-ref-pad:
    type: int
    default: 3
    enum: [0, 1, 2, 3]
    description: |
      Pad index of the external reference. Used only when ref-source is
      "external". No enabled child may use this pad.

  ref-voltage:
    type: int
    default: 50
    enum: [0, 10, 20, 30, 40, 50, 60, 70]
    description: |
      Internal reference, in percent of VDD, in steps of 10. Used only when
      ref-source is "internal".

  hysteresis-mv:
    type: int
    default: 0
    enum: [0, 40, 80, 120]
    description: |
      Nominal hysteresis around the internal reference, in millivolts. The
      actual value is hardware-dependent. Must be 0 when ref-source is
      "external".

  clock-source:
    type: string
    default: "default"
    enum:
      - "default"
      - "xtal"
      - "rc-fast"
    description: |
      Function clock. "default" selects the SoC default PLL clock. "xtal" is
      the crystal. "rc-fast" is the internal fast RC oscillator.

  poll-period-ns:
    type: int
    default: 1000
    min: 1
    description: |
      Settling time, in nanoseconds, spent on a pad before its sample. The
      driver converts this to function-clock cycles.

  resample-limit:
    type: int
    default: 5
    min: 1
    max: 255
    description: |
      Consecutive samples that must agree before the stored comparison
      changes. Applies to the level read and to edges.

  debounce-cycles:
    type: int
    default: 1
    min: 1
    description: |
      Function-clock cycles ignored after a cross interrupt. Applies to edges.

  scan-period-us:
    type: int
    default: 20
    min: 1
    description: |
      Period of the scan trigger, in microseconds. It must be longer than one
      full pass over the enabled inputs.

child-binding:
  description: One comparison input. Each enabled child is a comparator device.

  properties:
    reg:
      type: array
      required: true
      description: Channel index. 0, 1 and 2 select hardware channels 1, 2 and 3.

    source-pad:
      type: int
      required: true
      enum: [0, 1, 2, 3]
      description: |
        Pad index compared against the shared reference. The GPIO selected by
        each index is SoC-specific.
```

## dts/bindings/comparator/infineon,hppass-csg-comp.yaml
```yaml
# SPDX-FileCopyrightText: Copyright (c) 2026 Infineon Technologies AG,
# SPDX-FileCopyrightText: or an affiliate of Infineon Technologies AG. All rights reserved.
#
# SPDX-License-Identifier: Apache-2.0

description: |
  Infineon HPPASS CSG comparator.

  One instance represents the comparator inside a CSG slice.  This
  node must be a child of an "infineon,hppass-csg" CSG MFD parent.

  The comparator's negative input may select either the paired in-slice
  DAC output or an available external analog input path (AIN_NA, AIN_NB):

    - When negative-input = "dac", the paired DAC must also be configured
      and enabled.
    - When negative-input = "ain-na" or "ain-nb", the comparator operates
      as a standalone analog-only comparator and the paired DAC is unused.

  The CSG MFD parent owns the combined comparator interrupt and dispatches
  callbacks. On PSC3M6 it also configures the shared analog route muxes
  through its infineon,aroute-inputs property.

compatible: "infineon,hppass-csg-comp"

include: [base.yaml]

properties:
  reg:
    type: array
    required: true
    description: |
      Register region for this slice's CMP_CFG within the CSG block.
      Slice index is derived at compile time from the offset divided
      by the CSG slice stride.

  positive-input:
    type: string
    required: true
    enum:
      - "ain-pa"
      - "ain-pb"
    description: |
      Selects the comparator's positive input source (CMP_CFG.CMP_POS_SEL):
        - "ain-pa": positive analog input path AIN_PA
        - "ain-pb": positive analog input path AIN_PB

      On PSC3M5 these paths select the fixed external AIN_PA and AIN_PB
      pins. On PSC3M6 the input paths use slice-dependent analog routing,
      including CSG route-mux outputs. AIN_PB on slices 6-8 uses a
      neighboring mux. Configure the mux inputs on the CSG parent with
      infineon,aroute-inputs; enabling a neighboring comparator is not
      required to configure its mux.

  negative-input:
    type: string
    required: true
    enum:
      - "dac"
      - "ain-na"
      - "ain-nb"
    description: |
      Selects the comparator's negative input source (CMP_CFG.CMP_NEG_SEL):
        - "dac":    paired in-slice DAC output (default operating mode)
        - "ain-na": negative analog input path AIN_NA (standalone comparator)
        - "ain-nb": negative analog input path AIN_NB (standalone comparator)

      On PSC3M5 the external negative input paths use fixed pins from
      the next slice. On PSC3M6 slices 0, 1, 3, 4, 6 and 7, the external
      negative input routing includes the next slice's route-mux output.
      The AIN_NA/AIN_NB connections are slice-specific; consult the device
      input-routing table and configure the shared muxes through the CSG
      parent's infineon,aroute-inputs property.

      PSC3M5 slice 4 and PSC3M6 slices 2, 5 and 8 have no external negative
      input. They must select "dac"; "ain-na" and "ain-nb" cause a build
      error on these slices.

  invert-output:
    type: boolean
    description: |
      Invert the digital comparator output before edge detection, blanking
      and status visibility (CMP_CFG.CMP_POLARITY).

  blank-mode:
    type: string
    default: "disabled"
    enum:
      - "disabled"
      - "gate-on-one"
      - "gate-on-zero"
    description: |
      Comparator output blanking mode (CMP_CFG.CMP_BLANK_MODE).

      Blanking gates the comparator output to inactive while a selected
      external trigger is asserted, preventing a trip on a transient condition.

        - "disabled":     no blanking applied
        - "gate-on-one":  comparator output is forced inactive while the
                          selected blanking trigger is high
        - "gate-on-zero": comparator output is forced inactive while the
                          selected blanking trigger is low

  blank-trigger-sel:
    type: string
    default: "disabled"
    enum:
      - "disabled"
      - "tr0"
      - "tr1"
      - "tr2"
      - "tr3"
      - "tr4"
      - "tr5"
      - "tr6"
      - "tr7"
    description: |
      Selects which HPPASS trigger input gates the comparator output when
      blank-mode is enabled (CMP_CFG.CMP_BLANK_TR_SEL).  Trigger sources
      "tr0".."tr7" correspond to the eight HPPASS trigger inputs
      configured on the parent "infineon,hppass-analog" node.
```

## dts/bindings/counter/aesc,timer.yaml
```yaml
#
# SPDX-FileCopyrightText: 2026 Aesc Silicon
#
# SPDX-License-Identifier: Apache-2.0
#

title: Aesc Silicon general-purpose timer

description: |
  The general-purpose timer IP core contains one or more up-counting timers,
  each with a prescaler, a reload register and compare channels. Each timer
  counts from 0 to the reload value and raises an overflow event on wrap-around
  and a compare event when the counter matches a compare register.

  The driver uses timer 0 of the IP core with compare channel 0 as alarm
  channel.

compatible: "aesc,timer"

include: base.yaml

properties:
  reg:
    required: true

  interrupts:
    required: true

  clock-frequency:
    type: int
    description: |
      Input clock frequency in Hz. Only used when the node has no clocks
      property.

  resolution:
    type: int
    required: true
    description: Counter width in bits.

  prescaler:
    type: int
    default: 0
    description: |
      Prescaler register value. The counter advances once every
      prescaler + 1 input clock cycles.
```

## dts/bindings/counter/arm,armv7-timer-mem-block.yaml
```yaml
# SPDX-FileCopyrightText: Copyright Analog Devices, Inc.
# SPDX-License-Identifier: Apache-2.0

description: |
  ARM memory-mapped system counter and its timer frames.

  CNTCTLBase ("ctl") is the timer-control frame. CNTControlBase
  ("control") is the counter-control frame, present when this image
  can access it. CNTControlBase is usually Secure-only.
  The count is read from a timer frame. CNTReadBase is omitted.

  Linux arm,armv7-timer-mem is CNTCTLBase alone, and its frames have
  no compatible. This compatible is the block, so each frame is its
  own node. The frame compatible is Zephyr-only. A frame interrupt
  is the physical timer.

compatible: "arm,armv7-timer-mem-block"

include: base.yaml

properties:
  reg:
    required: true

  reg-names:
    required: true
    description: |
      "ctl" is CNTCTLBase. "control" is CNTControlBase. Present only
      when this image can access it; it is usually Secure-only.

  clocks:
    description: |
      Clock that drives the system counter. The clock cell is named
      clkid.

  ranges:
    required: true

  "#address-cells":
    required: true
    enum:
      - 1
      - 2

  "#size-cells":
    required: true
    enum:
      - 1
      - 2
```

## dts/bindings/counter/arm,armv7-timer-mem-frame.yaml
```yaml
# SPDX-FileCopyrightText: Copyright Analog Devices, Inc.
# SPDX-License-Identifier: Apache-2.0

description: |
  One timer frame (CNTBaseN) of an arm,armv7-timer-mem-block.

  The frame is one physical compare on the shared system counter.
  Its interrupt is the physical timer. The compatible is Zephyr-only.

compatible: "arm,armv7-timer-mem-frame"

include: base.yaml

properties:
  reg:
    required: true

  interrupts:
    required: true

  frame-number:
    type: int
    required: true
    max: 7
    description: |
      Frame index n. CNTACRn in CNTCTLBase is the access-control
      register for this frame. The block has frames 0 through 7.
```

## dts/bindings/counter/nuvoton,npcm-itim32.yaml
```yaml
# Copyright (c) 2026 Nuvoton Technology Corporation.
# SPDX-License-Identifier: Apache-2.0

description: |
  Nuvoton NPCM internal 32-bit timer (ITIM32).

  The timer counts down from a programmed value and reloads when it reaches
  zero, which raises an interrupt and, with the 32 kHz input clock, a wake-up
  event. The input clock is the one the clock controller reports for the
  module, divided by the prescaler.

compatible: "nuvoton,npcm-itim32"

include: base.yaml

properties:
  reg:
    required: true

  clocks:
    required: true

  interrupts:
    required: true

  prescaler:
    type: int
    default: 1
    description: |
      Divider of the input clock, from 1 to 256. The counter frequency is the
      input clock frequency divided by this value.
```

## dts/bindings/counter/nxp,lpc-rit.yaml
```yaml
# SPDX-FileCopyrightText: Copyright The Zephyr Project Contributors
# SPDX-License-Identifier: Apache-2.0

description: |
  NXP LPC Repetitive Interrupt Timer: a 48 bit up-counter with one compare
  register, a compare mask and clear-on-match.

compatible: "nxp,lpc-rit"

include: base.yaml

properties:
  reg:
    required: true

  interrupts:
    required: true

  clocks:
    required: true
```

## dts/bindings/counter/st,stm32-counter.yaml
```yaml
# Copyright (c) 2021, Kent Hall
# SPDX-License-Identifier: Apache-2.0

description: STM32 counters

compatible: "st,stm32-counter"

include: [base.yaml, pinctrl-device.yaml]

properties:
  "#counter-alarm-cells":
    type: int
    const: 1
    description: Number of items to expect in a counter alarm specifier

counter-alarm-cells:
  - channel

counter-capture-cells:
  - channel
  - flags
```

## dts/bindings/counter/zephyr,native-sim-counter.yaml
```yaml
# Copyright (c) 2022, Kumar Gala <galak@kernel.org>
# SPDX-License-Identifier: Apache-2.0

description: Native_sim Counter

compatible: "zephyr,native-sim-counter"

include: base.yaml

properties:
  rising-edge:
    type: boolean
    description: Emulated counter supports rising-edge capture detection

  falling-edge:
    type: boolean
    description: Emulated counter supports falling-edge capture detection

  "#counter-alarm-cells":
    type: int
    const: 1
    description: Number of items to expect in a counter alarm specifier

counter-alarm-cells:
  - channel

counter-capture-cells:
  - channel
  - flags
```

## dts/bindings/cpu/arm,arm926ej-s.yaml
```yaml
# Copyright (C) 2026 Microchip Technology Inc.
# SPDX-License-Identifier: Apache-2.0

description: ARM926EJ-S CPU

compatible: "arm,arm926ej-s"

include: cpu.yaml
```

## dts/bindings/cpu/arm,cortex-a35.yaml
```yaml
# Copyright 2026 Arm Limited and/or its affiliates <open-source-office@arm.com>
# SPDX-License-Identifier: Apache-2.0

description: Arm Cortex-A35 CPU

compatible: "arm,cortex-a35"

include: cpu.yaml
```

## dts/bindings/cpu/thead,c908.yaml
```yaml
# Copyright (c) 2026 Process Mission
# SPDX-License-Identifier: Apache-2.0

description: T-Head XuanTie C908 Core CPU

compatible: "thead,c908"

include: riscv-common.yaml
```

## dts/bindings/cpu/wch,qingke-v4a.yaml
```yaml
# SPDX-FileCopyrightText: Copyright The Zephyr Project Contributors
# SPDX-License-Identifier: Apache-2.0

description: WCH QingKe V4A RISC-V MCU

compatible: "wch,qingke-v4a"

include: riscv-common.yaml
```

## dts/bindings/crc/arm,armv8-crc32.yaml
```yaml
# Copyright (c) 2026 Nokia
# SPDX-License-Identifier: Apache-2.0

description: |
  CRC32 and CRC32C computed with the Armv8 CRC extension (FEAT_CRC32)
  instructions of the CPU.

  This node has no registers. It selects the instruction-based CRC driver and
  can be referenced from the zephyr,crc chosen node. Only add it on SoCs whose
  CPUs implement the CRC extension.

compatible: "arm,armv8-crc32"

include: base.yaml
```
