## dts/bindings/pinctrl/renesas,rcar-pfc-x5h.yaml
```yaml
# Copyright (c) 2026 BayLibre, SAS
# SPDX-License-Identifier: Apache-2.0

description: |
    Renesas R-Car Gen5 Pin Function Controller (PFC)

    The R-Car PFC is a singleton node responsible for controlling pin function
    selection and pin properties.

    The node has the 'pfc' node label set in the SoC's devicetree and can be
    modified through a 'board-pinctrl.dtsi' file in the board directory, or a
    devicetree overlay in the application. All device pin configurations must
    be placed in child nodes of the 'pfc' node. For example, this node can be
    used to route CAN8 TX to pin 'CLK_EXTFXR', and enable pull-up resistor as
    well as driving ability.

compatible: "renesas,rcar-pfc-x5h"

include: base.yaml

properties:
  reg:
    required: true

child-binding:
  description: R-Car Gen5 pin configuration

  include:
    - name: pincfg-node.yaml
      property-allowlist:
        - bias-disable
        - bias-pull-down
        - bias-pull-up
        - drive-strength-microamp

  properties:
    pin:
      type: array
      required: true
      description: |
        The array is expected to have up to two elements. The first element
        is the pin, the second optional element is the pin function.
    drive-strength-microamp:
      enum: [7500, 9500, 10300, 10600, 10800, 11000, 11200]

examples:
- |
  /*
   * In the 'board-pinctrl.dtsi' file, include pre-defined pins
   * and functions for the SoC used by the board
   */
  #include <zephyr/dt-bindings/pinctrl/renesas/pinctrl-r8a78000.h>

  &pfc {
    /* ... */

    /* Configuration for CAN8 TX default state */
    can8_tx_default: can8_tx_default {
      /* Configure PIN_CLK_EXTFXR as FUNC_CAN8TX */
      pin = <PIN_CLK_EXTFXR FUNC_CAN8TX>;
    };
    /* Configuration for CAN8 RX default state */
    can8_rx_default: can8_rx_default {
      /* Configure PIN_FXR_CLKOUT2 as FUNC_CAN8RX_INTP8 */
      pin = <PIN_FXR_CLKOUT2 FUNC_CAN8RX_INTP8>;
    };
  };

  /*
   * In the board's DTS file', use pinctrl-N properties to link
   * pin configurations with a device
   */
  #include "board-pinctrl.dtsi"

  &can8 {
    /* ... */

    pinctrl-0 = <&can8_tx_default &can8_rx_default>;
    pinctrl-1 = <&can8_tx_sleep &can8_rx_sleep>;
    pinctrl-names = "default", "sleep";
  };
```

## dts/bindings/pinctrl/renesas,rcar-pfc.yaml
```yaml
# Copyright (c) 2021 IoT.bzh
# SPDX-License-Identifier: Apache-2.0

description: |
    Renesas R-Car Pin Function Controller node
    This binding gives a base representation of the R-Car pins configuration.
    The R-Car pin controller is a singleton node responsible for controlling
    pin function selection and pin properties. For example, you can use this
    node to route CAN0 TX A to pin 'RD', and enable pull-up resistor as well
    as driving ability.

    The node has the 'pfc' node label set in your SoC's devicetree, so you can
    modify it like this:

    &pfc {
         /* your modifications go here */
    };

    All device pin configurations should be placed in child nodes of the
    'pfc' node, as shown in this example:
      /* You can put this in places like a board-pinctrl.dtsi file in
       * your board directory, or a devicetree overlay in your application.
       */

      /* include pre-defined pins and functions for the SoC used by the board */
      #include <dt-bindings/pinctrl/renesas/pinctrl-r8a77951.h>

      &pfc {
        /* configuration for can0 data a tx default state */
        can0_data_a_tx_default: can0_data_a_tx_default {
          /* configure PIN_RD as FUNC_CAN0_TX_A */
          pin = <PIN_RD FUNC_CAN0_TX_A>;
        };
        /* configuration for can0 data a rx default state */
        can0_data_a_rx_default: can0_data_a_rx_default {
          /* configure PIN_RD_WR as FUNC_CAN0_RX_A */
          pin = <PIN_RD_WR FUNC_CAN0_RX_A>;
        };
      };

    The 'can0_data_a_tx_default' child node encodes the pin configurations
    for a particular state of a device; in this case, the default
    (that is, active) state. You would specify the low-power configuration for
    the same device in a separate child node.

    A pin configuration can also specify pin properties such as the
    'bias-pull-up' property. Here is a list of supported standard pin
    properties:

    - bias-disable
    - bias-pull-down
    - bias-pull-up
    - drive-strength
    - power-source

    To link pin configurations with a device, use a pinctrl-N property for some
    number N, like this example you could place in your board's DTS file:

      #include "board-pinctrl.dtsi"

      &can0 {
        pinctrl-0 = <&can0_data_a_tx_default &can0_data_a_rx_default>;
        pinctrl-1 = <&can0_data_a_tx_sleep &can0_data_a_rx_sleep>;
        pinctrl-names = "default", "sleep";
      };

compatible: "renesas,rcar-pfc"

include: base.yaml

properties:
  reg:
    required: true

child-binding:
  description: |
     This binding gives a base representation of the R-Car pins configuration.

  include:
    - name: pincfg-node.yaml
      property-allowlist:
        - bias-disable
        - bias-pull-down
        - bias-pull-up
        - drive-strength
        - power-source

  properties:
    pin:
      type: array
      required: true
      description: |
        The array is expected to have up to two elements. The first element is
        the pin the second optional element is the pin function.
    drive-strength:
      enum: [3, 6, 9, 12, 15, 18, 21, 24]
```

## dts/bindings/pinctrl/renesas,rcar-pinmux.yaml
```yaml
# Copyright (c) 2021 IoT.bzh
# SPDX-License-Identifier: Apache-2.0

description: Renesas R-Car pinmux node

compatible: "renesas,rcar-pinmux"

include: base.yaml

properties:
    reg:
      required: true

child-binding:
  description: |
     This binding gives a base representation of the R-Car pins configuration
  properties:
    renesas,rcar-pins:
      type: array
      required: true
```

## dts/bindings/pinctrl/renesas,rh850-pinctrl.yaml
```yaml
# Copyright (c) 2026 Renesas Electronics Corporation
# SPDX-License-Identifier: Apache-2.0

title: Renesas RH850 Pin Controller

description: |
    Node responsible for controlling pin function selection and pin properties.

    The node has the 'pinctrl' node label set in your SoC's devicetree,
    so you can modify it like this:

      &pinctrl {
              /* your modifications go here */
      };

    All device pin configurations should be placed in child nodes of the
    'pinctrl' node, as shown in this example:

      /* You can put this in places like a board-pinctrl.dtsi file in
       * your board directory, or a devicetree overlay in your application.
       */

      /* include pre-defined combinations for the SoC variant used by the board */
      #include <dt-bindings/pinctrl/renesas/pinctrl-u2b.h>

      &pinctrl {
        /* configuration for the rlin30 "default" state */
          rlin30_default: rlin30_default {
          group1 {
            /* tx */
            psels = <RH850_PSEL(PORT_02, 6, ALT_OUT8)>;
            drive-strength = "medium";
          };
          group2 {
            /* rx */
            psels = <RH850_PSEL(PORT_02, 5, ALT_IN11)>;
          };
        };
      };

    The 'rlin30_default' child node encodes the pin configurations for a
    particular state of a device; in this case, the default (that is, active)
    state.

    As shown, pin configurations are organized in groups within each child node.
    Each group can specify a list of pin function selections in the 'psels'
    property.

    A group can also specify shared pin properties common to all the specified
    pins, such as the 'input-enable' property in group 2. Here is a list of
    supported standard pin properties:

    - bias-pull-up: Enable pull-up resistor.
    - bias-pull-down: Enable pull-down resistor.

    - drive-push-pull: Specify push-pull output buffer function (default is push-pull)
    - drive-open-drain: Specify open-drain output buffer function
    - drive-open-source: Specify open-source output buffer function
    Only one of the above drive mode properties shall be specified, as they are mutually
    exclusive. If none is provided, push-pull mode is used by default.

    - input-enable: Enable input from the pin.
    - output-high: Set the initial output to high.
    - drive-strength: Set the drive strength of the pin. Possible
      values are: very low, low, medium, high.
    - renesas,direct-control: Enable direct I/O control.
    - renesas,bidirect-control: Enable bi-direction mode.

    To link pin configurations with a device, use a pinctrl-N property for some
    number N, like this example you could place in your board's DTS file:

       #include "board-pinctrl.dtsi"

       &rlin30 {
             pinctrl-0 = <&rlin30_default>;
             pinctrl-1 = <&rlin30_sleep>;
             pinctrl-names = "default", "sleep";
       };

compatible: "renesas,rh850-pinctrl"

include: base.yaml

child-binding:
  description: |
    Definitions for a pinctrl state.
  child-binding:

    include:
      - name: pincfg-node.yaml
        property-allowlist:
          - bias-pull-up
          - bias-pull-down
          - drive-push-pull
          - drive-open-drain
          - drive-open-source
          - input-enable
          - output-high
    properties:
      psels:
        required: true
        type: array
        description: |
          An array of pins sharing the same group properties. Each
          element of the array is an integer constructed from the
          pin number and the alternative function of the pin.

      drive-strength:
        type: string
        enum:
          - "very low"
          - "low"
          - "medium"
          - "high"
        default: "low"
        description: |
          The drive strength of a pin. The default value is low, as this
          is the power on reset value.

      renesas,direct-control:
        type: boolean
        description: |
          Set in alternative functions that require direct control
          of the I/O direction.

      renesas,bidirect-control:
        type: boolean
        description: |
          Enable/Disable the Bi-direction mode that enable input buffer
          when a pin is used in output mode.

      renesas,input-buffer-selection:
        type: string
        enum:
          - "disable"
          - "schmitt1"
          - "schmitt4"
          - "ttl"
          - "schmittmsc"
        default: "disable"
        description: |
          Set the input buffer charecteristics that require input buffer pin.
          Default value "disable" reflects the hardware reset state.
```

## dts/bindings/pinctrl/renesas,rx-pinctrl.yaml
```yaml
# Copyright (c) 2024 Renesas Electronics Corporation
# SPDX-License-Identifier: Apache-2.0

description: |
  description: |
    The Renesas RX pin controller is a node responsible for controlling
    pin function selection and pin properties

    The node has the 'pinctrl' node label set in your SoC's devicetree,
    so you can modify it like this:

      &pinctrl {
              /* your modifications go here */
      };

    All device pin configurations should be placed in child nodes of the
    'pinctrl' node, as shown in this example:

      /* You can put this in places like a board-pinctrl.dtsi file in
       * your board directory, or a devicetree overlay in your application.
       */

      /* include pre-defined combinations for the SoC variant used by the board */
      #include <dt-bindings/pinctrl/renesas/rx-pinctrl.h>

      &pinctrl {
        sci1_default: sci1_default {
          group1 {
            psels = <RX_PSEL(RX_PSEL_SCI_1, 2, 6)>; /* TX */
            drive-strength = "medium";
          };
          group2 {
            psels = <RX_PSEL(RX_PSEL_SCI_1, 3, 0)>; /* RX */
            drive-strength = "medium";
          };
        };
      };

    The 'sci1_default' child node encodes the pin configurations for a
    particular state of a device; in this case, the default (that is, active)
    state.

    As shown, pin configurations are organized in groups within each child node.
    Each group can specify a list of pin function selections in the 'psels'
    property.

    A group can also specify shared pin properties common to all the specified
    pins, such as the 'input-enable' property in group 2. Here is a list of
    supported standard pin properties:

    - bias-disable: Disable pull-up/down (default, not required).
    - bias-pull-up: Enable pull-up resistor.
    - input-enable: Enable input from the pin.
    - drive-strength: Set the drive strength of the pin. Possible
      values are: normal, high.

    To link pin configurations with a device, use a pinctrl-N property for some
    number N, like this example you could place in your board's DTS file:

       #include "board-pinctrl.dtsi"

       &sci1 {
             pinctrl-0 = <&uart0_default>;
             pinctrl-1 = <&uart0_sleep>;
             pinctrl-names = "default", "sleep";
       };

compatible: "renesas,rx-pinctrl"

include: base.yaml

child-binding:
  description: |
    Definitions for a pinctrl state.
  child-binding:
    include:
      - name: pincfg-node.yaml
        property-allowlist:
          - bias-disable
          - bias-pull-up
          - input-enable
          - output-enable
          - output-high
          - drive-open-drain

    properties:
      psels:
        required: true
        type: array
        description: |
          An array of pins sharing the same group properties. Each
          element of the array is an integer constructed from the
          pin number and the alternative function of the pin.
      drive-strength:
        type: string
        enum:
          - "normal"
          - "high"
        default: "normal"
        description: |
          The drive strength of a pin. The default value is normal, as this
          is the power on reset value.
      renesas,analog-enable:
        type: boolean
        description: enable analog input
```

## dts/bindings/pinctrl/renesas,rx-pinmux.yaml
```yaml
# Copyright (c) 2024 Renesas Electronics Corporation
# SPDX-License-Identifier: Apache-2.0

description: Rensas RX Pinmux (Multi Function Pin Controller, MPC)

compatible: "renesas,rx-pinmux"

include: base.yaml

properties:
  reg:
    required: true

  "#pinmux-cells":
    type: int
    required: true
    const: 2
    description: number of items in a pinmux specifier

pinmux-cells:
  - pin
  - function

child-binding:
  include: pincfg-node.yaml
```
