## dts/bindings/pinctrl/renesas,rzv-pinctrl.yaml
```yaml
# Copyright (c) 2025 Renesas Electronics Corporation
# SPDX-License-Identifier: Apache-2.0

description: |
    Renesas RZ/V pin controller

    The Renesas RZ/V pin controller is a node responsible for controlling
    pin function selection and pin properties, such as routing the TX and RX of UART2
    to pin 0 and pin 1 of port 48.

    #include <zephyr/dt-bindings/pinctrl/renesas/pinctrl-rzv-common.h>
    example_pins: device_pin {
        device-pinmux {
          pinmux = <RZV_PINMUX(PORT_04, 0, 2)>,
                   <RZV_PINMUX(PORT_04, 1, 2);
          bias_pull_up;
          renesas,filter = RZV_FILTER_SET(RZV_FILNUM_8_STAGE,RZV_FILCLKSEL_DIV_18000);
          drive-strength = <1>;
          slew-rate = <fast>;
        };

        device-spins {
          pins = <BSP_IO_QSPI0_IO0>, <BSP_IO_QSPI0_IO3>;
          input-enable;
          renesas,filter = RZV_FILTER_SET(RZV_FILNUM_8_STAGE,RZV_FILCLKSEL_DIV_18000);
          drive-strength = <2>;
          slew-rate = "fast";
        };
      };


compatible: renesas,rzv-pinctrl

include: base.yaml
properties:
  reg:
    required: true

  reg-names:
    required: true

child-binding:
  description: |
    This RZV pins mux/cfg nodes description.

  child-binding:
    description: |
      The RZV pinmux/pincfg configuration nodes description.

    include:
    - name: pincfg-node.yaml
      property-allowlist:
      - bias-pull-down
      - bias-pull-up
      - drive-strength
      - input-enable

    properties:
      pinmux:
        type: array
        description: |
          Pinmux configuration node.
          Values are constructed from GPIO port number, pin number, and
          alternate function configuration number using the RZV_PINMUX()
          helper macro in pinctrl-rzv-common.h

      pins:
        type: array
        description: |
          Special Purpose pins configuration node.
          Values are define in pinctrl-rzv-common.h.
          Ex: BSP_IO_QSPI0_IO0,BSP_IO_RIIC1_SCL,...

      drive-strength:
        type: int
        default: 0
        description: |
          Maximum sink or source current in mA for pin which shell be selected
          depending on device and pin group.

      renesas,filter:
        type: int
        default: 0
        description: |
          Digital Noise Filter configuration for a pin which shell be defined
          using RZV_FILTER_SET() helper macro in pinctrl-rzv-common.h to specify
          FILNUM and FILCLKSEL. With 24Mhz external clock:
          - min debounce time will be 166.666ns for FILNUM=0 and FILCLKSEL=0
          - max debounce time will be 24ms for FILNUM=3 and FILCLKSEL=3.
          This property intentionally redefined to avoid unnecessary conversation from usec to
          FILNUM and FILCLKSEL values depending on external clock value as this configuration
          is static.

      slew-rate:
        type: string
        default: "fast"
        enum:
        - "slow"
        - "fast"
        description: |
          Select slew rate for pin.
```

## dts/bindings/pinctrl/renesas,smartbond-pinctrl.yaml
```yaml
# Copyright (c) 2022 Renesas Electronics Corporation
# SPDX-License-Identifier: Apache-2.0

description: |
    The SmartBond pin controller is a singleton node responsible for controlling
    pin function selection and pin properties, such as routing a UART RX to pin
    P1.8 and enabling the pullup resistor on that pin.

    The node has the 'pinctrl' node label set in your SoC's devicetree,
    so you can modify it like this:

      &pinctrl {
              /* your modifications go here */
      };

    All device pin configurations should be placed in child nodes of the
    'pinctrl' node, as shown in this example:

      /* You can put this in places like a board-pinctrl.dtsi file in
       * your board directory, or a devicetree overlay in your application.
       */

     /* include definitions and utility macros for the SoC used by the board */
     #include <dt-bindings/pinctrl/smartbond-pinctrl.h>

      &pinctrl {
        /* configuration for uart device, default state */
        uart_default: uart_default {
          /* group 1 */
          group1 {
            /* route UART TX to P0.9 */
            pinmux = <SMARTBOND_PINMUX(UART_TX, 0, 9)>;
          };
          /* group 2 */
          group2 {
            /* route UART RX to P0.8 and enable pull-up */
            pinmux = <SMARTBOND_PINMUX(UART_RX, 0, 8)>;
            bias-pull-up;
          };
        };
      };

    The 'uart0_default' child node encodes the pin configurations for a
    particular state of a device; in this case, the default (that is, active)
    state.

    As shown, pin configurations are organized in groups within each child node.
    Each group can specify a list of pin function selections in the 'pinmux'
    property. Note that 'pinmux' property is an array so you can configure multiple
    pins at once there. The SMARTBOND_PINMUX macro is used to create pinmux value.

    A group can also specify shared pin properties common to all the specified
    pins, such as the 'bias-pull-up' property in group 2. Here is a list of
    supported standard pin properties:

    - bias-pull-up: Enable pull-up resistor.
    - bias-pull-down: Enable pull-down resistor.

    Note that bias options are mutually exclusive.

    To link this pin configuration with a device, use a pinctrl-N property
    for some number N, like this example you could place in your board's DTS
    file:

       #include "board-pinctrl.dtsi"

       &uart {
             pinctrl-0 = <&uart_default>;
             pinctrl-names = "default";
       };

compatible: "renesas,smartbond-pinctrl"

include: base.yaml

child-binding:
  description: |
    Definitions for a pinctrl state.
  child-binding:

    include:
      - name: pincfg-node.yaml
        property-allowlist:
          - bias-pull-down
          - bias-pull-up
          - output-enable
          - input-enable

    properties:
      pinmux:
        required: true
        type: array
        description: |
          An array of pins sharing the same group properties. The pins should
          be defined using the SMARTBOND_PINMUX utility macro that encodes the port,
          pin and function.
```
