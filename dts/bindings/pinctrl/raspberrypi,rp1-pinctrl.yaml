## dts/bindings/pinctrl/renesas,rza-pinctrl.yaml
```yaml
# Copyright (c) 2025 Renesas Electronics Corporation
# SPDX-License-Identifier: Apache-2.0

description: |
  Below generic example shows of supported pinctrl definitions:

    #include <zephyr/dt-bindings/pinctrl/renesas/pinctrl-rza-common.h>
    example_pins: device_pin {
        device-pinmux {
          pinmux = <RZA_PINMUX(PORT_08, 1, 5)>,
                   <RZA_PINMUX(PORT_08, 2, 5)>;
          bias_pull_up;
          renesas,filter = RZA_FILTER_SET(RZA_FILNUM_8_STAGE,RZA_FILCLKSEL_DIV_18000);
          drive-strength = <1>;
          slew-rate = "fast";
        };

        device-spins {
          pins = <BSP_IO_XSPI_IO0>, <BSP_IO_XSPI_IO4>;
          input-enable;
          renesas,filter = RZA_FILTER_SET(RZA_FILNUM_8_STAGE,RZA_FILCLKSEL_DIV_18000);
          drive-strength = <2>;
          slew-rate = "fast";
        };
      };


compatible: renesas,rza-pinctrl

include: base.yaml
properties:
  reg:
    required: true

  reg-names:
    required: true

child-binding:
  description: |
    This RZA pins mux/cfg nodes description.

  child-binding:
    description: |
      The RZA pinmux/pincfg configuration nodes description.

    include:
    - name: pincfg-node.yaml
      property-allowlist:
      - bias-disable
      - bias-high-impedance
      - bias-pull-down
      - bias-pull-up
      - bias-pull-pin-default
      - drive-strength
      - input-enable
      - input-disable
      - output-enable
      - power-source
      - low-power-enable
      - low-power-disable

    properties:
      pinmux:
        type: array
        description: |
          Pinmux configuration node.
          Values are constructed from GPIO port number, pin number, and
          alternate function configuration number using the RZA_PINMUX()
          helper macro in pinctrl_rza.h

      pins:
        type: array
        description: |
          Special Purpose pins configuration node.
          Values are define in pinctrl_rza.h.
          Ex: BSP_IO_XSPI_IO0,BSP_IO_I3C_SCL,...

      drive-strength:
        type: int
        default: 0
        description: |
          Maximum sink or source current in mA for pin which shall be selected
          depending on device and pin group.

      renesas,filter:
        type: int
        default: 0
        description: |
          Digital Noise Filter configuration for a pin which shall be defined
          using RZA_FILTER_SET() helper macro in pinctrl_rza.h to specify
          FILNUM and FILCLKSEL. With 24Mhz external clock:
          - min debounce time will be 166.666ns for FILNUM=0 and FILCLKSEL=0
          - max debounce time will be 24ms for FILNUM=3 and FILCLKSEL=3.
          This property intentionally redefined to avoid unnecessary conversation from usec to
          FILNUM and FILCLKSEL values depending on external clock value as this configuration
          is static.

      slew-rate:
        type: string
        default: "fast"
        enum:
        - "slow"
        - "fast"
        description: |
          Select slew rate for pin.
```

## dts/bindings/pinctrl/renesas,rza2m-pinctrl.yaml
```yaml
# Copyright (c) 2025 Renesas Electronics Corporation
# SPDX-License-Identifier: Apache-2.0

description: |
    Renesas RZ/A2M pin controller

    The Renesas RZ/A2M pin controller is a node responsible for controlling
    pin function selection and pin properties, such as routing the TX and RX of UART4
    to pin 0 and pin 1 of port 9.

    #include <zephyr/dt-bindings/pinctrl/renesas/pinctrl-rza2m.h>
    example_pins: device_pin {
        device-pinmux {
          pinmux = <RZA2M_PINMUX(PORT_09, 0, 4)>, /* TXD */
                   <RZA2M_PINMUX(PORT_09, 1, 4)>; /* RXD */
        };
    };

compatible: "renesas,rza2m-pinctrl"

include: base.yaml

properties:
  reg:
    required: true

child-binding:
  description: |
    This RZA2M pins mux/cfg nodes description.

  child-binding:
    description: |
      The RZA2M pinmux/pincfg configuration nodes description.

    include:
      - name: pincfg-node.yaml

    properties:
      pinmux:
        type: array
        required: true
        description: |
          Pinmux configuration node.
          Values are constructed from GPIO port number, pin number, and
          alternate function configuration number using the RZA2M_PINMUX()
          helper macro in pinctrl-rza2m.h

      drive-strength:
        type: int
        enum:
          - 0 # 2 mA
          - 1 # 8 mA
          - 2 # 12 mA
        description: |
          The DSCR register controls driving ability of the ports.
          The PCKIO register controls driving ability of the CKIO pin.
          The PSDMMC(0/1/2) registers specify the driving ability of the pins of the SD/MMC.
          The PSPIBSC register specifies the driving ability of the pins
            of the SPI multi I/O bus controller.
```

## dts/bindings/pinctrl/renesas,rzg-pinctrl.yaml
```yaml
# Copyright (c) 2024 Epam Systems
# Copyright (c) 2024-2025 Renesas Electronics Corporation
# SPDX-License-Identifier: Apache-2.0

description: |
    Renesas RZ/G pin controller

    The Renesas RZ/G pin controller is a node responsible for controlling
    pin function selection and pin properties.

    The pre-defined combinations for the RZ/G variants are defined in the below headers
    - pinctrl-rzg-common.h for RZ/G3S
    - pinctrl-rzg2-common.h for RZ/G2L, RZ/G2LC

    #include <zephyr/dt-bindings/pinctrl/renesas/pinctrl-rzg(2)-common.h>
    example_pins: device_pin {
        device-pinmux {
          pinmux = <RZG_PINMUX(PORT_08, 1, 5)>,
                   <RZG_PINMUX(PORT_08, 2, 5)>;
          bias_pull_up;
          renesas,filter = RZG_FILTER_SET(RZG_FILNUM_8_STAGE,RZG_FILCLKSEL_DIV_18000);
          drive-strength = <1>;
        };

        device-spins {
          pins = <BSP_IO_XSPI_IO0>, <BSP_IO_XSPI_IO4>;
          input-enable;
          renesas,filter = RZG_FILTER_SET(RZG_FILNUM_8_STAGE,RZG_FILCLKSEL_DIV_18000);
          drive-strength = <2>;
        };
      };


compatible: renesas,rzg-pinctrl

include: base.yaml
properties:
  reg:
    required: true

  reg-names:
    required: true

child-binding:
  description: |
    This RZG pins mux/cfg nodes description.

  child-binding:
    description: |
      The RZG pinmux/pincfg configuration nodes description.

    include:
    - name: pincfg-node.yaml
      property-allowlist:
      - bias-disable
      - bias-high-impedance
      - bias-pull-down
      - bias-pull-up
      - bias-pull-pin-default
      - drive-strength
      - input-enable
      - input-disable
      - output-enable
      - power-source
      - low-power-enable
      - low-power-disable

    properties:
      pinmux:
        type: array
        description: |
          Pinmux configuration node.
          Values are constructed from GPIO port number, pin number, and
          alternate function configuration number using the RZG_PINMUX()
          helper macro in pinctrl-rzg(2)-common.h.

      pins:
        type: array
        description: |
          Special Purpose pins configuration node.
          Values are define in pinctrl-rzg(2)-common.h.
          Ex: BSP_IO_XSPI_IO0,BSP_IO_I3C_SCL,...

      drive-strength:
        type: int
        default: 0
        description: |
          Maximum sink or source current in mA for pin which shell be selected
          depending on device and pin group.

      renesas,filter:
        type: int
        default: 0
        description: |
          Digital Noise Filter configuration for a pin which shell be defined
          using RZG_FILTER_SET() helper macro in pinctrl_rzg.h to specify
          FILNUM_m and FILCLKSEL_m. With 24Mhz external clock:
          - min debounce time will be 166.666ns for FILNUM_m=0 and FILCLKSEL_m=0
          - max debounce time will be 24ms for FILNUM_m=3 and FILCLKSEL_m=3.
          This property intentionally redefined to avoid unnecessary conversation from usec to
          FILNUM_m and FILCLKSEL_m values depending on external clock value as this configuration
          is static.
```

## dts/bindings/pinctrl/renesas,rzn-pinctrl.yaml
```yaml
# Copyright (c) 2025 Renesas Electronics Corporation
# SPDX-License-Identifier: Apache-2.0


description: |
    The Renesas RZ/N2L pin controller is a node responsible for controlling
    pin function selection and pin properties, such as routing the TX and RX of UART0
    to pin 5 and pin 6 of port 16.

    The node has the 'pinctrl' node label set in your SoC's devicetree,
    so you can modify it like this:

      &pinctrl {
              /* your modifications go here */
      };

    All device pin configurations should be placed in child nodes of the
    'pinctrl' node, as shown in this example:

      /* You can put this in places like a board-pinctrl.dtsi file in
       * your board directory, or a devicetree overlay in your application.
       */

      /* include pre-defined combinations for the SoC variant used by the board */
      #include <zephyr/dt-bindings/pinctrl/renesas/pinctrl-rzn-common.h>

      &pinctrl {
        uart0_pins: uart0 {
          group1 {
            pinmux = <RZN_PINMUX(PORT_16, 5, 1)>; /* TXD */
          };
          group2 {
            pinmux = <RZN_PINMUX(PORT_16, 6, 2)>; /* RXD */
            input-enable;
          };
        };
      };

    The 'uart0_pins' child node encodes the pin configurations for a
    particular state of a device; in this case, the default (that is, active)
    state.

    As shown, pin configurations are organized in groups within each child node.
    Each group can specify a list of pin function selections in the 'pinmux'
    property.

    A group can also specify shared pin properties common to all the specified
    pins, such as the 'input-enable' property in group 2.

compatible: "renesas,rzn-pinctrl"

include: base.yaml

child-binding:
  description: |
    Definitions for a pinctrl state.
  child-binding:

    include:
      - name: pincfg-node.yaml
        property-allowlist:
          - input-enable
          - output-enable
          - output-high
          - bias-pull-up
          - bias-pull-down
          - input-schmitt-enable

    properties:
      pinmux:
        required: true
        type: array
        description: |
          An array of pins sharing the same group properties. Each
          element of the array is an integer constructed from the
          pin number and the alternative function of the pin.
      drive-strength:
        type: string
        enum:
          - "low"
          - "middle"
          - "high"
          - "ultrahigh"
        default: "low"
        description: |
          The drive strength of a pin, relative to full-driver strength.
          The default value is "low", which is the reset value.
      slew-rate:
        type: string
        enum:
          - "slow"
          - "fast"
        default: "slow"
        description: |
          Select slew rate for a pin. The default is slow, which is the reset value.
```

## dts/bindings/pinctrl/renesas,rzt2m-pinctrl.yaml
```yaml
# Copyright (c) 2023 Antmicro <www.antmicro.com>
# SPDX-License-Identifier: Apache-2.0

description: |
    The Renesas RZ/T2M pin controller is a node responsible for controlling
    pin function selection and pin properties, such as routing the TX and RX of UART0
    to pin 5 and pin 6 of port 16.

    The node has the 'pinctrl' node label set in your SoC's devicetree,
    so you can modify it like this:

      &pinctrl {
              /* your modifications go here */
      };

    All device pin configurations should be placed in child nodes of the
    'pinctrl' node, as shown in this example:

      /* You can put this in places like a board-pinctrl.dtsi file in
       * your board directory, or a devicetree overlay in your application.
       */

      /* include pre-defined combinations for the SoC variant used by the board */
      #include <dt-bindings/pinctrl/renesas-rzt2m-pinctrl.h>

      &pinctrl {
        uart0_default: uart0_default {
          group1 {
            pinmux = <UART0TX_P16_5>;
          };
          group2 {
            pinmux = <UART0RX_P16_6>;
            input-enable;
          };
        };
      };

    The 'uart0_default' child node encodes the pin configurations for a
    particular state of a device; in this case, the default (that is, active)
    state.

    As shown, pin configurations are organized in groups within each child node.
    Each group can specify a list of pin function selections in the 'pinmux'
    property.

    A group can also specify shared pin properties common to all the specified
    pins, such as the 'input-enable' property in group 2.

compatible: "renesas,rzt2m-pinctrl"

include: base.yaml

child-binding:
  description: |
    Definitions for a pinctrl state.
  child-binding:

    include:
      - name: pincfg-node.yaml
        property-allowlist:
          - input-enable
          - bias-pull-up
          - bias-pull-down
          - bias-high-impedance
          - input-schmitt-enable

    properties:
      pinmux:
        required: true
        type: array
        description: |
          An array of pins sharing the same group properties. Each
          element of the array is an integer constructed from the
          pin number and the alternative function of the pin.
      drive-strength:
        type: string
        enum:
          - "low"
          - "middle"
          - "high"
          - "ultrahigh"
        default: "low"
        description: |
          The drive strength of a pin, relative to full-driver strength.
          The default value is "low", which is the reset value.
      slew-rate:
        type: string
        enum:
          - "slow"
          - "fast"
        default: "slow"
        description: |
          Select slew rate for a pin. The default is slow, which is the reset value.
```
