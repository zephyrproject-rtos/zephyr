## dts/bindings/pinctrl/renesas,ra-pincrl-pfs.yaml
```yaml
# Copyright (c) 2024 Renesas Electronics Corporation
# SPDX-License-Identifier: Apache-2.0

description: |
    The Renesas RA pin controller is a node responsible for controlling
    pin function selection and pin properties, such as routing a SCI0 RXD
    to P610.

    The node has the 'pinctrl' node label set in your SoC's devicetree,
    so you can modify it like this:

      &pinctrl {
              /* your modifications go here */
      };

    All device pin configurations should be placed in child nodes of the
    'pinctrl' node, as shown in this example:

      /* You can put this in places like a board-pinctrl.dtsi file in
       * your board directory, or a devicetree overlay in your application.
       */

      /* include pre-defined combinations for the SoC variant used by the board */
      #include <dt-bindings/pinctrl/renesas/pinctrl-ra.h>

      &pinctrl {
        /* configuration for the sci0 "default" state */
          sci0_default: sci0_default {
          group1 {
            /* tx */
            psels = <RA_PSEL(RA_PSEL_SCI_0, 6, 9)>;
            drive-strength = "medium";
          };
          group2 {
            /* rx */
            psels = <RA_PSEL(RA_PSEL_SCI_0, 6, 10)>;
          };
        };
      };

    The 'sci0_default' child node encodes the pin configurations for a
    particular state of a device; in this case, the default (that is, active)
    state.

    As shown, pin configurations are organized in groups within each child node.
    Each group can specify a list of pin function selections in the 'psels'
    property.

    A group can also specify shared pin properties common to all the specified
    pins, such as the 'input-enable' property in group 2. Here is a list of
    supported standard pin properties:

    - bias-disable: Disable pull-up/down (default, not required).
    - bias-pull-up: Enable pull-up resistor.
    - input-enable: Enable input from the pin.
    - drive-strength: Set the drive strength of the pin. Possible
      values are: low, medium, highspeed-high, high.

    To link pin configurations with a device, use a pinctrl-N property for some
    number N, like this example you could place in your board's DTS file:

       #include "board-pinctrl.dtsi"

       &sci0 {
             pinctrl-0 = <&uart0_default>;
             pinctrl-1 = <&uart0_sleep>;
             pinctrl-names = "default", "sleep";
       };

compatible: "renesas,ra-pinctrl-pfs"

include: base.yaml

child-binding:
  description: |
    Definitions for a pinctrl state.
  child-binding:

    include:
      - name: pincfg-node.yaml
        property-allowlist:
          - bias-disable
          - bias-pull-up
          - input-enable
          - drive-open-drain

    properties:
      psels:
        required: true
        type: array
        description: |
          An array of pins sharing the same group properties. Each
          element of the array is an integer constructed from the
          pin number and the alternative function of the pin.
      drive-strength:
        type: string
        enum:
          - "low"
          - "medium"
          - "highspeed-high"
          - "high"
        default: "low"
        description: |
          The drive strength of a pin. The default value is low, as this
          is the power on reset value.
      renesas,analog-enable:
        type: boolean
        description: enable analog input
```

## dts/bindings/pinctrl/renesas,ra-pinctrl.yaml
```yaml
# Copyright (c) 2023 TOKITA Hiroshi <tokita.hiroshi@fujitsu.com>
# SPDX-License-Identifier: Apache-2.0

description: |
  Renesas RA series pin controller

compatible: "renesas,ra-pinctrl"

include: base.yaml

child-binding:
  description: |
    Definitions for a pinctrl state.
  child-binding:

    properties:
      pinmux:
        required: true
        type: array
        description: |
          An array of pins sharing the same group properties. Each
          element of the array is an integer constructed from the
          pin number and the alternative function of the pin.
```

## dts/bindings/pinctrl/renesas,ra0-pinctrl-pfs.yaml
```yaml
# Copyright (c) 2026 Renesas Electronics Corporation
# SPDX-License-Identifier: Apache-2.0

title: Renesas RA0 Pin Controller

description: |
    Node responsible for controlling pin function selection and pin properties,
    such as routing a TXD0_A to P101.

    The node has the 'pinctrl' node label set in your SoC's devicetree,
    so you can modify it like this:

      &pinctrl {
              /* your modifications go here */
      };

    All device pin configurations should be placed in child nodes of the
    'pinctrl' node, as shown in this example:

      /* You can put this in places like a board-pinctrl.dtsi file in
       * your board directory, or a devicetree overlay in your application.
       */

      /* include pre-defined combinations for the SoC variant used by the board */
      #include <zephyr/dt-bindings/pinctrl/renesas/pinctrl-ra0.h>

      &pinctrl {
        /* configuration for the uart0 "default" state */
        uart0_default: uart0_default {
          group1 {
            psels = <RA_PSEL(RA_PSEL_P1nPFS_TXD0A, 1, 1)>;  /* tx */
            output-enable;
          };

          group2 {
            psels = <RA_PSEL(RA_PSEL_P1nPFS_RXD0A, 1, 0)>;  /* rx */
          };
        };
      };

    The 'uart0_default' child node encodes the pin configurations for a
    particular state of a device; in this case, the default (that is, active)
    state.

    As shown, pin configurations are organized in groups within each child node.
    Each group can specify a list of pin function selections in the 'psels'
    property.

    A group can also specify shared pin properties common to all the specified
    pins, such as the 'output-enable' property in group 1. Here is a list of
    supported standard pin properties:

    - bias-pull-up: Enable pull-up resistor.
    - input-enable: Enable input from the pin.
    - drive-open-drain: Drive with open drain
    - output-enable: Enable output on a pin without actively driving it
    - output-high: Set the pin to output mode with high level

    To link pin configurations with a device, use a pinctrl-N property for some
    number N, like this example you could place in your board's DTS file:

       #include "board-pinctrl.dtsi"

       &sci0 {
             pinctrl-0 = <&uart0_default>;
             pinctrl-1 = <&uart0_sleep>;
             pinctrl-names = "default", "sleep";
       };

compatible: "renesas,ra0-pinctrl-pfs"

include: base.yaml

child-binding:
  description: |
    Definitions for a pinctrl state.
  child-binding:

    include:
      - name: pincfg-node.yaml
        property-allowlist:
          - bias-pull-up
          - input-enable
          - drive-open-drain
          - output-enable
          - output-high

    properties:
      psels:
        required: true
        type: array
        description: |
          An array of pins sharing the same group properties. Each
          element of the array is an integer constructed from the
          pin number and the alternative function of the pin.

      analog-enable:
        type: boolean
        description: enable analog input

      ttl-input-buffer:
        type: boolean
        description:
          Use the TTL input buffer. The default is normal input
          buffer.
```

## dts/bindings/pinctrl/renesas,ra2-ioports.yaml
```yaml
# Copyright (c) 2023-2024 MUNIC SA
# SPDX-License-Identifier: Apache-2.0

description: |
  Renesas RA2 Ioports Controller node

compatible: renesas,ra2-ioports

include: base.yaml

properties:
  reg:
    required: true

  prwcntr:
    type: int
    enum:
    - 1
    - 2
    - 3
    default: 1
    description: |
      Number of Port Read Wait Cycles
```

## dts/bindings/pinctrl/renesas,ra2-pfs.yaml
```yaml
# Copyright (c) 2023-2024 MUNIC SA
# SPDX-License-Identifier: Apache-2.0

description: Renesas RA2 Pinmux (aka PFS) node

compatible: "renesas,ra2-pfs"

include: base.yaml

properties:
  reg:
    required: true

  ngpios:
    type: int
    default: 16
    description: |
        This property indicates the number of in-use slots of available slots
        for GPIOs. The typical example is something like this: the hardware
        register is 32 bits wide, but only 18 of the bits have a physical
        counterpart. The driver is generally written so that all 32 bits can
        be used, but the IP block is reused in a lot of designs, some using
        all 32 bits, some using 18 and some using 12. In this case, setting
        "ngpios = <18>;" informs the driver that only the first 18 GPIOs, at
        local offset 0 .. 17, are in use.  For cases in which there might be
        holes in the slot range, this value should be the max slot number-1.

  gpio-reserved-ranges:
    type: array
    description: |
        If not all the GPIOs at offsets 0...N-1 are usable for ngpios = <N>,
        then this property contains an additional set of tuples which specify
        which GPIOs are unusable. This property indicates the start and size of
        the GPIOs that can't be used.

        For example, setting "gpio-reserved-ranges = <3 2>, <10 1>;" means that
        GPIO offsets 3, 4, and 10 are not usable, even if ngpios = <18>.

  "#pinmux-cells":
    type: int
    required: true
    const: 2

pinmux-cells:
  - pin
  - fn
```

## dts/bindings/pinctrl/renesas,ra2-pinctrl.yaml
```yaml
# Copyright (c) 2023-2024 MUNIC SA
# SPDX-License-Identifier: Apache-2.0

description: |
  Renesas RA2 pinctrl node.

  This node will define pin configurations in pin groups,
  and has the 'pinctrl' node identifier in the SOC's devicetree. Each group
  within the pin configuration defines the pin configuration for a peripheral,
  and each subgroup in the pin group defines all the pins for that
  peripheral with the same configuration properties. The 'pinmux' property in
  a group selects the pins to be configured, and the remaining properties set

  configuration values for those pins, as in the i2c0 example shown at the end


  Here is a list of supported standard pin properties:

  - bias-disable: Disable pull-up/down.
  - bias-pull-up: Enable pull-up resistor.
  - drive-open-drain: Output driver is open-drain.
  - input-enable: enable input.
  - output-enable: enable output
  - output-low: set output low

  - output-high: set output high
  - analog-enable: use as an analog pin
  - irq-enable: enable interrupt attached to the pin

  The pinctrl I2C controller example:
     &i2c0 {
        pinctrl-0 = <&i2c0_default>;
        pinctrl-1 = <&i2c0_sleep>;
        pinctrl-names = "default", "sleep";
     }

     &pinctrl {
        i2c0_default: i2c0_default {
           i2c0_scl {
              pinmux = <&iport1 0 RA_PSEL_I2C>;
              bias-pull-up;
              drive-open-drain;
              input-enable;
           };
           i2c0_sda {
              pinmux = <&iport1 1 RA_PSEL_I2C>;
              bias-pull-up;
              drive-open-drain;
              input-enable;
           };
        };

        i2c0_sleep: i2c0_sleep {
           i2c0 {
              pinmux = <&iport1 0 RA_PSEL_IO>,
                       <&iport1 1 RA_PSEL_IO>;
              input-enable;
           };
        };
     };

compatible: renesas,ra2-pinctrl
include: base.yaml
child-binding:

  description: PFS pin group
  child-binding:
    description: |
      This binding gives a base representation of the Renesas RA family
      pins configuration.

    include:
    - name: pincfg-node.yaml
      property-allowlist:
      - bias-disable
      - bias-pull-up

      - drive-open-drain
      - input-enable
      - output-enable
      - output-low
      - output-high

    properties:
      pinmux:
        required: true
        type: phandle-array
        specifier-space: pinmux
        description: |
          Renesas RA pin's configuration (IO portmux, IO pin, IO function).

      analog-enable:
        type: boolean
        description: |
          Set the pin to analog mode. Only valid for analog type pins.

      irq-enable:
        type: boolean
        description: |
          Enable interrupt line attached to the pin.
```

## dts/bindings/pinctrl/renesas,ra6-pinctrl.yaml
```yaml
# Copyright (c) 2024 Renesas Electronics Corporation
# SPDX-License-Identifier: Apache-2.0

description: |
    The Renesas RA pin controller is a node responsible for controlling
    pin function selection and pin properties, such as routing a SCI0 Rx
    to P100 and enabling the pullup resistor on that pin.

    The node has the 'pinctrl' node label set in your SoC's devicetree,
    so you can modify it like this:

      &pinctrl {
              /* your modifications go here */
      };

    All device pin configurations should be placed in child nodes of the
    'pinctrl' node, as shown in this example:

      /* You can put this in places like a board-pinctrl.dtsi file in
       * your board directory, or a devicetree overlay in your application.
       */

      /* include pre-defined combinations for the SoC variant used by the board */
      #include <dt-bindings/pinctrl/ra-pinctrl.h>

      &pinctrl {
        /* configuration for the usart0 "default" state */
        sci0_default: sci0_default {
          /* group 1 */
          group1 {
            /* configure P101 as SCI0 TX */
            psels = <UART0_TX_P101>;
          };
          /* group 2 */
          group2 {
            /* configure P100 as SCI0 RX */
            psels = <UART0_RX_P100>;
            /* enable input on pin 100 */
            input-enable;
          };
        };
      };

    The 'sci0_default' child node encodes the pin configurations for a
    particular state of a device; in this case, the default (that is, active)
    state.

    As shown, pin configurations are organized in groups within each child node.
    Each group can specify a list of pin function selections in the 'psels'
    property.

    A group can also specify shared pin properties common to all the specified
    pins, such as the 'input-enable' property in group 2. Here is a list of
    supported standard pin properties:

    - bias-disable: Disable pull-up/down (default, not required).
    - bias-pull-up: Enable pull-up resistor.
    - input-enable: Enable input from the pin.
    - drive-strength: Set the drive strength of the pin. Possible
      values are: low, median, highspeed-high, high.

    To link pin configurations with a device, use a pinctrl-N property for some
    number N, like this example you could place in your board's DTS file:

       #include "board-pinctrl.dtsi"

       &uart0 {
             pinctrl-0 = <&uart0_default>;
             pinctrl-1 = <&uart0_sleep>;
             pinctrl-names = "default", "sleep";
       };

compatible: "renesas,ra6-pinctrl"

include: base.yaml

child-binding:
  description: |
    Definitions for a pinctrl state.
  child-binding:

    include:
      - name: pincfg-node.yaml
        property-allowlist:
          - bias-disable
          - bias-pull-up
          - input-enable
          - drive-open-drain

    properties:
      psels:
        required: true
        type: array
        description: |
          An array of pins sharing the same group properties. Each
          element of the array is an integer constructed from the
          pin number and the alternative function of the pin.
      drive-strength:
        type: string
        enum:
          - "low"
          - "medium"
          - "highspeed-high"
          - "high"
        default: "low"
        description: |
          The drive strength of a pin. The default value is low, as this
          is the power on reset value.
```
