## dts/bindings/pinctrl/raspberrypi,rp1-pinctrl.yaml
```yaml
# Copyright (c) 2025 TOKITA Hiroshi
# SPDX-License-Identifier: Apache-2.0

title: Raspberry Pi RP1 Pin Controller

description: |
  RP1 I/O controller pinmux and pad configuration. The RP1 is the
  peripheral controller used on the Raspberry Pi 5. Each controller bank
  manages a group of GPIO pins and exposes the function selection and pad
  control registers for those pins.

compatible: "raspberrypi,rp1-pinctrl"

include: base.yaml

properties:
  reg:
    required: true

child-binding:
  description: |
    Pin controller state node.
  child-binding:

    include:
      - name: pincfg-node.yaml
        property-allowlist:
          - bias-disable
          - bias-pull-down
          - bias-pull-up
          - input-enable
          - input-schmitt-enable
          - output-disable
          - drive-strength
          - slew-rate

    properties:
      pinmux:
        required: true
        type: array
        description: |
          Pin mux selections, encoded using RP1_PINMUX() or the helper
          RP1_BANKn_PIN() macros defined in
          :zephyr_file:`include/zephyr/dt-bindings/pinctrl/rp1-pinctrl.h`.
      drive-strength:
        enum:
          - 2
          - 4
          - 8
          - 12
        default: 4
        description: |
          Drive strength in mA. The value is encoded as an index in the
          driver.
      slew-rate:
        enum:
          - 0
          - 1
        default: 0
        description: |
          Slew rate of a pin. 0 selects slow, 1 selects fast.

      raspberrypi,f-m:
        type: int
        enum:
          - 0
          - 1
          - 2
          - 3
          - 4
          - 5
          - 6
          - 7
        default: 4

      raspberrypi,oe-override:
        type: int
        enum:
          - 0
          - 1
          - 2
          - 3
        default: 0
        description: |
          Override output-enable for a pin.

          - 0 - drive output enable from selected peripheral signal.
          - 1 - drive output enable from inverse of selected peripheral
            signal.
          - 2 - disable output.
          - 3 - enable output.

          The default value is 0, as this is the power on reset value.
      raspberrypi,out-override:
        type: int
        enum:
          - 0
          - 1
          - 2
          - 3
        default: 0
        description: |
          Override output for a pin.

          - 0 - drive output from selected peripheral signal.
          - 1 - drive output from inverse of selected peripheral signal.
          - 2 - drive output low.
          - 3 - drive output high.

          The default value is 0, as this is the power on reset value.
      raspberrypi,in-override:
        type: int
        enum:
          - 0
          - 1
          - 2
          - 3
        default: 0
        description: |
          Override input for a pin.

          - 0 - input comes from the selected pin.
          - 1 - input comes from the inverse of the selected pin.
          - 2 - force input low.
          - 3 - force input high.

          The default value is 0, as this is the power on reset value.
      raspberrypi,irq-override:
        type: int
        enum:
          - 0
          - 1
          - 2
          - 3
        default: 0
        description: |
          Override interrupt signal for a pin.

          - 0 - interrupt signal from the selected pin.
          - 1 - interrupt signal from the inverse of the selected pin.
          - 2 - force interrupt low.
          - 3 - force interrupt high.

          The default value is 0, as this is the power on reset value.

      raspberrypi,irqmask-edge-low:
        type: boolean
        description: |
          Override interrupt signal for a pin.

      raspberrypi,irqmask-edge-high:
        type: boolean
        description: |
          Override interrupt signal for a pin.

      raspberrypi,irqmask-level-low:
        type: boolean
        description: |
          Override interrupt signal for a pin.

      raspberrypi,irqmask-level-high:
        type: boolean
        description: |
          Override interrupt signal for a pin.

      raspberrypi,irqmask-f-edge-low:
        type: boolean
        description: |
          Override interrupt signal for a pin.

      raspberrypi,irqmask-f-edge-high:
        type: boolean
        description: |
          Override interrupt signal for a pin.

      raspberrypi,irqmask-db-level-low:
        type: boolean
        description: |
          Override interrupt signal for a pin.

      raspberrypi,irqmask-db-level-high:
        type: boolean
        description: |
          Override interrupt signal for a pin.
```

## dts/bindings/pinctrl/realtek,ameba-pinctrl.yaml
```yaml
# Copyright (c) 2024 Realtek Semiconductor Corp.
# SPDX-License-Identifier: Apache-2.0

description: |
  Realtek Ameba pinctrl is a singleton node responsible for controlling pin function selection
  and pin properties. For example, you can use this node to route UART0 TX to pin PB_17
  and enable the pull-up resistor on the pin.

  All device pin configurations should be placed in child nodes of the 'pinctrl' node,
  as shown in this example:
    /* put this example in places like a board-pinctrl.dtsi file in your board directory,
     * or a devicetree overlay in your application.
     */
    &pinctrl {
      /* configuration for uart0 device, default state */
      uart0_default: uart0_default {
        /* 'group1' name is arbitrary, if pin's settings are not same,
         * add other group like group2 {}
         */
        group1 {
          pinmux = <AMEBA_PINMUX('B', 17, AMEBA_UART2_TXD)>,
                   <AMEBA_PINMUX('B', 18, AMEBA_UART2_RXD)>;
          bias-pull-up;
        };
      };
    };

  The 'uart0_default' child node encodes the pin configurations for a particular state of a device;
  in this case, the default (that is, active) state. You would specify the low-power configuration
  for the same device in a separate child node.

  As shown, pin configurations are organized in groups within each child node. Each group can
  specify a list of pin function selections in the 'pinmux' property. The AMEBA_PINMUX macro is
  used to specify a pin function selection and pin configuration. You could choose pinmux specified
  function to specified pin. And you could configure driver direction, driver state and pull state
  for the specified pad.

  To link this pin configuration with a device, use a pinctrl-N property for some number N,
  like this example you could place in your board's DTS file:
    &uart0 {
      pinctrl-0 = <&uart0_default>;
      pinctrl-names = "default";
    };

compatible: "realtek,ameba-pinctrl"

include: base.yaml

properties:
  reg:
    required: true
child-binding:
  description: |
    Realtek Ameba pin controller pin group for a pinctrl state.
  child-binding:
    description: |
      Realtek Ameba pin controller pin configuration node.
    include:
      - name: pincfg-node.yaml
        property-allowlist:
          - bias-disable
          - bias-pull-down
          - bias-pull-up
          - input-schmitt-disable
    properties:
      pinmux:
        required: true
        type: array
        description: |
          Pin mux selections for this group. An array of pins sharing the same group properties.
          Each element of the array is an integer constructed from the pin number and
          the alternative function of the pin.
      slew-rate-slow:
        type: boolean
        description: |
          Pin output slew rate.If not set, default value is fast.
      drive-strength-low:
        type: boolean
        description: |
          Drive strength of the output pin.If not set, default ability is high.
      digital-input-disable:
        type: boolean
        description: |
          Disable the digital input function.
      swd-off:
        type: boolean
        description: |
          Disable the SWD function.
```

## dts/bindings/pinctrl/realtek,bee-pinctrl.yaml
```yaml
# Copyright (c) 2026, Realtek Semiconductor Corporation
# SPDX-License-Identifier: Apache-2.0

description: |
  Bee pin controller.
  The bee pin controller is a singleton node responsible for controlling
  pin function selection and pin properties. For example, you can use this
  node to route UART2 TX to pin P3_2 and enable the pull-up resistor on the
  pin.

  The node has the 'pinctrl' node label set in your SoC's devicetree,
  so you can modify it like this:

    &pinctrl {
            /* your modifications go here */
    };

  All device pin configurations should be placed in child nodes of the
  'pinctrl' node, as shown in this example:

    /* You can put this in places like a board-pinctrl.dtsi file in
     * your board directory, or a devicetree overlay in your application.
     */
    &pinctrl {
      /* configuration for uart2 device, default state */
      uart2_default: uart2_default {
        /* group 1 ('group1' name is arbitrary) */
        group1 {
          psels = <BEE_PSEL(UART2_TX, P3_2)>;
          output-enable;
          output-high;
          bias-pull-up;
        };

        group2 {
          psels = <BEE_PSEL(UART2_RX, P3_3)>;
          output-disable;
          bias-pull-up;
        };
      };
    };

  The 'uart2_default' child node encodes the pin configurations for a
  particular state of a device; in this case, the default (that is, active)
  state. You would specify the low-power configuration for the same device
  in a separate child node.

  As shown, pin configurations are organized into groups within each child node.
  Each group can specify a list of pin function selections in the psels property.
  The BEE_PSEL macro is used to specify pin function selection and pin properties,
  allowing you to map a specific function to a specific pin. Additionally, within
  a group, you can configure shared pin states for that group, such as
  the direction, drive strength, and pull state of the corresponding pads.
  Available pin functions can be found in the
  zephyr\include\zephyr\dt-bindings\pinctrl\rtl87xxx-pinctrl.h header file.

  To link this pin configuration with a device, use a pinctrl-N property
  for some number N, like this example you could place in your board's DTS
  file:

     #include "rtlxxxx_evb-pinctrl.dtsi"

     &uart2 {
           pinctrl-0 = <&uart2_default>;
           pinctrl-names = "default";
     };

compatible: "realtek,bee-pinctrl"

include: base.yaml

child-binding:
  description: |
    Bee pin controller pin configuration state nodes.
  child-binding:
    include:
      - name: pincfg-node.yaml
        property-allowlist:
          - bias-disable
          - bias-pull-up
          - bias-pull-down
          - output-disable
          - output-enable
          - output-low
          - output-high

    description: |
      Realtek Bee pin controller pin configuration group.

    properties:
      psels:
        required: true
        type: array
        description: |
          Pinmux function number and pad configurations.

      bias-pull-strong:
        type: boolean
        description: enable pull-strong resistor

      current-level:
        type: int
        description: |
          current level of pin
          when VDDIO is set to 1.8V, the pad driving current is as followed:
              level0: 1.25 mA
              level1: 2.50 mA
              level2: 3.75 mA
              level3: 5.00 mA
          When VDDIO is set to 3.3V, the pad driving current is as followed:
              level0: 4 mA
              level1: 8 mA
              level2: 12 mA
              level3: 16 mA
        enum:
          - 0
          - 1
          - 2
          - 3
```

## dts/bindings/pinctrl/realtek,rts5817-pinctrl.yaml
```yaml
# Copyright (c) 2024 Realtek Semiconductor, Inc.
# SPDX-License-Identifier: Apache-2.0

description: |
  Realtek RTS5817 series pin controller

compatible: "realtek,rts5817-pinctrl"

include: base.yaml

child-binding:
  description: RTS5817 pin controller pin group.
  child-binding:
    description: RTS5817 pin controller pin mux and configuration.

    include:
      - name: pincfg-node.yaml
        property-allowlist:
          - bias-disable
          - bias-pull-down
          - bias-pull-up
          - input-enable
          - output-enable
          - drive-strength
          - power-source

    properties:
      pinmux:
        required: true
        type: array
        description: |
          An array of pins sharing the same group properties. Must
          encode all the pin muxing information in a 32-bit value.
```

## dts/bindings/pinctrl/realtek,rts5912-pinctrl.yaml
```yaml
# SPDX-License-Identifier: Apache-2.0
#
# Copyright (c) 2024 Realtek Semiconductor Corporation, SIBG-SD7
#

description: Realtek RTS5912 Pin Controller

compatible: "realtek,rts5912-pinctrl"

include: [base.yaml, pinctrl-device.yaml, pincfg-node.yaml]

properties:
  reg:
    required: true

child-binding:
  description: |
    This binding gives a base representation of the pins configuration

  include:
    - name: pincfg-node.yaml
      property-allowlist:
        - bias-pull-down
        - bias-pull-up
        - drive-push-pull
        - drive-open-drain
        - input-enable
        - output-enable
        - output-high
        - output-low
        - input-schmitt-enable

  properties:
    pinmux:
      type: int
      required: true
      description: Pinmux selection
    drive-strength:
      type: string
      enum:
        - "low"
        - "high"
      description: |
        "low" — 4mA/8mA drive strength
        "high" — 8mA/12mA drive strength
    slew-rate:
      type: string
      enum:
        - "fast"
        - "low"
      description: |
        "fast" — Fast Frequency Slew Rate
        "slow" — Slow Frequency Slew Rate
```
