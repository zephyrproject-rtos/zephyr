## dts/bindings/pinctrl/silabs,gecko-pinctrl.yaml
```yaml
# Copyright (c) 2022 Silicon Labs
# SPDX-License-Identifier: Apache-2.0

description: |
    The Silabs pin controller is a singleton node responsible for controlling
    pin function selection and pin properties. For example, you can use this
    node to route UART0 RX to pin P0.1 and enable the pull-up resistor on the
    pin.

    The node has the 'pinctrl' node label set in your SoC's devicetree,
    so you can modify it like this:

      &pinctrl {
              /* your modifications go here */
      };

    All device pin configurations should be placed in child nodes of the
    'pinctrl' node, as shown in this example:

      /* You can put this in places like a board-pinctrl.dtsi file in
       * your board directory, or a devicetree overlay in your application.
       */
      &pinctrl {
        /* configuration for usart0 device, default state */
        usart0_default: usart0_default {
          /* group 1 ('group1' name is arbitrary) */
          group1 {
            /* configure P0.1 as UART_TX and P0.2 as UART_RTS */
            psels = <GECKO_PSEL(UART_TX, A, 1)>, <GECKO_PSEL(UART_RTS, A, 2)>;
          };
          /* group 2 */
          group2 {
            /* configure P0.3 as UART_RX and P0.4 as UART_CTS */
            psels = <GECKO_PSEL(UART_RX, A, 3)>, <GECKO_PSEL(UART_CTS, A, 4)>;
          };
        };
      };

    The 'usart0_default' child node encodes the pin configurations for a
    particular state of a device; in this case, the default (that is, active)
    state. You would specify the low-power configuration for the same device
    in a separate child node.

    As shown, pin configurations are organized in groups within each child node.
    Each group can specify a list of pin function selections in the 'psels'
    property. The GECKO_PSEL macro is used to specify a pin function selection.
    Available pin functions can be found in the
    include/dt-bindings/pinctrl/gecko-pinctrl.h header file.

    To link this pin configuration with a device, use a pinctrl-N property
    for some number N, like this example you could place in your board's DTS
    file:

       #include "board-pinctrl.dtsi"

       &usart0 {
             pinctrl-0 = <&usart0_default>;
             pinctrl-names = "default";
       };

compatible: "silabs,gecko-pinctrl"

include: base.yaml

child-binding:
  description: |
    Silabs pin controller pin configuration state nodes.
  include: pincfg-node.yaml
  child-binding:
    description: |
      Silabs pin controller pin configuration group.
    properties:
      psels:
        required: true
        type: array
        description: |
          An array of pins sharing the same group properties. The pins should
          be defined using the GECKO_PSEL utility macro that encodes the port,
          pin and function.
```

## dts/bindings/pinctrl/silabs,si32-pinctrl.yaml
```yaml
# Copyright (c) 2024 GARDENA GmbH
#
# SPDX-License-Identifier: Apache-2.0

description: Silabs Si32 Pin Controller

compatible: "silabs,si32-pinctrl"

include:
  - name: base.yaml

child-binding:
  description: Si32 pin controller pin group
  child-binding:
    description: |
      Si32 pin controller pin configuration node

    include:
      - name: pincfg-node.yaml
        property-allowlist:
          - input-enable
          - output-enable
          - output-low
          - output-high

    properties:
      pinmux:
        required: true
        type: array
        description: |
          Pin mux selections for this group.
```

## dts/bindings/pinctrl/silabs,siwx91x-pinctrl.yaml
```yaml
# Copyright (c) 2023 Antmicro
# Copyright (c) 2024 Silicon Laboratories Inc.
# SPDX-License-Identifier: Apache-2.0

description: |
  The Silabs SiWx91x pin controller is a devicetree node tasked with selecting
  the proper IO function for a given pin.

  The pinctrl settings are referenced in a device tree peripheral node. For
  example when configuring a UART:

    &ulpuart {
      pinctrl-0 = <&ulpuart_default>;
      pinctrl-names = "default";
    }

  pinctrl-0 is a phandle that stores the pin settings for the peripheral, in
  this example &ulpuart_default. This phandle is defined as a child node of the
  'pinctrl' node, typically in a board-pinctrl.dtsi file in the board directory
  or a device tree overlay in the application:

    &pinctrl {
      ulpuart_default: ulpuart_default {
        out {
          pinmux = <ULPUART_TX_ULP11>; /* Configure ULP pin 11 as ULPUART TX */
        };
        in {
          pinmux = <ULPUART_RX_ULP9>; /* Configure ULP pin 9 as ULPUART RX */
        };
      };
    };

  The 'ulpuart_default' child node encodes the pin configurations for a
  particular state of the device, the default (active) state.

  Pin configurations are organized in groups within each child node. The name
  given to groups is arbitrary. Each group can specify a list of pin function
  selections in the `pinmux` property, as well as a selection of pin properties
  as given by the rest of the properties on the group.

compatible: "silabs,siwx91x-pinctrl"

include: base.yaml

child-binding:
  description: |
    Silabs SiWx91x pin configuration. Each child node defines
    the configuration for a particular group of pins.
  child-binding:
    description: |
      Silabs SiWx91x pin configuration group.
    include:
      - name: pincfg-node.yaml
        property-allowlist: []

    properties:
      pinmux:
        required: true
        type: array
        description: |
          An array of pins sharing the same group properties. The pins should be
          defined using the <peripheral>_<signal>_<pin> macros available from
          the SoC DeviceTree files.
```

## dts/bindings/pinctrl/snps,creg-gpio-mux-hsdk.yaml
```yaml
# Copyright (c) 2021, Linaro Limited
# SPDX-License-Identifier: Apache-2.0

description: |
  Synopsys CREG HSDK GPIO pin mux

compatible: "snps,creg-gpio-mux-hsdk"

include: base.yaml

properties:
    reg:
      required: true

pinmux-cells:
  - pin
  - function
```

## dts/bindings/pinctrl/snps,emsdp-pinctrl.yaml
```yaml
# Copyright (c) 2023 Synopsys, Inc. All rights reserved.
# SPDX-License-Identifier: Apache-2.0

description: |
  Synopsys ARC EMSDP board Pin controller for Pmod and Arduino shield interface.

  Device pin configuration should be placed in the child nodes of this node.
  Populate the 'pinmux' field with a pair consisting of a pin number and its IO
  function.

  For example, setting PmodA to SPI would look like this:

    #include <zephyr/dt-bindings/pinctrl/emsdp-pinctrl.h>

    &pinctrl {
      pmodA_spi1_cs0: pmodA_spi1_cs0 {
        pinmux = <PMOD_A PMOD_SPI>;
      };
    };

compatible: "snps,emsdp-pinctrl"

include: base.yaml

properties:
  reg:
    required: true

child-binding:
  description: |
    This binding gives a base representation of the EMSDP pins
    configuration.

  properties:
    pinmux:
      required: true
      type: array
      description: |
        EMSDP pin's configuration (pin, IO function).
```

## dts/bindings/pinctrl/sophgo,cvi-pinctrl.yaml
```yaml
# Copyright (c) 2023-2024 Chen Xingyu <hi@xingrz.me>
# SPDX-License-Identifier: Apache-2.0

description: SOPHGO CVI series pin controller driver

compatible: "sophgo,cvi-pinctrl"

include: base.yaml

child-binding:
  description: CVI pinmux group

  child-binding:
    properties:
      pinmux:
        required: true
        type: array
```

## dts/bindings/pinctrl/st,stm32-pinctrl.yaml
```yaml
# Copyright (c) 2020 Linaro Limited
# SPDX-License-Identifier: Apache-2.0

description: |
    STM32 Pin controller Node
    Based on pincfg-node.yaml binding.

    Note: `bias-disable` and `drive-push-pull` are default pin configurations.
           They will be applied in case no `bias-foo` or `driver-bar` properties
           are set.

compatible: "st,stm32-pinctrl"

include: base.yaml

properties:
  reg:
    required: true

  remap-pa11:
    type: boolean
    description: Remaps the PA11 pin to operate as PA9 pin.
      Use of this property is restricted to STM32G0 and STM32C0 SoCs.

  remap-pa12:
    type: boolean
    description: Remaps the PA12 pin to operate as PA10 pin.
      Use of this property is restricted to STM32G0 and STM32C0 SoCs.

  remap-pa11-pa12:
    type: boolean
    description: Remaps the PA11/PA12 pin to operate as PA9/PA10 pin.
      Use of this property is restricted to STM32F070x SoCs.

child-binding:
  description: |
      This binding gives a base representation of the STM32 pins configuration

  include:
    - name: pincfg-node.yaml
      property-allowlist:
        - bias-disable
        - bias-pull-down
        - bias-pull-up
        - drive-push-pull
        - drive-open-drain
        - output-low
        - output-high

  properties:
    pinmux:
      required: true
      type: int
      description: |
        Reused from
        https://github.com/torvalds/linux/blob/master/Documentation/devicetree/bindings/pinctrl/st,stm32-pinctrl.yaml
        Integer represents gpio pin number and mux setting.
        Each integer encodes a port, line and alternate function.
        Refer to STM32_PINMUX() for details about encoding in
        include/zephyr/dt-bindings/pinctrl/stm32-pinctrl.h

    slew-rate:
      type: string
      default: "low-speed"
      enum:
        - "low-speed"           # Default value.
        - "medium-speed"
        - "high-speed"
        - "very-high-speed"
      description: |
        Pin speed. Default to low-speed. For few pins (PA11 and
        PB3 depending on SoCs)hardware reset value could differ
        (very-high-speed). Carefully check reference manual for these pins.
```

## dts/bindings/pinctrl/st,stm32-pinmux.yaml
```yaml
description: STM32 PINMUX

compatible: "st,stm32-pinmux"

include: base.yaml

properties:
    reg:
      required: true

pinmux-cells:
  - pin
  - function
```

## dts/bindings/pinctrl/st,stm32f1-pinctrl.yaml
```yaml
# Copyright (c) 2020 Linaro Limited
# SPDX-License-Identifier: Apache-2.0

description: |
    STM32F1 Pin controller Node
    Based on pincfg-node.yaml binding.

    Note: `bias-disable` and `drive-push-pull` are default pin configurations.
           They will be applied in case no `bias-foo` or `driver-bar` properties
           are set.

compatible: "st,stm32f1-pinctrl"

include: base.yaml

properties:
  reg:
    required: true

  swj-cfg:
    type: string
    default: "full" # reset state
    enum:
      - "full"
      - "no-njtrst"
      - "jtag-disable"
      - "disable"
    description: |
      Configures number of pins assigned to the SWJ debug port.

      * full         - Full SWJ (JTAG-DP + SW-DP).
      * no-njtrst    - Full SWJ (JTAG-DP + SW-DP) but without NJTRST.
                       Releases: PB4.
      * jtag-disable - JTAG-DP Disabled and SW-DP Enabled.
                       Releases: PA15 PB3 PB4.
      * disable      - JTAG-DP Disabled and SW-DP Disabled.
                       Releases: PA13 PA14 PA15 PB3 PB4.

      If absent, then Full SWJ (JTAG-DP + SW-DP) is used (reset state).

child-binding:
  description: |
      This binding gives a base representation of the STM32F1 pins
      configuration

  include:
    - name: pincfg-node.yaml
      property-allowlist:
        - bias-disable
        - bias-pull-down
        - bias-pull-up
        - drive-push-pull
        - drive-open-drain
        - output-low
        - output-high

  properties:
    pinmux:
      required: true
      type: int
      description: |
        Adapted from
        https://github.com/torvalds/linux/blob/master/Documentation/devicetree/bindings/pinctrl/st,stm32-pinctrl.yaml
        Integer represents gpio pin number and mux setting.
        Each integer encodes a port, line, alternate function and remap.
        Refer to STM32F1_PINMUX() for details about encoding in
        include/zephyr/dt-bindings/pinctrl/stm32f1-pinctrl.h

    slew-rate:
      type: string
      default: "max-speed-10mhz"
      enum:
        - "max-speed-10mhz"       # Default
        - "max-speed-2mhz"
        - "max-speed-50mhz"
      description: |
        Pin output mode, maximum achievable speed. Only applies to
        output mode (alternate).
```

## dts/bindings/pinctrl/st,stm32h5-pinctrl.yaml
```yaml
# Copyright (c) 2026 CodeWrights GmbH
# SPDX-License-Identifier: Apache-2.0

description: |
  STM32 pin controller with High-Speed Low-Voltage (HSLV) support

  Identical to the "regular" pin controller with "st,stm32-pinctrl" compatible,
  with an additional "High-Speed Low-Voltage" feature. This feature allows to
  increase their maximum speed at low voltage.

  This pin controller can be found on STM32H5 series.

compatible: "st,stm32h5-pinctrl"

include: "st,stm32-pinctrl.yaml"

child-binding:
  properties:
    st,hslv-enable:
      type: boolean
      description: |
        Enable High-Speed Low-Voltage (HSLV) mode for pin.

        HSLV mode is available only on specific I/O pins and can
        only be used if the corresponding bit in option bytes is
        enabled. Refer to your device's Datasheet and Reference
        Manual for more details.

        WARNING: Enabling HSLV mode when I/O supply voltage for
        a given I/O pin is above 2.7V can damage the device.
```

## dts/bindings/pinctrl/st,stm32n6-pinctrl.yaml
```yaml
# Copyright (c) 2025 STMicroelectronics
# SPDX-License-Identifier: Apache-2.0

description: |
  STM32 pin controller with "I/O synchronization"

  Identical to the "regular" pin controller with "st,stm32-pinctrl" compatible,
  with an additional "I/O synchronization" feature. This feature allows addition
  of a programmable delay to the signal input or output path ("I/O delay"), and
  synchronization of GPIO data with configuration clock edge(s) ("I/O retime").

  This pin controller can be found on STM32N6 series.

compatible: "st,stm32n6-pinctrl"

include: "st,stm32-pinctrl.yaml"

child-binding:
  properties:
    st,io-retime-edge:
      type: string
      description: |
        Clock edges on which input/output should be retimed

        If this property is present, I/O retiming is enabled,
        and this property selects whether the input/output data
        is retimed on rising, falling or both edges of clock.

        If this property is not present, I/O retiming is disabled.
      enum:
        - "rising"
        - "falling"
        - "both"

    st,io-delay-ps:
      type: int
      default: 0
      description: |
        Delay applied to input or output path (in picoseconds)

        The default value matches hardware default, and allows to keep
        the property unspecified on most pinctrl nodes which do not use
        the I/O delay feature.
      enum:
        - 0
        - 300
        - 500
        - 750
        - 1000
        - 1250
        - 1500
        - 1750
        - 2000
        - 2250
        - 2500
        - 2750
        - 3000
        - 3250

    st,io-delay-path:
      type: string
      default: "output"
      description: |
        Direction in which the I/O delay should be applied

        The default value corresponds to hardware default.
      enum:
        - "output"
        - "input"
```
