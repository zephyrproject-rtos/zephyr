## dts/bindings/pinctrl/syna,pinctrl.yaml
```yaml
# Copyright (c) 2025 Synaptics, Inc.
# SPDX-License-Identifier: Apache-2.0

description: |
    Synaptics Pin controller Node
    Based on pincfg-node.yaml binding.

    Note: `bias-disable` and `drive-push-pull` are default pin configurations.
           They will be applied in case no `bias-foo` or `driver-bar` properties
           are set.

compatible: "syna,pinctrl"

include: base.yaml

properties:
  reg:
    required: true

child-binding:
  description: |
      This binding gives a base representation of the Synaptics pins configuration

  include:
    - name: pincfg-node.yaml
      property-allowlist:
        - bias-disable
        - bias-pull-down
        - bias-pull-up
        - slew-rate
        - drive-strength

  properties:
    pincfg:
      type: int
      description: |
        Register offset of pin configuration (drive strength, slew-rate etc.).
    port:
      type: int
      description: |
        Port control configuration (input pin routing). The following macro is
        available to define this part of the configuration:
        - SRXXX_PORT_PINMUX(reg, bit, mode, mask)
    pinmux:
      required: true
      type: int
      description: |
        Pin muxing configuration. The bitfield contains the following fields:
        - ctrl [ 0.. 7]: Pinmux controller (0..4): in Global, AON, LPS, SWIRE, I2C1
        - reg  [ 8..15]: Register offset for pinmux configuration
        - bit  [16..23]: Bit offset in register for pinmux configuration
        - mode [24..31]: Alternate function

        To simplify the usage, macros are available to generate the "pinmux"
        field:
        - SRXXX_GLOBAL_PINMUX(reg, bit, mode)
        - SRXXX_AON_PINMUX(reg, bit, mode)
        - SRXXX_LPS_PINMUX(reg, bit, mode)
        - SRXXX_SWIRE_PINMUX(reg, bit, mode)
```

## dts/bindings/pinctrl/syna,sr100-pinctrl.yaml
```yaml
# Copyright (c) 2025 Synaptics, Inc.
# SPDX-License-Identifier: Apache-2.0

description: |
    Synaptics SR100 Pin controller Node
    Based on pincfg-node.yaml binding.

    Note: `bias-disable` and `input-enable` are default pin configurations.
           They will be applied in case no `bias-foo` or `input-bar` properties
           are set.

compatible: "syna,sr100-pinctrl"

include: base.yaml

properties:
  reg:
    required: true

child-binding:
  description: |
      This binding gives a base representation of the Synaptics pins configuration

  include:
    - name: pincfg-node.yaml
      property-allowlist:
        - bias-disable
        - bias-bus-hold
        - bias-pull-up
        - bias-pull-down
        - drive-strength
        - input-enable
        - input-disable
        - input-schmitt-enable
        - input-schmitt-disable
        - slew-rate

  properties:
    pincfg:
      type: int
      description: |
        Register offset of pin configuration (drive strength, slew-rate etc.).
    port:
      type: int
      description: |
        Port control configuration (input pin routing). The following macro is
        available to define this part of the configuration:
        - SRXXX_PORT_PINMUX(reg, bit, mode, mask)
    pinmux:
      required: true
      type: int
      description: |
        Pin muxing configuration. The bitfield contains the following fields:
        - ctrl [ 0.. 2]: Pinmux controller (0..3): in Global, AON, LPS, SWIRE
        - bit  [ 3.. 7]: Bit offset in register for pinmux configuration
        - mode [ 8..10]: Alternate function
        - mask [11..14]: Mask for mode/alternate function setting
        - reg  [16..23]: Register offset for pinmux configuration
        - cfg  [24..31]: Register offset for pin configuration

        To simplify the usage, macros are available to generate the "pinmux"
        field:
        - SRXXX_GLOBAL_PINMUX(reg, bit, mode, cfg)
        - SRXXX_AON_PINMUX(reg, bit, mode, cfg)
        - SRXXX_LPS_PINMUX(reg, bit, mode, cfg)
        - SRXXX_SWIRE_PINMUX(bit, mode)
        - SRXXX_FIXED_PINMUX(cfg) (for pins with fixed mode/function)
```

## dts/bindings/pinctrl/telink,b91-pinctrl.yaml
```yaml
# Copyright (c) 2022, Telink Semiconductor
# SPDX-License-Identifier: Apache-2.0

description: |
    The Telink B91 pin controller is a singleton node responsible for
    controlling pin function selection and pin properties. For example, you can
    use this node to route UART0 TX to pin PB2 and enable the pull-up resistor
    on the pin.

    The node has the 'pinctrl' node label set in your SoC's devicetree,
    so you can modify it like this:

      &pinctrl {
              /* your modifications go here */
      };

    All device pin configurations should be placed in child nodes of the
    'pinctrl' node, as shown in this example:

      /* You can put this in places like a board-pinctrl.dtsi file in
       * your board directory, or a devicetree overlay in your application.
       */

      /* include pre-defined pins and functions for the SoC used by the board */
      #include <dt-bindings/pinctrl/b91-pinctrl.h>

      &pinctrl {
        /* configuration for UART0 TX default state */
        uart0_tx_pb2_default: uart0_tx_pb2_default {
          /* configure PB2 as B91_FUNC_C */
          pinmux = <B91_PINMUX_SET(B91_PORT_B, B91_PIN_2, B91_FUNC_C)>;
        };
        /* configuration for UART0 RX default state */
        uart0_rx_pb3_default: uart0_rx_pb3_default {
          /* configure PB2 as B91_FUNC_C */
          pinmux = <B91_PINMUX_SET(B91_PORT_B, B91_PIN_3, B91_FUNC_C)>;
        };
      };

    The 'uart0_tx_pb2_default' child node encodes the pin configurations
    for a particular state of a device; in this case, the default
    (that is, active) sate. You would specify the low-power configuration for
    the same device in a separate child node.

    A pin configuration can also specify pin properties such as the
    'bias-pull-up' property. Here is a list of supported standard pin
    properties:

    - bias-disable
    - bias-pull-down
    - bias-pull-up

    To link pin configurations with a device, use a pinctrl-N property for some
    number N, like this example you could place in your board's DTS file:

      #include "board-pinctrl.dtsi"

      &uart0 {
        pinctrl-0 = <&uart0_tx_pb2_default &uart0_rx_pb3_default>;
        pinctrl-1 = <&uart0_tx_pb2_sleep &uart0_rx_pb3_sleep>;
        pinctrl-names = "default", "sleep";
      };

compatible: "telink,b91-pinctrl"

include:
    - name: base.yaml
    - name: pincfg-node.yaml
      child-binding:
        property-allowlist:
          - bias-disable
          - bias-pull-down
          - bias-pull-up

properties:
    reg:
      required: true

    label:
      required: true

    pad-mul-sel:
      type: int
      required: true
      description: |
          PinMux pad_mul_sel register value. Pin functions depend on it.

          For instance:
          Function C of PB2 configs the pin to UART0_TX if pad_mul_sel is set to <1>.
          But, the same function configs the same pin to DAC_I_DAT2_I if pad_mul_sel is set to <0>.

          Refer to the Telink TLSR9 specs to get more information about pins configuration.

child-binding:
    description: |
        This binding gives a base representation of the Telink B91 pins configration.

    properties:
        pinmux:
          required: true
          type: int
          description: |
              Telink B91 pin's configuration (port, pin and function).
```

## dts/bindings/pinctrl/telink,b91-pinmux.yaml
```yaml
# Copyright (c) 2021, Telink Semiconductor
# SPDX-License-Identifier: Apache-2.0

description: Telink B91 PinMux

compatible: "telink,b91-pinmux"

include: base.yaml

properties:
    reg:
      required: true

    label:
      required: true

    pad-mul-sel:
      type: int
      required: true
      description: PinMux pad_mul_sel register values.

child-binding:
    description:
        This binding gives a base representation of the Telink B91 pins configration.

    properties:
        pinmux:
          required: true
          type: int
```

## dts/bindings/pinctrl/telink,w91-pinctrl.yaml
```yaml
# Copyright (c) 2024, Telink Semiconductor
# SPDX-License-Identifier: Apache-2.0

description: |
    The Telink W91 pin controller is a singleton node responsible for
    controlling pin function selection and pin properties. For example, you can
    use this node to route UART2 TX to pin P16 and enable the pull-up resistor
    on the pin.

    The node has the 'pinctrl' node label set in your SoC's devicetree,
    so you can modify it like this:

      &pinctrl {
              /* your modifications go here */
      };

    All device pin configurations should be placed in child nodes of the
    'pinctrl' node, as shown in this example:

      /* You can put this in places like a board-pinctrl.dtsi file in
       * your board directory, or a devicetree overlay in your application.
       */

      /* include pre-defined pins and functions for the SoC used by the board */
      #include <dt-bindings/pinctrl/w91-pinctrl.h>

      &pinctrl {
        /* configuration for UART2 TX default state */
        uart2_tx_p15_default: uart2_tx_p15_default {
          /* configure P16 as W91_FUNC_UART_TXD */
          pinmux = ...
        };
        /* configuration for UART2 RX default state */
        uart2_rx_p15_default: uart2_rx_p15_default {
          /* configure P15 as W91_FUNC_UART_RXD */
          pinmux = ...
        };
      };

    The 'uart2_tx_p15_default' child node encodes the pin configurations
    for a particular state of a device; in this case, the default
    (that is, active) sate. You would specify the low-power configuration for
    the same device in a separate child node.

    A pin configuration can also specify pin properties such as the
    'bias-pull-up' property. Here is a list of supported standard pin
    properties:

    - bias-disable
    - bias-pull-down
    - bias-pull-up

    To link pin configurations with a device, use a pinctrl-N property for some
    number N, like this example you could place in your board's DTS file:

      #include "board-pinctrl.dtsi"

      &uart2 {
        pinctrl-0 = <&uart2_tx_p15_default &uart2_rx_p15_default>;
        pinctrl-names = "default";
      };

compatible: "telink,w91-pinctrl"

include: base.yaml

properties:
  pad-mul-sel:
    type: int
    required: true
    description: |
        PinMux pad_mul_sel register value. Pin functions depend on it.

        For instance:
        Function C of P16 configs the pin to UART2_TX if pad_mul_sel is set to <1>.
        But, the same function configs the same pin to DAC_I_DAT2_I if pad_mul_sel is set to <0>.

        Refer to the Telink TLSR9 specs to get more information about pins configuration.

child-binding:
  description: |
      This binding gives a base representation of the Telink B91 pins configuration.

  include:
  - name: pincfg-node.yaml
    property-allowlist:
    - bias-disable
    - bias-pull-down
    - bias-pull-up

  properties:
    pinmux:
      required: true
      type: int
      description: |
          Telink W91 pin's configuration (port, pin and function).
```

## dts/bindings/pinctrl/ti,am26x-pinctrl.yaml
```yaml
# Copyright (c) 2025 Texas Instruments
# SPDX - License - Identifier : Apache - 2.0

description: |
  TI AM26x pinctrl node.

  Pins can be configured using following macro:
    TI_AM26X_PINMUX(gpio_num, value)

  - Pass gpio_num using macro: PIN_GPIO(gpio_num).
    Example: if you want to configure GPIO0,
      use macro as PIN_GPIO(0)

  - value is a 32-bit number that will be written to IOMUX register
    in TI_AM26X_PINMUX macro, pass value as an ORed list of following macros:

      > Choose pin's MUX mode by using following macro: PIN_MODE(num)
        The exact MUX mode can be determined by reading TRM

      > To override default PINMUX configuration and forcibly
        enable/disable input/output , use following macros:
          PIN_FORCE_INPUT_ENABLE  to forcibly enable input
          PIN_FORCE_INPUT_DISABLE to forcibly disable input
          PIN_FORCE_OUTPUT_ENABLE to forcibly enable output
          PIN_FORCE_OUTPUT_DISABLE to forcibly disable output

      > Enable/disable pull selection by following macros:
        PIN_PULL_ENABLE or PIN_PULL_DISABLE
        Set pull to up / down by using:
        PIN_PULL_UP or PIN_PULL_DOWN

      > Set slew rate to high / low by using :
        PIN_SLEW_RATE_HIGH or PIN_SLEW_RATE_LOW

      > Set GPIO - CPU ownership by using following macros:
        PIN_GPIO_R5SS0_0 to allow cluster0, CPU0 to get control
        PIN_GPIO_R5SS0_1 to allow cluster0, CPU1 to get control

      > Choose input qualifier type by following macros:
        PIN_QUAL_SYNC for sync input
        PIN_QUAL_3SAMPLE for a qual of 3 samples
        PIN_QUAL_6SAMPLE for a qual of 6 samples
        PIN_QUAL_ASYNC for async input

      > To choose whether input to pad must be inverted or not:
        PIN_INVERT to invert input
        PIN_NON_INVERT to NOT invert input (default)

  Example: To configure UART Tx pin, macro is used as follows:
    TI_AM26X_PINMUX(PIN_GPIO(28),
      (PIN_MODE(0) | PIN_PULL_DISABLE | PIN_SLEW_RATE_LOW))
    Above macro means GPIO 28 is configured as follows:
      - MUX Mode 0
      - PULL selection is disabled
      - Slew rate is low

compatible: "ti,am26x-pinctrl"

include: base.yaml

properties:
  reg:
    required: true

child-binding:
  description: |
    This binding gives a base representation of the TI AM26x
    pin configuration.

  properties:
    pinmux:
      required: true
      type: array
      description: |
        TI AM26x pin configuration.
```
