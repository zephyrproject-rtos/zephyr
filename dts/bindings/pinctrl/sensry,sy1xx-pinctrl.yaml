## dts/bindings/pinctrl/sensry,sy1xx-pinctrl.yaml
```yaml
# Copyright (c) 2024 sensry.io
# SPDX-License-Identifier: Apache-2.0

description: |
  The sensry SY1xx pin controller is a single node responsible for controlling
  pin configuration, such as pull-up, pull-down, tri-state, ...

  The node has the 'pinctrl0' node label set in your SoC's devicetree,
  so you can modify it like this:

    &pinctrl0 {
            /* your modifications go here */
    };

  For example:
    &pinctrl0 {

      /* UART0 */
      uart0_tx: uart0_tx {
        pinmux = <SY1XX_UART0_PAD_CFG0 SY1XX_PAD(0)>;
      };

      uart0_rx: uart0_rx {
        pinmux = <SY1XX_UART0_PAD_CFG0 SY1XX_PAD(1)>;
        input-enable;
      };
    }

  Then define the uart:
    &uart0 {
      pinctrl-0 = <&uart0_tx &uart0_rx>;
      pinctrl-names = "default";
    };

  Every pin configuration will be configured in a 32bit register. The configuration
  itself is 8bit wide. So we have a number of 4 pin configurations per 32bit register.

  The pinmux describes the registers address and the offset [0, 8, 16, 24] for
  the individual configuration.

  Allowed modifiers for each pin are:
  - bias-high-impedance
  - bias-pull-down
  - bias-pull-up
  - input-enable
  - input-schmitt-enable

compatible: "sensry,sy1xx-pinctrl"

include: base.yaml

properties:
  reg:
    required: true

child-binding:
  description: Each child node defines the configuration of a particular state.

  include:
    - name: pincfg-node.yaml
      property-allowlist:
        - bias-high-impedance
        - bias-pull-down
        - bias-pull-up
        - input-enable
        - input-schmitt-enable

  properties:
    pinmux:
      required: true
      type: array
      description: |
        Pin mux selection. See the SOC level pinctrl header
        for a defined list of these options.
```

## dts/bindings/pinctrl/sifive,iof.yaml
```yaml
# Copyright (c) 2021, Linaro Limited
# SPDX-License-Identifier: Apache-2.0

description: |
  SiFive FE310 IO Function (iof)
  Binding covers the IOF_EN/IOF_SEL registers that are a subset of the GPIO
  controller.

compatible: "sifive,iof"

include: base.yaml

properties:
    reg:
      required: true

pinmux-cells:
  - pin
  - function
```

## dts/bindings/pinctrl/sifive,pinctrl.yaml
```yaml
# Copyright (c) 2022 Antmicro <www.antmicro.com>
# SPDX-License-Identifier: Apache-2.0

description: |
  SiFive FE310 IO Function (iof) binding covers the IOF_EN/IOF_SEL registers
  that are a subset of the GPIO controller. You can use this node to set the
  value of IOF_EN/IOF_SEL registers to control pin settings.

  Device pin configuration should be placed in the child nodes of this node.
  Populate the 'pinmux' field with a pair consisting of a pin number and its IO
  function. The available IO functions are:
    - SIFIVE_PINMUX_IOF0
    - SIFIVE_PINMUX_IOF1

  For example, setting pins 16 and 17 both to IOF0 would look like this:

    #include <dt-bindings/pinctrl/sifive-pinctrl.h>

    &pinctrl {
      uart0_rx_default: uart0_rx_default {
        pinmux = <16 SIFIVE_PINMUX_IOF0>;
      };
      uart0_tx_default: uart0_tx_default {
        pinmux = <17 SIFIVE_PINMUX_IOF0>;
      };
    };

compatible: "sifive,pinctrl"

include: base.yaml

properties:
    reg:
      required: true

child-binding:
  description: |
    This binding gives a base representation of the SiFive FE310 pins
    configuration.

  properties:
    pinmux:
      required: true
      type: array
      description: |
        SiFive FE310 pin's configuration (pin, IO function).
```

## dts/bindings/pinctrl/sifli,sf32lb52x-pinmux.yaml
```yaml
# Copyright (c) 2025 Core Devices LLC
# Copyright (c) 2025 SiFli Technologies(Nanjing) Co., Ltd
# SPDX-License-Identifier: Apache-2.0

description: |
    SF32LB52x Pin multiplexer and pin configuration controller (HPSYS_PINMUX)

    Singleton node responsible for controlling pin function selection and pin
    properties. For example, you can use this node to route USART1 RX to pin
    PA19 and enable the pull-up resistor on the pin.

    The node has the 'pinctrl' node label set in your SoC's devicetree,
    so you can modify it like this:

      &pinctrl {
              /* your modifications go here */
      };

    All device pin configurations should be placed in child nodes of the
    'pinctrl' node, as shown in this example:

      /* You can put this in places like a board-pinctrl.dtsi file in
       * your board directory, or a devicetree overlay in your application.
       */

      /* include pre-defined combinations for the SoC variant used by the board */
      #include <zephyr/dt-bindings/pinctrl/sf32lb52x.h>

      &pinctrl {
        /* configuration for the usart1 "default" state */
        usart1_default: usart1_default {
          /* group 1 */
          group1 {
            /* configure PA19 as USART1 TX and PA20 as USART1 CTS */
            pinmux = <USART1_TX_PA19>, <USART1_CTS_PA20>;
            /* both PA19 and PA20 have input buffer enabled */
            input-enable;
          };
          /* group 2 */
          group2 {
            /* configure PA21 as USART1 RX and PA22 as USART1 RTS */
            pinmux = <USART1_RX_PA21>, <USART0_RTS_PA22>;
            /* both PA20 and PA21 have pull-up enabled */
            bias-pull-up;
          };

    The 'usart0_default' child node encodes the pin configurations for a
    particular state of a device; in this case, the default (that is, active)
    state.

    As shown, pin configurations are organized in groups within each child node.
    Each group can specify a list of pin function selections in the 'pinmux'
    property.

    A group can also specify shared pin properties common to all the specified
    pins, such as the 'bias-pull-up' property in group 2. Here is a list of
    supported standard pin properties:

    - bias-pull-up: Enable pull-up resistor.
    - bias-pull-down: Enable pull-down resistor.
    - input-enable: Enable input buffer.
    - drive-strength: 2, 4, 8, 12 or 20 mA drive strength. 20mA is only valid
      for PA39-PA42 pins.

    Note that drive and bias options are mutually exclusive.
    Note: SR (slew-rate) and IS (input-schmitt) registers are preserved
    from hardware defaults and cannot be changed via pinctrl.

    To link pin configurations with a device, use a pinctrl-N property for some
    number N, like this example you could place in your board's DTS file:

       #include "board-pinctrl.dtsi"

       &usart1 {
             pinctrl-0 = <&usart1_default>;
             pinctrl-names = "default";
       };

compatible: "sifli,sf32lb52x-pinmux"

include: [base.yaml, sifli-sf32lb-cfg.yaml]

properties:
  reg:
    required: true

  reg-names:
    required: true

  clocks:
    required: true

  sifli,cfg:
    required: true

  "#sifli,pinmux-cells":
    type: int
    const: 2

sifli,pinmux-cells:
  - port
  - offset

child-binding:
  child-binding:
    include:
      - name: pincfg-node.yaml
        property-allowlist:
          - bias-pull-down
          - bias-pull-up
          - input-enable
          - input-schmitt-enable
          - slew-rate
          - drive-strength

    properties:
      pinmux:
        required: true
        type: array
        description: |
          An array of pins sharing the same group properties. The pins should
          be defined using pre-defined macros or, alternatively, using the
          SF32_PINMUX utility macro.

      slew-rate:
        default: 0
        enum:
          - 0
          - 1

      drive-strength:
        default: 4
        enum:
          - 2
          - 8
          - 4
          - 12
          - 20
```

## dts/bindings/pinctrl/sifli,sf32lb58-hpsys-pinctrl.yaml
```yaml
# Copyright (c) 2025 Qingdao IotPi Ltd.
# SPDX-License-Identifier: Apache-2.0

description: |
  Sifli SF32LB58 HPSYS pinctrl node

compatible: "sifli,sf32lb58-hpsys-pinctrl"

include: [base.yaml]

child-binding:
  description: Sifli SF32LB58 HPSYS pin controller pin group
  child-binding:
    description: Sifli SF32LB58 HPSYS pin controller pin configuration node

    include:
      - name: pincfg-node.yaml
        property-allowlist:
          - input-enable
          - bias-disable
          - bias-pull-up
          - bias-pull-down

    properties:
      pinmux:
        required: true
        type: phandles
      drive-strength:
        type: int
        enum:
          - 0
          - 1
          - 2
          - 3
        description: |
          Corresponds to DS1/DS0 field in pinmux registers
          0 (DS1 = 0, DS0 = 0)
          1 (DS1 = 0, DS0 = 1)
          2 (DS1 = 1, DS0 = 0)
          1 (DS1 = 1, DS0 = 1)
          Defaults to 1

      slew-rate:
        type: string
        enum:
          - "fast"
          - "slow"
        description: |
          Corresponds to SR field in pinmux registers.
          Fast slew rate: 0
          Slow slew rate: 1
          defaults to fast
      schmitt-input:
        type: boolean
        description: |
          Corresponds to SR field in pinmux registers.
```

## dts/bindings/pinctrl/sifli,sf32lb58-hpsys-pinmux.yaml
```yaml
# Copyright (c) 2025 Qingdao IotPi Ltd.
# SPDX-License-Identifier: Apache-2.0

description: |
  Sifli SF32LB58 HPSYS pinmux


compatible: "sifli,sf32lb58-hpsys-pinmux"

include: [base.yaml]

properties:
  reg:
    required: true

child-binding:
  description: SF32LB58 HPSYS pinmux option
  properties:
    pinmux:
      required: true
      type: array
      description: |
        An array of values defines the pinmux options, in the format:
        <pinmux_reg sel>
        pinmux_reg: register address of the pinmux
        sel: function selection of the pinmux. the value need to be
        combined with other fields values, like pull-up/down bit
```

## dts/bindings/pinctrl/silabs,dbus-pinctrl.yaml
```yaml
# Copyright (c) 2024 Silicon Labs
# SPDX-License-Identifier: Apache-2.0

description: |
    The Silabs pin controller is a singleton node responsible for controlling
    pin function selection and pin properties. For example, you can use this
    node to route USART0 RX to pin PA1 and enable the pull-up resistor on the
    pin. This pin controller is used for devices that use DBUS (Digital Bus)
    for alternate function configuration, including Series 2 devices.

    The pinctrl settings are referenced in a device tree peripheral node. For
    example when configuring a USART:

      &usart0 {
        compatible = "silabs,gecko-usart";
        pinctrl-0 = <&usart0_default>;
        pinctrl-names = "default";
      }

    pinctrl-0 is a phandle that stores the pin settings for the peripheral, in
    this example &usart0_default. This phandle is defined as a child node of the
    'pinctrl' node, typically in a board-pinctrl.dtsi file in the board
    directory or a device tree overlay in the application:

      &pinctrl {
        /* Configuration for USART0 peripheral, default state */
        usart0_default: usart0_default {
          /* Group of output pins with shared properties (name is arbitrary) */
          group0 {
            /* Configure PA8 as USART0 TX in GPIO DBUS */
            pins = <USART0_TX_PA8>;
            /* Configure GPIO to push-pull mode */
            drive-push-pull;
            /* Set DOUT high */
            output-high;
          };
          /* Group of input pins with shared properties (name is arbitrary) */
          group1 {
            /* Configure PA9 as USART0 RX in GPIO DBUS */
            pins = <USART0_RX_PA9>;
            /* Configure GPIO to input mode */
            input-enable;
            /* Enable input glitch filter */
            silabs,input-filter;
          };
        };
      };

    The 'usart0_default' child node encodes the pin configurations for a
    particular state of the device, the default (active) state.

    Pin configurations are organized in groups within each child node. Each
    group can specify a list of pin function selections in the `pins` property,
    that all will be configured with the same GPIO mode as given by the rest
    of the properties on the group.

    The possible pin properties are as follows:

    - input-disable: Configure GPIO to disabled mode. Setting this property is
                     optional, as pins are disabled by default. If the "Input
                     disabled with pull-up" mode is desired, the property must
                     be set in combination with bias-pull-up.
    - input-enable: Configure GPIO to input mode.
    - drive-push-pull: Configure GPIO to push-pull mode.
    - drive-open-drain: Configure GPIO to open-drain (wired-AND) mode.
    - drive-open-source: Configure GPIO to open-source (wired-OR) mode.

    Only one of the above properties must be set at a time, as they are mutually
    exclusive. Additional properties may be combined with the above ones:

    - bias-pull-down: Enable pull-down resistor. Allowed in input-enable and
                      drive-open-source modes.
    - bias-pull-up: Enable pull-up resistor. Allowed in input-disable,
                    input-enable and drive-open-drain modes.
    - output-high: Drive GPIO high. Allowed in drive-push-pull mode.
    - output-low: Drive GPIO low. Allowed in drive-push-pull mode. Setting
                  this property is optional, leaving it out has the same effect.
    - silabs,input-filter: Enable input glitch filter. Allowed in input-enable
                           and drive-open-drain modes.
    - silabs,alternate-port-control: Use alternate port control settings.
                                     Allowed in drive-push-pull and
                                     drive-open-drain modes.

compatible: "silabs,dbus-pinctrl"

include: base.yaml

child-binding:
  description: |
    Silabs DBUS pin controller pin configuration. Each child node defines
    the configuration for a particular group of pins.
  child-binding:
    description: |
      Silabs DBUS pin controller pin configuration group.
    include:
      - name: pincfg-node.yaml
        property-allowlist:
          - bias-pull-down
          - bias-pull-up
          - drive-open-drain
          - drive-open-source
          - drive-push-pull
          - input-disable
          - input-enable
          - output-high
          - output-low

    properties:
      pins:
        required: true
        type: array
        description: |
          An array of pins sharing the same group properties. The pins should be
          defined using the <peripheral>_<signal>_<pin> macros available from
          the SoC DeviceTree files.

      silabs,input-filter:
        description: |
          Enable input glitch filter on this pin. May be used in input-enable
          and drive-open-drain modes.
        type: boolean

      silabs,alternate-port-control:
        description: |
          Use Alternate Port Control settings for Slew Rate and Input Disable
          for this pin. May be used in drive-push-pull and drive-open-drain
          modes.
        type: boolean
```
