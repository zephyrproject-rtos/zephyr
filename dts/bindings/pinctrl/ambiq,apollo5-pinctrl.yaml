## dts/bindings/pinctrl/gd,gd32-pinctrl-afio.yaml
```yaml
# Copyright (c) 2021 Teslabs Engineering S.L.
# SPDX-License-Identifier: Apache-2.0

description: |
    The GD32 pin controller (AFIO model) is a singleton node responsible for
    controlling pin function selection and pin properties. For example, you can
    use this node to route USART0 RX to pin PA10 and enable the pull-up resistor
    on the pin. Remapping is also supported.

    The node has the 'pinctrl' node label set in your SoC's devicetree,
    so you can modify it like this:

      &pinctrl {
              /* your modifications go here */
      };

    All device pin configurations should be placed in child nodes of the
    'pinctrl' node, as shown in this example:

      /* You can put this in places like a board-pinctrl.dtsi file in
       * your board directory, or a devicetree overlay in your application.
       */

      /* include pre-defined combinations for the SoC variant used by the board */
      #include <dt-bindings/pinctrl/gd32f403z(k-i-g-e-c-b)xx-pinctrl.h>

      &pinctrl {
        /* configuration for the usart0 "default" state */
        usart0_default: usart0_default {
          /* group 1 */
          group1 {
            /* configure PA9 as USART0 TX and PA11 as USART0 CTS (no remap) */
            pinmux = <USART0_TX_PA9_NORMP>, <USART0_CTS_PA11_NORMP>;
          };
          /* group 2 */
          group2 {
            /* configure PA10 as USART0 RX and PA12 as USART0 RTS (no remap) */
            pinmux = <USART0_RX_PA10_NORMP>, <USART0_RTS_PA12_NORMP>;
            /* both PA10 and PA12 have pull-up enabled */
            bias-pull-up;
          };

        /* configuration for the usart0 "sleep" state */
        usart0_sleep: usart0_sleep {
          /* group 1 */
          group1 {
            /* configure PA9, PA10, PA11 and PA12 in analog mode */
            pinmux = <ANALOG_PA9>, <ANALOG_PA10>, <ANALOG_PA12>, <ANALOG_PA11>;
          };
        };

    The 'usart0_default' child node encodes the pin configurations for a
    particular state of a device; in this case, the default (that is, active)
    state. Similarly, 'usart0_sleep' child node encodes the pin configurations
    for the sleep state (used in device low power mode). Note that analog mode
    is used for low power states because it disconnects the pin pull-up/down
    resistor, schmitt trigger, and output buffer.

    As shown, pin configurations are organized in groups within each child node.
    Each group can specify a list of pin function selections in the 'pinmux'
    property.

    A group can also specify shared pin properties common to all the specified
    pins, such as the 'bias-pull-up' property in group 2. Here is a list of
    supported standard pin properties:

    - drive-push-pull: Push-pull drive mode (default, not required). Only
      applies for GPIO_IN mode.
    - drive-open-drain: Open-drain drive mode. Only applies for GPIO_IN mode.
    - bias-disable: Disable pull-up/down (default, not required). Only applies
      for GPIO_IN mode.
    - bias-pull-up: Enable pull-up resistor. Only applies for GPIO_IN mode.
    - bias-pull-down: Enable pull-down resistor. Only applies for GPIO_IN mode.
    - slew-rate: Set the maximum speed (and so the slew-rate) of the output
      signal (default: 2MHz). Only applies for ALTERNATE mode.

    Note that drive and bias options are mutually exclusive.

    Peripherals that are remappable will have their pre-defined macros suffixed
    with the remap option being selected, for example:

      - CAN0_RX_PA11_NORMP: No remap
      - CAN0_RX_PB8_PRMP: Partial remap
      - CAN0_RX_PD0_FRMP: Full remap

    It is important that **ALL** pinmux entries share the same remap. For
    example:

      &pinctrl {
        can0_default: can0_default {
          group1 {
            pinmux = <CAN0_RX_PD0_FRMP>, <CAN0_TX_PD1_FRMP>;
            /*                    ^^^^                ^^^^           */
            /* CAN0 pins are remapped choosing the full remap option */
          };
        };
      };

    To link pin configurations with a device, use a pinctrl-N property for some
    number N, like this example you could place in your board's DTS file:

       #include "board-pinctrl.dtsi"

       &usart0 {
             pinctrl-0 = <&usart0_default>;
             pinctrl-1 = <&usart0_sleep>;
             pinctrl-names = "default", "sleep";
       };

compatible: "gd,gd32-pinctrl-afio"

include: gd,gd32-pinctrl-common.yaml

child-binding:
  description: |
    Each child node defines the configuration for a particular state.
  child-binding:
    description: |
      The grandchild nodes group pins that share the same pin configuration.
    properties:
      slew-rate:
        type: string
        default: "max-speed-2mhz"
        enum:
          - "max-speed-10mhz"
          - "max-speed-2mhz"
          - "max-speed-50mhz"
          - "max-speed-highest"
        description: |
          Set the maximum speed of a pin. This setting effectively limits the
          slew rate of the output signal. Defaults to "max-speed-2mhz", the SoC
          default. The max-speed-highest option may not be available on all SoC
          variants. If selected and not available the 50 MHz maximum speed will
          be used instead. Note that usage of max-speed-highest may require
          enabling the I/O compensation cell (refer to the gd,gd32-afio binding
          for more details).
```

## dts/bindings/pinctrl/gd,gd32-pinctrl-common.yaml
```yaml
# Copyright (c) 2021 Teslabs Engineering S.L.
# SPDX-License-Identifier: Apache-2.0

include: base.yaml

child-binding:
  child-binding:
    include:
      - name: pincfg-node.yaml
        property-allowlist:
          - drive-push-pull
          - drive-open-drain
          - bias-disable
          - bias-pull-down
          - bias-pull-up

    properties:
      pinmux:
        required: true
        type: array
        description: |
          An array of pins sharing the same group properties. The pins should
          be defined using pre-defined macros or, alternatively, using the
          GD32_PINMUX_AF or GD32_PINMUX_AFIO utility macros depending on the
          pinmux model used by the SoC series.
```

## dts/bindings/pinctrl/hisilicon,hi3861-pinctrl.yaml
```yaml
# Copyright (c) 2023 Chen Xingyu <hi@xingrz.me>
# SPDX-License-Identifier: Apache-2.0

description: Hi3861 IO MUX

compatible: "hisilicon,hi3861-pinctrl"

include: base.yaml

child-binding:
  description: Hi3861 pin controller pin group

  child-binding:
    include:
      - name: pincfg-node.yaml
        property-allowlist:
          - input-schmitt-enable
          - drive-strength
          - slew-rate
          - bias-pull-up
          - bias-pull-down
          - input-enable

    properties:
      pinmux:
        required: true
        type: array

      drive-strength:
        enum:
          - 16
          - 14
          - 12
          - 10
          - 8
          - 6
          - 4
          - 2
        description: |
          The drive strength of a pin, in mA.

          Note that only GPIO 12 and SFC pins support drive strength higher than
          8mA.

      slew-rate:
        enum:
          - 0
          - 1
        default: 1
        description: |
          The slew rate of a pin. 0 corresponds to slow, and 1 corresponds to fast.
```

## dts/bindings/pinctrl/infineon,cat1-pinctrl.yaml
```yaml
# Copyright (c) 2022 Cypress Semiconductor Corporation (an Infineon company) or
# an affiliate of Cypress Semiconductor Corporation
#
# SPDX-License-Identifier: Apache-2.0

description: |
  Infineon CAT1 Pinctrl container node

  This is a singleton node responsible for controlling the pin function selection
  and pin properties. For example, you can use this node to route
  UART0 RX to a particular port/pin and enable the pull-up resistor on that
  pin.

  The node has the 'pinctrl' node label set in SoC's devicetree,
  so you can modify it like this:

  &pinctrl {
      /* Your modifications go here */
  };

  Pin configuration can also specify the pin properties, for example the
  'bias-pull-up' property. Here is a list of the supported standard pin
  properties:
    * bias-high-impedance
    * bias-pull-up
    * bias-pull-down
    * drive-open-drain
    * drive-open-source
    * drive-push-pull   (strong)
    * input-enable      (input-buffer)

  Infineon CAT1 SoC's devicetree includes a set of pre-defined pin control
  Nodes, which can be found via MPN dtsi.
  For example, board cy8cproto_062_4343w uses the CY8C624ABZI_S2D44 part, so
  board dts (boards\arm\cy8cproto_062_4343w\cy8cproto_062_4343w.dts) includes MPN dts
  (infineon/psoc6/mpns/CY8C624ABZI_S2D44.dtsi).

  Each MPN dtsi includes package dtsi (../psoc6_xx/psoc6_xx.yyy-zzz.dtsi),
  For example, CY8C624ABZI_S2D44 includes "../psoc6_02/psoc6_02.124-bga.dtsi".

  An example of pre-defined pin control from package dtsi (e.g. psoc6_02.124-bga.dtsi):
  p3_0_scb2_uart_rx - RX pin UART2 (SCB2) which connected to port3.0

    /omit-if-no-ref/ p3_0_scb2_uart_rx: p3_0_scb2_uart_rx {
          pinmux = <DT_CAT1_PINMUX(3, 0, HSIOM_SEL_ACT_6)>;
    };

  Refer to psoc6_02.124-bga.dtsi for the list of all pre-defined pin control nodes.

  NOTE1 Pre-defined pin control nodes use macro DT_CAT1_PINMUX to
    initialize pinmux. DT_CAT1_PINMUX has the following input parameters
    DT_CAT1_PINMUX(port_number, pin_number, hsiom),
    hsiom is defined in the HSIOM_SEL_xxx macros in the
    zephyr\include\zephyr\dt-bindings\pinctrl\ifx_cat1-pinctrl.h file.

        You can use DT_CAT1_PINMUX to define your own pin control node:
          &pinctrl {
              my_uart_rx: my_uart_rx {
                  pinmux = <DT_CAT1_PINMUX(3, 0, HSIOM_SEL_ACT_6)>;
              };
          };

  NOTE2 Pre-defined pin control nodes do not have bias pin configuration.
    The bias configuration can be updated in board-pinctrl.dtsi
    &pinctrl {
      /* Configure pin control Bias mode for uart2 pins */
      p3_1_scb2_uart_tx {
        drive-push-pull;
      };

      p3_0_scb2_uart_rx {
        input-enable;
      };

      p3_2_scb2_uart_rts {
        drive-push-pull;
      };

      p3_3_scb2_uart_cts {
        input-enable;
      };
    };

  An example of the usage of pre-defined pin control nodes in your board's DTS file:

    &uart5 {
      pinctrl-0 = <&p5_1_scb5_uart_tx &p5_0_scb5_uart_rx>;
      pinctrl-names = "default";
    };

    /* Configure pin control bias mode for uart5 pins */
    &p5_1_scb5_uart_tx {
      drive-push-pull;
    };

    &p5_0_scb5_uart_rx {
      input-enable;
    };

compatible: "infineon,cat1-pinctrl"

include: base.yaml

child-binding:
  description: This binding gives a base representation of the Infineon CAT1 pins configuration
  include:
    - name: pincfg-node.yaml
      property-allowlist:
        - bias-high-impedance
        - bias-pull-down
        - bias-pull-up
        - drive-push-pull
        - drive-open-drain
        - drive-open-source
        - input-enable

  properties:
    pinmux:
      description: |
        Encodes port/pin and alternate function.
      required: true
      type: int
```

## dts/bindings/pinctrl/infineon,tc3x-pinctrl.yaml
```yaml
# Copyright (c) 2024 Infineon Technologies AG
# SPDX-License-Identifier: Apache-2.0

description: TC3X Pinmux description

compatible: "infineon,tc3x-pinctrl"

include: base.yaml

properties:
  "#address-cells":
    required: true
    const: 1
  "#size-cells":
    required: true
    const: 1

child-binding:
  child-binding:
    description: Each child node defines the configuration for a particular state.

    include:
      - name: pincfg-node.yaml
        property-allowlist:
          - bias-pull-down
          - bias-pull-up
          - drive-push-pull
          - drive-open-drain
          - input-disable
          - output-enable
          - output-high
          - output-low

    properties:
      pinmux:
        type: array
        required: true

      slew-rate:
        description: Slew rate of the output pin
        type: string
        default: "sharp"
        enum:
          - "sharp"
          - "medium"

      drive-strength:
        description: |
          Drive strength of the output pin.
        default: "medium"
        type: string
        enum:
          - "strong"
          - "medium"
          - "rgmii"

      input-level:
        type: string
        description: |
          Input level of the input pin
        default: "automotive"
        enum:
          - "automotive"
          - "ttl_5v"
          - "ttl_3v3"

      output-select:
        type: boolean
        description: Use advanced output select function (e.g. RGMII, SCR, SMU)
```
