## dts/bindings/pinctrl/espressif,esp32-pinctrl.yaml
```yaml
# Copyright (c) 2022 Espressif Systems (Shanghai) Co., Ltd.
# SPDX-License-Identifier: Apache-2.0

description: |
    Espressif's pin controller is in charge of controlling pin configurations, pin
    functionalities and pin properties as defined by pin states. In its turn, pin
    states are composed by groups of pre-defined pin muxing definitions and user
    provided pin properties.

    Each Zephyr-based application has its own set of pin muxing/pin configuration
    requirements. The next steps use ESP-WROVER-KIT's I2C_0 to illustrate how one
    could change a node's pin state properties. Though based on a particular board,
    the same steps can be tweaked to address specifics of any other target board.

    Suppose an application running on top of the ESP-WROVER-KIT board, for some
    reason it needs I2C_0's SDA signal to be routed to GPIO_33. When looking at
    that board's original device tree source file (i.e., 'esp_wrover_kit.dts'),
    you'll notice that the I2C_0 node is already assigned to a pre-defined state.
    Below is highlighted the information that most interests us on that file


        #include "esp_wrover_kit-pinctrl.dtsi"

        &i2c0 {
                ...
                pinctrl-0 = <&i2c0_default>;
                pinctrl-names = "default";
        };


    From the above excerpt, the pincrl-0 property is assigned the 'i2c0_default'
    state value. This and other pin states of the board are defined on another file
    (in this case, 'esp_wrover_kit-pinctrl.dtsi') on the same folder of the DTS file.
    Check below the excerpt describing I2C_0's default state on that file


        i2c0_default: i2c0_default {
                group1 {
                        pinmux = <I2C0_SDA_GPIO21>,
                                 <I2C0_SCL_GPIO22>;
                        bias-pull-up;
                        drive-open-drain;
                        output-high;
                };
        };


    Only the 'pinmux' property above is actually required, other properties can
    be chosen if meaningful for the target application and, of course, supported
    by your target hardware. For example, some custom board may have an external
    pull-up resistor soldered to GPIO_21's pin pad, in which case, 'bias-pull-up'
    could be no longer required.

    Back to our fictional application, the previous I2C_0 state definition does not
    meet our expectations as we would like to route I2C_0's SDA signal to GPIO_33
    instead of to GPIO_21. To achieve it, we need to update the 'pinmux' property
    accordingly.

    Note that replacing 'I2C0_SDA_GPIO21' by 'I2C0_SDA_GPIO33' is very tempting and
    may even work, however, unless you have checked the hardware documentation first,
    it is not recommended. That's because there are no guarantees that a particular
    IO pin has the capability to route any specific signal.

    The recommendation is to check the pinmux macros definitions available for the
    target SoC in the following URL


    https://github.com/zephyrproject-rtos/hal_espressif/tree/zephyr/include/dt-bindings/pinctrl


    The ESP-WROVER-KIT board is based on the ESP32 SoC, in that case, we search
    through the file 'esp32-pinctrl.h' in the above URL. Luckily for us, there is
    one definition on that file that corresponds to our needs


        #define I2C0_SDA_GPIO33 \
                ESP32_PINMUX(33, ESP_I2CEXT0_SDA_IN, ESP_I2CEXT0_SDA_OUT)


    Now, we go back to edit 'esp_wrover_kit-pinctrl.dtsi' and create a new pin state
    on that file (or replace/update the one already defined) using the pinmux macro
    definition above, yielding


        i2c0_default: i2c0_default {
                group1 {
                        pinmux = <I2C0_SDA_GPIO33>,
                                 <I2C0_SCL_GPIO22>;
                        bias-pull-up;
                        drive-open-drain;
                        output-high;
                };
        };


    With proper modifications, the same steps above apply when using different
    combinations of boards, SoCs, peripherals and peripheral pins.

    Note: Not all pins are available for a given peripheral, it depends if that
          pin supports a set of properties required by the target peripheral.

          When defining a state, the pin muxing information is constrained to
          the definitions at 'hal_espressif', however, pin properties (like
          bias-push-pull, drive-open-drain, etc) can be freely chosen, given the
          property is meaningful to the peripheral signal and that it is also
          available in the target GPIO.

          Another thing worth noting is that all pin properties should be grouped.
          All pins sharing common properties go under a common group (in the above
          example, all pins are in 'group1'). Other peripherals can have more than
          one group.

compatible: "espressif,esp32-pinctrl"

include: base.yaml

child-binding:
  description: |
    Espressif pin controller pin configuration state nodes.
  child-binding:
    description:
      Espressif pin controller pin configuration group.

    include:
      - name: pincfg-node.yaml
        property-allowlist:
          - bias-disable
          - bias-pull-down
          - bias-pull-up
          - drive-push-pull
          - drive-open-drain
          - input-enable
          - output-enable
          - output-high
          - output-low

    properties:
      pinmux:
        required: true
        type: array
        description: |
          Each array element represents pin muxing information of an individual
          pin. The array elements are pre-declared macros taken from Espressif's
          HAL.
```

## dts/bindings/pinctrl/espressif,esp32-pinmux.yaml
```yaml
# Copyright (c) 2019 Mohamed ElShahawi
# SPDX-License-Identifier: Apache-2.0

description: ESP32 PINMUX

compatible: "espressif,esp32-pinmux"

include: base.yaml

properties:
    reg:
      required: true
```

## dts/bindings/pinctrl/gaisler,gr716-pinctrl.yaml
```yaml
# SPDX-License-Identifier: Apache-2.0
description: GR716A pin configuration

compatible: "gaisler,gr716-pinctrl"

include: base.yaml

properties:
    reg:
      required: true

pinmux-cells:
  - pin
  - function
```

## dts/bindings/pinctrl/gd,gd32-afio.yaml
```yaml
# Copyright (c) 2021 Teslabs Engineering S.L.
# SPDX-License-Identifier: Apache-2.0

description: |
  The AFIO peripheral is used to configure pin remapping, EXTI sources and,
  when available, enable the I/O compensation cell.

compatible: "gd,gd32-afio"

include: base.yaml

properties:
  reg:
    required: true

  rcu-periph-clock:
    type: int
    description: Reset Control Unit Peripheral Clock ID
    required: true

  enable-cps:
    required: false
    type: boolean
    description: |
      Enable the I/O compensation cell. This option should be enabled when the
      output speed is greater than 50MHz to reduce the I/O noise effects on
      the power supply. This option is only available on certain GD32 series.
```

## dts/bindings/pinctrl/gd,gd32-pinctrl-af.yaml
```yaml
# Copyright (c) 2021 Teslabs Engineering S.L.
# SPDX-License-Identifier: Apache-2.0

description: |
    The GD32 pin controller (AF model) is a singleton node responsible for
    controlling pin function selection and pin properties. For example, you can
    use this node to route USART0 RX to pin PA10 and enable the pull-up resistor
    on the pin.

    The node has the 'pinctrl' node label set in your SoC's devicetree,
    so you can modify it like this:

      &pinctrl {
              /* your modifications go here */
      };

    All device pin configurations should be placed in child nodes of the
    'pinctrl' node, as shown in this example:

      /* You can put this in places like a board-pinctrl.dtsi file in
       * your board directory, or a devicetree overlay in your application.
       */

      /* include pre-defined combinations for the SoC variant used by the board */
      #include <dt-bindings/pinctrl/gd32f450i(g-i-k)xx-pinctrl.h>

      &pinctrl {
        /* configuration for the usart0 "default" state */
        usart0_default: usart0_default {
          /* group 1 */
          group1 {
            /* configure PA9 as USART0 TX and PA11 as USART0 CTS */
            pinmux = <USART0_TX_PA9>, <USART0_CTS_PA11>;
          };
          /* group 2 */
          group2 {
            /* configure PA10 as USART0 RX and PA12 as USART0 RTS */
            pinmux = <USART0_RX_PA10>, <USART0_RTS_PA12>;
            /* both PA10 and PA12 have pull-up enabled */
            bias-pull-up;
          };

        /* configuration for the usart0 "sleep" state */
        usart0_sleep: usart0_sleep {
          /* group 1 */
          group1 {
            /* configure PA9, PA10, PA11 and PA12 in analog mode */
            pinmux = <ANALOG_PA9>, <ANALOG_PA10>, <ANALOG_PA12>, <ANALOG_PA11>;
          };
        };

    The 'usart0_default' child node encodes the pin configurations for a
    particular state of a device; in this case, the default (that is, active)
    state. Similarly, 'usart0_sleep' child node encodes the pin configurations
    for the sleep state (used in device low power mode). Note that analog mode
    is used for low power states because it disconnects the pin pull-up/down
    resistor, schmitt trigger, and output buffer.

    As shown, pin configurations are organized in groups within each child node.
    Each group can specify a list of pin function selections in the 'pinmux'
    property.

    A group can also specify shared pin properties common to all the specified
    pins, such as the 'bias-pull-up' property in group 2. Here is a list of
    supported standard pin properties:

    - drive-push-pull: Push-pull drive mode (default, not required).
    - drive-open-drain: Open-drain drive mode.
    - bias-disable: Disable pull-up/down (default, not required).
    - bias-pull-up: Enable pull-up resistor.
    - bias-pull-down: Enable pull-down resistor.
    - slew-rate: Set the maximum speed (and so the slew-rate) of the output
      signal (default: 2MHz).

    Note that drive and bias options are mutually exclusive.

    To link pin configurations with a device, use a pinctrl-N property for some
    number N, like this example you could place in your board's DTS file:

       #include "board-pinctrl.dtsi"

       &usart0 {
             pinctrl-0 = <&usart0_default>;
             pinctrl-1 = <&usart0_sleep>;
             pinctrl-names = "default", "sleep";
       };

compatible: "gd,gd32-pinctrl-af"

include: gd,gd32-pinctrl-common.yaml

child-binding:
  description: |
    Each child node defines the configuration for a particular state.
  child-binding:
    description: |
      The grandchild nodes group pins that share the same pin configuration.
    properties:
      slew-rate:
        type: string
        default: "max-speed-2mhz"
        enum:
          - "max-speed-2mhz"
          - "max-speed-25mhz"
          - "max-speed-50mhz"
          - "max-speed-200mhz"
        description: |
          Set the maximum speed of a pin. This setting effectively limits the
          slew rate of the output signal. Defaults to "max-speed-2mhz", the SoC
          default.
```
