## dts/bindings/pinctrl/atmel,sam-pinctrl.yaml
```yaml
# Copyright (c) 2020, Linaro Limited
# Copyright (c) 2021, Teslabs Engineering S.L.
# Copyright (c) 2021-2022, Gerson Fernando Budke <nandojve@gmail.com>
# SPDX-License-Identifier: Apache-2.0

description: |
  Atmel SAM Pinctrl Container

  The Atmel SAM pin controller is a singleton node responsible for controlling
  pin function selection and pin properties. For example, you can use this node
  to route USART0 RX to pin PA10 and enable the pull-up resistor on the pin.

  The node has the 'pinctrl' node label set in your SoC's devicetree, so you can
  modify it like this:

    &pinctrl {
            /* your modifications go here */
    };

  All device pin configurations should be placed in child nodes of the 'pinctrl'
  node, as shown in this example:

    /** You can put this in places like a <board>-pinctrl.dtsi file in
      * your board directory, or a devicetree overlay in your application.
      */

    /** include pre-defined combinations for the SoC variant used by the board */
    #include <dt-bindings/pinctrl/sam4sXc-pinctrl.h>

    &pinctrl {
      /* configuration for the usart0 "default" state */
      usart0_default: usart0_default {
        /* group 1 */
        group1 {
          /* configure PA6 as USART0 TX and PA8 as USART0 CTS */
          pinmux = <PA6A_USART0_TXD0>, <PA8A_USART0_CTS0>;
        };
        /* group 2 */
        group2 {
          /* configure PA5 as USART0 RX and PA7 as USART0 RTS */
          pinmux = <PA5A_USART0_RXD0>, <PA7A_USART0_RTS0>;
          /* both PA5 and PA7 have pull-up enabled */
          bias-pull-up;
        };
      };
    };

  The 'usart0_default' child node encodes the pin configurations for a
  particular state of a device; in this case, the default (that is, active)
  state.

  As shown, pin configurations are organized in groups within each child node.
  Each group can specify a list of pin function selections in the 'pinmux'
  property.

  A group can also specify shared pin properties common to all the specified
  pins, such as the 'bias-pull-up' property in group 2. Here is a list of
  supported standard pin properties:

  - bias-pull-up: Enable pull-up resistor.
  - bias-pull-down: Enable pull-down resistor.
  - drive-open-drain: Open-drain drive mode.

  To link pin configurations with a device, use a pinctrl-N property for some
  number N, like this example you could place in your board's DTS file:

    #include "board-pinctrl.dtsi"

    &usart0 {
          pinctrl-0 = <&usart0_default>;
          pinctrl-names = "default";
    };

compatible: "atmel,sam-pinctrl"

include: base.yaml

properties:
  "#address-cells":
    required: true
    const: 1
  "#size-cells":
    required: true
    const: 1

child-binding:
  description: |
    Each child node defines the configuration for a particular state.
  child-binding:
    description: |
      The grandchild nodes group pins that share the same pin configuration.

    include:
      - name: pincfg-node.yaml
        property-allowlist:
          - bias-pull-up
          - bias-pull-down
          - drive-open-drain

    properties:
      pinmux:
        required: true
        type: array
        description: |
          An array of pins sharing the same group properties. The pins should
          be defined using pre-defined macros or, alternatively, using the
          SAM_PINMUX utility macros depending on the pinmux model used by the
          SoC series.
```

## dts/bindings/pinctrl/atmel,sam0-pinctrl.yaml
```yaml
# Copyright (c) 2020, Linaro Limited
# Copyright (c) 2021, Gerson Fernando Budke
# SPDX-License-Identifier: Apache-2.0

description: |
  Atmel SAM0 Pinctrl container node

  The Atmel SAM0 pins implements following pin configuration option:

    * bias-pull-up
    * bias-pull-down
    * drive-strength
    * input-enable
    * output-enable
    * pinmux-enable

  These options define devicetree flags that are converted to SoC flags at
  ATMEL_SAM0_PIN_FLAGS().

compatible: "atmel,sam0-pinctrl"

include:
    - name: base.yaml
    - name: pincfg-node.yaml
      child-binding:
        property-allowlist:
          - bias-pull-up
          - bias-pull-down
          - drive-strength
          - input-enable
          - output-enable

properties:
    reg:
      required: true

properties:
    "#address-cells":
      required: true
      const: 1
    "#size-cells":
      required: true
      const: 1

child-binding:
    description: Atmel pins
    properties:
      "atmel,pins":
        type: phandle-array

      pinmux-enable:
        required: false
        type: boolean
        description: |
          Assign pin to an embedded device peripheral
```

## dts/bindings/pinctrl/atmel,sam0-pinmux.yaml
```yaml
description: Atmel SAM0 PINMUX

compatible: "atmel,sam0-pinmux"

include: base.yaml

properties:
    reg:
      required: true

pinmux-cells:
  - pin
  - function
```

## dts/bindings/pinctrl/bflb,bl-pinctrl.yaml
```yaml
# Copyright (c) 2021, Gerson Fernando Budke <nandojve@gmail.com>
# SPDX-License-Identifier: Apache-2.0

description: Bouffalo Lab Pinctrl node

compatible: "bflb,bl-pinctrl"

include:
    - name: base.yaml
    - name: pincfg-node-group.yaml
      child-binding:
        child-binding:
          property-allowlist:
            - bias-high-impedance
            - bias-pull-down
            - bias-pull-up
            - input-enable
            - input-schmitt-enable
            - output-enable

properties:
    "#address-cells":
      required: true
      const: 1
    "#size-cells":
      required: true
      const: 1

child-binding:
  description: |
    Bouffalo Lab pin controller pin configuration nodes. Each node is composed
    by one or more groups, each defining the configuration for a set of pins.

  child-binding:
    description: |
      Bouffalo Lab pin controller pin configuration group. Each group contains
      a list of pins sharing the same set of properties. Example:
      uart0_default: uart0_default {
        /* group 1 (name is arbitrary) */
        pins1 {
          /* configure to uart0 function plus modem interrupt, pin 7 as UART_RX
             pin 16 as UART_TX and finally pin 18 as gpio */
          bflb,pins = <BFLB_PIN(uart0,   7)>,
                      <BFLB_PIN(uart0,  16)>,
                      <BFLB_PIN(gpio,   18)>;
          bflb,signals = <BFLB_SIG_UART_RXD>,
                         <BFLB_SIG_UART_TXD>;
          bias-pull-up;
          input-schmitt-enable;
        };
      };
      The list of supported standard properties:
      - bias-high-impedance: Disable pull-up/down (default behavior, not
        required).
      - bias-pull-up: Enable pull-up resistor.
      - bias-pull-down: Enable pull-down resistor.
      - input-enable: Enable GPIO as input (default behavior, not required).
      - input-schmitt-enable: Enable Schimitt Trigger when GPIO is Input.
      - output-enable: Enable GPIO as output.

      Note that bias options are mutually exclusive. It is the same with GPIO
      input/output enable options.
    properties:
      "bflb,pins":
        required: true
        type: phandle-array
        description: |
          An phandle-array of pins sharing the same group properties. The pins
          should be defined using the BFLB_PIN utility macro that encode
          function and pin. Some special functions require a signal to complete
          route matrix.
      "bflb,signals":
        required: false
        type: array
        description: |
          An optional array that add flags to a pin. The signal flag is defined
          at bflb-pinctrl.h and have BFLB_SIG_ as prefix. It don't require same
          len that bflb,pins property.
      drive-strength:
        required: false
        type: int
        default: 0
        enum:
        - 0     # Default value, lower strength, 8mA
        - 1     # 9.6mA
        - 2     # 11.2mA
        - 3     # highest strength, 12.8mA
        description: |
          Pin drive strength. It tunes pin max current where 0 means lower
          value, which is the default, and 3 represents max drive strength.
```

## dts/bindings/pinctrl/bflb,pinctrl.yaml
```yaml
# Copyright (c) 2021-2025 Gerson Fernando Budke <nandojve@gmail.com>
#
# SPDX-License-Identifier: Apache-2.0

description: Bouffalo Lab Pinctrl node

compatible: "bflb,pinctrl"

include: base.yaml

properties:
  "#address-cells":
    required: true
    const: 1
  "#size-cells":
    required: true
    const: 1

child-binding:
  description: |
    Bouffalo Lab pin controller pin configuration nodes. Each node is composed
    by one or more groups, each defining the configuration for a set of pins.

  child-binding:
    description: |
      Bouffalo Lab pin controller pin configuration group. Each group contains
      a list of pins sharing the same set of properties. Example:

      uart0_default: uart0_default {
        /* group 1 (name is arbitrary) */
        group1 {
          /* configure to uart0 function plus modem interrupt, pin 7 as UART_RX
             pin 16 as UART_TX and finally pin 18 as gpio */
          pinmux = <GPIO7_UART0_RX>,
                   <GPIO16_UART0_TX>;
          bias-pull-up;
          input-schmitt-enable;
        };
      };

      uart0_sleep: uart0_sleep {
        group1 {
          pinmux = <GPIO7_UART0_RX>,
                   <GPIO16_UART0_TX>;
          bias-high-impedance;
        };
      };

      The list of supported standard properties:
      - bias-high-impedance: Disable pull-up/down (default behavior, not
        required).
      - bias-pull-up: Enable pull-up resistor.
      - bias-pull-down: Enable pull-down resistor.
      - input-enable: Enable GPIO as input (default behavior, not required).
      - input-schmitt-enable: Enable Schimitt Trigger when GPIO is Input.
      - output-enable: Enable GPIO as output.

      Note that bias options are mutually exclusive. It is the same with GPIO
      input/output enable options.

    include:
      - name: pincfg-node.yaml
        property-allowlist:
          - bias-high-impedance
          - bias-pull-down
          - bias-pull-up
          - input-enable
          - input-schmitt-enable
          - output-enable

    properties:
      pinmux:
        required: true
        type: array
        description: |
          An array of pins sharing the same group properties. The pins should be
          defined using the BFLB_PINMUX utility macro that encode all the pin
          route matrix.
      drive-strength:
        type: int
        default: 0
        enum:
          - 0     # Default value, lower strength, 8mA
          - 1     # 9.6mA
          - 2     # 11.2mA
          - 3     # highest strength, 12.8mA
        description: |
          Pin drive strength. It tunes pin max current where 0 means lower
          value, which is the default, and 3 represents max drive strength.
          The driver will automatically apply the default value (8mA) to all
          pins to save power.
```

## dts/bindings/pinctrl/brcm,bcm2711-pinctrl.yaml
```yaml
# Copyright (c) 2025 Muhammad Waleed Badar
# SPDX-License-Identifier: Apache-2.0

description: Broadcom BCM2711 pin controller

compatible: "brcm,bcm2711-pinctrl"

include: base.yaml

properties:
  reg:
    required: true

child-binding:
  description: |
    Pin configuration state nodes.

  child-binding:
    description: |
      Pin configuration group.

      Each group within a pin configuration state contains pins that share
      the same bias (pull-up/pull-down) configuration.

    include:
      - name: pincfg-node.yaml
        property-allowlist:
          - bias-disable
          - bias-pull-down
          - bias-pull-up

    properties:
      pinmux:
        type: array
        required: true
        description: |
          An array of pins for this group. Each element is encoded as:
          - Bits 0-7: Pin number (0-57)
          - Bits 8-10: Function select (0-7)

          Use BCM2711_PINMUX(pin, func) to construct values.
```

## dts/bindings/pinctrl/brcm,bcm2712-pinctrl.yaml
```yaml
# Copyright (c) 2025 TOKITA Hiroshi
# SPDX-License-Identifier: Apache-2.0

title: Broadcom BCM2712 Pin Controller

description: |
  BCM2712 SoC pinmux and pad control. Each controller bank manages a group
  of GPIO pins and exposes the function selection and pad control registers
  for those pins.

compatible: "brcm,bcm2712-pinctrl"

include: base.yaml

properties:
  reg:
    required: true

child-binding:
  description: RP1 pin controller pin group.
```

## dts/bindings/pinctrl/cypress,psoc6-pinctrl.yaml
```yaml
# Copyright (c) 2020, Linaro Limited
# Copyright (c) 2021, ATL Electronics
# SPDX-License-Identifier: Apache-2.0

description: |
  Cypress PSoC-6 Pinctrl container node

  The Cypress PSoC-6 pins implements following pin configuration option:

    * bias-pull-up
    * bias-pull-down
    * drive-open-drain
    * drive-open-source
    * drive-push-pull   (strong)
    * input-enable      (input-buffer)

  These options define devicetree flags that are converted to SoC flags at
  CY_PSOC6_PIN_FLAGS().

compatible: "cypress,psoc6-pinctrl"

include: base.yaml

properties:
  "#address-cells":
    required: true
    const: 1
  "#size-cells":
    required: true
    const: 1

child-binding:
  description: cypress pins

  include: pincfg-node.yaml

  properties:
    "cypress,pins":
      type: phandle-array
```
