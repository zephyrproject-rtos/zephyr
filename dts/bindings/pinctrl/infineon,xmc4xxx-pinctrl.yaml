## dts/bindings/pinctrl/infineon,xmc4xxx-pinctrl.yaml
```yaml
# Copyright (c) 2022, Andriy Gelman <andriy.gelman@gmail.com>
# SPDX-License-Identifier: Apache-2.0

description: |
  The Infineon XMC4XXX pin controller is responsible for connecting peripheral outputs
  to specific port/pins (also known as alternate functions) and configures pin properties.

  The pinctrl settings are referenced in a device tree peripheral node. For example in a UART
  node:

  &usic1ch1 {
      compatible = "infineon,xmc4xxx-uart";
      pinctrl-0 = <&uart_tx_p0_1_u1c1 &uart_rx_p0_0_u1c1>;
      pinctrl-names = "default";
      input-src = "DX0D";
      ...
  };

  pinctrl-0 is the phandle that stores the pin settings for two pins: &uart_tx_p0_1_u1c1
  and &uart_rx_p0_0_u1c1. These nodes are pre-defined and their naming convention is designed
  to help the user select the correct pin settings. Note the use of peripheral type,
  pin direction, port/pin number and USIC in the name.

  The pre-defined nodes only set the alternate function of the output pin. The
  configuration for the pin (i.e. drive strength) should be set in the board setup.
  The set of possible configurations are defined in the properties section below (in addition
  to the inherited property-allowlist list from pincfg-node.yaml).

  To create a new pin configuration, the user may append to the &pinctrl node, for example

  #include <zephyr/dt-bindings/pinctrl/xmc4xxx-pinctrl.h>
  &pinctrl {
      my_node_config: my_node_config {
      pinmux = <XMC4XXX_PINMUX_SET(0, 1, 2)>;
      drive-push-pull;
        ... other supported pin configurations ..
  };
  where XMC4XXX_PINMUX_SET(PORT, PIN, ALTERNATE_FUNCTION) is a helper macro for setting the
  alternate function for a given port/pin. Setting ALTERNATE_FUNCTION = 0 means that no
  alternate function is selected.

  The pinctrl driver only sets the alternate function for output pins. The input mux is
  handled by the peripheral drivers. For example the &usic1ch1 node has input-src property for
  this purpose. There are no pre-defined nodes for the input mux and this must be properly set
  by the user. Refer to the peripheral .yaml file (i.e. infineon,xmc4xxx-uart.yaml) and
  XMC4XXX documentation.

compatible: "infineon,xmc4xxx-pinctrl"

include: base.yaml

properties:
  "#address-cells":
    required: true
    const: 1
  "#size-cells":
    required: true
    const: 1

child-binding:
  description: Each child node defines the configuration for a particular state.

  include:
    - name: pincfg-node.yaml
      property-allowlist:
        - bias-pull-down
        - bias-pull-up
        - drive-push-pull
        - drive-open-drain
        - output-high
        - output-low

  properties:
    pinmux:
      description: |
        Encodes port/pin and alternate function. See helper macro XMC4XX_PINMUX_SET().
        Alternate function is only set for output pins; It selects  ALT1-ALT4
        output line in the GPIO element. The alternate function for input pins is
        handled separately by the peripheral. It is upto the peripheral to configure which
        input pin to use (For example see parameter input-src in infineon,xmc4xxx-uart.yaml).
      required: true
      type: int

    drive-strength:
      description: |
        Drive strength of the output pin. Following options as in XMC_GPIO_OUTPUT_STRENGTH
        See xmc4_gpio.h. This only has an effect if the pin is in drive-push-pull mode.
      required: true
      type: string
      enum:
        - "strong-sharp-edge"
        - "strong-medium-edge"
        - "strong-soft-edge"
        - "strong-slow-edge"
        - "medium"
        - "medium-unknown1-edge"
        - "medium-unknown2-edge"
        - "weak"

    invert-input:
      description: Inverts the input.
      type: boolean

    hwctrl:
      description: Pre-assigns hardware control of the pin to a certain peripheral.
      required: true
      type: string
      enum:
        - "disabled"
        - "periph1"
        - "periph2"
```

## dts/bindings/pinctrl/intel,s1000-pinmux.yaml
```yaml
# SPDX-License-Identifier: Apache-2.0
description: Intel S1000 pinmux

compatible: "intel,s1000-pinmux"

include: base.yaml

properties:
    reg:
      required: true

pinmux-cells:
  - pin
  - function
```

## dts/bindings/pinctrl/ite,it8xxx2-pinctrl-conf.yaml
```yaml
# Copyright (c) 2021 ITE Corporation. All Rights Reserved.
# SPDX-License-Identifier: Apache-2.0

description: ITE IT8XXX2 Pin-Mux Configuration

compatible: "ite,it8xxx2-pinctrl-conf"
child-binding:
    description: ITE Pinmux configuration child node
    properties:
        pinctrls:
            type: phandle-array
            required: true
            description: Pin alternate function selection
```

## dts/bindings/pinctrl/ite,it8xxx2-pinctrl-func.yaml
```yaml
# Copyright (c) 2022 ITE Corporation. All Rights Reserved.
# SPDX-License-Identifier: Apache-2.0

description: ITE IT8XXX2 Pin Controller

compatible: "ite,it8xxx2-pinctrl-func"

include: base.yaml

properties:
  func3-gcr:
    type: array

  func3-en-mask:
    type: array

  func3-ext:
    type: array
    description: |
      When the alternate setting is configured as func3, in addition to
      the setting of func3-gcr, some pins require external setting.

  func3-ext-mask:
    type: array

  func4-gcr:
    type: array

  func4-en-mask:
    type: array

  func5-gcr:
    type: array

  func5-en-mask:
    type: array

  volt-sel:
    type: array

  volt-sel-mask:
    type: array

  pp-od-mask:
    type: int
    description: |
      KSI[7:0] does not support push-pull and open-drain mode.
      If KSO[17:0] is in KBS mode, setting 1 selects open-drain mode,
      setting 0 selects push-pull mode.
      If KSO[15:0] is in GPIO mode, then this bit is always disabled.

  pullup-mask:
    type: int
    description: |
      If KSI[7:0]/KSO[15:0] is in KBS mode , setting 1 enables the internal
      pull-up (KSO[17:16] setting internal pull-up by GPIO port GPCR register).
      If KSI[7:0]/KSO[15:0] is in GPIO mode, then this bit is always disabled.

  gpio-group:
    type: boolean
    description: |
      Default setting pin configure to alternate mode for all GPIO group pins
      (include KSO[17:16]), otherwise setting pin configure to keyboard scan
      mode for KSI[7:0] and KSO[15:0] pins.

pinmux-cells:
  - pin
  - alt_func
```

## dts/bindings/pinctrl/ite,it8xxx2-pinctrl.yaml
```yaml
# Copyright (c) 2022 ITE Corporation. All Rights Reserved.
# SPDX-License-Identifier: Apache-2.0

description: |
    The ITE IT8XXX2 pin controller is a node responsible for controlling
    pin function selection and pin properties. For example, you can
    use this node to route UART1 RX and TX setting the alternate
    function on the pin.

    The node has the 'pinctrl' node label set in your SoC's devicetree,
    so you can modify it like this:

      &pinctrl {
              /* your modifications go here */
      };

    All device pin configurations should be placed in child nodes of the
    'pinctrl' node, as shown in this example:

      /* You can put this in places like a board-pinctrl.dtsi file in
       * your board directory, or a devicetree overlay in your application.
       */

      /* include pre-defined pins and functions for the SoC used by the board */
      #include <dt-bindings/pinctrl/it8xxx2-pinctrl.h>

      &pinctrl {
        /* configuration for I2C0 default state */
        i2c0_clk_pb3_default: i2c0_clk_pb3_default {
                pinmuxs = <&pinctrlb 3 IT8XXX2_ALT_FUNC_1>;
                gpio-voltage = "1p8";
        };
        i2c0_data_pb4_default: i2c0_data_pb4_default {
                pinmuxs = <&pinctrlb 4 IT8XXX2_ALT_FUNC_1>;
                gpio-voltage = "1v8";
        };
        /* configuration for UART0 default state */
        uart1_rx_pb0_default: uart1_rx_pb0_default {
                pinmuxs = <&pinctrlb 0 IT8XXX2_ALT_FUNC_3>;
                bias-pull-up;
        };
        uart1_tx_pb1_default: uart1_tx_pb1_default {
                pinmuxs = <&pinctrlb 1 IT8XXX2_ALT_FUNC_3>;
        };
      };

    The 'uart1_rx_pb0_default' child node encodes the pin configurations
    for a particular state of a device; in this case, the default
    (that is, active) state.

    To link pin configurations with a device, use a pinctrl-N property for some
    number N, like this example you could place in your board's DTS file:

      #include "board-pinctrl.dtsi"

      &uart0 {
        pinctrl-0 = <&uart1_rx_pb0_default &uart1_tx_pb1_default>;
        pinctrl-1 = <&uart1_rx_pb0_sleep &uart1_tx_pb1_sleep>;
        pinctrl-names = "default", "sleep";
      };

compatible: "ite,it8xxx2-pinctrl"

include: base.yaml

child-binding:
  description: |
      This binding gives a base representation of the ITE IT8XXX2 pins configuration.

  include:
    - name: pincfg-node.yaml
      property-allowlist:
        - bias-high-impedance
        - bias-pull-pin-default
        - bias-pull-up
        - bias-pull-down
        - input-enable
        - drive-push-pull
        - drive-open-drain

  properties:
    pinmuxs:
      required: true
      type: phandle-array
      description: |
          ITE IT8XXX2 pin's configuration (pinctrl node, pin and function).

    gpio-voltage:
      type: string
      description: |
          Pin input voltage selection 3.3V or 1.8V. All gpio pins support 3.3V.
          This property only needs to be configured if the board specifies a
          pin as 1.8V. So the default is 3.3V.
          kSI[7:0] and KSO[15:0] pins only support 3.3V.
      default: "3v3"
      enum:
        - "3v3"
        - "1v8"
```

## dts/bindings/pinctrl/ite,it8xxx2-pinmux.yaml
```yaml
# Copyright (c) 2020 ITE Corporation. All Rights Reserved.
# SPDX-License-Identifier: Apache-2.0

description: ITE IT8XXX2 pinmux node

compatible: "ite,it8xxx2-pinmux"

include: base.yaml

properties:
    reg:
      required: true

    func3_gcr:
        type: array
        required: true

    func3_en_mask:
        type: array
        required: true

    func4_gcr:
        type: array
        required: true

    func4_en_mask:
        type: array
        required: true

pinctrl-cells:
  - pin
  - alt_func
```

## dts/bindings/pinctrl/microchip,dspic33-pinctrl.yaml
```yaml
description: |
  Microchip dsPIC33 pin controller

compatible: "microchip,dspic33-pinctrl"

include: base.yaml

properties:
  reg:
    required: true

  "#address-cells":
    const: 1

  "#size-cells":
    const: 1

child-binding:
  description: Pin configuration node
  properties:
    pinmux:
      description: |
        Pin multiplexing configuration for this group.
        Multiple pins (like TX/RX) can be grouped inside one node.
      required: true
      type: int
```

## dts/bindings/pinctrl/microchip,pic32cxsg-pinctrl.yaml
```yaml
# Copyright (c) 2024 Microchip
# SPDX-License-Identifier: Apache-2.0

description: |
  Microchip PIC32CXSG Pinctrl container node

  The Microchip PIC32CXSG pin controller is a singleton node responsible for controlling
  pin function selection and pin properties. For example, you can use this node
  to route SERCOM0 as UART were RX to pin PAD1 and enable the pull-up resistor
  on the pin.

  The node has the 'pinctrl' node label set in your SoC's devicetree, so you can
  modify it like this:

    &pinctrl {
            /* your modifications go here */
    };

  All device pin configurations should be placed in child nodes of the 'pinctrl'
  node, as shown in this example:

    /** You can put this in places like a <board>-pinctrl.dtsi file in
      * your board directory, or a devicetree overlay in your application.
      */

    /** include pre-defined combinations for the SoC variant used by the board */
    #include <dt-bindings/pinctrl/microchip_pic32cxsg_pinctrl.h>

    &pinctrl {
      /* configuration for the usart0 "default" state */
      sercom0_uart_default: sercom0_uart_default {
        /* group 1 */
        group1 {
          /* configure PA6 as USART0 TX and PA8 as USART0 CTS */
          pinmux = <PA5D_SERCOM0_PAD1>, <PA6D_SERCOM0_PAD2>;
        };
        /* group 2 */
        group2 {
          /* configure PA5 as USART0 RX and PA7 as USART0 RTS */
          pinmux = <PA4D_SERCOM0_PAD0>, <PA7D_SERCOM0_PAD3>;
          /* both PA5 and PA7 have pull-up enabled */
          bias-pull-up;
        };
      };
    };

  The 'usart0_default' child node encodes the pin configurations for a
  particular state of a device; in this case, the default (that is, active)
  state.

  As shown, pin configurations are organized in groups within each child node.
  Each group can specify a list of pin function selections in the 'pinmux'
  property.

  A group can also specify shared pin properties common to all the specified
  pins, such as the 'bias-pull-up' property in group 2. Here is a list of
  supported standard pin properties:

  - bias-pull-up: Enable pull-up resistor.
  - bias-pull-down: Enable pull-down resistor.
  - drive-strength: Increase sink current.
  - input-enable: Enable input on pin.
  - output-enable: Enable output on a pin without actively driving it.

  To link pin configurations with a device, use a pinctrl-N property for some
  number N, like this example you could place in your board's DTS file:

    #include "board-pinctrl.dtsi"

    &usart0 {
          pinctrl-0 = <&usart0_default>;
          pinctrl-names = "default";
    };

compatible: "microchip,pic32cxsg-pinctrl"

include: base.yaml

properties:
  "#address-cells":
    required: true
    const: 1
  "#size-cells":
    required: true
    const: 1

child-binding:
  description: |
    Each child node defines the configuration for a particular state.
  child-binding:
    description: |
      The grandchild nodes group pins that share the pic32cxsg pin configuration.

    include:
      - name: pincfg-node.yaml
        property-allowlist:
          - bias-pull-up
          - bias-pull-down
          - drive-strength
          - input-enable
          - output-enable

    properties:
      pinmux:
        required: true
        type: array
        description: |
          An array of pins sharing the pic32cxsg group properties. The pins should
          be defined using pre-defined macros or, alternatively, using the
          SAM_PINCTRL utility macros depending on the pinmux model used by the
          SoC series.
      drive-strength:
        enum:
          - 0
          - 1
        default: 0
        description: |
          The drive strength controls the output driver strength of an I/O pin
          configured as an output.
            0: Pin drive strength is set to normal drive strength.
            1: Pin drive strength is set to stronger drive strength.
```

## dts/bindings/pinctrl/microchip,pic32cxsg-pinmux.yaml
```yaml
description: Microchip PIC32CXSG PINMUX

compatible: "microchip,pic32cxsg-pinmux"

include: base.yaml

properties:
  reg:
    required: true

pinmux-cells:
  - pin
  - function
```
