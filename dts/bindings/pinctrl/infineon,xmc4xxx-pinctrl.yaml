## dts/bindings/pinctrl/microchip,pps-g1-pinctrl.yaml
```yaml
# Copyright (c) 2025 Microchip
# SPDX-License-Identifier: Apache-2.0

description: |
  MICROCHIP Pinctrl container node

  The Microchip PIC32CX_BZ2 pin controller is a singleton node responsible for controlling
  pin function selection and pin properties. For example, you can use this node
  to route SERCOM0 as UART were RX to pin PAD1 and enable the pull-up resistor
  on the pin.

  The node has the 'pinctrl' node label set in your SoC's devicetree, so you can
  modify it like this:

    &pinctrl {
            /* your modifications go here */
    };

  All device pin configurations should be placed in child nodes of the 'pinctrl'
  node, as shown in this example:

    /** You can put this in places like a <board>-pinctrl.dtsi file in
      * your board directory, or a devicetree overlay in your application.
      */

    /** include pre-defined combinations for the SoC variant used by the board */
    #include <dt-bindings/pic32c/pic32cx_bz/bz25/pic32cx1012bz25048-pinctrl.h>

    &pinctrl {
      /* configuration for the usart0 "default" state */
      sercom0_uart_default: sercom0_uart_default {
        /* group 1 */
        group1 {
          /* configure PA5 as USART1 RX and PA6 as USART1 TX */
          pinmux = <PA5_SCOM1P0_IN>, <PA6_SCOM1P1_OUT>;
        };
        /* group 2 */
        group2 {
          pinmux = <PA7_SCOM0P0_IN>, <PA8_SCOM0P2_IN>;
          /* both Pins have pull-up enabled (Input) */
          bias-pull-up;
          input-enable;
        };
         /* group 2 */
        group3 {
          pinmux = <PA3_SCOM0P2_OUT>, <PA4_SCOM1P0_OUT>;
          /* both Pins have open-drain enabled (Output) */
          drive-open-drain;
          output-enable;
        };
      };
    };

  To link pin configurations with a device, use a pinctrl-N property for some
  number N, like this example you could place in your board's DTS file:

    #include "board-pinctrl.dtsi"

    &usart0 {
          pinctrl-0 = <&usart0_default>;
          pinctrl-names = "default";
    };

compatible: "microchip,pps-g1-pinctrl"

include: base.yaml

properties:
  "#address-cells":
    required: true
    const: 1

child-binding:
  description: |
    Each child node defines the configuration for a particular state.
  child-binding:
    description: |
      The grandchild nodes group pins that share the same pin configuration.

    include:
      - name: pincfg-node.yaml
        property-allowlist:
          - bias-pull-up
          - bias-pull-down
          - drive-open-drain
          - input-enable
          - output-enable

    properties:
      pinmux:
        required: true
        type: array
        description: |
          An array of pins sharing the same group properties. The pins should
          be defined using pre-defined macros or, alternatively, using the
          MCHP_PINMUX utility macros depending on the pinmux model used by the
          SoC series.
```

## dts/bindings/pinctrl/microchip,sama7g5-pinctrl.yaml
```yaml
# Copyright (C) 2025 Microchip Technology Inc. and its subsidiaries
#
# SPDX-License-Identifier: Apache-2.0
#

description: |
  Microchip SAMA7G5 Pinctrl container node

compatible: "microchip,sama7g5-pinctrl"

include: base.yaml

properties:
  reg:
    required: true

child-binding:
  description: |
    Each child node defines the configuration for a particular state.
  child-binding:
    description: |
      The grandchild nodes group pins that share the same pin configuration.

    include:
      - name: pincfg-node.yaml
        property-allowlist:
          - bias-disable
          - bias-pull-down
          - bias-pull-up
          - drive-open-drain

    properties:
      pinmux:
        required: true
        type: array
        description: |
          An array of pins sharing the same group properties. The pins should
          be defined using pre-defined macros used by the SoC series.
```

## dts/bindings/pinctrl/microchip,xec-pinctrl.yaml
```yaml
# Copyright (c) 2020 Linaro Limited
# Copyright (c) 2021 Microchip Technology Inc.
# SPDX-License-Identifier: Apache-2.0

description: |
    Microchip XEC Pin Controller

    Based on pincfg-node.yaml binding.
    The MCHP XEC pin controller is a singleton node responsible for controlling
    pin function selection and pin properties. For example, you can use this
    node to select peripheral pin functions.

    The node has the 'pinctrl' node label set in your SoC's devicetree,
    so you can modify it like this:

      &pinctrl {
              /* your modifications go here */
      };

    All device pin configurations should be placed in child nodes of the
    'pinctrl' node, as in the spi0 example shown at the end:

    A group can also specify shared pin properties common to all the specified
    pins, such as the 'bias-pull-up' property in group 2. Here is a list of
    supported standard pin properties:

    - bias-disable: Disable pull-up/down (default behavior, not required).
    - bias-pull-down: Enable pull-down resistor.
    - bias-pull-up: Enable pull-up resistor.
    - drive-push-pull: Output driver is push-pull (default, not required).
    - drive-open-drain: Output driver is open-drain.
    - output-high: Set output state high when pin configured.
    - output-low: Set output state low when pin configured.

    Custom pin properties for drive strength and slew rate are available:
    - drive-strength
    - slew-rate

    Driver strength and slew rate hardware defaults vary by SoC and pin.

    An example for MEC172x family, include the chip level pinctrl
    DTSI file in the board level DTS:

      #include <microchip/mec172x/mec172xnsz-pinctrl.dtsi>

    We want to use the shared SPI port of the MEC172x QMSPI controller
    and want the chip select 0 to be open-drain.

    To change a pin's pinctrl default properties add a reference to the
    pin in the board's DTS file and set the properties.

      &spi0 {
        pinctrl-0 = < &shd_cs0_n_gpio055
                      &shd_clk_gpio056
                      &shd_io0_gpio223
                      &shd_io1_gpio224
                      &shd_io3_gpio016 >;
        pinctrl-names = "default";
      }

      &shd_cs0_n_gpio055 {
        drive-open-drain;
      };

compatible: "microchip,xec-pinctrl"

include: base.yaml

properties:
  reg:
    required: true

child-binding:
  description: |
    This binding gives a base representation of the Microchip XEC pins
    configuration

  include:
    - name: pincfg-node.yaml
      property-allowlist:
        - bias-disable
        - bias-pull-down
        - bias-pull-up
        - drive-push-pull
        - drive-open-drain
        - low-power-enable
        - output-disable
        - output-enable
        - output-high
        - output-low

  properties:
    pinmux:
      type: int
      required: true
      description: Pinmux selection

    drive-strength:
      type: int
      description: |
        GPIO pin output driver strength. Value range is 0 to 4.
        Refer to the part data sheet if the pin is PIO-12 or PIO-24.
        Value 0 is no change.
        PIO-12: 1(2 mA), 2(4 mA), 3(8 mA), or 4(12 mA).
        PIO-24: 1(4 mA), 2(8 mA), 3(16 mA), or 4(24 mA).

    slew-rate:
      type: int
      description: |
        GPIO pin slew rate. Value range is 0 to 2.
        Value 0 is no change.
        1 = fast slew rate(default), 2 = slow (half-speed) slew rate.

    microchip,output-func-invert:
      type: boolean
      description:
        Invert polarity of an output alternate function. Input functions
        are not affected.
```

## dts/bindings/pinctrl/microchip,xec-pinmux.yaml
```yaml
# SPDX-License-Identifier: Apache-2.0

description: Microchip XEC Pinmux node

compatible: "microchip,xec-pinmux"

include: base.yaml

child-binding:
  description: pinmux child node
  properties:
    ph-reg:
      type: phandle
      required: true

    port-num:
      type: int
      required: true
      description: |
        Zero based GPIO port number. Pin group 000 - 036 is port 0,
        040 - 076 is port 1, etc.
```

## dts/bindings/pinctrl/nordic,nrf-pinctrl.yaml
```yaml
# Copyright (c) 2021 Nordic Semiconductor ASA
# SPDX-License-Identifier: Apache-2.0

description: |
    The nRF pin controller is a singleton node responsible for controlling
    pin function selection and pin properties. For example, you can use this
    node to route UART0 RX to pin P0.1 and enable the pull-up resistor on the
    pin.

    The node has the 'pinctrl' node label set in your SoC's devicetree,
    so you can modify it like this:

      &pinctrl {
              /* your modifications go here */
      };

    All device pin configurations should be placed in child nodes of the
    'pinctrl' node, as shown in this example:

      /* You can put this in places like a board-pinctrl.dtsi file in
       * your board directory, or a devicetree overlay in your application.
       */
      &pinctrl {
        /* configuration for uart0 device, default state */
        uart0_default: uart0_default {
          /* group 1 ('group1' name is arbitrary) */
          group1 {
            /* configure P0.1 as UART_TX and P0.2 as UART_RTS */
            psels = <NRF_PSEL(UART_TX, 0, 1)>, <NRF_PSEL(UART_RTS, 0, 2)>;
          };
          /* group 2 */
          group2 {
            /* configure P0.3 as UART_RX and P0.4 as UART_CTS */
            psels = <NRF_PSEL(UART_RX, 0, 3)>, <NRF_PSEL(UART_CTS, 0, 4)>;
            /* both P0.3 and P0.4 are configured with pull-up */
            bias-pull-up;
          };
        };
      };

    The 'uart0_default' child node encodes the pin configurations for a
    particular state of a device; in this case, the default (that is, active)
    state. You would specify the low-power configuration for the same device
    in a separate child node.

    As shown, pin configurations are organized in groups within each child node.
    Each group can specify a list of pin function selections in the 'psels'
    property. The NRF_PSEL macro is used to specify a pin function selection.
    If a pin needs to be explicitly disconnected, there is also the
    NRF_PSEL_DISCONNECTED macro.
    Available pin functions can be found in the
    include/zephyr/dt-bindings/pinctrl/nrf-pinctrl.h header file.

    A group can also specify shared pin properties common to all the specified
    pins, such as the 'bias-pull-up' property in group 2. Here is a list of
    supported standard pin properties:

    - bias-disable: Disable pull-up/down (default behavior, not required).
    - bias-pull-up: Enable pull-up resistor.
    - bias-pull-down: Enable pull-down resistor.
    - low-power-enable: Configure pin as an input with input buffer
      disconnected.

    Note that bias options are mutually exclusive.

    To link this pin configuration with a device, use a pinctrl-N property
    for some number N, like this example you could place in your board's DTS
    file:

       #include "board-pinctrl.dtsi"

       &uart0 {
             pinctrl-0 = <&uart0_default>;
             pinctrl-names = "default";
       };

compatible: "nordic,nrf-pinctrl"

include: base.yaml

child-binding:
  description: |
    nRF pin controller pin configuration state nodes.
  child-binding:
    description: |
      nRF pin controller pin configuration group.

    include:
      - name: pincfg-node.yaml
        property-allowlist:
          - bias-disable
          - bias-pull-down
          - bias-pull-up
          - low-power-enable

    properties:
      psels:
        required: true
        type: array
        description: |
          An array of pins sharing the same group properties. The pins should
          be defined using the NRF_PSEL utility macro that encodes the port,
          pin and function. NRF_PSEL_DISCONNECTED is also available to explicitly
          disconnect a pin.

      nordic,drive-mode:
        type: int
        default: 0
        description: |
          Pin output drive mode. Available drive modes are pre-defined in
          nrf-pinctrl.h. Note that extra modes may not be available on certain
          devices. Defaults to standard mode for 0 and 1 (NRF_DRIVE_S0S1), the
          SoC default, except for the "nordic,nrf-twi" and "nordic,nrf-twim"
          nodes where NRF_DRIVE_S0S1 is always overridden with NRF_DRIVE_S0D1
          (standard '0', disconnect '1').

      nordic,invert:
        type: boolean
        description: |
          Invert pin polarity (set the active state to low).
          Only valid for PWM channel output pins.
```

## dts/bindings/pinctrl/nordic-clock-enable.yaml
```yaml
# Copyright (c) 2024 Nordic Semiconductor ASA
# SPDX-License-Identifier: Apache-2.0

properties:
  nordic,clock-enable:
    type: array
    description: |
      List of signals that require clock enablement (CLOCKPIN).
```

## dts/bindings/pinctrl/nordic-clockpin.yaml
```yaml
# Copyright (c) 2024 Nordic Semiconductor ASA
# SPDX-License-Identifier: Apache-2.0

properties:
  nordic,clockpin-enable:
    type: array
    description: |
      List of signals that require CLOCKPIN setting enablement.
```

## dts/bindings/pinctrl/nuvoton,nct-pinctrl-conf.yaml
```yaml
# Copyright (c) 2025 Nuvoton Technology Corporation.
# SPDX-License-Identifier: Apache-2.0

description: |
  Nuvoton NCT Pin-Mux Configuration
  Configuration map from Nuvoton NCT GPIO to pinmux controller
  (SCFG) driver instances.

compatible: "nuvoton,nct-pinctrl-conf"
child-binding:
  description: NCT Pinmux configuration child node
  properties:
    alts:
      type: phandle-array
      required: true
      description: A SCFG ALT (Alternative controllers) specifier for pinmuxing of nct esio
```

## dts/bindings/pinctrl/nuvoton,nct-pinctrl-def.yaml
```yaml
# Copyright (c) 2025 Nuvoton Technology Corporation.
# SPDX-License-Identifier: Apache-2.0

description: Nuvoton, NCT Default Pins Configurations

compatible: "nuvoton,nct-pinctrl-def"

include: [base.yaml]

properties:
  pinmux:
    type: phandles
    required: true
    description: list of configurations of pinmux controllers need to set
```
