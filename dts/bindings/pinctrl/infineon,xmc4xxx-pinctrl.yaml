## dts/bindings/pinctrl/nuvoton,nct-pinctrl.yaml
```yaml
# Copyright (c) 2025 Nuvoton Technology Corporation.
# SPDX-License-Identifier: Apache-2.0

description: |
  The Nuvoton pin controller is a singleton node responsible for controlling
  pin function selection and pin properties. For example, you can use these
  nodes to select peripheral pin functions.

  Here is a list of supported standard pin properties:
    - bias-pull-down: Enable pull-down resistor.
    - bias-pull-up: Enable pull-up resistor.

  Custom pin properties for nct series are available also:
    - pinmux-gpio: Inverse pinmux back to gpio

  An example for NCT6 family, include the chip level pinctrl DTSI file in the
  board level DTS:

    #include <nuvoton/nct/nct6/nct6-pinctrl.dtsi>

  We want to use the I2C0_0 port of the NCT6694B controller and enable the
  internal 3.3V pull-up if its i2c frequency won't exceed 400kHz.

  To change a pin's pinctrl default properties, add a reference to the
  pin in the board's DTS file and set the properties as below:

    &i2c0_0_sda_scl_gpb4_b5 {
      bias-pull-up; /* Enable internal pull-up for i2c0_0 */
      pinmux-locked; /* Lock pinmuxing */
    };

    &i2c0_0 {
      pinctrl-0 = <&i2c0_0_sda_scl_gpb4_b5>;
      pinctrl-names = "default";
    }

compatible: "nuvoton,nct-pinctrl"

include: base.yaml

child-binding:
  description: |
    NCT pin controller pin configuration nodes

  include:
    - name: pincfg-node.yaml
      property-allowlist:
        - bias-pull-down
        - bias-pull-up
        - drive-open-drain

  properties:
    pinmux:
      type: phandle
      description: Configurations of pinmux selection
    dev-ctl:
      type: array
      description: Configurations of device control such as tri-state, io type and so on.
    periph-pupd:
      type: array
      description: |
        A map to PUPD_ENn register/bit that enable pull-up/down of NPCX peripheral devices.
        Please don't overwrite this property in the board-level DT driver.
    psl-offset:
      type: int
      description: |
        Offset to PSL_CTS register that is used for PSL input's status and detection mode.
        Please don't overwrite this property in the board-level DT driver.
    psl-polarity:
      type: phandle
      description: |
        A map to DEVALTn that configures detection polarity of PSL input pads.
        Please don't overwrite this property in the board-level DT driver.
    pinmux-locked:
      type: boolean
      description: Lock pinmux selection
    pinmux-gpio:
      type: boolean
      description: Inverse pinmux selection to GPIO
    psl-in-mode:
      type: string
      description: |
        The assertion detection mode of PSL input selection
        - "level": Select the detection mode to level detection
        - "edge": Select the detection mode to edge detection
      enum:
        - "level"
        - "edge"
    psl-in-pol:
      type: string
      description: |
        The assertion detection polarity of PSL input selection
        - "low-falling": Select the detection polarity to low/falling
        - "high-rising": Select the detection polarity to high/rising
      enum:
        - "low-falling"
        - "high-rising"
```

## dts/bindings/pinctrl/nuvoton,npcm-pinctrl-conf.yaml
```yaml
# Copyright (c) 2024 Nuvoton Technology Corporation.
# SPDX-License-Identifier: Apache-2.0

description: |
  Nuvoton NPCM Pin-Mux Configuration
  Configuration map from Nuvoton NPCM GPIO to pinmux controller
  (SCFG) driver instances.

compatible: "nuvoton,npcm-pinctrl-conf"
child-binding:
  description: NPCM Pinmux configuration child node
  properties:
    alts:
      type: phandle-array
      required: true
      description: A SCFG ALT (Alternative controllers) specifier for pinmuxing of npcm esio
```

## dts/bindings/pinctrl/nuvoton,npcm-pinctrl-def.yaml
```yaml
# Copyright (c) 2024 Nuvoton Technology Corporation.
# SPDX-License-Identifier: Apache-2.0

description: Nuvoton, NPCM Default Pins Configurations

compatible: "nuvoton,npcm-pinctrl-def"

include: [base.yaml]

properties:
  pinmux:
    type: phandles
    required: true
    description: list of configurations of pinmux controllers need to set
```

## dts/bindings/pinctrl/nuvoton,npcx-leakage-io.yaml
```yaml
# Copyright (c) 2022 Nuvoton Technology Corporation.
# SPDX-License-Identifier: Apache-2.0

description: Nuvoton, NPCX power leakage IOs

compatible: "nuvoton,npcx-leakage-io"

include: [base.yaml]

properties:
  leak-gpios:
    type: phandle-array
    required: false
    description: |
      Array of IOs that have leakage current. The user can overwrite this
      property at the board level DT file to save more power consumption.
```

## dts/bindings/pinctrl/nuvoton,npcx-lvolctrl-conf.yaml
```yaml
# Copyright (c) 2020 Nuvoton Technology Corporation.
# SPDX-License-Identifier: Apache-2.0

description: |
  Nuvoton NPCX7 Low-Voltage level detection configuration map
  between Nuvoton NPCX GPIO and low-voltage controller (LV_GPIO_CTL)
  driver instances.

compatible: "nuvoton,npcx-lvolctrl-conf"

child-binding:
  description: Child node to present the mapping between GPIO pad and its low-voltage support
  properties:
    lvols:
      type: phandle-array
      required: true
      description: list of configurations map between io and low-voltage controllers
```

## dts/bindings/pinctrl/nuvoton,npcx-lvolctrl-def.yaml
```yaml
# Copyright (c) 2020 Nuvoton Technology Corporation.
# SPDX-License-Identifier: Apache-2.0

description: Nuvoton, NPCX Default Low-Voltage Configurations

compatible: "nuvoton,npcx-lvolctrl-def"

include: [base.yaml]

properties:
    lvol-io-pads:
        type: phandles
        required: false
        description: list of low-voltage configurations that need to set by default
```

## dts/bindings/pinctrl/nuvoton,npcx-pinctrl-conf.yaml
```yaml
# Copyright (c) 2020 Nuvoton Technology Corporation.
# SPDX-License-Identifier: Apache-2.0

description: |
  Nuvoton NPCX7 Pin-Mux Configuration
  Configuration map from Nuvoton NPCX GPIO to pinmux controller
  (SCFG) driver instances.

compatible: "nuvoton,npcx-pinctrl-conf"
child-binding:
    description: NPCX Pinmux configuration child node
    properties:
        alts:
            type: phandle-array
            required: true
            description: A SCFG ALT (Alternative controllers) specifier for pinmuxing of npcx ec
```
