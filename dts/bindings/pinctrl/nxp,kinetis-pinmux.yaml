## dts/bindings/pinctrl/nxp,mcux-rt11xx-pinctrl.yaml
```yaml
# Copyright (c) 2022 NXP
# SPDX-License-Identifier: Apache-2.0

description: |
  The node has the 'pinctrl' node label set in MCUX RT SoC's devicetree. These
  nodes can be autogenerated using the MCUXpresso config tools combined with
  the rt_dts_gen.py script in NXP's HAL. The mux, mode, input, daisy, and cfg
  fields in a group select the pins to be configured, and the remaining
  devicetree properties set configuration values for those pins
  for example, here is an group configuring LPUART1 pins:

  group0 {
      pinmux = <&iomuxc_gpio_ad_25_lpuart1_rxd>,
          <&iomuxc_gpio_ad_24_lpuart1_txd>;
      drive-strength = "high";
      slew-rate = "slow";
  };

  This will select GPIO_AD_25 as LPUART1 RX, and GPIO_AD_24 as LPUART1 TX.
  Both pins will be configured with a weak latch, high drive strength,
  and slow slew rates.
  Note that the soc level iomuxc dts file can be examined to find the possible
  pinmux options. Here are the affects of each property on the
  IOMUXC SW_PAD_CTL register:
  drive-open-drain: ODE/ODE_LPSR=1
  input-enable: SION=1 (in SW_MUX_CTL_PAD register)
  bias-pull-down: PUE=1, PUS=0
  bias-pull-up: PUE=1, PUS=1
  bias-disable: PULL=11 (in supported registers)
  slew-rate: SRE=<enum_idx>
  drive-strength: DSE=<enum_idx>

  If only required properties are supplied, the pin will have the following
  configuration:
  ODE=0
  SION=0
  PUE=0
  PUS=0
  SRE=0
  DSE=0

  For registers with PDVR and PULL fields, these are the defaults:
  PULL=11
  PDRV=0


compatible: "nxp,mcux-rt11xx-pinctrl"

include: base.yaml

child-binding:
  description: MCUX RT pin controller pin group
  child-binding:
    description: |
      MCUX RT pin controller pin configuration node.

    include:
      - name: pincfg-node.yaml
        property-allowlist:
          - drive-open-drain
          - input-enable
          - bias-disable
          - bias-pull-down
          - bias-pull-up

    properties:
      pinmux:
        required: true
        type: phandles
        description: |
          Pin mux selections for this group. See the soc level iomuxc DTSI file
          for a defined list of these options.
      drive-strength:
        type: string
        enum:
          - "normal"
          - "high"
        description: |
          Pin output drive strength. Sets the DSE field in the IOMUXC peripheral.
          0 (normal) - sets pin to normal drive strength
          1 (high) - sets pin to high drive strength
      slew-rate:
        type: string
        enum:
          - "fast"
          - "slow"
        description: |
          Select slew rate for pin. Corresponds to SRE field in IOMUXC peripheral
          0 (fast) — Fast Slew Rate
          1 (slow) — Slow Slew Rate
```

## dts/bindings/pinctrl/nxp,rt-iocon-pinctrl.yaml
```yaml
# Copyright 2022, NXP
# SPDX-License-Identifier: Apache-2.0

description: |
  RT600/RT500 pin control node. This node defines pin configurations in pin
  groups, and has the 'pinctrl' node identifier in the SOC's devicetree. Each
  group within the pin configuration defines a peripheral's pin configuration.
  Each numbered subgroup represents pins with shared configuration for that
  peripheral. The 'pinmux' property of each group selects the pins to be
  configured with these properties. For example, here is a configuration
  for FLEXCOMM0 pins:

  pinmux_flexcomm0_usart: pinmux_flexcomm0_usart {
    group0 {
      pinmux = <FC0_TXD_SCL_MISO_WS_PIO0_1>,
              <FC0_RXD_SDA_MOSI_DATA_PIO0_2>;
      slew-rate = "normal";
      drive-strength = "normal";
    };
  };

  If only the required properties are supplied, the ICON_PIO register will
  be assigned the following values:
  IOCON_FUNC=<pin mux selection>,
  IOCON_PUPDENA = 0,
  IOCON_PUPDSEL = 0,
  IOCON_IBENA = 0,
  IOCON_SLEWRATE = <slew-rate selection>,
  IOCON_FULLDRIVE = <drive-strength selection>,
  IOCON_AMENA = 0,
  IOCON_ODENA = 0,
  IOCON_IIENA = 0,

  Note the inherited pinctrl properties defined below have the following effects:
  drive-open-drain: IOCON_ODENA=1
  bias-pull-up: IOCON_PUPDENA=1, IOCON_PUPSEL=1
  bias-pull-down: IOCON_PUPDENA=1, IOCON_PUPSEL=0
  input-enable: IOCON_IBENA=1

compatible: "nxp,rt-iocon-pinctrl"

include:
  - name: base.yaml
  - name: pincfg-node-group.yaml
    child-binding:
      child-binding:
        property-allowlist:
          - drive-open-drain
          - bias-pull-up
          - bias-pull-down
          - input-enable

child-binding:
  description: iMX RT IOCON pin controller pin group
  child-binding:
    description: |
      iMX RT IOCON pin controller pin configuration node
    properties:
      pinmux:
        required: true
        type: array
        description: |
          Pin mux selection for this group. See the SOC level pinctrl header
          file in NXP's HAL for a defined list of these options.
      slew-rate:
        required: true
        type: string
        enum:
          - "normal"
          - "slow"
        description: |
          Pin output slew rate. Sets the SLEWRATE field in the IOCON register.
          0 SLEWRATE_0- normal mode, output slew rate is standard
          1 SLEWRATE_1- slow mode, output slew rate is slower
      drive-strength:
        required: true
        type: string
        enum:
          - "normal"
          - "high"
        description: |
          Pin output drive strength. Sets the FULLDRIVE field in the
          IOCON register.
          0 FULLDRIVE_0- Normal output drive mode
          1 FULLDRIVE_1- Full output drive mode, output strength is twice
          the drive strength of normal drive mode.
      nxp,invert:
        type: boolean
        description: |
          Invert the pin input logic level
      nxp,analog-mode:
        type: boolean
        description: |
          Set the pin to analog mode. Sets AMENA=1
```

## dts/bindings/pinctrl/nxp,rw-iomux-pinctrl.yaml
```yaml
# Copyright 2022, NXP
# SPDX-License-Identifier: Apache-2.0

description: |
  RW61x pin control node. This node defines pin configurations in pin
  groups, and has the 'pinctrl' node identifier in the SOC's devicetree. Each
  group within the pin configuration defines a peripheral's pin configuration.
  Each numbered subgroup represents pins with shared configuration for that
  peripheral. The 'pinmux' property of each group selects the pins to be
  configured with these properties. For example, here is a configuration
  for FLEXCOMM0 pins:

  pinmux_flexcomm0_usart: pinmux_flexcomm0_usart {
    group0 {
      pinmux = <IO_MUX_FC0_USART_DATA_IO2>,
              <IO_MUX_FC0_USART_DATA_IO3>;
      slew-rate = "normal";
    };
  };

  If only the required properties are supplied, the pin will be configured
  as normal drive strength and no pull. This corresponds to the following
  pin settings:
  PAD_PU_PD_ENx = (0x0 << pin_index)
  SR_CONFIGx = (0x2 << pin_index)

  Note

  Note the inherited pinctrl properties defined below have the following effects:
  bias-pull-up: PAD_PU_PD_ENx= (0x1 << pin_index)
  bias-pull-down: PAD_PU_PD_ENx= (0x10 << pin_index)

compatible: "nxp,rw-iomux-pinctrl"

include:
  - name: base.yaml

child-binding:
  description: iMX RW IOMUX pin controller pin group
  child-binding:
    description: |
      iMX RW IOMUX pin controller pin configuration node
    include:
      - name: pincfg-node.yaml
        property-allowlist:
          - bias-pull-up
          - bias-pull-down
    properties:
      pinmux:
        required: true
        type: array
        description: |
          Pin mux selection for this group. See the SOC level pinctrl header
          file in NXP's HAL for a defined list of these options.
      slew-rate:
        required: true
        type: string
        enum:
          - "slow"
          - "normal"
          - "fast"
          - "ultra"
        description: |
          Pin output slew rate. Sets the GPIOxx_SR field in the SR_CONFIGx
          register.
          0 - slow slew rate
          1 - normal slew rate
          2 - fast slew rate
          3 - fastest slew rate (ultra)
```

## dts/bindings/pinctrl/nxp,s32k3-pinctrl.yaml
```yaml
# Copyright 2023 NXP
# SPDX-License-Identifier: Apache-2.0

description: |
  NXP S32 pinctrl node for S32K3 SoCs.

  The NXP S32 pin controller is a singleton node responsible for controlling
  the pin function selection and pin properties. This node, labeled 'pinctrl' in
  the SoC's devicetree, will define pin configurations in pin groups. Each group
  within the pin configuration defines the pin configuration for a peripheral,
  and each numbered subgroup in the pin group defines all the pins for that
  peripheral with the same configuration properties. The 'pinmux' property in
  a group selects the pins to be configured, and the remaining properties set
  configuration values for those pins.

  For example, to configure the pinmux for UART0, modify the 'pinctrl' from your
  board or application devicetree overlay as follows:

    /* Include the SoC package header containing the predefined pins definitions */
    #include <nxp/s32/S32K344-257BGA-pinctrl.h>

    &pinctrl {
      uart0_default: uart0_default {
        group1 {
          pinmux = <PTA3_LPUART0_TX_O>;
          output-enable;
        };
        group2 {
          pinmux = <PTA28_LPUART0_RX>;
          input-enable;
        };
      };
    };

  The 'uart0_default' node contains the pin configurations for a particular state
  of a device. The 'default' state is the active state. Other states for the same
  device can be specified in separate child nodes of 'pinctrl'.

  In addition to 'pinmux' property, each group can contain other properties such as
  'bias-pull-up' or 'slew-rate' that will be applied to all the pins defined in
  'pinmux' array. To enable the input buffer use 'input-enable' and to enable the
  output buffer use 'output-enable'.

  To link the pin configurations with UART0 device, use pinctrl-N property in the
  device node, where 'N' is the zero-based state index (0 is the default state).
  Following previous example:

    &uart0 {
      pinctrl-0 = <&uart0_default>;
      pinctrl-names = "default";
      status = "okay";
    };

  If only the required properties are supplied, the pin configuration register
  will be assigned the following values:
    - input and output buffers disabled
    - internal pull not enabled
    - slew rate "fastest"
    - invert disabled
    - drive strength disabled.

  Additionally, following settings are currently not supported and default to
  the values indicated below:
    - Safe Mode Control (disabled)
    - Pad Keeping (disabled)
    - Input Filter (disabled).

compatible: "nxp,s32k3-pinctrl"

include: base.yaml

child-binding:
  description: NXP S32 pin controller pin group.
  child-binding:
    description: NXP S32 pin controller pin configuration node.

    include:
      - name: pincfg-node.yaml
        property-allowlist:
          - bias-disable
          - bias-pull-down
          - bias-pull-up
          - input-enable
          - output-enable

    properties:
      pinmux:
        required: true
        type: array
        description: |
          An array of pins sharing the same group properties. The pins must be
          defined using the S32_PINMUX macros that encodes all the pin muxing
          information in a 32-bit value.

      slew-rate:
        type: string
        enum:
          - "fastest"
          - "slowest"
        default: "fastest"
        description: |
          Slew rate control. Can be either slowest or fastest setting.
          See the SoC reference manual for applicability of this setting.

      nxp,invert:
        type: boolean
        description: |
          Invert the signal selected by Source Signal Selection (SSS) before
          transmitting it to the associated destination (chip pin or module port).

      nxp,drive-strength:
        type: boolean
        description: |
          Drive strength enable.
          See the SoC reference manual for applicability of this setting.
```
