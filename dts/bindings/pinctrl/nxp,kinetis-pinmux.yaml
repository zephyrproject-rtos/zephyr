## dts/bindings/pinctrl/nxp,s32ze-siul2-pinctrl.yaml
```yaml
# Copyright 2022, 2024-2025 NXP
# SPDX-License-Identifier: Apache-2.0

description: |
  NXP SIUL2 Pin Controller for S32Z/E SoCs

  The NXP SIUL2 pin controller is a singleton node responsible for controlling
  the pin function selection and pin properties. This node, labeled 'pinctrl' in
  the SoC's devicetree, will define pin configurations in pin groups. Each group
  within the pin configuration defines the pin configuration for a peripheral,
  and each numbered subgroup in the pin group defines all the pins for that
  peripheral with the same configuration properties. The 'pinmux' property in
  a group selects the pins to be configured, and the remaining properties set
  configuration values for those pins.

  For example, to configure the pinmux for UART0, modify the 'pinctrl' from your
  board or application devicetree overlay as follows:

    /* Include the SoC package header containing the predefined pins definitions */
    #include <nxp/s32/S32Z27-BGA594-pinctrl.h>

    &pinctrl {
      uart0_default: uart0_default {
        group1 {
          pinmux = <PB10_LIN_0_TX>;
          output-enable;
        };
        group2 {
          pinmux = <PB11_LIN_0_RX>;
          input-enable;
        };
      };
    };

  The 'uart0_default' node contains the pin configurations for a particular state
  of a device. The 'default' state is the active state. Other states for the same
  device can be specified in separate child nodes of 'pinctrl'.

  In addition to 'pinmux' property, each group can contain other properties such as
  'bias-pull-up' or 'slew-rate' that will be applied to all the pins defined in
  'pinmux' array. To enable the input buffer use 'input-enable' and to enable the
  output buffer use 'output-enable'.

  To link the pin configurations with UART0 device, use pinctrl-N property in the
  device node, where 'N' is the zero-based state index (0 is the default state).
  Following previous example:

    &uart0 {
      pinctrl-0 = <&uart0_default>;
      pinctrl-names = "default";
      status = "okay";
    };

  If only the required properties are supplied, the pin configuration register
  will be assigned the following reset values:
    - input and output buffers disabled
    - internal pull not enabled
    - open drain disabled
    - slew rate 4 (see description in property below).
    - termination resistor disabled (affect LVDS pads only).
    - current reference control disabled (affect LVDS pads only).
    - Rx current boost disabled  (affect LVDS pads only).

  Additionally:
  - Safe Mode is always kept as reset value (disabled).
  - Receiver Select is always kept as reset value (enables the differential vref based receiver).

compatible: "nxp,s32ze-siul2-pinctrl"

include: base.yaml

child-binding:
  description: NXP SIUL2 pin controller pin group.
  child-binding:
    description: NXP SIUL2 pin controller pin configuration node.

    include:
      - name: pincfg-node.yaml
        property-allowlist:
          - bias-pull-down
          - bias-pull-up
          - drive-open-drain
          - slew-rate
          - input-enable
          - output-enable

    properties:
      pinmux:
        required: true
        type: array
        description: |
          An array of pins sharing the same group properties. The pins must be
          defined using the macros from the SoC package header. These macros
          encode all the pin muxing information in a 32-bit value.

      slew-rate:
        enum: [0, 4, 5, 6, 7]
        default: 4
        description: |
          Slew rate control. Reset value is 4.
          - For 3.3 V / 1.8 V FAST pads:
            0: FMAX_3318 = 208 MHz (at 1.8 V), 166 MHz (at 3.3 V)
            4: FMAX_3318 = 166 MHz (at 1.8 V), 150 MHz (at 3.3 V)
            5: FMAX_3318 = 150 MHz (at 1.8 V), 133 MHz (at 3.3 V)
            6: FMAX_3318 = 133 MHz (at 1.8 V), 100 MHz (at 3.3 V)
            7: FMAX_3318 = 100 MHz (at 1.8 V), 83 MHz (at 3.3 V)
          - For 1.8 V GPIO pads:
            0: FMAX_18 = 208 MHz
            4: FMAX_18 = 150 MHz
            5: FMAX_18 = 133 MHz
            6: FMAX_18 = 100 MHz
            7: FMAX_18 = 50 MHz
          - For 3.3 V GPIO pads:
            0: Reserved
            4: FMAX_33 = 50 MHz
            5: FMAX_33 = 50 MHz
            6: FMAX_33 = 50 MHz
            7: FMAX_33 = 1 MHz

      nxp,current-reference-control:
        type: boolean
        description: |
          This configuration applies the current reference control to
          the associated pin. It is only applicable to LVDS pads and
          has no effect on other types of pads

      nxp,termination-resistor:
        type: boolean
        description: |
          This configuration applies the termination resistor to
          the associated pin. It is only applicable to LVDS pads and
          has no effect on other types of pads

      nxp,rx-current-boost:
        type: boolean
        description: |
          RX LVDS Current Boost
          Boosts RX IO current. It is only applicable to LVDS pads and
          has no effect on other types of pads
          0: Current reference is 200 μA; supports data rate up to 320 Mbaud
          1: Current reference is 1 mA; supports data rate up to 420 Mbaud
```

## dts/bindings/pinctrl/openisa,rv32m1-pinctrl.yaml
```yaml
# Copyright (c) 2022 Henrik Brix Andersen <henrik@brixandersen.dk>
# Copyright (c) 2022, NXP
# SPDX-License-Identifier: Apache-2.0

description: |
  OpenISA RV32M1 Pin Controller

  This node will define pin configurations in pin groups,
  and has the 'pinctrl' node identifier in the SOC's devicetree. Each group
  within the pin configuration defines the pin configuration for a peripheral,
  and each numbered subgroup in the pin group defines all the pins for that
  peripheral with the same configuration properties. The 'pins' property in
  a group selects the pins to be configured, and the remaining properties set
  configuration values for those pins. Here is an example group for UART0 pins:

  uart0_default: uart0_default {
    group0 {
      pinmux = <RV32M1_MUX('C', 7, 3)>,
               <RV32M1_MUX('C', 8, 3)>;
      drive-strength = "low";
      slew-rate = "fast";
    };
  };

  If only the required properties are supplied, the pin configuration register
  will be assigned the following values:
  PCR_PS=0,
  PCR_PE=0,
  PCR_ODE=0,
  PCR_SRE=<slew-rate selection>,
  PCR_PFE=0

compatible: "openisa,rv32m1-pinctrl"

include: base.yaml

child-binding:
  description: RV32M1 pin controller pin group
  child-binding:
    description: |
      RV31M1 pin controller pin configuration node

    include:
      - name: pincfg-node.yaml
        property-allowlist:
          - drive-open-drain
          - bias-pull-up
          - bias-pull-down

    properties:
      pinmux:
        required: true
        type: array
        description: |
          Pin mux selections for this group. See the SoC level pinctrl DTSI file
          in the OpenISA HAL for a defined list of these options
      slew-rate:
        required: true
        type: string
        enum:
          - "fast"
          - "slow"
        description: |
          Pin output slew rate. Sets the SRE field in the PORTx_PCRn register.
          0 SRE_0_fast- fast slew rate when pin is configured as output
          1 SRE_1_slow- slow slew rate when pin is configured as output
      openisa,passive-filter:
        type: boolean
        description: |
          Enable passive filter on pin. Sets the PFE field in the PORTx_PCRn register.
```

## dts/bindings/pinctrl/openisa,rv32m1-pinmux.yaml
```yaml
description: RV32M1 pinmux

compatible: "openisa,rv32m1-pinmux"

include: base.yaml

properties:
  reg:
    required: true

  clocks:
    required: true

pinmux-cells:
  - pin
  - function
```

## dts/bindings/pinctrl/pincfg-node-group.yaml
```yaml
# Copyright (c) 2020, Linaro Limited
# SPDX-License-Identifier: Apache-2.0

description: |
  Generic pin configuration schema.

  This file is equivalent to pincfg-node.yaml but inserts properties at a
  grandchildren level, useful for group based representation.

child-binding:
  child-binding:
    description: |
      Many data items that are represented in a pin configuration node are
      common and generic. Pin control bindings should use the properties
      defined below where they are applicable; not all of these properties are
      relevant or useful for all hardware or binding structures. Each
      individual binding document should state which of these generic
      properties, if any, are used, and the structure of the DT nodes that
      contain these properties.

      This is based on Linux, documentation:
        https://www.kernel.org/doc/Documentation/devicetree/bindings/pinctrl/pincfg-node.yaml

    properties:
      bias-disable:
        required: false
        type: boolean
        description: disable any pin bias

      bias-high-impedance:
        required: false
        type: boolean
        description: high impedance mode ("third-state", "floating")

      bias-bus-hold:
        required: false
        type: boolean
        description: latch weakly

      bias-pull-up:
        required: false
        type: boolean
        description: enable pull-up resistor

      bias-pull-down:
        required: false
        type: boolean
        description: enable pull-down resistor

      bias-pull-pin-default:
        required: false
        type: boolean
        description: use pin's default pull state

      drive-push-pull:
        required: false
        type: boolean
        description: drive actively high and low

      drive-open-drain:
        required: false
        type: boolean
        description: drive with open drain (hardware AND)

      drive-open-source:
        required: false
        type: boolean
        description: drive with open source (hardware OR)

      drive-strength:
        required: false
        type: int
        description: maximum sink or source current in mA

      drive-strength-microamp:
        required: false
        type: int
        description: maximum sink or source current in μA

      input-enable:
        required: false
        type: boolean
        description: |
          enable input on pin (no effect on output, such as enabling an input
          buffer)

      input-disable:
        required: false
        type: boolean
        description: |
          disable input on pin (no effect on output, such as disabling an input
          buffer)

      input-schmitt-enable:
        required: false
        type: boolean
        description: enable schmitt-trigger mode

      input-schmitt-disable:
        required: false
        type: boolean
        description: disable schmitt-trigger mode

      input-debounce:
        required: false
        type: int
        description: |
          Takes the debounce time in μsec, as argument or 0 to disable debouncing

      power-source:
        required: false
        type: int
        description: select between different power supplies

      low-power-enable:
        required: false
        type: boolean
        description: enable low power mode

      low-power-disable:
        required: false
        type: boolean
        description: disable low power mode

      output-disable:
        required: false
        type: boolean
        description: disable output on a pin (such as disable an output buffer)

      output-enable:
        required: false
        type: boolean
        description: |
          enable output on a pin without actively driving it (such as enabling
          an output buffer)

      output-low:
        required: false
        type: boolean
        description: set the pin to output mode with low level

      output-high:
        required: false
        type: boolean
        description: set the pin to output mode with high level

      sleep-hardware-state:
        required: false
        type: boolean
        description: |
          indicate this is sleep related state which will be programmed into
          the registers for the sleep state

      slew-rate:
        required: false
        type: int
        description: set the slew rate

      skew-delay:
        required: false
        type: int
        description: |
          This affects the expected clock skew on input pins and the delay
          before latching a value to an output pin. Typically indicates how
          many double-inverters are used to delay the signal.
```
