## dts/bindings/pinctrl/pincfg-node.yaml
```yaml
# Copyright (c) 2020, Linaro Limited
# SPDX-License-Identifier: Apache-2.0

description: |
  Generic pin configuration schema

  Many data items that are represented in a pin configuration node are
  common and generic. Pin control bindings should use the properties
  defined below where they are applicable; not all of these properties are
  relevant or useful for all hardware or binding structures. Each
  individual binding document should state which of these generic
  properties, if any, are used, and the structure of the DT nodes that
  contain these properties.

  This is based on Linux, documentation:
    https://www.kernel.org/doc/Documentation/devicetree/bindings/pinctrl/pincfg-node.yaml

properties:
  bias-disable:
    type: boolean
    description: disable any pin bias

  bias-high-impedance:
    type: boolean
    description: high impedance mode ("third-state", "floating")

  bias-bus-hold:
    type: boolean
    description: latch weakly

  bias-pull-up:
    type: boolean
    description: enable pull-up resistor

  bias-pull-down:
    type: boolean
    description: enable pull-down resistor

  bias-pull-pin-default:
    type: boolean
    description: use pin's default pull state

  drive-push-pull:
    type: boolean
    description: drive actively high and low

  drive-open-drain:
    type: boolean
    description: drive with open drain (hardware AND)

  drive-open-source:
    type: boolean
    description: drive with open source (hardware OR)

  drive-strength:
    type: int
    description: maximum sink or source current in mA

  drive-strength-microamp:
    type: int
    description: maximum sink or source current in μA

  input-enable:
    type: boolean
    description: |
      enable input on pin (e.g. enable an input buffer, no effect on output)

  input-disable:
    type: boolean
    description: |
      disable input on pin (e.g. disable an input buffer, no effect on output)

  input-schmitt-enable:
    type: boolean
    description: enable schmitt-trigger mode

  input-schmitt-disable:
    type: boolean
    description: disable schmitt-trigger mode

  input-debounce:
    type: int
    description: |
      Takes the debounce time in μsec, as argument or 0 to disable debouncing

  power-source:
    type: int
    description: select between different power supplies

  low-power-enable:
    type: boolean
    description: enable low power mode

  low-power-disable:
    type: boolean
    description: disable low power mode

  output-disable:
    type: boolean
    description: disable output on a pin (e.g. disable an output buffer)

  output-enable:
    type: boolean
    description: |
      enable output on a pin without actively driving it (e.g. enable an output
      buffer)

  output-low:
    type: boolean
    description: set the pin to output mode with low level

  output-high:
    type: boolean
    description: set the pin to output mode with high level

  sleep-hardware-state:
    type: boolean
    description: |
      indicate this is sleep related state which will be programmed into
      the registers for the sleep state

  slew-rate:
    type: int
    description: set the slew rate

  skew-delay:
    type: int
    description: |
      This affects the expected clock skew on input pins and the delay
      before latching a value to an output pin. Typically indicates how
        many double-inverters are used to delay the signal.
```

## dts/bindings/pinctrl/pinctrl-device.yaml
```yaml
# Copyright (c) 2021 Nordic Semiconductor ASA
# SPDX-License-Identifier: Apache-2.0

description: |
  This file needs to be included by devices that need to specify a set of pin
  controller states.

  The bindings file for each pin controller driver implementation should provide
  more information on what is the expected pin configuration format.

properties:
  "^pinctrl-[0-9]+$":
    type: phandles
    pattern: true
    description: |
      Pin configuration/s for the n-th state. Content is specific to the
      selected pin controller driver implementation.

  pinctrl-names:
    type: string-array
    description: |
      Names for the provided states. The number of names needs to match the
      number of states.
```

## dts/bindings/pinctrl/pinctrl-single.yaml
```yaml
# Copyright (c) 2023 Enphase Energy
# SPDX-License-Identifier: Apache-2.0

description: |
  pinctrl single node, adapted from Linux.
  One-register-per-pin type device tree based pinctrl driver.

  AM62x example:
    Pins can be configured using the following macro "AM62X_IOPAD(offset, value, mux_mode)".
    offset - the pin attribute register offset from the base address.
    value - one of the following:
      PIN_OUTPUT
      PIN_OUTPUT_PULLUP
      PIN_OUTPUT_PULLDOWN
      PIN_INPUT
      PIN_INPUT_PULLUP
      PIN_INPUT_PULLDOWN
    mux_mode - The mux mode for the pin, MUX_MODE0 -> MUX_MODE9.
    For AM62x the main pinctrl base address is 0xf4000.
    The default UART0_RX pin is located at 0x000f41c8 (mux mode 0).
    So the configuration would be "AM62X_IOPAD(0x1c8, PIN_INPUT, MUX_MODE0)".

compatible: "pinctrl-single"

include: base.yaml

properties:
  reg:
    required: true

  "#pinctrl-cells":
    required: true
    type: int
    description: |
      number of cells in addition to the index, set to 1
      or 2 for pinctrl-single,pins

  pinctrl-single,register-width:
    required: true
    type: int
    description: |
      pinmux register access width in bits

  pinctrl-single,function-mask:
    required: true
    type: int
    description: |
      mask of allowed pinmux function bits in the pinmux register

child-binding:
  description: |
    This binding gives a base representation of the pinctrl-single
    pin configuration.

  properties:
    pinctrl-single,pins:
      required: true
      type: array
      description: |
        pinctrl-single pin configuration
```

## dts/bindings/pinctrl/pinctrl.yaml
```yaml
#
# Copyright (c) 2018 Bobby Noelte
#
# SPDX-License-Identifier: Apache-2.0
#
---
title: Pinctrl Base Structure
id: pinctrl
version: 0.1

description: >
    This binding gives the base structures for all pin controller devices

properties:
    pin-controller:
      type: string
      category: required
      description: device controller identification
      generation: define

    compatible:
      type: string
      category: required
      description: compatible strings
      generation: define

    "#address-cells":
      type: int
      category: required
      description: should be 1.

    "#size-cells":
      type: int
      category: required
      description: should be 0.

    label:
      type: string
      category: required
      description: Human readable string describing the device (used by Zephyr for device name)
      generation: define
...
```

## dts/bindings/pinctrl/pinmux.yaml
```yaml
---
title: PINMUX Base structure
id: pinmux
version: 0.1

description: >
    This binding gives the base structures for all PINMUX devices

properties:
    compatible:
      type: string
      category: required
      description: compatible strings
    reg:
      type: int
      description: mmio register space
      generation: define
      category: required
    label:
      type: string
      category: required
      description: Human readable string describing the device (used by Zephyr for API name)
      generation: define

cell_string: PINMUX

...
```

## dts/bindings/pinctrl/quicklogic,eos-s3-pinctrl.yaml
```yaml
# Copyright (c) 2023 Antmicro <www.antmicro.com>
# SPDX-License-Identifier: Apache-2.0

description: |
  Quicklogic EOS S3 IO MUX binding covers the 46 IOMUX_PAD_x_CTRL registers
  that can be used to set the direction and the function of a pad.

  Device pin configuration should be placed in the child nodes of this node.
  Populate the 'pinmux' field with IO function and pin number.

  For example, setting pins 44 and 45 for use as UART would look like this:

    #include <dt-bindings/pinctrl/quicklogic-eos-s3-pinctrl.h>

    &pinctrl {
      uart0_rx_default: uart0_rx_default {
        pinmux = <UART_RX_PAD45>;
        input-enable;
      };
      uart0_tx_default: uart0_tx_default {
        pinmux = <UART_TX_PAD44>;
        output-enable;
      };
    };

compatible: "quicklogic,eos-s3-pinctrl"

include: base.yaml

properties:
  reg:
    required: true

child-binding:
  description: |
    This binding gives a base representation of the SiFive FE310 pins
    configuration.

  include:
    - name: pincfg-node.yaml
      property-allowlist:
        - input-enable
        - output-enable
        - bias-pull-up
        - bias-pull-down
        - bias-high-impedance
        - input-schmitt-enable
        - drive-strength
  properties:
    pinmux:
      required: true
      type: array
      description: |
        Quicklogic EOS S3 pin's configuration (pin, IO function).
    slew-rate:
      description: |
        The default value "slow" matches the power-on reset value.
      default: "slow"
      type: string
      enum:
        - "slow"
        - "fast"
    quicklogic,control-selection:
      description: |
        Control selection for IO output.
        It's either controlled from registers of the A0 always-on domain,
        fabric-controlled for signaling with FPGA,
        or other-controller for bidirectional signals.
        The default value "a0registers" matches the power-on reset value.
      default: "a0registers"
      type: string
      enum:
        - "a0registers"
        - "others"
        - "fabric"
```

## dts/bindings/pinctrl/rapidsi,pinctrl.yaml
```yaml
# Copyright (c) 2024 Rapid Silicon
# SPDX-License-Identifier: Apache-2.0

description: |
  The Rapid Silicon pin controller has one register per pin number. 
  Each register exposes the four modes:

     PIN_FN_MAIN
     PIN_FN_FPGA
     PIN_FN_ALT
     PIN_FN_DEBUG

  It also exposes the bits to enable or disable the pull resistors 
  as well as direction to pull a pin. 
  
  As a result, the following shows an example of a pin 
  configuration for one flow engine peripheral in virgo_tc_eval board.

  #include <dt-bindings/pinctrl/rapidsi_virgo_pinctrl.h>

  /*
    In the following example, each element in pins property is defined as:
    1 - phandle to pinctrl node
    2 - pin number
    3 - pin mode as listed above.
    4 - pin pull resistor enabled or disabled
    5 - pin pull resistor direction being up or down.
  */
  &pinctrl {
    #pin-cells = <4>;
    ofe_default_pinmux {   
      group1 { 
        pins = <&pinctrl 0 PIN_FN_ALT PIN_PULL_STATUS_DIS PIN_PULL_DIR_DOWN>;
        pin-names = "CONFIG_DONE";
      };
      group2 {
        pins = <&pinctrl 1 PIN_FN_ALT PIN_PULL_STATUS_DIS PIN_PULL_DIR_DOWN>;
        pin-names = "CONFIG_ERROR";
      };
    };
  };

  &ofe {
    pinctrl-0 = <&ofe_default_pinmux>;
  };

  In the above example, config_done is assigned pin number 0 with 
  alternate functionality where pull resistors are disabled. In case the
  pull resistors are disabled the PIN_PULL_DIR... argument is ignored.

compatible: "rapidsi,pinctrl"

include: [base.yaml]

child-binding:
  description: |
    rapidsi pin controller pin configuration state nodes.
    
  child-binding:
    description: |
      rapidsi pin controller pin configuration group.

    properties:

      pinmaps:
        type: phandle-array
        description: |
          This property describes the details about the pad to be configured
          for the purpose of driving a corresponding Pad in a specific
          mode.

      pinmap-names:
        type: string-array
        description: |
            This is an array of strings defining the names of the PAD lines
            going out of the PAD controller
          
properties:

  npins:
    type: int
    required: true

  "#pinmap-cells":
    type: int
    const: 4

pinmap-cells:
  - pin_num
  - pin_mode
  - pin_pull_state
  - pin_pull_dir
```
