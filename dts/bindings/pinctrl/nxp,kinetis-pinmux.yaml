## dts/bindings/pinctrl/nxp,kinetis-pinmux.yaml
```yaml
description: Kinetis pinmux node

compatible: "nxp,kinetis-pinmux"

include: base.yaml

properties:
  reg:
    required: true

  clocks:
    required: true

child-binding:
  include: pincfg-node.yaml
```

## dts/bindings/pinctrl/nxp,lpc-iocon-pinctrl.yaml
```yaml
# Copyright 2022 NXP
# SPDX-License-Identifier: Apache-2.0

description: |
  LPC pinctrl node. This node defines pin configurations in pin groups, and has
  the 'pinctrl' node identifier in the SOC's devicetree. Each group within the
  pin configuration defines a peripheral's pin configuration. Each numbered
  subgroup represents pins with shared configuration for that peripheral. The
  'pinmux' property of each group selects the pins to be configured with these
  properties. For example, here is a configuration for FLEXCOMM0 pins:

  pinmux_flexcomm0_usart: pinmux_flexcomm0_usart {
    group0 {
      pinmux = <FC0_TXD_SCL_MISO_WS_PIO0_30>,
              <FC0_RXD_SDA_MOSI_DATA_PIO0_29>;
      slew-rate = "standard";
    };
  };

  If only the required properties are supplied, the ICON_PIO register will
  be assigned the following values:
  IOCON_FUNC=<pin mux selection>,
  IOCON_MODE=0,
  IOCON_SLEW=<slew-rate selection>,
  IOCON_INVERT=0,
  IOCON_DIGIMODE=1,
  IOCON_OD=0,

  Values for I2C type and analog type pins have the following defaults:
  IOCON_ASW=0
  IOCON_SSEL=0
  IOCON_FILTEROFF=1
  IOCON_ECS=0
  IOCON_EGP=1
  IOCON_I2CFILTER=1

  Note the inherited pinctrl properties defined below have the following effects:
  drive-open-drain: IOCON_OD=1
  bias-pull-up: IOCON_MODE=2
  bias-pull-down: IOCON_MODE=1
  drive-push-pull: IOCON_MODE=3

  Note: for the LPC11u6x, the following fields are also supported:
  IOCON_HYS- set by input-schmitt-enable
  IOCON_S_MODE- set by nxp,digital-filter
  IOCON_CLKDIV- set by nxp,filter-clock-div
  IOCON_FILTR- set by nxp,analog-filter



compatible: "nxp,lpc-iocon-pinctrl"

include:
  - name: base.yaml
  - name: pincfg-node-group.yaml
    child-binding:
      child-binding:
        property-allowlist:
          - drive-open-drain
          - bias-pull-up
          - bias-pull-down
          - drive-push-pull
          - input-schmitt-enable

child-binding:
  description: LPC IOCON pin controller pin group
  child-binding:
    description: |
      LPC IOCON pin controller pin configuration node
    properties:
      pinmux:
        required: true
        type: array
        description: |
          Pin mux selection for this group. See the SOC level pinctrl header
          file in NXP's HAL for a defined list of these options.
      slew-rate:
        required: false
        default: "standard"
        type: string
        enum:
          - "standard"
          - "fast"
        description: |
          Pin output slew rate. Sets the SLEW field in the IOCON register.
          defaults to standard slew rate, due to this being the reset value of
          the field.
          0 SLEW_0- standard mode, output slew rate is slower
          1 SLEW_1- fast mode, output slew rate is faster
      nxp,invert:
        type: boolean
        description: |
          Invert the pin input logic level
      nxp,analog-mode:
        type: boolean
        description: |
          Set the pin to analog mode. Sets DIGIMODE=0, and ASW=1. Only valid for
          analog type pins.
      power-source:
        type: string
        enum:
         - "3v3"
         - "1v8"
        description: |
          Pin output power source. Only valid for I2C mode pins running in I2C
          mode.
      nxp,digital-filter:
        type: boolean
        description: |
          Digital input filter. Noise pulses below 10ms are filtered out.
      nxp,i2c-filter:
        type: string
        enum:
         - "slow"
         - "fast"
        description: |
          I2C glitch filter speed. Only valid for I2C mode pins. Fast mode
          typically only required for High speed I2C.
      nxp,i2c-speed:
        type: string
        enum:
         - "slow"
         - "fast"
        description: |
          I2C speed. Only valid for I2C mode pins. Fast mode should be used for
          fast mode plus I2C.
      nxp,i2c-pullup:
        type: boolean
        description: |
          Enable I2C pullup resistor. If not present, pin is open drain in I2C
          mode. Only valid for I2C mode pins in I2C mode
      nxp,i2c-mode:
        type: boolean
        description: |
          Enable I2C mode for a pin. If not present, pin is in GPIO mode. Only
          valid for I2C mode pins
```

## dts/bindings/pinctrl/nxp,lpc-iocon-pio.yaml
```yaml
# Copyright (c) 2021, Linaro Limited
# SPDX-License-Identifier: Apache-2.0

description: LPC I/O Pin Configuration (IOCON) Port I/O (PIO)

compatible: "nxp,lpc-iocon-pio"

include: base.yaml

properties:
    reg:
      required: true
```

## dts/bindings/pinctrl/nxp,lpc-iocon.yaml
```yaml
# Copyright (c) 2021, Linaro Limited
# SPDX-License-Identifier: Apache-2.0

description: LPC I/O Pin Configuration (IOCON)

compatible: "nxp,lpc-iocon"

include: [base.yaml, reset-device.yaml]

properties:
  clocks:
    type: phandle-array

  reg:
    required: true
```

## dts/bindings/pinctrl/nxp,lpc11u6x-pinctrl.yaml
```yaml
# Copyright 2022 NXP
# SPDX-License-Identifier: Apache-2.0

compatible: "nxp,lpc11u6x-pinctrl"

include:
  - name: base.yaml
  - name: nxp,lpc-iocon-pinctrl.yaml
    child-binding:
      child-binding:
        property-allowlist:
          - pinmux
          - nxp,invert
          - nxp,analog-mode
          - nxp,i2c-mode
          - nxp,i2c-filter
  - name: pincfg-node-group.yaml
    child-binding:
      child-binding:
        property-allowlist:
          - drive-open-drain
          - bias-pull-up
          - bias-pull-down
          - drive-push-pull
          - input-schmitt-enable

child-binding:
  description: LPC IOCON pin controller pin group
  child-binding:
    description: |
      LPC IOCON pin controller pin configuration node
    properties:
      nxp,digital-filter:
        type: int
        default: 0
        enum:
          - 0
          - 1
          - 2
          - 3
        description: |
          Enable digital filter. Set number of clock cycles to use as rejection
          threshold for input pulses. 0 disables the filter. Only valid for
          lpc11u6x SOC. Filter defaults to disabled, as this is default reset
          value for SOC
      nxp,filter-clock-div:
        type: int
        default: 0
        enum:
          - 0
          - 1
          - 2
          - 3
          - 4
          - 5
          - 6
        description: |
          set peripheral clock divider for input filter sampling clock
          IOCONCLKDIV. Only valid for lpc11u6x SOC. Default to 0, as this
          is the default reset value for the SOC.
      nxp,disable-analog-filter:
        type: boolean
        description: |
          Disable fixed 10 ns input glitch analog filter. Only valid for lpc11u6x
          SOC, on analog pins. Note that this filter is enabled on reset, hence
          the choice to make disabling the filter opt-in
```

## dts/bindings/pinctrl/nxp,lpc11u6x-pinmux.yaml
```yaml
# Copyright (c) 2020 Seagate Technology LLC
# SPDX-License-Identifier: Apache-2.0

description: NXP LPC11U6X pinmux (aka IOCON) node

compatible: "nxp,lpc11u6x-pinmux"

include: base.yaml

properties:
    reg:
      required: true

    "#pinmux-cells":
      type: int
      required: true
      const: 2
      description: number of items in a pinmux specifier

pinmux-cells:
  - pin
  - function
```

## dts/bindings/pinctrl/nxp,lpc84x-iocon.yaml
```yaml
# Copyright (c) 2026 Aerlync Labs Inc.
# SPDX-License-Identifier: Apache-2.0

description: NXP LPC84x IOCON Pin Controller

compatible: "nxp,lpc84x-iocon"

include: base.yaml

properties:
  reg:
    required: true
    description: IOCON register base address and size.

  clocks:
    required: true
    description: Clock required for IOCON.
```

## dts/bindings/pinctrl/nxp,lpc84x-swm.yaml
```yaml
# Copyright (c) 2026 Aerlync Labs Inc.
# SPDX-License-Identifier: Apache-2.0

description: NXP LPC84x Switch Matrix Pin Controller

compatible: "nxp,lpc84x-swm"

include:
  - name: base.yaml
  - name: pinctrl-device.yaml

properties:
  reg:
    required: true
    description: SWM register base address and size.

  clocks:
    required: true
    description: Clock required for SWM.

child-binding:
  description: LPC84x pinctrl child node
  child-binding:
    description: LPC84x pinctrl group

    include:
      - name: pincfg-node.yaml
        property-allowlist:
          - bias-pull-up
          - bias-pull-down
          - bias-disable
          - drive-open-drain
          - drive-push-pull

    properties:
      pinmux:
        required: true
        type: array
        description: Array of pinmux values.

      nxp,invert:
        type: boolean
        description: Invert input.

      nxp,hysteresis:
        type: boolean
        description: Enable input hysteresis.
```

## dts/bindings/pinctrl/nxp,mcux-rt-pinctrl.yaml
```yaml
# Copyright (c) 2022 NXP
# SPDX-License-Identifier: Apache-2.0

description: |
  The node has the 'pinctrl' node label set in MCUX RT SoC's devicetree. These
  nodes can be autogenerated using the MCUXpresso config tools combined with
  the rt_dts_gen.py script in NXP's HAL. The mux, mode, input, daisy, and cfg
  fields in a group select the pins to be configured, and the remaining
  devicetree properties set configuration values for those pins
  for example, here is an group configuring LPUART1 pins:

  group0 {
    pinmux = <&iomuxc_gpio_ad_b0_12_lpuart1_tx,
      &iomuxc_gpio_ad_b0_13_lpuart1_rx>;
    drive-strength = "r0-6";
    slew-rate = "slow";
    nxp,speed = "100-mhz";
  };

  This will select GPIO_AD_B0_12 as LPUART1 TX, and GPIO_AD_B0_13 as LPUART1 RX.
  Both pins will be configured with a weak latch, drive strength of "r0-6",
  slow slew rate, and 100 MHZ speed.
  Note that the soc level iomuxc dts file can be examined to find the possible
  pinmux options. Here are the affects of each property on the
  IOMUXC SW_PAD_CTL register:
  input-schmitt-enable: HYS=1
  drive-open-drain: ODE=1
  input-enable: SION=1 (in SW_MUX_CTL_PAD register)
  bias-pull-down: PUE=1, PUS=<bias-pull-down-value>
  bias-pull-up: PUE=1, PUS=<bias-pull-up-value>
  bias-disable: PKE=0
  slew-rate: SRE=<enum_idx>
  drive-strength: DSE=<enum_idx>
  nxp,speed: SPEED=<enum_idx>

  If only required properties are supplied, the pin will have the following
  configuration:
  HYS=0,
  ODE=0,
  SION=0,
  PUE=0,
  PUS=0,
  PKE=1,
  SRE=<slew-rate>,
  DSE=<drive-strength>,
  SPEED=<nxp,speed>


compatible: "nxp,mcux-rt-pinctrl"

include: base.yaml

child-binding:
  description: MCUX RT pin controller pin group
  child-binding:
    description: |
      MCUX RT pin controller pin configuration node.

    include:
      - name: pincfg-node.yaml
        property-allowlist:
          - input-schmitt-enable
          - drive-open-drain
          - input-enable
          - bias-disable
          - bias-pull-down
          - bias-pull-up

    properties:
      pinmux:
        required: true
        type: phandles
        description: |
          Pin mux selections for this group. See the soc level iomuxc DTSI file
          for a defined list of these options.
      drive-strength:
        required: true
        type: string
        enum:
          - "disabled"
          - "r0"
          - "r0-2"
          - "r0-3"
          - "r0-4"
          - "r0-5"
          - "r0-6"
          - "r0-7"
        description: |
          Pin output drive strength. Sets the DSE field in the IOMUXC peripheral.
          the drive strength is expressed as a output impedance at a given voltage,
          but maximum current values can be calculated from these impedances
          for a specific load impedance.
          000 DSE_0_output_driver_disabled_ — output driver disabled
          001 DSE_1_R0_1 — 157 Ohm impedance @3.3V, 260 Ohm impedance @1.8V
          010 DSE_2_R0_2 — 78 Ohm @3.3V, 130 Ohm @1.8V
          011 DSE_3_R0_3 — 53 Ohm @3.3V, 88 Ohm @1.8V
          100 DSE_4_R0_4 — 39 Ohm @3.3V, 65 Ohm @1.8V
          101 DSE_5_R0_5 — 32 Ohm @3.3V, 52 Ohm @1.8V
          110 DSE_6_R0_6 — 32 Ohm @3.3V, 43 Ohm @1.8V
          111 DSE_7_R0_7 — 26 Ohm @3.3V, 37 Ohm @1.8V
      bias-pull-up-value:
        type: string
        default: "47k"
        enum:
          - "unused"
          - "47k"
          - "100k"
          - "22k"
        description: |
          Select the value of the pull up resistor present on this pin
          Corresponds to the PUS field in the IOMUXC peripheral.
          47k resistor selected as default due to this being the default pullup
          value on most SOC pins
          00 Unused- no change will be applied to pin
          01 PUS_1_47K_Ohm_Pull_Up — 47K Ohm Pull Up
          10 PUS_2_100K_Ohm_Pull_Up — 100K Ohm Pull Up
          11 PUS_2_22K_Ohm_Pull_Up — 22K Ohm Pull Up

      bias-pull-down-value:
        type: string
        default: "100k"
        enum:
          - "100k"
        description: |
          Select the value of the pull up resistor present on this pin
          Corresponds to the PUS field in the IOMUXC peripheral. 100k is
          currently the only supported pull down resistance.
          00 PUS_0_100K_Ohm_Pull_Down - 100K Ohm Pull Down
      slew-rate:
        required: true
        type: string
        enum:
          - "slow"
          - "fast"
        description: |
          Select slew rate for pin. Corresponds to SRE field in IOMUXC peripheral
          0 SRE_0_Slow_Slew_Rate — Slow Slew Rate
          1 SRE_1_Fast_Slew_Rate — Fast Slew Rate
      nxp,speed:
        type: string
        enum:
          - "50-mhz"
          - "100-mhz"
          - "150-mhz"
          - "200-mhz"
        description: |
          Sets pin speed. Corresponds to SPEED field in IOMUXC peripheral
          00 SPEED_0_low_50MHz_ — low(50MHz)
          01 SPEED_1_medium_100MHz_ — medium(100MHz)
          10 SPEED_2_medium_150MHz_ — medium(150MHz)
          11 SPEED_3_max_200MHz_ — max(200MHz)
```
