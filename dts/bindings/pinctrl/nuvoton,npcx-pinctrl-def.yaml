## dts/bindings/pinctrl/nxp,imx-iomuxc.yaml
```yaml
# Copyright (c) 2022 NXP
# SPDX-License-Identifier: Apache-2.0

description: |
  This compatible binding should be applied to the device's iomuxc DTS node.
  the DTS node will be populated with all pinmux options for the specific SOC.
  These options can then be used in a pinctrl node with the "nxp,mcux-rt-pinctrl"
  compatible string to define pin groups.

  The user should not edit the bindings defined within this node to make pinmux
  selections, but should instead edit the pinctrl groups for their board.

compatible: "nxp,imx-iomuxc"

include:
    - name: base.yaml

properties:
    reg:
      required: true

child-binding:
  description: MCUX RT pin mux option
  properties:
    pinmux:
      required: true
      type: array
      description: |
        An array of values defining the pin mux selection, in the following format:
        <mux_register, mux_val, input_reg, daisy_val, cfg_reg>
        mux_register: register that will be written to to make mux selection
        mux_val: value to write to mux_register
        input_reg: peripheral register that will direct peripheral signal to pin
        daisy_val: value to write to input_reg
        cfg_reg: register that will configure pin pull, drive strength, and open drain
    gpr:
      required: false
      type: array
      description: |
        An array of values defining the GPR bit write required, if one exists.
        Some IOMUXC options require writing to an IOMUXC_GPR register to select
        them. This array has the following elements:
        <gpr_reg, gpr_shift, gpr_val>
        gpr_reg: GPR register address to write to
        gpr_shift: shift to apply to value before writing
        gpr_val: value to write
    # Note: the below properties should ideally be an enum. However, the pinctrl driver
    # will need to initialize the pin configuration register differently based on
    # the type of register provided, and it does so using the IF_ENABLED macro. This
    # macro cannot work using preprocessor equality statements (like DT_ENUM_IDX(prop) == val),
    # so we cannot use an enum and instead must use individual properties.
    pin-pue:
      required: false
      type: boolean
      description: |
          RT11xx parts have multiple types of IOMUXC registers defined, with
          different register layouts. This property can be set to indicate
          to the pinctrl driver the type of register this pinmux represents,
          and should not be modified by the user.
    pin-pdrv:
      required: false
      type: boolean
      description: |
          RT11xx parts have multiple types of IOMUXC registers defined, with
          different register layouts. This property can be set to indicate
          to the pinctrl driver the type of register this pinmux represents,
          and should not be modified by the user.
    pin-lpsr:
      required: false
      type: boolean
      description: |
          RT11xx parts have multiple types of IOMUXC registers defined, with
          different register layouts. This property can be set to indicate
          to the pinctrl driver the type of register this pinmux represents,
          and should not be modified by the user.
    pin-snvs:
      required: false
      type: boolean
      description: |
          RT11xx parts have multiple types of IOMUXC registers defined, with
          different register layouts. This property can be set to indicate
          to the pinctrl driver the type of register this pinmux represents,
          and should not be modified by the user.
```

## dts/bindings/pinctrl/nxp,imx-pinmux.yaml
```yaml
# Copyright (c) 2021, NXP
# SPDX-License-Identifier: Apache-2.0

description: i.MX IOMUXC node

compatible: "nxp,imx-pinmux"

include: base.yaml

properties:
    reg:
      required: true

    label:
      required: true

pinmux-cells:
  - pin
  - function
```

## dts/bindings/pinctrl/nxp,imx7d-pinctrl.yaml
```yaml
# Copyright (c) 2022 NXP
# SPDX-License-Identifier: Apache-2.0

description: |
  The node has the 'pinctrl' node label set in MCUX SoC's devicetree. These
  nodes can be autogenerated using the MCUXpresso config tools combined with
  the imx_dts_gen.py script in NXP's HAL. The mux, mode, input, daisy, and cfg
  fields in a group select the pins to be configured, and the remaining
  devicetree properties set configuration values for those pins

  Note that the soc level iomuxc dts file can be examined to find the possible
  pinmux options. Here are the affects of each property on the
  IOMUXC SW_PAD_CTL register:
  bias-pull-up: PE=1, PS=<bias-pull-up-value index>
  bias-pull-down: PE=1, PS=0
  input-schmitt-enable: HYS=1
  slew-rate: SRE=<enum idx>
  drive-strength: DSE=<enum idx>
  input-enable: SION=1 (in SW_PAD_CTL_MUX register)

  If only required properties are supplied, the pin will have the following
  configuration:
  HYS=0,
  PS=0,
  PE=0
  SRE=<slew-rate>,
  DSE=<drive-strength>,
  SION=0,

  Note that pins marked with LPSR can only have their PE and PS registers
  configured


compatible: "nxp,imx7d-pinctrl"

include: base.yaml

child-binding:
  description: iMX pin controller pin group
  child-binding:
    description: |
      iMX pin controller pin configuration node.

    include:
      - name: pincfg-node.yaml
        property-allowlist:
          - input-schmitt-enable
          - input-enable
          - bias-pull-up
          - bias-pull-down

    properties:
      pinmux:
        required: true
        type: phandles
        description: |
          Pin mux selections for this group. See the soc level iomuxc DTSI file
          for a defined list of these options.
      drive-strength:
        required: true
        type: string
        enum:
          - "x1"
          - "x4"
          - "x2"
          - "x6"
        description: |
          Pin output drive strength. Sets the DSE field in the IOMUXC peripheral.
      slew-rate:
        required: true
        type: string
        enum:
          - "fast"
          - "slow"
        description: |
          Select slew rate for pin. Corresponds to SRE field in IOMUXC peripheral
          0 FAST — Fast Frequency Slew Rate
          1 SLOW — Slow Frequency Slew Rate
      bias-pull-up-value:
        type: string
        default: "100k"
        enum:
          - "unused"
          - "5k"
          - "47k"
          - "100k"
        description: |
          Select pull up resistor value. Sets PS field in IOMUXC peripheral.
          Default of 100k as this is most common default register value for
          SOC pads.
          01: 5K- 5K pull up resistor
          10: 47K- 47K pull up resistor
          11: 100K- 100K pull up resistor
```

## dts/bindings/pinctrl/nxp,imx8-pinctrl.yaml
```yaml
# Copyright 2023 NXP
# SPDX-License-Identifier: Apache-2.0

description: Use this compatible for i.MX8QM/QXP boards.

compatible: "nxp,imx8-pinctrl"

include: base.yaml

child-binding:
  description: i.MX8QM/QXP pin controller pin group
  child-binding:
    description: i.MX8QM/QXP pin controller pin configuration node.
    properties:
      pinmux:
        required: true
        type: phandles
```

## dts/bindings/pinctrl/nxp,imx8m-pinctrl.yaml
```yaml
# Copyright (c) 2022 NXP
# SPDX-License-Identifier: Apache-2.0

description: |
  The node has the 'pinctrl' node label set in MCUX SoC's devicetree. These
  nodes can be autogenerated using the MCUXpresso config tools combined with
  the imx_dts_gen.py script in NXP's HAL. The mux, mode, input, daisy, and cfg
  fields in a group select the pins to be configured, and the remaining
  devicetree properties set configuration values for those pins
  for example, here is an group configuring UART2 pins:

  group0 {
      pinmux = <&iomuxc_uart2_rxd_uart_rx_uart2_rx,
          &iomuxc_uart2_txd_uart_tx_uart2_tx>;
      drive-strength = "40-ohm";
      slew-rate = "slow";
  };

  This will select UART2_RXD as UART2 rx, and UART2_TXD as UART2 tx.
  Both pins will be configured with a slow slew rate, and maximum drive
  strength.
  Note that the soc level iomuxc dts file can be examined to find the possible
  pinmux options. Here are the affects of each property on the
  IOMUXC SW_PAD_CTL register:
  nxp,lvttl: LVTTL=1
  input-schmitt-enable: HYS=1
  bias-pull-up: PUE=1
  drive-open-drain: ODE=1
  slew-rate: SRE=<enum_idx>
  drive-strength: DSE=<enum_idx>
  input-enable: SION=1 (in SW_MUX_CTL_PAD register)

  If only required properties are supplied, the pin will have the following
  configuration:
  LVTLL=0,
  HYS=0,
  PUE=0,
  ODE=0,
  SRE=<slew-rate>,
  DSE=<drive-strength>,
  SION=0,


compatible: "nxp,imx8m-pinctrl"

include:
    - name: base.yaml
    - name: pincfg-node-group.yaml
      child-binding:
        child-binding:
          property-allowlist:
            - input-schmitt-enable
            - drive-open-drain
            - input-enable
            - bias-pull-up
            - bias-pull-down

child-binding:
  description: iMX pin controller pin group
  child-binding:
    description: |
      iMX pin controller pin configuration node.
    properties:
      pinmux:
        required: true
        type: phandles
        description: |
          Pin mux selections for this group. See the soc level iomuxc DTSI file
          for a defined list of these options.
      drive-strength:
        required: true
        type: string
        enum:
          - "disabled"
          - "255-ohm"
          - "105-ohm"
          - "75-ohm"
          - "85-ohm"
          - "65-ohm"
          - "45-ohm"
          - "40-ohm"
        description: |
          Pin output drive strength. Sets the DSE field in the IOMUXC peripheral.
          the drive strength is expressed as a output impedance at a given voltage,
          but maximum current values can be calculated from these impedances
          for a specific load impedance.
          000 HI-Z — Output driver is disabled (Hi-Z State)
          001 255_OHM — 255 Ohm @3.3V, 240 Ohm @2.5V, 230 Ohm @1.8V, 265 Ohm @1.2V
          010 105_OHM — 105 Ohm @3.3V, 100 Ohm @2.5V, 85 Ohm @1.8V, 110 Ohm @1.2V
          011 75_OHM — 75 Ohm @3.3V, 70 Ohm @2.5V, 60 Ohm @1.8V, 80 Ohm @1.2V
          100 85_OHM — 85 Ohm @3.3V, 80 Ohm @2.5V, 75 Ohm @1.8V, 90 Ohm @1.2V
          101 65_OHM — 65 Ohm @3.3V, 60 Ohm @2.5V, 55 Ohm @1.8V, 65 Ohm @1.2V
          110 45_OHM — 45 Ohm @3.3V, 45 Ohm @2.5V, 40 Ohm @1.8V, 50 Ohm @1.2V
          111 40_OHM — 40 Ohm @3.3V, 40 Ohm @2.5V, 33 Ohm @1.8V, 40 Ohm @1.2V
      slew-rate:
        required: true
        type: string
        enum:
          - "slow"
          - "medium"
          - "fast"
          - "max"
        description: |
          Select slew rate for pin. Corresponds to SRE field in IOMUXC peripheral
          00 SLOW — Slow Frequency Slew Rate (50Mhz)
          01 MEDIUM — Medium Frequency Slew Rate (100Mhz)
          10 FAST — Fast Frequency Slew Rate (150Mhz)
          11 MAX — Max Frequency Slew Rate (200Mhz)
      nxp,lvttl:
        type: boolean
        description: |
          Enable LVTTL input. Sets LVTTL field in IOMUXC peripheral
```

## dts/bindings/pinctrl/nxp,imx8mp-pinctrl.yaml
```yaml
# Copyright (c) 2022 NXP
# SPDX-License-Identifier: Apache-2.0

description: |
  The node has the 'pinctrl' node label set in MCUX SoC's devicetree. These
  nodes can be autogenerated using the MCUXpresso config tools combined with
  the imx_dts_gen.py script in NXP's HAL. The mux, mode, input, daisy, and cfg
  fields in a group select the pins to be configured, and the remaining
  devicetree properties set configuration values for those pins
  for example, here is an group configuring LPUART1 pins:

  group0 {
    pinmux = <&iomuxc_uart4_rxd_uart_rx_uart4_rx:,
      &iomuxc_uart4_txd_uart_tx_uart4_tx>;
      bias-pull-up;
      slew-rate = "slow";
      drive-strength = "x1";
  };

  This will select UART4_RXD as UART4 rx, and UART4_TXD as UART4 tx.
  Both pins will be configured with a slow slew rate, and minimum drive
  strength.
  Note that the soc level iomuxc dts file can be examined to find the possible
  pinmux options. Here are the affects of each property on the
  IOMUXC SW_PAD_CTL register:
  input-schmitt-enable: HYS=1
  bias-pull-up: PUE=1, PE=1
  bias-pull-down: PUE=0, PE=1
  drive-open-drain: ODE=1
  slew-rate: FSEL=<enum_idx>
  drive-strength: DSE=<enum_idx>
  input-enable: SION=1 (in SW_MUX_CTL_PAD register)

  If only required properties are supplied, the pin will have the following
  configuration:
  HYS=0,
  PE=0
  PUE=0
  ODE=0,
  SRE=<slew-rate>,
  DSE=<drive-strength>,
  SION=0,


compatible: "nxp,imx8mp-pinctrl"

include:
    - name: base.yaml
    - name: pincfg-node-group.yaml
      child-binding:
        child-binding:
          property-allowlist:
            - input-schmitt-enable
            - drive-open-drain
            - input-enable
            - bias-pull-up
            - bias-pull-down

child-binding:
  description: iMX pin controller pin group
  child-binding:
    description: |
      iMX pin controller pin configuration node.
    properties:
      pinmux:
        required: true
        type: phandles
        description: |
          Pin mux selections for this group. See the soc level iomuxc DTSI file
          for a defined list of these options.
      drive-strength:
        required: true
        type: string
        enum:
          - "x1"
          - "x4"
          - "x2"
          - "x6"
        description: |
          Pin output drive strength. Sets the DSE field in the IOMUXC peripheral.
          00 X1- low drive strength
          01 X4- high drive strength
          10 X2- medium drive strength
          11 X6- max drive strength
      slew-rate:
        required: true
        type: string
        enum:
          - "slow"
          - "fast"
        description: |
          Select slew rate for pin. Corresponds to SRE field in IOMUXC peripheral
          0 SLOW — Slow Frequency Slew Rate
          1 FAST — Fast Frequency Slew Rate
```

## dts/bindings/pinctrl/nxp,imx8qm-pinctrl.yaml
```yaml
# Copyright 2023 NXP
# SPDX-License-Identifier

description: Use this compatible for i.MX8QM board.

compatible: "nxp,imx8qm-pinctrl"

include: base.yaml

child-binding:
  description: i.MX8QM pin controller pin group.
  child-binding:
    description: i.MX8QM pin controller pin configuration node.
    properties:
      pinmux:
        required: true
        type: phandles
```
