## dts/bindings/pinctrl/nxp,imx8ulp-pinctrl.yaml
```yaml
# Copyright 2024 NXP
# SPDX-License-Identifier: Apache-2.0

description: Use this compatible for the i.MX8ULP boards

compatible: "nxp,imx8ulp-pinctrl"

include: base.yaml

child-binding:
  description: i.MX8ULP pin controller pin group
  child-binding:
    description: i.MX8ULP pin controller pin configuration node
    include:
      - name: pincfg-node.yaml
        property-allowlist:
          - bias-pull-up
          - bias-pull-down
          - drive-open-drain
    properties:
      pinmux:
        required: true
        type: phandles
      drive-strength:
        type: string
        description: |
          Used to configure the pad's drive strength, which, together
          with the slew rate, affects the maximum frequency the pad's
          output buffer can yield. If "normal" drive strength is used,
          the maximum frequency will be lower as per the measurements
          found in the SoC datasheet. Note that the TRM refers to the
          "normal" drive strength as "standard". If unspecified, the
          default will be "normal".
        enum:
          - "normal"
          - "high"
      slew-rate:
        type: string
        description: |
          Used to configure the pad's slew rate, which affects the
          maximum frequency the pad's output buffer can yield (
          "fast" slew rate -> higher pad frequency, "slow" slew rate ->
          lower pad frequency). Note that the TRM refers to the "fast"
          slew rate as "standard". If unspecified, the default will be
          "fast".
        enum:
          - "fast"
          - "slow"
```

## dts/bindings/pinctrl/nxp,imx93-pinctrl.yaml
```yaml
# Copyright (c) 2022 NXP
# SPDX-License-Identifier: Apache-2.0

description: |
  The node has the 'pinctrl' node label set in MCUX SoC's devicetree. These
  nodes can be autogenerated using the MCUXpresso config tools combined with
  the imx_dts_gen.py script in NXP's HAL. The mux, mode, input, daisy, and cfg
  fields in a group select the pins to be configured, and the remaining
  devicetree properties set configuration values for those pins
  for example, here is an group configuring LPUART1 pins:

  group0 {
    pinmux = <&iomuxc_uart2_rxd_uart_rx_uart2_rx,
      &iomuxc_uart2_txd_uart_tx_uart2_tx>;
      bias-pull-up;
      slew-rate = "slow";
      drive-strength = "x1";
  };

  This will select UART2_RXD as UART2 rx, and UART2_TXD as UART2 tx.
  Both pins will be configured with a slow slew rate, and x1 drive
  strength.
  Note that the soc level iomuxc dts file can be examined to find the possible
  pinmux options. Here are the affects of each property on the
  IOMUXC SW_PAD_CTL register:
  input-schmitt-enable: HYS=1
  drive-open-drain: OD=1
  bias-pull-down: PD=0
  bias-pull-up: PU
  slew-rate: FSEL1=<enum_idx>
  drive-strength: DSE=<enum_idx>
  input-enable: SION=1 (in SW_MUX_CTL_PAD register)

  If only required properties are supplied, the pin will have the following
  configuration:
  HYS=0,
  PD=0
  PU=0
  OD=0,
  FSEL1=<slew-rate>,
  DSE=<drive-strength>,
  SION=0,


compatible: "nxp,imx93-pinctrl"

include: base.yaml

child-binding:
  description: iMX pin controller pin group
  child-binding:
    description: |
      iMX pin controller pin configuration node.

    include:
      - name: pincfg-node.yaml
        property-allowlist:
          - input-schmitt-enable
          - drive-open-drain
          - input-enable
          - bias-pull-up
          - bias-pull-down

    properties:
      pinmux:
        required: true
        type: phandles
        description: |
          Pin mux selections for this group. See the soc level iomuxc DTSI file
          for a defined list of these options.
      drive-strength:
        required: true
        type: string
        enum:
          - "x0"
          - "x1"
          - "x2"
          - "x3"
          - "x4"
          - "x5"
          - "x6"
        description: |
          Pin output drive strength. Sets the DSE field in the IOMUXC peripheral.
          00_0000 X0, No driver
          00_0001 X1
          00_0011 X2
          00_0111 X3
          00_1111 X4
          01_1111 X5
          11_1111 X6
      slew-rate:
        required: true
        type: string
        enum:
          - "slow"
          - "slightly_slow"
          - "slightly_fast"
          - "fast"
        description: |
          Select slew rate for pin. Corresponds to SRE field in IOMUXC peripheral
          0 SLOW — Slow Frequency Slew Rate
          1 Slightly SLOW — Slightly Slow Frequency Slew Rate
          2 Slightly FAST — Slightly Fast Frequency Slew Rate
          3 FAST — Fast Frequency Slew Rate
```

## dts/bindings/pinctrl/nxp,iopctl.yaml
```yaml
# Copyright 2024 NXP
# SPDX-License-Identifier: Apache-2.0

description: IO PAD Controller (IOPCTL)

compatible: "nxp,iopctl"

include: base.yaml

properties:
  reg:
    required: true
```

## dts/bindings/pinctrl/nxp,k32-iocon-pinctrl.yaml
```yaml
# Copyright 2024, Sendrato.com
# SPDX-License-Identifier: Apache-2.0

description: |
  K32 pinctrl node. This node defines pin configurations in pin groups, and has
  the 'pinctrl' node identifier in the SOC's devicetree. Each group within the
  pin configuration defines a peripheral's pin configuration. Each numbered
  subgroup represents pins with shared configuration for that peripheral. The
  'pinmux' property of each group selects the pins to be configured with these
  properties. For example, here is a configuration for FLEXCOMM0 pins:

  pinmux_flexcomm0_usart: pinmux_flexcomm0_usart {
    group0 {
      pinmux = <FC0_TXD_SCL_MISO_WS_PIO0_30>,
              <FC0_RXD_SDA_MOSI_DATA_PIO0_29>;
      slew-rate = "standard";
    };
  };

  Note the inherited pinctrl properties defined below have the following effects:
  bias-pull-up: IOCON_MODE=0
  drive-push-pull: IOCON_MODE=1
  pin-plain-mode: IOCON_MODE=2
  bias-pull-down: IOCON_MODE=3
  drive-open-drain: IOCON_OD=1


compatible: "nxp,k32-iocon-pinctrl"

include: base.yaml

child-binding:
  description: K32 IOCON pin controller pin group
  child-binding:
    description: |
      K32 IOCON pin controller pin configuration node

    include:
      - name: pincfg-node.yaml
        property-allowlist:
          - drive-open-drain
          - bias-pull-up
          - bias-pull-down

    properties:
      pinmux:
        required: true
        type: array
        description: |
          Pin mux selection for this group. See the SOC level pinctrl header
          file in NXP's HAL for a defined list of these options.
      slew-rate:
        default: "standard"
        type: string
        enum:
          - "standard"
          - "fast"
        description: |
          Pin output slew rate. Sets the SLEW field in the IOCON register.
          defaults to standard slew rate, due to this being the reset value of
          the field.
          0 SLEW_0- standard mode, output slew rate is slower
          1 SLEW_1- fast mode, output slew rate is faster
      nxp,invert:
        type: boolean
        description: |
          Invert the pin input logic level
      nxp,analog-mode:
        type: boolean
        description: |
          Set the pin to analog mode. Sets DIGIMODE=0. Only valid for
          analog type pins.
      nxp,plain-mode:
        type: boolean
        description: |
          No pull-up or pull-down enabled is referred to as plain mode.
      nxp,repeater-mode:
        type: boolean
        description: |
          Enables the pull-up resistor if the pin is high and enables the
          pull-down resistor if the pin is low (aka drive-push-pull).
      nxp,i2c-pin:
        type: boolean
        description: |
          Should be selected for pins 10 and 11 regardless if I2C mode
          is used or not. On QN9090 pin 10 and 11 the IOCON register
          has a different format compared to standard IO pins.
      nxp,i2c-filter:
        type: string
        enum:
          - "slow"
          - "fast"
        description: |
          I2C glitch filter speed. Only valid for I2C mode pins. Fast mode
          typically only required for High speed I2C.
      nxp,i2c-mode:
        type: boolean
        description: |
          Enable I2C mode for a pin. If not present, pin is in GPIO mode. Only
          valid for I2C mode pins
```

## dts/bindings/pinctrl/nxp,kinetis-pinctrl.yaml
```yaml
# Copyright (c) 2022, NXP
# SPDX-License-Identifier: Apache-2.0

description: |
  Kinetis pinctrl node. This node will define pin configurations in pin groups,
  and has the 'pinctrl' node identifier in the SOC's devicetree. Each group
  within the pin configuration defines the pin configuration for a peripheral,
  and each numbered subgroup in the pin group defines all the pins for that
  peripheral with the same configuration properties. The 'pins' property in
  a group selects the pins to be configured, and the remaining properties set
  configuration values for those pins. Here is an example group for UART0 pins:

  uart0_default: uart0_default {
    group0 {
      pins = <UART0_RX_PTB16
        UART0_TX_PTB17>;
      drive-strength = "low";
      slew-rate = "fast";
      };
  };

  If only the required properties are supplied, the pin configuration register
  will be assigned the following values:
  PCR_PS=0,
  PCR_PE=0,
  PCR_ODE=0,
  PCR_SRE=<slew-rate selection>,
  PCR_DSE=<drive-strength selection>,
  PCR_PFE=0

compatible: "nxp,kinetis-pinctrl"

include:
  - name: base.yaml
  - name: pincfg-node-group.yaml
    child-binding:
      child-binding:
        property-allowlist:
          - drive-open-drain
          - bias-pull-up
          - bias-pull-down

child-binding:
  description: Kinetis pin controller pin group
  child-binding:
    description: |
      Kinetis pin controller pin configuration node
    properties:
      pinmux:
        required: true
        type: array
        description: |
          Pin mux selections for this group. See the soc level pinctrl DTSI file
          in NXP's HAL for a defined list of these options
      drive-strength:
        required: true
        type: string
        enum:
          - "low"
          - "high"
        description: |
          Pin output drive strength. Sets the DSE field in the PORTx_PCRn register.
          0 DSE_0- low drive strength when pin is configured as output
          1 DSE_1- high drive strength when pin is configured as output
      slew-rate:
        required: true
        type: string
        enum:
          - "fast"
          - "slow"
        description: |
          Pin output slew rate. Sets the SRE field in the PORTx_PCRn register.
          0 SRE_0_fast- fast slew rate when pin is configured as output
          1 SRE_1_slow- slow slew rate when pin is configured as output
      nxp,passive-filter:
        type: boolean
        description: |
          Enable passive filter on pin. Sets the PFE field in the PORTx_PCRn register.
```
