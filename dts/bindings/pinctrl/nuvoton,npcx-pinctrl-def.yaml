## dts/bindings/pinctrl/nuvoton,npcx-pinctrl-def.yaml
```yaml
# Copyright (c) 2020 Nuvoton Technology Corporation.
# SPDX-License-Identifier: Apache-2.0

description: Nuvoton, NPCX Default Pins Configurations

compatible: "nuvoton,npcx-pinctrl-def"

include: [base.yaml]

properties:
  pinmux:
    type: phandles
    required: true
    description: list of configurations of pinmux controllers need to set
```

## dts/bindings/pinctrl/nuvoton,npcx-pinctrl-npckn.yaml
```yaml
# Copyright (c) 2025 Nuvoton Technology Corporation.
# SPDX-License-Identifier: Apache-2.0

description: |
  Nuvoton npcx pinctrl for npckn variant

compatible: "nuvoton,npcx-pinctrl-npckn"

include: nuvoton,npcx-pinctrl.yaml
```

## dts/bindings/pinctrl/nuvoton,npcx-pinctrl.yaml
```yaml
# Copyright (c) 2022 Nuvoton Technology Corporation.
# SPDX-License-Identifier: Apache-2.0

description: |
  The Nuvoton pin controller is a singleton node responsible for controlling
  pin function selection and pin properties. For example, you can use these
  nodes to select peripheral pin functions.

  Here is a list of supported standard pin properties:
    - bias-pull-down: Enable pull-down resistor.
    - bias-pull-up: Enable pull-up resistor.
    - drive-open-drain: Output driver is open-drain.

  Custom pin properties for npcx series are available also:
    - pinmux-locked: Lock pinmux configuration for peripheral device
    - pinmux-gpio: Inverse pinmux back to gpio
    - psl-in-mode: Select the assertion detection mode of PSL input
    - psl-in-pol: Select the assertion detection polarity of PSL input

  An example for NPCX7 family, include the chip level pinctrl DTSI file in the
  board level DTS:

    #include <nuvoton/npcx/npcx7/npcx7-pinctrl.dtsi>

  We want to use the I2C0_0 port of the NPCX7M6FB controller and enable the
  internal 3.3V pull-up if its i2c frequency won't exceed 400kHz.

  To change a pin's pinctrl default properties, add a reference to the
  pin in the board's DTS file and set the properties as below:

    &i2c0_0_sda_scl_gpb4_b5 {
      bias-pull-up; /* Enable internal pull-up for i2c0_0 */
      pinmux-locked; /* Lock pinmuxing */
    };

    &i2c0_0 {
      pinctrl-0 = <&i2c0_0_sda_scl_gpb4_b5>;
      pinctrl-names = "default";
    }

compatible: "nuvoton,npcx-pinctrl"

include:
    - name: base.yaml
    - name: pincfg-node.yaml
      child-binding:
        property-allowlist:
          - bias-pull-down
          - bias-pull-up
          - drive-open-drain

child-binding:
    description: |
      NPCX pin controller pin configuration nodes
    properties:
      pinmux:
        type: phandle
        required: false
        description: Configurations of pinmux selection
      periph-pupd:
        type: array
        required: false
        description: |
          A map to PUPD_ENn register/bit that enable pull-up/down of NPCX peripheral devices.
          Please don't overwrite this property in the board-level DT driver.
      psl-offset:
        type: int
        description: |
          Offset to PSL_CTS register that is used for PSL input's status and detection mode.
          Please don't overwrite this property in the board-level DT driver.
      psl-polarity:
        type: phandle
        required: false
        description: |
          A map to DEVALTn that configures detection polarity of PSL input pads.
          Please don't overwrite this property in the board-level DT driver.
      pinmux-locked:
        required: false
        type: boolean
        description: Lock pinmux selection
      pinmux-gpio:
        required: false
        type: boolean
        description: Inverse pinmux selection to GPIO
      psl-in-mode:
        type: string
        required: false
        description: |
          The assertion detection mode of PSL input selection
          - "level": Select the detection mode to level detection
          - "edge": Select the detection mode to edge detection
        enum:
          - "level"
          - "edge"
      psl-in-pol:
        type: string
        required: false
        description: |
          The assertion detection polarity of PSL input selection
          - "low-falling": Select the detection polarity to low/falling
          - "high-rising": Select the detection polarity to high/rising
        enum:
          - "low-falling"
          - "high-rising"
```

## dts/bindings/pinctrl/nuvoton,npcx-pslctrl-conf.yaml
```yaml
# Copyright (c) 2021 Nuvoton Technology Corporation.
# SPDX-License-Identifier: Apache-2.0

description: |
  Nuvoton NPCX pads configuration map between Pin Mux controller and
  Power Switch Logic (PSL) controller driver instances.

compatible: "nuvoton,npcx-pslctrl-conf"

child-binding:
   description: |
     Child node to present the mapping between pin-mux controller
     and its power switch logic (PSL) support

   properties:
      offset:
         type: int
         required: true
         description: Offset in PSL_CTS for status and detection mode.

      pinctrl-0:
         type: phandles
         required: true
         description: Pinmux controller configuration for PSL io pads.

      polarity-0:
         type: phandles
         required: true
         description: Active polarity configuration for PSL io pads.

      flag:
         type: int
         required: false
         description: |
            Detection mode and type for wake-up event detection.
            5 = Configures PSL input in detecting rising edge.
            6 = Configures PSL input in in detecting level high state.
            9 = Configures PSL input in detecting falling edge.
            10 = Configures PSL input in detecting level low state.
         enum:
            - 5
            - 6
            - 9
            - 10
```

## dts/bindings/pinctrl/nuvoton,npcx-pslctrl-def.yaml
```yaml
# Copyright (c) 2021 Nuvoton Technology Corporation.
# SPDX-License-Identifier: Apache-2.0

description: Nuvoton, NPCX Default Power Switch Logic (PSL) input pads configurations

compatible: "nuvoton,npcx-pslctrl-def"

include: [base.yaml]

properties:
    psl-in-pads:
        type: phandles
        required: true
        description: |
            list of PSL input pads that are in charge of detecting the wake-up
            signals and the related circuit will turn on core power supply
            (VCC1) from standby power state (ultra-low-power mode) later.
```

## dts/bindings/pinctrl/nuvoton,npcx-scfg.yaml
```yaml
# Copyright (c) 2020 Nuvoton Technology Corporation.
# SPDX-License-Identifier: Apache-2.0

description: Nuvoton, NPCX System Configuration (Pinmux, 1.8V support and so on) node

compatible: "nuvoton,npcx-scfg"

include: [base.yaml]

properties:
    reg:
        required: true

    "#alt-cells":
        type: int
        required: true
        description: Number of items to expect in a SCFG ALT (Alternative controllers) specifier

    "#lvol-cells":
        type: int
        required: true
        description: Number of items to expect in a SCFG LV_GPIO_CTL (Low level IO controllers) specifier

alt-cells:
    - group
    - bit
    - inv

lvol-cells:
    - ctrl
    - bit
```

## dts/bindings/pinctrl/nuvoton,numaker-pinctrl.yaml
```yaml
# Copyright (c) Nuvoton Technology Corp. All rights reserved.
# SPDX-License-Identifier: Apache-2.0

description: |
  Pin controller is responsible for controlling pin function
  selection and pin properties. For example, for example you can
  use this node to set UART0 RX as pin PB12 to fulfill SYS_GPB_MFP3_PB12MFP_UART0_RXD.

  The node has the 'pinctrl' node label set in your SoC's devicetree,
  so you can modify it like this:

    &pinctrl {
            /* your modifications go here */
    };

  All device pin configurations should be placed in child nodes of the
  'pinctrl' node, as shown in this example:

    &pinctrl {
      /* configuration for the uart0 "default" state */
      uart0_default: uart0_default {
          /* configure PB13 as UART0 TX and PB12 as UART0 RX */
        group0 {
          pinmux = <PB12MFP_UART0_RXD>, <PB13MFP_UART0_TXD>;
        };
      };
    };


  To link pin configurations with a device, use a pinctrl-N property for some
  number N, like this example you could place in your board's DTS file:

    #include "board-pinctrl.dtsi"

    &uart0 {
        pinctrl-0 = <&uart0_default>;
        pinctrl-names = "default";
    };

compatible: "nuvoton,numaker-pinctrl"

include: base.yaml

properties:
  reg:
    required: true

child-binding:
  description: NuMaker pin controller pin group
  child-binding:
    description: |
      Each child node defines the configuration for a particular state.
    include:
      - name: pincfg-node.yaml
        property-allowlist:
          - drive-open-drain
          - input-schmitt-enable
    properties:
      pinmux:
        required: true
        type: array
        description: |
          An array of pins sharing the same group properties. The pins should
          be defined using pre-defined macros or, alternatively, using NVT_PINMUX
          macros depending on the pinmux model used by the SoC series.
      drive-strength:
        type: string
        default: "low"
        enum:
          - "low"
          - "fast"
        description: |
          Set the driving strength of a pin. Hardware default configuration is low and
          it's enough to drive most components, like as LED, CAN transceiver and so on.
      slew-rate:
        type: string
        default: "low"
        enum:
          - "low"
          - "high"
          - "fast"
        description: |
          Set the speed of a pin. This setting effectively limits the
          slew rate of the output signal. Hardware default configuration is low.
          Fast slew rate could support fast speed pins, like as SPI CLK up to 50MHz.
```

## dts/bindings/pinctrl/nuvoton,numicro-pinctrl.yaml
```yaml
# Copyright (c) 2022 SEAL AG
# SPDX-License-Identifier: Apache-2.0

description: |
  Nuvoton NuMicro pinctrl node. This node will define pin configurations in pin groups,
  and has the 'pinctrl' node identifier in the SOC's devicetree. Each group
  within the pin configuration defines the pin configuration for a peripheral,
  and each numbered subgroup in the pin group defines all the pins for that
  peripheral with the same configuration properties. The 'pinmux' property in
  a group selects the pins to be configured, and the remaining properties set
  configuration values for those pins. Here is an example group for UART0 pins:

  uart0_default: uart0_default {
    group0 {
      pinmux = <UART0_RXD_PB12>, <UART0_TXD_PB13>;
    };
  };

compatible: "nuvoton,numicro-pinctrl"

include: base.yaml

properties:
  reg:
    required: true

child-binding:
  description: NuMicro pin controller pin group
  child-binding:
    description: |
      NuMicro pin controller pin configuration node
    include:
      - name: pincfg-node.yaml
        property-allowlist:
          - bias-pull-down
          - bias-pull-up
          - drive-open-drain
          - input-schmitt-enable
          - input-disable
    properties:
      pinmux:
        required: true
        type: array
        description: |
          Pin mux selections for this group. See the SoC level pinctrl dtsi file
          for a defined list of these options.
      slew-rate:
        default: "normal"
        type: string
        enum:
          - "normal"
          - "high"
          - "fast"
        description: |
          Pin output slew rate. Sets the HSRENx register. If not set, defaults to the
          reset value (normal).
      input-debounce:
        type: boolean
        description: |
          enable the input debounce function
```

## dts/bindings/pinctrl/nxp,imx-blkctrl-ns-aon.yaml
```yaml
# Copyright 2025 NXP
# SPDX-License-Identifier: Apache-2.0

description: i.MX BLK CTRL NS AONMIX

compatible: "nxp,imx-blkctrl-ns-aon"

include: base.yaml

properties:
  reg:
    required: true

pinmux-cells:
  - offset
  - mask
```

## dts/bindings/pinctrl/nxp,imx-blkctrl-wakeup.yaml
```yaml
# Copyright 2025 NXP
# SPDX-License-Identifier: Apache-2.0

description: i.MX BLK CTRL WAKEUP

compatible: "nxp,imx-blkctrl-wakeup"

include: base.yaml

properties:
  reg:
    required: true

pinmux-cells:
  - offset
  - mask
```

## dts/bindings/pinctrl/nxp,imx-gpr.yaml
```yaml
# Copyright (c) 2021, NXP
# SPDX-License-Identifier: Apache-2.0

description: |
  i.MX IOMUXC

  The specifier space "pinmux" of this binding should have two cells describing
  the resources needed from the GPR registers.
  For each specifier, the first cell should be the offset of the GPR register in bytes
  from the base address of the GPR device base address. The second cell should be a
  bitmask indicating which bits in the specified register are relevant to the referencing device.

compatible: "nxp,imx-gpr"

include: base.yaml

properties:
  reg:
    required: true

pinmux-cells:
  - offset
  - mask
```

## dts/bindings/pinctrl/nxp,imx-iomuxc-scmi.yaml
```yaml
# Copyright 2024 NXP
# SPDX-License-Identifier: Apache-2.0

description: i.MX SCMI iomuxc node

compatible: "nxp,imx-iomuxc-scmi"

include: base.yaml

properties:
  reg:
    required: true

child-binding:
  description: pin mux option
  properties:
    pinmux:
      required: true
      type: array
      description: |
        An array of values defining the pin mux selection, in the following format:
        <mux_register, mux_val, input_reg, daisy_val, cfg_reg>
        mux_register: register that will be written to make mux selection
        mux_val: value to write to mux_register
        input_reg: peripheral register that will direct peripheral signal to pin
        daisy_val: value to write to input_reg
        cfg_reg: register that will configure pin pull, drive strength, and open drain
```

## dts/bindings/pinctrl/nxp,imx-iomuxc-scu.yaml
```yaml
# Copyright 2023 NXP
# SPDX-License-Identifier: Apache-2.0

description: |
  Use this compatible for i.MX boards on which the
  IOMUXC is managed by the SCU.

compatible: "nxp,imx-iomuxc-scu"

include: base.yaml

child-binding:
  description: SCFW-based IOMUXC pin mux.
  properties:
    pinmux:
      required: true
      type: array
      description: |
        This is an array of values defining the pin mux selection
        with the following format:

          <pad, mux>

        pad: Which pad to configure.
        mux: Select which signal to route.
```
