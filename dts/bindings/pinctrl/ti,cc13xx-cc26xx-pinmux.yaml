## dts/bindings/pmci/mctp/i2c_gpio_target.yaml
```yaml
# Copyright (c) 2025 Intel Corporation
# SPDX-License-Identifier: Apache-2.0

description: |
  A configuration for MCTP bindings to an I2C target with GPIO.

compatible: "zephyr,mctp-i2c-gpio-target"

properties:
  i2c:
    type: phandle
    description: |
      I2C peripheral that is used as an MCTP bus with the target mode API.

  i2c-addr:
    type: int
    description: |
      I2C address of endpoint

  endpoint-id:
    type: int
    description: |
      MCTP endpoint id

  endpoint-gpios:
    type: phandle-array
    description: |
      GPIO connected to the endpoint.
```

## dts/bindings/pmci/mctp/i3c_controller.yaml
```yaml
# Copyright (c) 2025 Intel Corporation
# SPDX-License-Identifier: Apache-2.0

description: |
  A configuration for MCTP bindings to an I3C controller.

compatible: "zephyr,mctp-i3c-controller"

properties:
  i3c:
    type: phandle
    description: |
      I3C controller that is used as an MCTP bus.

  endpoints:
    type: int
    description: |
      Number of MCTP endpoints supported by the I3C controller

  endpoint-ids:
    type: array
    description: |
      MCTP endpoint ids, length must match the number of endpoints

  endpoint-pids:
    type: array
    description: |
      I3C provisional ids of endpoints, an array of 2 32bit values. The length of
      which must match the described number of endpoints. The value must contain
      a valid i3c provisional id. An associated dts node with this provisional id
      must exist so that the I3C device handle may be obtained using it.
```

## dts/bindings/pmci/mctp/i3c_endpoint.yaml
```yaml
# Copyright (c) 2025 Intel Corporation
# SPDX-License-Identifier: Apache-2.0

include: [i3c-device.yaml]

description: |
  A configuration for MCTP endpoint connected to an I3C bus.

compatible: "zephyr,mctp-i3c-endpoint"
```

## dts/bindings/pmci/mctp/i3c_target.yaml
```yaml
# Copyright (c) 2025 Intel Corporation
# SPDX-License-Identifier: Apache-2.0

description: |
  A configuration for MCTP bindings to an I3C target.

compatible: "zephyr,mctp-i3c-target"

properties:
  i3c:
    type: phandle
    description: |
      I2C peripheral that is used as an MCTP bus with the target mode API.

  i3c-addr:
    type: int
    description: |
      I3C address of endpoint

  endpoint-id:
    type: int
    description: |
      MCTP endpoint id
```

## dts/bindings/pmci/mctp/usb.yaml
```yaml
# Copyright 2025 NXP
# SPDX-License-Identifier: Apache-2.0

description: |
  A configuration for MCTP binding to a USB target.

compatible: "zephyr,mctp-usb"

properties:
  endpoint-id:
    type: int
    description: |
      MCTP Endpoint ID
```
