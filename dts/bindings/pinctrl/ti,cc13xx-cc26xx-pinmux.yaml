## dts/bindings/pinctrl/ti,cc13xx-cc26xx-pinmux.yaml
```yaml
# Copyright (c) 2019 Brett Witherspoon
# SPDX-License-Identifier: Apache-2.0

description: TI SimpleLink CC13xx / CC26xx pinmux node

compatible: "ti,cc13xx-cc26xx-pinmux"

include: base.yaml

properties:
    reg:
      required: true
```

## dts/bindings/pinctrl/ti,cc23x0-pinctrl.yaml
```yaml
# Copyright (c) 2024 Texas Instruments Incorporated
# Copyright (c) 2024 BayLibre, SAS
# SPDX-License-Identifier: Apache-2.0

description: |
    TI SimpleLink CC23X0 Pin Controller

    Device pin configuration should be placed in the child nodes of this node.
    Populate the 'pinmux' field with a pair consisting of a pin number and its IO
    functions.

    The node has the 'pinctrl' node label set in your SoC's devicetree,
    so you can modify it like this:

      &pinctrl {
              /* your modifications go here */
      };

    All device pin configurations should be placed in child nodes of the
    'pinctrl' node, as in the i2c0 example shown at the end.

    Here is a list of
    supported standard pin properties:

    - bias-disable: Disable pull-up/down.
    - bias-pull-down: Enable pull-down resistor.
    - bias-pull-up: Enable pull-up resistor.
    - drive-open-drain: Output driver is open-drain.
    - drive-open-source: Output driver is open-source.
    - input-enable: enable input.
    - input-schmitt-enable: enable input schmitt circuit.

compatible: "ti,cc23x0-pinctrl"

include: base.yaml

properties:
  reg:
    required: true

child-binding:
  description: |
    This binding gives a base representation of the CC23X0
    pins configuration.

  include:
    - name: pincfg-node.yaml
      property-allowlist:
        - bias-disable
        - bias-pull-down
        - bias-pull-up
        - drive-open-drain
        - drive-open-source
        - input-enable
        - input-schmitt-enable

  properties:
    pinmux:
      required: true
      type: array
      description: |
        CC23X0 pin's configuration (IO pin, IO function).
```

## dts/bindings/pinctrl/ti,cc2650-pinmux.yaml
```yaml
# SPDX-License-Identifier: Apache-2.0
description: TI CC2650 pinmux node

compatible: "ti,cc2650-pinmux"

include: base.yaml

properties:
    reg:
      required: true

pinmux-cells:
  - pin
  - function
```

## dts/bindings/pinctrl/ti,cc32xx-pinctrl.yaml
```yaml
# Copyright (c) 2023 Nordic Semiconductor ASA
# SPDX-License-Identifier: Apache-2.0

description: |
    The TI CC32XX pin controller is a singleton node responsible for controlling
    pin function selection and pin properties. For example, you can
    use this node to route UART0 RX to pin 55 and enable the pull-up resistor
    on the pin.

    The node has the 'pinctrl' node label set in your SoC's devicetree,
    so you can modify it like this:

      &pinctrl {
              /* your modifications go here */
      };

    All device pin configurations should be placed in child nodes of the
    'pinctrl' node, as shown in this example:

      /* You can put this in places like a board-pinctrl.dtsi file in
       * your board directory, or a devicetree overlay in your application.
       */

      /* include pre-defined combinations for the SoC variant used by the board */
      #include <dt-bindings/pinctrl/gd32f450i(g-i-k)xx-pinctrl.h>

      &pinctrl {
        /* configuration for the uart0 "default" state */
        uart0_default: uart0_default {
          /* group 1 */
          group1 {
            /* configure pin 55 as UART0 TX and pin 61 as UART0 CTS */
            pinmux = <UART0_TX_P55>, <UART0_CTS_P61>;
          };
          /* group 2 */
          group2 {
            /* configure pin 57 as UART0 RX and pin 62 as UART0 RTS  */
            pinmux = <UART0_RX_P57>, <UART0_RTS_P62>;
            /* both pin 57 and 62 have pull-up enabled */
            bias-pull-up;
          };
        };

    The 'uart0_default' child node encodes the pin configurations for a
    particular state of a device; in this case, the default (that is, active)
    state.

    As shown, pin configurations are organized in groups within each child node.
    Each group can specify a list of pin function selections in the 'pinmux'
    property.

    A group can also specify shared pin properties common to all the specified
    pins, such as the 'bias-pull-up' property in group 2. Here is a list of
    supported standard pin properties:

    - drive-push-pull: Push-pull drive mode (default, not required).
    - drive-open-drain: Open-drain drive mode.
    - bias-disable: Disable pull-up/down (default, not required).
    - bias-pull-up: Enable pull-up resistor.
    - bias-pull-down: Enable pull-down resistor.
    - drive-strength: Configure drive strength in mA (defaults to 6mA, IC default).

    Note that drive and bias options are mutually exclusive.

    To link pin configurations with a device, use a pinctrl-N property for some
    number N, like this example you could place in your board's DTS file:

       #include "board-pinctrl.dtsi"

       &uart0 {
             pinctrl-0 = <&uart0_default>
             pinctrl-names = "default";
       };

compatible: "ti,cc32xx-pinctrl"

include: base.yaml

child-binding:
  child-binding:
    include:
      - name: pincfg-node.yaml
        property-allowlist:
          - drive-push-pull
          - drive-open-drain
          - bias-disable
          - bias-pull-down
          - bias-pull-up
          - drive-strength

    properties:
      pinmux:
        required: true
        type: array
        description: |
          An array of pins sharing the same group properties. The pins should
          be defined using pre-defined macros or, alternatively, using the
          TI_CC32XX_PINMUX helper macro.

      drive-strength:
        default: 6
        enum:
          - 0
          - 2
          - 4
          - 6
          - 8
          - 10
          - 12
          - 14
```

## dts/bindings/pinctrl/ti,k3-pinctrl.yaml
```yaml
# Copyright (c) 2023 Enphase Energy
# SPDX-License-Identifier: Apache-2.0

description: |
  TI K3 pinctrl node.

  Pins can be configured using the following macro "K3_PINMUX(offset, value, mux_mode)".
  offset - the pin attribute register offset from the base address.
  value - one of the following:
    PIN_OUTPUT
    PIN_OUTPUT_PULLUP
    PIN_OUTPUT_PULLDOWN
    PIN_INPUT
    PIN_INPUT_PULLUP
    PIN_INPUT_PULLDOWN
  mux_mode - The mux mode for the pin, MUX_MODE_0 -> MUX_MODE_9.
  e.g. for AM62x the pinctrl base address is 0xf4000.
       The default UART0_RX pin is located at 0x000f41c8 (mux mode 0).
       So the configuration would be "K3_PINMUX(0x1c8, PIN_INPUT, MUX_MODE_0)".

compatible: "ti,k3-pinctrl"

include: base.yaml

properties:
  reg:
    required: true

child-binding:
  description: |
    This binding gives a base representation of the TI K3
    pin configuration.

  properties:
    pinmux:
      required: true
      type: array
      description: |
        TI K3 pin configuration.
```

## dts/bindings/pinctrl/ti,mspm0-pinctrl.yaml
```yaml
# Copyright (c) 2024 Texas Instruments
# SPDX-License-Identifier: Apache-2.0

description: |
    TI MSPM0 pinctrl node.

    Device pin configuration should be placed in the child nodes of this node.
    Populate the 'pinmux' field with a pair consisting of a pin number and its IO
    functions.

    The node has the 'pinctrl' node label set in your SoC's devicetree,
    so you can modify it like this:

      &pinctrl {
              /* your modifications go here */
      };

    All device pin configurations should be placed in child nodes of the
    'pinctrl' node, as in the i2c0 example shown at the end.

    Here is a list of
    supported standard pin properties:

    - bias-disable: Disable pull-up/down.
    - bias-pull-down: Enable pull-down resistor.
    - bias-pull-up: Enable pull-up resistor.
    - drive-open-drain: Output driver is open-drain. (and is thus high-impedance)
    - drive-strength: Maximum current that can be sourced from the pin.
    - input-enable: enable input.
    - ti,invert: enable logical inversion of a digital input or output
    - ti,hysteresis: enable hysteresis control on open-drain pins

    An example for MSPM0 family, include the chip level pinctrl
    DTSI file in the board level DTS:

      #include <dt-bindings/pinctrl/mspm0-pinctrl.h>

    We want to configure the I2C pins to open drain, with pullup enabled
    and input enabled.

    To change a pin's pinctrl default properties add a reference to the
    pin in the board's DTS file or in the project overlay and set the
    properties.

      &i2c1 {
        pinctrl-0 = <&i2c1_scl_pb2_pull_up &i2c1_sda_pb3_pull_up>;
        pinctrl-names = "default";
      }

    The i2c1_scl_pb2_pull_up corresponds to the following pin configuration in
    the board dts file:

      &pinctrl {
        i2c1_scl_pb2_pull_up: i2c1_scl_pb2_pull_up {
          pinmux = <MSP_PINMUX(15,MSPM0_PIN_FUNCTION_4)>;
          input-enable;
          bias-pull-up;
          drive-open-drain;
        };
      };

    Pin pb2 refers to the device pin name that one would see printed on the
    launchpad, and the number 15 in the pinmux define refers to the PINCMx.

    These are obtained from the device-specific datasheet.

compatible: "ti,mspm0-pinctrl"

include: base.yaml

properties:
  reg:
    required: true

child-binding:
  description: |
    This binding gives a base representation of the MSPM0
    pins configuration.

  include:
    - name: pincfg-node.yaml
      property-allowlist:
        - bias-disable
        - bias-pull-down
        - bias-pull-up
        - drive-open-drain
        - drive-open-source
        - drive-strength
        - input-enable

  properties:
    pinmux:
      required: true
      type: int
      description: |
        MSPM0 pin's configuration (IO pin, IO function).

    drive-strength:
      enum:
        - 6
        - 20
      default: 6
      description: |
        The drive strength controls the maximum output drive strength sunk or
        sourced by an I/O pin.
          low is max 6 mA (SoC default)
          high is max 20 mA on high-drive capable IOs only (HDIO).

    ti,invert:
      type: boolean
      description: |
        Enables inversion of the input or output using the internal
        inversion capability of the GPIO

    ti,hysteresis:
      type: boolean
      description: |
        Enables the hysteresis control for access to CMOS logic
        (on open-drain capable pins)
```

## dts/bindings/pinctrl/ti,tiva-c-pinctrl.yaml
```yaml
# SPDX-License-Identifier: Apache-2.0
#
# Copyright (c) 2026 Linumiz
# Author: Sri Surya <srisurya@linumiz.com>

description: |
  TI Tiva C Series pin controller.

  Device pin configuration should be placed in child nodes of this node.
  Each child node specifies a single pinmux value that encodes the port,
  pin number, mux function, and peripheral type in one 32-bit integer
  (see dt-bindings/pinctrl/tiva-c-pinctrl.h):

    Bits [15:0]  — port index  (0=A … 5=F)
    Bits [18:16] — pin number  (0-7)
    Bits [22:19] — mux function (alternate-function 0-15)
    Bits [25:23] — pin type    (0=GPIO, 1=UART, … 6=PWM)

  Use the TIVA_C_PINMUX() helper macro from the dt-bindings header.

  Example for UART0 on PA0/PA1:

    #include <dt-bindings/pinctrl/tiva-c-pinctrl.h>

    &pinctrl {
      uart0_rx_pa0: uart0_rx_pa0 {
        pinmux = <TIVA_C_PINMUX(TIVA_C_PORT_A, 0, 1, TIVA_C_TYPE_UART)>;
      };
      uart0_tx_pa1: uart0_tx_pa1 {
        pinmux = <TIVA_C_PINMUX(TIVA_C_PORT_A, 1, 1, TIVA_C_TYPE_UART)>;
      };
    };

compatible: "ti,tiva-c-pinctrl"

include: base.yaml

properties:
  reg:
    required: true

child-binding:
  description: TI Tiva C pin configuration node.

  include:
    - name: pincfg-node.yaml
      property-allowlist:
        - bias-disable
        - bias-pull-up
        - bias-pull-down
        - drive-open-drain

  properties:
    pinmux:
      required: true
      type: int
      description: |
        32-bit pinmux value built with TIVA_C_PINMUX(port, pin, mux, type).
        Encodes port index (lower 16 bits) and pin number, mux function,
        and peripheral type (upper 16 bits) in a single value.
```

## dts/bindings/pinctrl/ti,tms570-pinmux.yaml
```yaml
# Copyright (c) 2025 ispace, inc.
# SPDX-License-Identifier: Apache-2.0

description: TI TMS570 pinmux driver

compatible: "ti,tms570-pinmux"

include: base.yaml

properties:
  reg:
    required: true

child-binding:
  properties:
    pinmux:
      required: true
      type: array
      description: |
        TMS570 pin's configuration (select bit pair) based on the "Output Multiplexing"
        table in the reference manual.
```

## dts/bindings/pinctrl/wch,20x_30x-afio.yaml
```yaml
# Copyright (c) 2024 Michael Hope
# SPDX-License-Identifier: Apache-2.0

description: WCH CH32V20x/30x AFIO

compatible: "wch,20x_30x-afio"

include: base.yaml

properties:
  reg:
    required: true
  "#address-cells":
    required: true
    const: 1
  "#size-cells":
    required: true
    const: 1

child-binding:
  description: |
    Each child node defines the configuration for a particular state.
  child-binding:
    description: |
      The grandchild nodes group pins that share the same pin configuration.

    include:
      - name: pincfg-node.yaml
        property-allowlist:
          - bias-high-impedance
          - bias-pull-up
          - bias-pull-down
          - drive-open-drain
          - drive-push-pull
          - output-high
          - output-low

    properties:
      slew-rate:
        type: string
        default: "max-speed-2mhz"
        enum:
          - "max-speed-10mhz"
          - "max-speed-2mhz"
          - "max-speed-50mhz"

      pinmux:
        required: true
        type: array
        description: |
          An array of pins sharing the same group properties. The pins should
          be defined using pre-defined macros.
```

## dts/bindings/pinctrl/wch,ch570-pinctrl.yaml
```yaml
# SPDX-FileCopyrightText: 2026 SMILE (smile.eu)
# SPDX-License-Identifier: Apache-2.0

description: WCH CH570/CH572 Alternate Function

compatible: "wch,ch570-pinctrl"

include: base.yaml

properties:
  reg:
    required: true
  "#address-cells":
    required: true
    const: 1
  "#size-cells":
    required: true
    const: 1

child-binding:
  description: |
    Each child node defines the configuration for a particular state.
  child-binding:
    description: |
      The grandchild nodes group pins that share the same pin configuration.

    include:
      - name: pincfg-node.yaml
        property-allowlist:
          - input-disable
          - bias-high-impedance
          - bias-pull-up
          - bias-pull-down
          - drive-push-pull
          - output-high
          - output-low

    properties:
      output-capacity:
        type: string
        default: "5mA-level"
        enum:
          - "5mA-level"
          - "20mA-level"
        description: |
          Configures the output pin drive strength (5 mA or 20 mA current
          drive capability).

      pinmux:
        required: true
        type: array
        description: |
          An array of pins sharing the same group properties. The pins should
          be defined using pre-defined macros.
```
