## dts/bindings/i2c/nuvoton,npcx-i2c-port.yaml
```yaml
# Copyright (c) 2020 Nuvoton Technology Corporation.
# SPDX-License-Identifier: Apache-2.0

description: Nuvoton NPCX-I2C port pads

compatible: "nuvoton,npcx-i2c-port"

include: [i2c-controller.yaml, pinctrl-device.yaml]

properties:
  port:
    type: int
    required: true
    description: |
      Index of i2c port
      This property is used to differentiate between multiple I2C ports controlled by the same
      or different I2C controllers.
      Bit[7:4] module id (controller).
      Bit[3:0] port id.
      Use the macro NPCX_I2C_CTRL_PORT(ctrl, port) to set this property.

  controller:
    type: phandle
    required: true
    description: i2c controller to handle signals from port pads

  pinctrl-0:
    required: true

  pinctrl-names:
    required: true

  clock-frequency:
    required: true
```

## dts/bindings/i2c/nuvoton,npcx-i2c.yaml
```yaml
# Copyright (c) 2020 Nuvoton Technology Corporation.
# SPDX-License-Identifier: Apache-2.0

description: Nuvoton, NPCX-I2C node

compatible: "nuvoton,npcx-i2c"

include: [i2c-controller.yaml]

properties:
    reg:
        required: true
    clocks:
        required: true
    label:
        required: true
    pinctrl:
        type: phandles
        required: true
        description: configurations of pinmux controllers
```

## dts/bindings/i2c/nuvoton,numaker-i2c.yaml
```yaml
# Copyright (c) 2023 Nuvoton Technology Corporation
# SPDX-License-Identifier: Apache-2.0

description: Nuvoton, NuMaker I2C controller

compatible: "nuvoton,numaker-i2c"

include: [i2c-controller.yaml, reset-device.yaml, pinctrl-device.yaml]

properties:
  reg:
    required: true

  interrupts:
    required: true

  resets:
    required: true

  clocks:
    required: true
```

## dts/bindings/i2c/nuvoton,numicro-i2c.yaml
```yaml
# Copyright (c) 2026 Fiona Behrens
# SPDX-License-Identifier: Apache-2.0

description: Nuvoton, Numicro I2C controller

compatible: "nuvoton,numicro-i2c"

include: [i2c-controller.yaml, reset-device.yaml, pinctrl-device.yaml]

properties:
  reg:
    required: true

  clock-frequency:
    required: true

  interrupts:
    required: true

  resets:
    required: true

  clocks:
    required: true
```

## dts/bindings/i2c/nxp,ii2c.yaml
```yaml
# Copyright 2024-2025 NXP
# SPDX-License-Identifier: Apache-2.0

description: NXP II2C

compatible: "nxp,ii2c"

include: [i2c-controller.yaml, pinctrl-device.yaml, "nxp,rdc-policy.yaml"]

properties:
  reg:
    required: true

  interrupts:
    required: true
```

## dts/bindings/i2c/nxp,imx-lpi2c.yaml
```yaml
# Copyright (c) 2019, NXP
# SPDX-License-Identifier: Apache-2.0

description: NXP i.MX LPI2C controller

compatible: "nxp,imx-lpi2c"

include: [i2c-controller.yaml, pinctrl-device.yaml]

properties:
    reg:
      required: true

    interrupts:
      required: true

    bus-idle-timeout:
      required: false
      type: int
      description: Bus idle timeout in nanoseconds

    scl-gpios:
      type: phandle-array
      required: false
      description: |
        GPIO to which the I2C SCL signal is routed. This is only needed for I2C bus recovery support.

    sda-gpios:
      type: phandle-array
      required: false
      description: |
        GPIO to which the I2C SDA signal is routed. This is only needed for I2C bus recovery support.
```

## dts/bindings/i2c/nxp,kinetis-i2c.yaml
```yaml
# Copyright (c) 2017 Linaro Limited
# SPDX-License-Identifier: Apache-2.0

description: Kinetis I2C node

compatible: "nxp,kinetis-i2c"

include: ["i2c-controller.yaml", "pinctrl-device.yaml"]

properties:
  reg:
    required: true

  interrupts:
    required: true

  pinctrl-0:
    required: true
```

## dts/bindings/i2c/nxp,lpc-i2c.yaml
```yaml
# Copyright (c) 2019 NXP
# SPDX-License-Identifier: Apache-2.0

description: LPC I2C node

compatible: "nxp,lpc-i2c"

include: [i2c-controller.yaml, "nxp,lpc-flexcomm.yaml"]

properties:
  scl-gpios:
    type: phandle-array
    description: |
      GPIO to which the I2C SCL signal is routed. This is only needed for I2C bus recovery
      support.

  sda-gpios:
    type: phandle-array
    description: |
      GPIO to which the I2C SDA signal is routed. This is only needed for I2C bus recovery
      support.
```

## dts/bindings/i2c/nxp,lpc11u6x-i2c.yaml
```yaml
# Copyright (c) 2020 Seagate Technology LLC
# SPDX-License-Identifier: Apache-2.0

description: LPC11U6X I2C Controller

compatible: "nxp,lpc11u6x-i2c"

include: [i2c-controller.yaml, pinctrl-device.yaml]

properties:
    reg:
      required: true

    interrupts:
      required: true

    clocks:
      required: true

    pinctrl-0:
      required: true

    pinctrl-names:
      required: true
```

## dts/bindings/i2c/nxp,lpi2c.yaml
```yaml
# Copyright (c) 2019, NXP
# SPDX-License-Identifier: Apache-2.0

description: NXP LPI2C controller

compatible: "nxp,lpi2c"

include: [i2c-controller.yaml, pinctrl-device.yaml]

properties:
  reg:
    required: true

  bus-idle-timeout:
    type: int
    description: Bus idle timeout in nanoseconds

  scl-gpios:
    type: phandle-array
    description: |
      GPIO to which the I2C SCL signal is routed. This is only needed for I2C bus recovery
      support.

  sda-gpios:
    type: phandle-array
    description: |
      GPIO to which the I2C SDA signal is routed. This is only needed for I2C bus recovery
      support.
```

## dts/bindings/i2c/nxp,s32-i2c-i3c.yaml
```yaml
# Copyright 2024 NXP
# SPDX-License-Identifier: Apache-2.0

description: NXP S32 I2C controller over I3C peripheral

compatible: "nxp,s32-i2c-i3c"

include: [i2c-controller.yaml, pinctrl-device.yaml]

properties:
  reg:
    required: true

  interrupts:
    required: true

  pinctrl-0:
    required: true

  pinctrl-names:
    required: true

  clocks:
    required: true

  baudrate-cfg:
    type: array
    required: true
    description: |
      An array of pre-computed baudrates needed for the controller to setting
      up I2C speed for I2C communication. For each used I2C rate, three elements
      need to be provided in the order: I2C, Open-Drain and Push-pull baudrate.
      These baudrates should be calculated by user based on Functional Clock and
      as required by application.

      For example: I3C instance 0 with Functional Clock is 134Mhz and application
      intends to use STANDARD, FAST and FAST_PLUS speed:

        &i3c0 = {
          baudrate-cfg = <I2C_BITRATE_STANDARD 500000 6000000>,
                          <I2C_BITRATE_FAST 1000000 6000000>,
                          <I2C_BITRATE_FAST_PLUS 1000000 6000000>;
        }

      The baudrate configuration does not need to be declared for unused I2C speeds.

  disable-timeout:
    type: boolean
    description: disable timeout to prevent application errors

  high-keeper:
    type: string
    default: HIGH_KEEPER_NONE
    enum:
      - HIGH_KEEPER_NONE
      - PASSIVE_SDA_SCL
    description: indicates how high-keeper is supposed to be support
```

## dts/bindings/i2c/nxp,sc18im704-i2c.yaml
```yaml
# Copyright (c), 2023 Basalte bv
# SPDX-License-Identifier: Apache-2.0

description: I2C controller part for the SC18IM704 bridge

compatible: "nxp,sc18im704-i2c"

include: i2c-controller.yaml

on-bus: nxp,sc18im704
```

## dts/bindings/i2c/openisa,rv32m1-lpi2c.yaml
```yaml
# Copyright (c) 2019, Henrik Brix Andersen <henrik@brixandersen.dk>
# SPDX-License-Identifier: Apache-2.0

description: OpenISA LPI2C controller

compatible: "openisa,rv32m1-lpi2c"

include: [i2c-controller.yaml, pinctrl-device.yaml]

properties:
    reg:
      required: true

    interrupts:
      required: true
```

## dts/bindings/i2c/quicklogic,eos-s3-i2c.yaml
```yaml
# Copyright (c) 2023 Szymon Duchniewicz
# SPDX-License-Identifier: Apache-2.0

description: Quicklogic EOS S3 I2C interface

compatible: "quicklogic,eos-s3-i2c"

include: i2c-controller.yaml

properties:
  reg:
    required: true
```

## dts/bindings/i2c/raspberrypi,pico-i2c.yaml
```yaml
description: Raspberry Pi Pico I2C

compatible: "raspberrypi,pico-i2c"

include: ["snps,designware-i2c.yaml", "reset-device.yaml"]
```

## dts/bindings/i2c/raspberrypi,pico-pio-i2c.yaml
```yaml
description: Raspberry Pi Pico I2C implemented on PIO

compatible: raspberrypi,pico-pio-i2c

include:
- i2c-controller.yaml
- pinctrl-device.yaml
- raspberrypi,pico-pio-device.yaml
- reset-device.yaml

properties: {}
```

## dts/bindings/i2c/realtek,ameba-i2c.yaml
```yaml
# Copyright (c) 2024 Realtek Semiconductor Corp.
# SPDX-License-Identifier: Apache-2.0

description: Ameba I2C

compatible: "realtek,ameba-i2c"

include: [i2c-controller.yaml, pinctrl-device.yaml]

properties:
  reg:
    required: true

  clock-frequency:
    required: true

  clocks:
    required: true

  interrupts:
    required: true

  pinctrl-0:
    required: true

  pinctrl-names:
    required: true
```

## dts/bindings/i2c/realtek,rts5912-i2c.yaml
```yaml
# Copyright (c) 2025 Realtek, SIBG-SD7
# SPDX-License-Identifier: Apache-2.0

description: Realtek RTS5912 I2C node

compatible: "realtek,rts5912-i2c"

include: base.yaml

properties:
  dw-i2c-dev:
    type: phandle
    required: true
    description: |
      DesignWare i2c device

  scl-gpios:
    type: phandle-array
    required: true
    description: |
      The SCL pin for the selected port.

  sda-gpios:
    type: phandle-array
    required: true
    description: |
      The SDA pin for the selected port.
```

## dts/bindings/i2c/refsoc,i2c.yaml
```yaml
#
# Copyright (c) 2018 Linaro Limited
#
# SPDX-License-Identifier: Apache-2.0
#
---
title: REFSOC I2C
version: 0.1

description: >
    This binding gives a base representation of the REFSOC I2C controller

inherits:
    !include i2c.yaml

properties:
    compatible:
      constraint: "refsoc,i2c"

    reg:
      type: array
      description: mmio register space
      generation: define
      category: required

    interrupts:
      type: array
      category: required
      description: required interrupts
      generation: define

    interrupt-names:
      type: stringlist
      category: optional
      description: readable string describing the interrupts
      generation: define
...
```

## dts/bindings/i2c/renesas,ra-i2c-sci-b.yaml
```yaml
# Copyright (c) 2025 Renesas Electronics Corporation
# SPDX-License-Identifier: Apache-2.0

description: Renesas RA SCI-B I2C controller

compatible: "renesas,ra-i2c-sci-b"

include: [i2c-controller.yaml, pinctrl-device.yaml]

properties:

  channel:
    required: true
    type: int

  sda-output-delay:
    type: int
    default: 300
    description: |
      SDA Output Delay in nano seconds.

  noise-filter-clock-select:
    type: int
    default: 1
    enum: [1, 2, 3, 4]
    description: |
      Select the on-chip baud rate generator source clock
      division setting for the digital noise filter.

  bit-rate-modulation:
    type: boolean
    description: |
      Enabling bitrate modulation reduces the percent error
      of the actual bitrate with respect to the requested baud rate.
```

## dts/bindings/i2c/renesas,ra-i2c.yaml
```yaml
# Copyright (c) 2024 TOKITA Hiroshi <tokita.hiroshi@fujitsu.com>
# SPDX-License-Identifier: Apache-2.0

description: Renesas RA series I2C

compatible: "renesas,ra-i2c"

include: [i2c-controller.yaml, pinctrl-device.yaml]

properties:
  reg:
    required: true

  clocks:
    required: true

  pinctrl-0:
    required: true

  pinctrl-names:
    required: true

  clock-rise-time:
    type: int
    description: |
      Specify the rise time of the SCL pulse in microseconds.

  clock-fall-time:
    type: int
    description: |
      Specify the fall time of the SCL pulse in microseconds.
```

## dts/bindings/i2c/renesas,ra-iic.yaml
```yaml
# Copyright (c) 2024-2025 Renesas Electronics Corporation
# SPDX-License-Identifier: Apache-2.0

description: Renesas RA I2C controller

compatible: "renesas,ra-iic"

include: [i2c-controller.yaml, pinctrl-device.yaml]

properties:
  reg:
    required: true

  clocks:
    required: true

  channel:
    required: true
    type: int

  interrupts:
    required: true

  interrupt-names:
    required: true
    enum: ["tei", "eri", "rxi", "txi"]

  rise-time-ns:
    type: int
    default: 120

  fall-time-ns:
    type: int
    default: 120

  duty-cycle-percent:
    type: int
    default: 50

  max-bitrate-supported:
    type: int
    default: 1000000
    description: |
      Maximum supported I2C bitrate in Hz, with the default set to I2C_BITRATE_FAST_PLUS.
      This property may be overlayed if the device supports higher or lower speeds.

  target-digital-noise-filter:
    type: int
    enum: [0, 1, 2, 3, 4]
    default: 3
    description: |
      Select the number of digital filter stages for IIC target
```

## dts/bindings/i2c/renesas,rcar-i2c.yaml
```yaml
# Copyright (c) 2021, IoT.bzh
# SPDX-License-Identifier: Apache-2.0

description: Renesas R-Car I2C controller

compatible: "renesas,rcar-i2c"

include: i2c-controller.yaml

properties:
  reg:
    required: true
  interrupts:
    required: true
  clocks:
    required: true
```

## dts/bindings/i2c/renesas,rx-i2c.yaml
```yaml
# Copyright (c) 2025 Renesas Electronics Corporation
# SPDX-License-Identifier: Apache-2.0

description: Renesas RX I2C Master controller

compatible: "renesas,rx-i2c"

include: [i2c-controller.yaml, pinctrl-device.yaml]

properties:
  channel:
    required: true
    type: int

  interrupts:
    required: true

  interrupt-names:
    required: true
```

## dts/bindings/i2c/renesas,rz-riic.yaml
```yaml
# Copyright (c) 2024-2025 Renesas Electronics Corporation
# SPDX-License-Identifier: Apache-2.0

description: Renesas RZ I2C controller

compatible: "renesas,rz-riic"

include: [i2c-controller.yaml, pinctrl-device.yaml]

properties:
  reg:
    required: true

  channel:
    required: true
    type: int

  interrupts:
    required: true

  rise-time-ns:
    type: int
    default: 120
    description: |
      Number of nanoseconds the SCL signal takes to rise; t(r) in the I2C specification.

  fall-time-ns:
    type: int
    default: 120
    description: |
      Number of nanoseconds the SCL signal takes to fall; t(f) in the I2C specification.

  duty-cycle-percent:
    type: int
    default: 50

  noise-filter-stages:
    type: int
    default: 1
    enum:
      - 1
      - 2
      - 3
      - 4
```
