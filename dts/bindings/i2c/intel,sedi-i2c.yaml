## dts/bindings/i2c/intel,sedi-i2c.yaml
```yaml
#
# Copyright (c) 2023 Intel Corporation.
#
# SPDX-License-Identifier: Apache-2.0
#

description: Intel SEDI I2C

compatible: "intel,sedi-i2c"

include: i2c-controller.yaml

properties:
  reg:
    required: true

  interrupts:
    required: true

  peripheral-id:
    type: int
    description: Peripheral Instance ID
    required: true

  # Optional bus timing values (all units are nanoseconds). If omitted,
  # driver will use built-in defaults.
  bus-timings-std:
    type: array
    description: Standard mode timings [sda-hold, hcnt, lcnt] in ns

  bus-timings-fst:
    type: array
    description: Fast mode timings [sda-hold, hcnt, lcnt] in ns

  bus-timings-fsp:
    type: array
    description: Fast-plus mode timings [sda-hold, hcnt, lcnt] in ns

  bus-timings-high:
    type: array
    description: High mode timings [sda-hold, hcnt, lcnt] in ns
```

## dts/bindings/i2c/it8xxx2-i2c.yaml
```yaml
# Copyright (c) 2020 ITE Corporation. All Rights Reserved.
# SPDX-License-Identifier: Apache-2.0

description: ITE it8xxx2 I2C

compatible: "it8xxx2-i2c"

include: i2c-controller.yaml

properties:
    reg:
      required: true

    label:
      required: true

    interrupts:
      required: true

    port_num:
      type: int
      required: true
```

## dts/bindings/i2c/ite,common-i2c.yaml
```yaml
# Copyright (c) 2022 ITE Corporation. All Rights Reserved.
# SPDX-License-Identifier: Apache-2.0

description: Common fields for ITE it8xxx2 I2C

include: [i2c-controller.yaml, pinctrl-device.yaml]

properties:
  reg:
    required: true

  interrupts:
    required: true

  port-num:
    type: int
    required: true
    enum:
      - 0
      - 1
      - 2
      - 3
      - 4
      - 5
    description: Ordinal identifying the port
      0 = SMB_CHANNEL_A,
      1 = SMB_CHANNEL_B,
      2 = SMB_CHANNEL_C,
      3 = I2C_CHANNEL_D,
      4 = I2C_CHANNEL_E,
      5 = I2C_CHANNEL_F,

  channel-switch-sel:
    type: int
    required: true
    enum:
      - 0
      - 1
      - 2
      - 3
      - 4
      - 5
    description: |
      The default setting is as described below
      0 = I2C_CHA_LOCATE: Channel A is located at SMCLK0/SMDAT0
      1 = I2C_CHB_LOCATE: Channel B is located at SMCLK1/SMDAT1
      2 = I2C_CHC_LOCATE: Channel C is located at SMCLK2/SMDAT2
      3 = I2C_CHD_LOCATE: Channel D is located at SMCLK3/SMDAT3
      4 = I2C_CHE_LOCATE: Channel E is located at SMCLK4/SMDAT4
      5 = I2C_CHF_LOCATE: Channel F is located at SMCLK5/SMDAT5

      The following is an example of the 'channel-switch-sel' property
      being swapped between node &i2c0 and &i2c2 in the application:
      Note: The property of 'port-num' cannot be changed in the
            application.

      Channel C is located at SMCLK0/SMDAT0:
      &i2c0 {
             channel-switch-sel = <I2C_CHC_LOCATE>;
             pinctrl-0 = <&i2c2_clk_gpf6_default
                          &i2c2_data_gpf7_default>;
             pinctrl-names = "default";
             scl-gpios = <&gpiof 6 0>;
             sda-gpios = <&gpiof 7 0>;
      };

      Channel A is located at SMCLK2/SMDAT2:
      &i2c2 {
             channel-switch-sel = <I2C_CHA_LOCATE>;
             pinctrl-0 = <&i2c0_clk_gpb3_default
                          &i2c0_data_gpb4_default>;
             pinctrl-names = "default";
             scl-gpios = <&gpiob 3 0>;
             sda-gpios = <&gpiob 4 0>;
      };

      If the property of 'channel-switch-sel' is changed, the pinctrl
      setting and recovery pin in &i2c0 and &i2c2 nodes must also be
      modified accordingly.

  scl-gpios:
    type: phandle-array
    required: true
    description: |
      The SCL pin for the selected port.

  sda-gpios:
    type: phandle-array
    required: true
    description: |
      The SDA pin for the selected port.

  clock-gate-offset:
    type: int
    required: true
    description: |
      The clock gate offsets combine the register offset from
      ECPM_BASE and the mask within that register into one value.

  transfer-timeout-ms:
    type: int
    default: 100
    description: |
      Maximum time allowed for an I2C transfer.

  pinctrl-0:
    required: true

  pinctrl-names:
    required: true

  push-pull-recovery:
    type: boolean
    description: |
      This property is enabled when selecting the push-pull GPIO output
      type to drive the I2C recovery. The default is open-drain.
```

## dts/bindings/i2c/ite,it51xxx-i2c.yaml
```yaml
# Copyright (c) 2025 ITE Corporation. All Rights Reserved.
# SPDX-License-Identifier: Apache-2.0

description: ITE it51xxx I2C

compatible: "ite,it51xxx-i2c"

include: [i2c-controller.yaml, pinctrl-device.yaml]

properties:
  reg:
    required: true

  interrupts:
    required: true

  pinctrl-0:
    required: true

  pinctrl-names:
    required: true

  scl-gpios:
    type: phandle-array
    required: true
    description: |
      The SCL pin for the selected port.

  sda-gpios:
    type: phandle-array
    required: true
    description: |
      The SDA pin for the selected port.

  transfer-timeout-ms:
    type: int
    default: 500
    description: |
      Maximum time allowed for an I2C transfer.

  port-num:
    type: int
    required: true
    enum:
      - 0
      - 1
      - 2
      - 3
      - 4
      - 5
      - 6
      - 7
      - 8
    description: Ordinal identifying the port
      0 = SMB_CHANNEL_A,
      1 = SMB_CHANNEL_B,
      2 = SMB_CHANNEL_C,
      3 = SMB_CHANNEL_D,
      4 = SMB_CHANNEL_E,
      5 = SMB_CHANNEL_F,
      6 = SMB_CHANNEL_G,
      7 = SMB_CHANNEL_H,
      8 = SMB_CHANNEL_I,

  channel-switch-sel:
    type: int
    required: true
    enum:
      - 1
      - 2
      - 3
      - 4
      - 5
      - 6
      - 7
      - 8
      - 9
      - 10
      - 11
      - 12
      - 13
    description: |
      The default setting is as described below
      1 = SMB_SWITCH_INTERFACE0: Switch to interface0 SMCLK0/SMDAT0
      2 = SMB_SWITCH_INTERFACE1: Switch to interface1 SMCLK1/SMDAT1
      3 = SMB_SWITCH_INTERFACE2: Switch to interface2 SMCLK2/SMDAT2
      4 = SMB_SWITCH_INTERFACE3: Switch to interface3 SMCLK3/SMDAT3
      5 = SMB_SWITCH_INTERFACE4: Switch to interface4 SMCLK4/SMDAT4
      6 = SMB_SWITCH_INTERFACE5: Switch to interface5 SMCLK5/SMDAT5
      7 = SMB_SWITCH_INTERFACE6: Switch to interface6 SMCLK6/SMDAT6
      8 = SMB_SWITCH_INTERFACE7: Switch to interface7 SMCLK7/SMDAT7
      9 = SMB_SWITCH_INTERFACE8: Switch to interface8 SMCLK8/SMDAT8
      10 = SMB_SWITCH_INTERFACE9: Switch to interface9 SMCLK9/SMDAT9
      11 = SMB_SWITCH_INTERFACE10: Switch to interface10 SMCLK10/SMDAT10
      12 = SMB_SWITCH_INTERFACE11: Switch to interface11 SMCLK11/SMDAT11
      13 = SMB_SWITCH_INTERFACE12: Switch to interface12 SMCLK12/SMDAT12

      The following is an example of the 'channel-switch-sel' property
      being swapped between node &i2c0 and &i2c2 in the application:
      Note: The property of 'port-num' cannot be changed in the
            application.

            If the property of 'channel-switch-sel' is changed, the pinctrl
            setting and recovery pin in &i2c0 and &i2c2 nodes must also be
            modified accordingly.

      Valid example(Host):

      Channel A switches to interface2:
      &i2c0 {
             status = "okay";
             pinctrl-0 = <&i2c2_clk_gpf6_default
                          &i2c2_data_gpf7_default>;
             pinctrl-names = "default";
             scl-gpios = <&gpiof 6 0>;
             sda-gpios = <&gpiof 7 0>;
             channel-switch-sel = <SMB_SWITCH_INTERFACE2>;
      };

      Channel C switches to interface0:
      &i2c2 {
             status = "okay";
             pinctrl-0 = <&i2c0_clk_gpf2_default
                          &i2c0_data_gpf3_default>;
             pinctrl-names = "default";
             scl-gpios = <&gpiof 2 0>;
             sda-gpios = <&gpiof 3 0>;
             channel-switch-sel = <SMB_SWITCH_INTERFACE0>;
      };

      Invalid example(Host):

      Channel A switches to interface2:
      &i2c0 {
             status = "okay";
             pinctrl-0 = <&i2c2_clk_gpf6_default
                          &i2c2_data_gpf7_default>;
             pinctrl-names = "default";
             scl-gpios = <&gpiof 6 0>;
             sda-gpios = <&gpiof 7 0>;
             channel-switch-sel = <SMB_SWITCH_INTERFACE2>;
      };

      Channel C maintains the original configuration:
      &i2c2 {
             status = "okay";
             pinctrl-0 = <&i2c2_clk_gpf6_default
                          &i2c2_data_gpf7_default>;
             pinctrl-names = "default";
      };

      Valid example(Target):

      Channel A switches to interface5:
      &i2c0 {
             status = "okay";
             pinctrl-0 = <&i2c5_clk_gpa4_default
                          &i2c5_data_gpa5_default>;
             pinctrl-names = "default";
             scl-gpios = <&gpioa 4 0>;
             sda-gpios = <&gpioa 5 0>;
             channel-switch-sel = <SMB_SWITCH_INTERFACE5>;

             target-enable;
             i2c0_target: target@52 {
                 compatible = "ite,target-i2c";
                 reg = <0x52>;
             };
      };

  target-enable:
    type: boolean
    description: |
      This option is used when the I2C target is enabled. It is
      necessary to prevent the target port from being configured
      with I2C host related initialization.

  target-fifo-mode:
    type: boolean
    description: |
      Only supports write or read mode and the maximum buffer size
      is 256 bytes. Support dedicated FIFO mode 16 bytes.

  target-shared-fifo-mode:
    type: boolean
    description: |
      This option is used to support non-FIFO write to shared FIFO
      read mode. The maximum supported shared FIFO is 256 bytes.

  fifo-enable:
    type: boolean
    description: |
      The I2C controller supports two 32-bytes FIFOs,
      FIFO1 supports I2C port 0. FIFO2 only supports one port among
      1~8. The default is I2C port 1.

  push-pull-recovery:
    type: boolean
    description: |
      This property is enabled when selecting the push-pull GPIO output
      type to drive the I2C recovery. The default is open-drain.
```

## dts/bindings/i2c/ite,it8xxx2-i2c.yaml
```yaml
# Copyright (c) 2020 ITE Corporation. All Rights Reserved.
# SPDX-License-Identifier: Apache-2.0

description: ITE it8xxx2 I2C

compatible: "ite,it8xxx2-i2c"

include: ite,common-i2c.yaml

properties:
    fifo-enable:
      required: false
      type: boolean
      description: |
        FIFO1 supports channel A.
        FIFO2 only supports one channel of B or C.
```

## dts/bindings/i2c/litex,i2c.yaml
```yaml
#
# Copyright (c) 2019 Antmicro <www.antmicro.com>
#
# SPDX-License-Identifier: Apache-2.0
#

description: LiteX I2C controller

compatible: "litex,i2c"

include: i2c-controller.yaml

properties:
    reg:
      required: true
```

## dts/bindings/i2c/litex,litei2c.yaml
```yaml
#
# Copyright (c) 2024 Vogl Electronic GmbH
#
# SPDX-License-Identifier: Apache-2.0
#

description: LiteX LiteI2C I2C controller

compatible: "litex,litei2c"

include: i2c-controller.yaml

properties:
  reg:
    required: true

  clock-frequency:
    required: true
```

## dts/bindings/i2c/lowrisc,opentitan-i2c.yaml
```yaml
# Copyright (c) 2025 Rivos Inc.
# SPDX-License-Identifier: Apache-2.0

description: OpenTitan I2C controller

compatible: "lowrisc,opentitan-i2c"

include: i2c-controller.yaml

properties:
  reg:
    description: Base address and size of the I2C registers.
    required: true
  clocks:
    description: Input clock for the I2C controller.
    required: true
```

## dts/bindings/i2c/microchip,mec5-i2c.yaml
```yaml
# Copyright (c) 2024 Microchip Technology Inc.
# SPDX-License-Identifier: Apache-2.0

description: Microchip MEC5 I2C-SMB controller

compatible: "microchip,mec5-i2c"

include: [i2c-controller.yaml, pinctrl-device.yaml]

properties:
  reg:
    required: true

  port_sel:
    type: int
    description: soc block mapping to pin
    required: true

  pinctrl-0:
    required: true

  pinctrl-names:
    required: true

  sda-gpios:
    type: phandle-array
    required: true
    description: |
      The SDA pin for the selected port. Pin choice for port is
      determined by chip and package.

  scl-gpios:
    type: phandle-array
    required: true
    description: |
      The SCL pin for the selected port. Pin choice for port is
      determined by chip and package.
```

## dts/bindings/i2c/microchip,mpfs-i2c.yaml
```yaml
#
# Copyright (c) 2023 Microchip Technology Inc.
#
# SPDX-License-Identifier: Apache-2.0
#

description: Microchip MPFS I2C Controller

compatible: "microchip,mpfs-i2c"

include: i2c-controller.yaml

properties:
  reg:
    required: true

  interrupts:
    required: true

  clock-frequency:
    description: |
      Desired I2C bus clock frequency in Hz. As only Standard and Fast
      modes are supported, possible values are 100000 and 400000.
    enum: [100000, 400000]
```

## dts/bindings/i2c/microchip,pic32cxsg-i2c.yaml
```yaml
# Copyright (c) 2024 Microchip
# SPDX-License-Identifier: Apache-2.0

description: Microchip PIC32CXSG series SERCOM I2C node

compatible: "microchip,pic32cxsg-i2c"

include:
  - name: i2c-controller.yaml
  - name: pinctrl-device.yaml

properties:
  reg:
    required: true

  interrupts:
    required: true

  clocks:
    required: true

  clock-names:
    required: true

  dmas:
    description: |
      Optional TX & RX dma specifiers.  Each specifier will have a phandle
      reference to the dmac controller, the channel number, and peripheral
      trigger source.

      For example dmas for TX, RX on SERCOM3
         dmas = <&dmac 0 0xb>, <&dmac 0 0xa>;

  dma-names:
    description: |
      Required if the dmas property exists.  This should be "tx" and "rx"
      to match the dmas property.

      For example
         dma-names = "tx", "rx";
```

## dts/bindings/i2c/microchip,sercom-g1-i2c.yaml
```yaml
# Copyright (c) 2025 Microchip Technology Inc.
# SPDX-License-Identifier: Apache-2.0

title: Microchip SERCOM G1 I2C driver

description: |
  Microchip SERCOM I2C driver bindings.

  Group g1 SERCOM I2C driver supports following hardware peripherals:
    - module name="SERCOM" id="U2201" version="5.0.0"

compatible: "microchip,sercom-g1-i2c"

include:
  - name: i2c-controller.yaml
  - name: pinctrl-device.yaml

properties:
  reg:
    required: true

  interrupts:
    required: true

  clocks:
    required: true

  clock-names:
    required: true

  run-in-standby-en:
    type: int
    enum:
      - 0
      - 1
    default: 1
    description: |
      Enable (1) or disable (0) runstandby mode for SERCOM I2C.

  dmas:
    description: |
      Optional TX & RX dma specifiers.  Each specifier will have a phandle
      reference to the dmac controller, the channel number, and peripheral
      trigger source.

      For example dmas for TX, RX on SERCOM3
         dmas = <&dmac 0 0xb>, <&dmac 0 0xa>;

  dma-names:
    description: |
      Required if the dmas property exists.  This should be "tx" and "rx"
      to match the dmas property.

      For example
         dma-names = "tx", "rx";
```
