## dts/bindings/i2c/microchip,xec-i2c-v2.yaml
```yaml
# Copyright (c) 2019 Intel Corporation
# SPDX-License-Identifier: Apache-2.0

description: Microchip I2C/SMB V2 controller

compatible: "microchip,xec-i2c-v2"

include:
  - "i2c-controller.yaml"
  - "pinctrl-device.yaml"
  - "microchip,dmec-ecia-girq.yaml"

properties:
  reg:
    required: true

  port-sel:
    type: int
    description: soc block mapping to pin
    required: true

  pcr-scr:
    type: int
    required: true
    description: |
      Encoded PCR index and bit position used for peripheral sleep enable
      and reset.

  pinctrl-0:
    required: true

  pinctrl-names:
    required: true

  sda-gpios:
    type: phandle-array
    required: true
    description: |
      I2C controller versions older than v3.8 do not make pin
      state monitoring visible in the bit-bang register without
      switching the pins from I2C control to bit-bang control.
      This can cause disruption of an open I2C session. For older
      hardware access pin state using the GPIO driver.

  scl-gpios:
    type: phandle-array
    required: true
    description: |
      Refer to the description of sda-gpios.

  wakeup-source:
    type: boolean
    description: |
      Set this property if the I2C controller is used as a wake source for
      the SoC. When set, the driver arms the SMB block's native START-bit
      wake detector during PM suspend so an external master initiating a
      transaction wakes the EC. The hardware auto clock-stretches SCL
      until clocks are restored, so no data is lost. Only effective for
      target-mode use (a controller-only master initiates STARTs and does
      not need wake).
```

## dts/bindings/i2c/microchip,xec-i2c-v3.yaml
```yaml
# Copyright (c) 2026 Microchip Technology Inc.
# SPDX-License-Identifier: Apache-2.0

description: Microchip XEC I2C-SMB V3 controller byte mode driver

compatible: "microchip,xec-i2c-v3"

include: [i2c-controller.yaml, pinctrl-device.yaml]

properties:
  reg:
    required: true

  interrupts:
    required: true

  port-sel:
    type: int
    required: true
    description: |
      XEC I2C controller has a hardware MUX to select among
      multiple I2C ports. I2C pins must be set to their I2C
      mode using PINCTRL. The driver can then select the pins
      by programming the port select register field in the
      controller's configuration register.

  girqs:
    type: array
    required: true
    description: array of GIRQ numbers [8:26] and bit positions [0:31]

  pcr-scr:
    type: int
    required: true
    description: |
      I2C controller PCR register index and bit position encoded
      in an integer.

  pinctrl-0:
    required: true

  pinctrl-names:
    required: true

  sda-gpios:
    type: phandle-array
    description: |
      I2C controller versions older than v3.8 do not make pin
      state monitoring visible in the bit-bang register without
      switching the pins from I2C control to bit-bang control.
      This can cause disruption of an open I2C session. For older
      hardware use access pin state using the GPIO driver.

  scl-gpios:
    type: phandle-array
    description: |
      Refer to the description of sda-gpios.

  target-buf-write-req-buffer-size:
    type: int
    default: 8
    description: |
      The property allows each instance of the driver to have
      a unique target buffer write request buffer size in bytes.
      This property is only used if the driver is built with
      I2C target buffer mode enabled.
```

## dts/bindings/i2c/microchip,xec-i2c.yaml
```yaml
# Copyright (c) 2019 Intel Corporation
# SPDX-License-Identifier: Apache-2.0

description: Microchip I2C/SMB controller

compatible: "microchip,xec-i2c"

include: [i2c-controller.yaml, pinctrl-device.yaml]

properties:
  reg:
    required: true

  port-sel:
    type: int
    description: soc block mapping to pin
    required: true

  girq:
    type: int
    required: true
    description: GIRQ for this device

  girq-bit:
    type: int
    required: true
    description: Bit position in GIRQ for this device

  pcrs:
    type: array
    required: true
    description: PCR sleep register index and bit position

  pinctrl-0:
    required: true

  pinctrl-names:
    required: true

  sda-gpios:
    type: phandle-array
    required: true
    description: |
      The SDA pin for the selected port. Pin choice for port is
      determined by chip and package.

  scl-gpios:
    type: phandle-array
    required: true
    description: |
      The SCL pin for the selected port. Pin choice for port is
      determined by chip and package.
```

## dts/bindings/i2c/nios2,i2c.yaml
```yaml
# Copyright (c) 2018 Intel Corporation
# SPDX-License-Identifier: Apache-2.0

description: NIOS2 I2C

compatible: "nios2,i2c"

include: i2c-controller.yaml

properties:
    reg:
      required: true

    interrupts:
      required: true
```

## dts/bindings/i2c/nordic,nrf-i2c.yaml
```yaml
# Copyright (c) 2018 Aapo Vienamo
# Copyright (c) 2018 Nordic Semiconductor ASA
# SPDX-License-Identifier: Apache-2.0

title: Nordic nRF Family I2C Master node

description: >
    This is a representation of the Nordic nRF I2C node

compatible: "nordic,nrf-i2c"

include: i2c-controller.yaml

properties:
    reg:
      required: true

    interrupts:
      required: true

    sda-pin:
      type: int
      description: SDA pin
      required: true

    scl-pin:
      type: int
      description: SCL pin
      required: true
```

## dts/bindings/i2c/nordic,nrf-twi-common.yaml
```yaml
# Copyright (c) 2018 Aapo Vienamo
# Copyright (c) 2018 Nordic Semiconductor ASA
# SPDX-License-Identifier: Apache-2.0

# Common fields for Nordic nRF family TWI peripherals

include: [i2c-controller.yaml, pinctrl-device.yaml, nordic-clockpin.yaml]

properties:
  reg:
    required: true

  interrupts:
    required: true

  pinctrl-0:
    required: true

  pinctrl-names:
    required: true

  easydma-maxcnt-bits:
    type: int
    required: true
    description: |
      Maximum number of bits available in the EasyDMA MAXCNT register. This
      property must be set at SoC level DTS files.

  clock-tolerance-percent:
    type: int
    description: |
      This property is used to correct for clock inaccuracy to ensure that SCL
      frequency does not exceed the value specified in "clock-frequency".
```

## dts/bindings/i2c/nordic,nrf-twi.yaml
```yaml
# Copyright (c) 2019 Nordic Semiconductor ASA
# SPDX-License-Identifier: Apache-2.0

description: |
  Nordic nRF family TWI (TWI master).

  This binding can be used for nodes which can represent TWI
  peripherals. When a single SoC peripheral ID corresponds to multiple
  I2C peripherals (like TWI or TWIM), the corresponding devicetree
  nodes must be set up to select TWI before use.

  To select TWI, set the node's "compatible" to "nordic,nrf-twi" and
  its "status" to "okay", e.g. using an overlay file like this:

      /* This is for TWI0 -- change to "i2c1" for TWI1. */
      &i2c0 {
              compatible = "nordic,nrf-twi";
              status = "okay";
              /* other property settings can go here */
      };

  You can use either of these options to check TWI availability on
  your SoC:

      1. Check the peripheral Instantiation table in the Memory
         section of your SoC's Product Specification document.
         A "TWI0" instance in the table means "i2c0" in the devicetree
         can be used with this binding, and similarly for "TWI1".

      2. Open your SoC's .dtsi file and look for a node definition that
         documents TWI support, like this:

             i2c0: i2c@40003000 {
                     /*
                      * This i2c node can be TWI, [...].
                      */
                     ...
             };

   If your SoC only has TWIM and TWIS I2C peripherals, you cannot use
   this binding. See the "nordic,nrf-twim" binding instead.

compatible: "nordic,nrf-twi"

include: nordic,nrf-twi-common.yaml
```

## dts/bindings/i2c/nordic,nrf-twim.yaml
```yaml
# Copyright (c) 2019 Nordic Semiconductor ASA
# SPDX-License-Identifier: Apache-2.0

description: |
  Nordic nRF family TWIM (TWI master with EasyDMA).

  This binding can be used for nodes which can represent TWIM
  peripherals. A single SoC peripheral ID is often associated with
  multiple I2C peripherals, like a TWIM and a TWIS. You can choose
  TWIM by setting the node's "compatible" to "nordic,nrf-twim"
  and "status" to "okay", e.g. using an overlay file like this one:

      /* This is for TWIM0 -- change to "i2c1" for TWIM1, etc. */
      &i2c0 {
              compatible = "nordic,nrf-twim";
              status = "okay";
              /* other property settings can go here */
      };

  This works on any supported SoC, for all TWIM instances.

  Note: on nRF51 SoCs, use the "nordic,nrf-twi" binding instead.

compatible: "nordic,nrf-twim"

include: nordic,nrf-twi-common.yaml

properties:
    zephyr,concat-buf-size:
        type: int
        required: false
        default: 16
        description: |
            Size of a concatenation buffer that the driver is to use for merging
            multiple same direction I2C messages that have no RESTART or STOP
            flag between them (see e.g. the i2c_burst_write() function) into one
            transfer on the bus.

            This property must be provided when interacting with devices like
            the SSD1306 display that cannot tolerate a repeated start and
            address appearing on the bus between message fragments. For many
            devices a concatenation buffer is not necessary.

    zephyr,flash-buf-max-size:
        type: int
        required: false
        default: 16
        description: |
            TWIM peripherals cannot perform write transactions from buffers
            located in flash. If such buffers are expected to be used with
            a given instance of the TWIM peripheral, this property must be
            set to the maximum possible size of those buffers, so that the
            driver can reserve enough space in RAM to copy there the contents
            of particular buffers before requesting the actual transfers.

            If this property is not set to a value adequate for a given
            application, write transactions may fail for buffers that are
            located in flash, what in turn may cause certain components,
            like the DPS310 sensor driver, to not work.

            It is recommended to use the same value for this property and for
            the zephyr,concat-buf-size one, as both these buffering mechanisms
            can utilize the same space in RAM.
```

## dts/bindings/i2c/nordic,nrf-twis.yaml
```yaml
# Copyright (c) 2024 Nordic Semiconductor ASA
# SPDX-License-Identifier: Apache-2.0

description: |
  Nordic nRF family TWIS

  The TWIS peripheral is an I2C controller which supports the I2C
  peripheral role, and EasyDMA. TWIS shares resources with TWIM and TWI,
  only one of them can be enabled for each peripheral instance.
  Overwrite the compatible of the i2c node to select between TWIM/TWI
  and TWIS, along with the pinctrl instances to select between TWIM/TWI
  and TWIS pin functions.

  Example:

    &pinctrl {
            i2c2_default: i2c2_default {
                    group1 {
                            psels = <NRF_PSEL(TWIS_SDA, 0, 26)>,
                                    <NRF_PSEL(TWIS_SCL, 0, 25)>;
                            bias-pull-up;
                    };
            };

            i2c2_sleep: i2c2_sleep {
                    group1 {
                            psels = <NRF_PSEL(TWIS_SDA, 0, 26)>,
                                    <NRF_PSEL(TWIS_SCL, 0, 25)>;
                            low-power-enable;
                    };
            };
    };

    &i2c2 {
            compatible = "nordic,nrf-twis";
            pinctrl-0 = <&i2c2_default>;
            pinctrl-1 = <&i2c2_sleep>;
            pinctrl-names = "default", "sleep";
            status = "okay";
    };

compatible: "nordic,nrf-twis"

include:
  - "nordic,nrf-twi-common.yaml"
  - "memory-region.yaml"
```

## dts/bindings/i2c/nordic,nrf5-i2c.yaml
```yaml
#
# Copyright (c) 2018 Aapo Vienamo
#
# SPDX-License-Identifier: Apache-2.0
#
---
title: Nordic nRF5 Family I2C Master node
id: nordic,nrf5-i2c
version: 0.1

description: >
    This is a representation of the Nordic nRF5 I2C node

inherits:
    !include i2c.yaml

properties:
    compatible:
      type: string
      category: required
      description: compatible strings
      constraint: "nordic,nrf5-i2c"

    reg:
      type: array
      description: mmio register space
      generation: define
      category: required

    interrupts:
      type: array
      category: required
      description: required interrupts
      generation: define

    sda-pin:
      type: int
      description: SDA pin
      generation: define
      category: required

    scl-pin:
      type: int
      description: SCL pin
      generation: define
      category: required
...
```

## dts/bindings/i2c/nuvoton,nct-i2c.yaml
```yaml
# Copyright (c) 2025 Nuvoton Technology Corporation.
# SPDX-License-Identifier: Apache-2.0

description: Nuvoton, NCT-I2C controller node

compatible: "nuvoton,nct-i2c"

include: [base.yaml, i2c-controller.yaml, pinctrl-device.yaml]

properties:
  reg:
    required: true
  clocks:
    required: true
  pinctrl-0:
    required: true
  pinctrl-names:
    required: true
  clock-frequency:
    required: true
```

## dts/bindings/i2c/nuvoton,npcm-i2c.yaml
```yaml
# Copyright (c) 2024 Nuvoton Technology Corporation.
# SPDX-License-Identifier: Apache-2.0

description: Nuvoton, NPCM-I2C controller node

compatible: "nuvoton,npcm-i2c"

include: [base.yaml, i2c-controller.yaml, pinctrl-device.yaml]

properties:
  reg:
    required: true
  clocks:
    required: true
  pinctrl-0:
    required: true
  pinctrl-names:
    required: true
  clock-frequency:
    required: true
```

## dts/bindings/i2c/nuvoton,npcx-i2c-ctrl.yaml
```yaml
# Copyright (c) 2020 Nuvoton Technology Corporation.
# SPDX-License-Identifier: Apache-2.0

description: Nuvoton NPCX-I2C controller

compatible: "nuvoton,npcx-i2c-ctrl"

include: base.yaml

properties:
  reg:
    required: true
  clocks:
    required: true
  smb-wui:
    type: phandle
    required: true
    description: |
        Mapping table between Wake-Up Input (WUI) and SMB module.

        For example the WUI mapping on SMB 4 module would be
           smb-wui = <&wui_smb4>;
  dma-driven:
    type: boolean
    description: |
        If true, the I2C controller has a dedicated DMA controller for data transfer.
        If false, it will use FIFO.
```
