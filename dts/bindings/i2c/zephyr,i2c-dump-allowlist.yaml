## dts/bindings/i2c/zephyr,i2c-dump-allowlist.yaml
```yaml
# Copyright 2023 Google LLC
# SPDX-License-Identifier: Apache-2.0

description: Devices allowlist for i2c messages dump

compatible: "zephyr,i2c-dump-allowlist"

include: base.yaml

properties:
  status:
    const: "okay"

  devices:
    required: true
    type: phandles
```

## dts/bindings/i2c/zephyr,i2c-emul-controller.yaml
```yaml
# Copyright 2020 Google LLC
# SPDX-License-Identifier: Apache-2.0

description: Zephyr I2C Emulation controller

compatible: "zephyr,i2c-emul-controller"

include: i2c-controller.yaml

properties:
  reg:
    required: true
  target-buffered-mode:
    type: boolean
    description: |
      This option is used when the I2C target is enabled and it can support
      buffered mode for I2C target transfer. When 'false', the target will use
      PIO (Programmed I/O) mode.
  forwards:
    type: phandle-array
    description: |
      When added, read/write requests sent to this bus for a given address will
      be forwarded to the specified phandle (must be another i2c bus). As an
      example, if we wanted to forward any requests from i2c0@0x20 to i2c1, we
      would use:

      &i2c0 {
        forward = <&i2c1 0x20>;
      };

forward-cells:
  - addr
```

## dts/bindings/i2c/zephyr,i2c-pec-test.yaml
```yaml
#
# Copyright 2023 Google, LLC
#
# SPDX-License-Identifier: Apache-2.0
#

description: I2C device to test PEC functionality

compatible: "zephyr,i2c-pec-test"

include: [i2c-device.yaml]
```

## dts/bindings/i2s/adi,max32-i2s.yaml
```yaml
# Copyright (c) 2025 Croxel Inc.
# SPDX-License-Identifier: Apache-2.0

description: Analog Devices MAX32 series I2S controller

compatible: "adi,max32-i2s"

include: [i2s-controller.yaml, pinctrl-device.yaml]

properties:
  reg:
    required: true

  dmas:
    required: true
    description: |
      DMA channels for both RX and TX.

  dma-names:
    required: true
    description: |
      Names of DMA channels for both RX and TX.

  i2s-clk-frequency:
    type: int
    default: 12288000
    description: |
      Frequency of the I2S clock in Hz.
      This clock is used to derive the bit clock and frame clock.
      Default to 12.288 MHz, which is suitable for common audio sample rates.
```

## dts/bindings/i2s/ambiq,i2s.yaml
```yaml
# Copyright (c) 2025 Ambiq Micro Inc.
# SPDX-License-Identifier: Apache-2.0

description: Ambiq I2S

compatible: "ambiq,i2s"

include: ["base.yaml", "pinctrl-device.yaml"]

properties:
  reg:
    required: true

  interrupts:
    required: true

  pinctrl-0:
    required: true

  pinctrl-names:
    required: true

  i2s-buffer-location:
    type: string
    description: |
      Define I2S DMA buffer location section

  i2s-buffer-size:
    type: int
    description: |
      Define I2S DMA buffer size in (4-byte) words
```

## dts/bindings/i2s/atmosic,atm-i2s.yaml
```yaml
# Copyright (c) 2025 Atmosic
# SPDX-License-Identifier: Apache-2.0

description: Atmosic I2S

compatible: "atmosic,atm-i2s"

include: i2s-controller.yaml

properties:
  reg:
    required: true

  interrupts:
    required: true

  sck-out-pin:
    type: int
    required: false
    description: SCK OUT pin to use

  ws-out-pin:
    type: int
    required: false
    description: WS OUT pin to use

  sd-out-pin:
    type: int
    required: false
    description: SD OUT pin to use

  sck-in-pin:
    type: int
    required: false
    description: SCK IN pin to use

  ws-in-pin:
    type: int
    required: false
    description: WS IN pin to use

  sd-in-pin:
    type: int
    required: false
    description: SD IN pin to use
```

## dts/bindings/i2s/brcm,bcm2835-i2s.yaml
```yaml
# Copyright (c) 2026 Jonathan Elliot Peace <jep@alphabetiq.com>
# SPDX-License-Identifier: Apache-2.0

description: |
  Broadcom BCM2835 / BCM2710 / BCM2837 PCM / I2S controller.

  DMA-paced: sample buffers stream between memory and the TX/RX FIFOs
  through the BCM2835 DMA controller, paced by the PCM TX/RX DREQ
  lines. In master mode the bit clock is derived from the SoC clock
  manager's PCM divider, which the driver programs directly; no
  clocks phandle is required.

compatible: "brcm,bcm2835-i2s"

include: [i2s-controller.yaml, pinctrl-device.yaml]

properties:
  reg:
    required: true

  interrupts:
    required: true

  dmas:
    required: true
    description: |
      TX and RX DMA channel specifiers. The dma-cell is the peripheral
      DREQ number: 2 for PCM TX, 3 for PCM RX.

  dma-names:
    required: true
    description: Must be "tx" and "rx".
```

## dts/bindings/i2s/i2s-controller.yaml
```yaml
# Copyright (c) 2018, STMicroelectronics
# SPDX-License-Identifier: Apache-2.0

# Common fields for I2S controllers

include: base.yaml

bus: i2s

properties:
    "#address-cells":
      required: true
      const: 1
    "#size-cells":
      required: true
      const: 0
    label:
      required: true
```

## dts/bindings/i2s/i2s-device.yaml
```yaml
# Copyright (c) 2018, STMicroelectronics
# SPDX-License-Identifier: Apache-2.0

# Common fields for I2S devices

include: base.yaml

on-bus: i2s

properties:
    reg:
      required: true
```

## dts/bindings/i2s/i2s.yaml
```yaml
#
# Copyright (c) 2018, STMicroelectronics
#
# SPDX-License-Identifier: Apache-2.0
#

# Common fields for I2S controllers

inherits:
    !include base.yaml

child:
    bus: i2s

properties:
    "#address-cells":
      category: required
      const: 1
    "#size-cells":
      category: required
      const: 0
    label:
      category: required
```

## dts/bindings/i2s/infineon,i2s-v2.yaml
```yaml
# SPDX-FileCopyrightText: Copyright (c) 2026 Linumiz
# SPDX-License-Identifier: Apache-2.0

description: |
  Infineon CAT1 AUDIOSS I2S (v2) controller. Used by Traveo II / cyt4bf-class
  devices where the audio sub-system implements the legacy I2S register block
  (cyt4bf, cytvii_b_h_8m, etc.) rather than the TDM block used by other SoC.

  The peripheral expects:
    * a single combined IRQ line (TX/RX share one),
    * one DMA channel per direction (named "tx" / "rx").

compatible: "infineon,i2s-v2"

include: [base.yaml, pinctrl-device.yaml]

properties:
  reg:
    required: true

  interrupts:
    required: true

  clocks:
    required: true
    description: HF clock that feeds the AUDIOSS input (e.g. <&clk_hf5>).

  dmas:
    required: true
    description: |
      DMA channels for audio data. Channel direction is implied by the name.

  dma-names:
    required: true
    description: Must contain "tx" and "rx".

  pinctrl-0:
    required: true

  pinctrl-names:
    required: true
```

## dts/bindings/i2s/infineon,i2s.yaml
```yaml
# SPDX-FileCopyrightText: <text>Copyright (c) 2026 Infineon Technologies AG,
# or an affiliate of Infineon Technologies AG. All rights reserved.</text>
#
# SPDX-License-Identifier: Apache-2.0

description: Infineon I2S Controller

compatible: "infineon,i2s"

include: [i2s-controller.yaml, pinctrl-device.yaml]

properties:
  reg:
    type: array
    required: true

  interrupts:
    type: array
    required: true

  pinctrl-0:
    required: true

  pinctrl-names:
    required: true

  dmas:
    required: true

  dma-names:
    required: true

  clk-dst:
    type: int
    description: |
      Peripheral clock destination ID for this I2S instance must be select
      other than traveo family devices

  clksel:
    type: int
    enum: [0, 1, 2, 3, 4]
    description: |
      TDM interface clock source select must be select (TRAVEO only; ignored on
      other Infineon families).
        0..3 - clk_if_srss[0..3]
        4    - tdm_tx/rx_mclk_in (external MCLK pin)
      SRSS source must be driven by the clk_hf in 'clocks'.
```

## dts/bindings/i2s/intel,cavs-i2s.yaml
```yaml
# Copyright (c) 2020 Intel Corporation
#
# SPDX-License-Identifier: Apache-2.0

description: Intel CAVS I2S controller

compatible: "intel,cavs-i2s"

include: [i2s-controller.yaml]

properties:
    reg:
      required: true

    interrupts:
      required: true

    interrupt-parent:
      required: true

    dmas:
      required: true

    dma-names:
      required: true
```

## dts/bindings/i2s/intel,ssp-dai.yaml
```yaml
# Copyright (c) 2024 Intel Corporation
# SPDX-License-Identifier: Apache-2.0

description: Intel SSP DAI node

compatible: "intel,ssp-dai"

include: base.yaml

properties:
  reg:
    required: true
```

## dts/bindings/i2s/intel,ssp-sspbase.yaml
```yaml
# Copyright (c) 2022 Intel Corporation
#
# SPDX-License-Identifier: Apache-2.0

description: Intel SSP SHIM controller

compatible: "intel,ssp-sspbase"

include: base.yaml

properties:
    reg:
      required: true
```

## dts/bindings/i2s/intel,ssp.yaml
```yaml
# Copyright (c) 2024 Intel Corporation
#
# SPDX-License-Identifier: Apache-2.0

description: Intel SSP DAI controller

compatible: "intel,ssp"

include: base.yaml

properties:
  reg:
    required: true

  interrupts:
    required: true

  interrupt-parent:
    required: true

  dmas:
    required: true

  dma-names:
    required: true

  i2svss:
    type: array

  ssp-index:
    type: int
    required: true
```

## dts/bindings/i2s/litex,i2s.yaml
```yaml
#
# Copyright (c) 2020 Antmicro <www.antmicro.com>
#
# SPDX-License-Identifier: Apache-2.0
#

description: LiteX I2S controller

compatible: "litex,i2s"
include: i2s-controller.yaml

properties:
  reg:
    required: true

  fifo_depth:
    type: int
    required: true
```

## dts/bindings/i2s/nordic,nrf-i2s.yaml
```yaml
# Copyright (c) 2019 Nordic Semiconductor ASA
# SPDX-License-Identifier: Apache-2.0

description: Nordic I2S (Inter-IC sound interface)

compatible: "nordic,nrf-i2s"

interrupt-source: true

include: [i2s-controller.yaml, pinctrl-device.yaml]

properties:
  reg:
    required: true

  pinctrl-0:
    required: true

  clock-source:
    type: string
    default: "PCLK32M_HFXO"
    description: |
      Clock source to be used by the I2S peripheral for the master clock
      (MCK) generator. The generator is only needed when the I2S peripheral
      is operating in Master mode. The following options are available:
      - "PCLK32M": 32 MHz peripheral clock, synchronous to HFCLK
      - "PCLK32M_HFXO": PCLK32M running off the 32 MHz crystal oscillator
        (HFXO) for better clock accuracy and jitter performance
      - "ACLK": Audio PLL clock with configurable frequency (frequency for
        this clock must be set via the "hfclkaudio-frequency" property
        in the "nordic,nrf-clock" node); this clock source is only available
        in the nRF53 Series SoCs and it requires the use of HFXO
    enum:
      - "PCLK32M"
      - "PCLK32M_HFXO"
      - "ACLK"
```

## dts/bindings/i2s/nordic,nrf-tdm.yaml
```yaml
# Copyright (c) 2024 Nordic Semiconductor ASA
# SPDX-License-Identifier: Apache-2.0

description: Nordic TDM (Time division multiplexed audio interface)

compatible: "nordic,nrf-tdm"

include: [i2s-controller.yaml, pinctrl-device.yaml, nordic-clockpin.yaml, "memory-region.yaml"]

properties:
  reg:
    required: true

  interrupts:
    required: true

  mck-frequency:
    type: int
    description: |
      Frequency of the MCK clock. Configured independently of SCK.

  pinctrl-0:
    required: true

  pinctrl-names:
    required: true

  easydma-maxcnt-bits:
    type: int
    required: true
    description: |
      Maximum number of bits available in the EasyDMA MAXCNT register. This
      property must be set at SoC level DTS files.

  clock-source:
    type: string
    default: "PCLK"
    description: |
      Clock source to be used by the TDM peripheral. The following options
      are available:
      - "PCLK": Peripheral clock
      - "ACLK": Audio PLL clock with configurable frequency (frequency for
        this clock must be set via the "hfclkaudio-frequency" property
        in the "nordic,nrf-clock" node); this clock source is only available
        in the nRF53 Series SoCs and it requires the use of HFXO
    enum:
      - "PCLK"
      - "ACLK"
```

## dts/bindings/i2s/nxp,lpc-i2s.yaml
```yaml
# Copyright (c) 2020 NXP
# SPDX-License-Identifier: Apache-2.0

description: LPC I2S node

compatible: "nxp,lpc-i2s"

include: [i2s-controller.yaml, "nxp,lpc-flexcomm.yaml"]
```

## dts/bindings/i2s/nxp,mcux-i2s.yaml
```yaml
# Copyright 2021,2023-2026 NXP
# SPDX-License-Identifier: Apache-2.0

description: NXP mcux SAI-I2S controller

compatible: "nxp,mcux-i2s"

include: [i2s-controller.yaml, pinctrl-device.yaml, reset-device.yaml]

properties:
  reg:
    required: true

  interrupts:
    required: true

  dma-names:
    required: true

  nxp,tx-dma-channel:
    type: int
    required: true
    description: tx dma channel number

  nxp,rx-dma-channel:
    type: int
    required: true
    description: rx dma channel number

  nxp,tx-sync-mode:
    type: boolean
    description: tx sync mode

  nxp,rx-sync-mode:
    type: boolean
    description: rx sync mode

  pre-div:
    type: int
    description: pre divider

  podf:
    type: int
    description: post-divider fraction

  pll-clocks:
    type: phandle-array
    description: pll settings
    specifier-space: pll-clock

  pll-clock-names:
    type: string-array
    description: Provided names of pll-clock specifiers

  pinmuxes:
    type: phandle-array
    specifier-space: pinmux
    description: iomux settings

  nxp,tx-channel:
    type: int
    description: tx channel the maximum number is SOC dependent

  clock-mux:
    type: int
    description: Clock mux source for SAI root clock

  nxp,bclk-source:
    type: int
    default: 1
    enum: [0, 1, 2, 3]
    description: |
      Bit clock source (TCR2/RCR2 MSEL). 0 = bus clock, 1 = master clock
      divider / MCLK option 1, 2/3 = MCLK option 2/3 or other SAI. Defaults
      to 1, the master clock divider, which matches the i.MX-family SAI
      clocking. SoCs without an internal master clock divider and no MCLK
      routing (e.g. MCXE31x) must select the bus clock (0).

  mclk-output:
    type: boolean
    description: |
      Set if MCLK signal is an output.  Hardware default sets MCLK signal as input.

pinmux-cells:
  - offset
  - mask
```

## dts/bindings/i2s/renesas,ra-i2s-ssie.yaml
```yaml
# Copyright (c) 2025 Renesas Electronics Corporation
# SPDX-License-Identifier: Apache-2.0

description: Renesas RA I2S controller

compatible: "renesas,ra-i2s-ssie"

include: [i2s-controller.yaml, pinctrl-device.yaml]

properties:
  reg:
    required: true

  channel:
    required: true
    type: int

  clocks:
    required: true

  clock-names:
    required: true
    enum:
      - "pclk"
      - "audio-clock"

  pinctrl-0:
    required: true

  pinctrl-names:
    required: true

  interrupts:
    required: true

  interrupt-names:
    required: true
    enum:
      - "ssi_txi"
      - "ssi_rxi"
      - "ssi_if"
      - "ssi_rt"
    description: |
      A list of interrupt identifiers that correspond to the interrupt lines
      provided in the `interrupts` property. The names must be listed in the
      same order as their matching entries in `interrupts`.

      Common configurations based on the operating mode:

      - Full-duplex mode: "ssi_txi", "ssi_rxi", "ssi_if"
          "ssi_txi": Transmit interrupt
          "ssi_rxi": Receive interrupt
          "ssi_if" : Idle/Error interrupt

      - Half-duplex mode: "ssi_rt", "ssi_if"
          "ssi_rt" : Combined receive/transmit interrupt
          "ssi_if" : Idle/Error interrupt

  full-duplex:
    type: boolean
    description: |
      Indicates whether the device node supports full-duplex operation.
```
