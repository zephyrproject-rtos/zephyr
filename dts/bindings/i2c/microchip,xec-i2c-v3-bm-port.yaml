## dts/bindings/i2c/puya,py32-i2c.yaml
```yaml
# SPDX-FileCopyrightText: Copyright The Zephyr Project Contributors
# SPDX-License-Identifier: Apache-2.0

description: |
  Puya PY32 I2C controller. Supports 7-bit controller transfers at 100 kHz
  and 400 kHz. Configure SDA and SCL as alternate-function open-drain pins
  and provide external pull-up resistors.

compatible: "puya,py32-i2c"

include: [i2c-controller.yaml, pinctrl-device.yaml, reset-device.yaml]

properties:
  reg:
    required: true
  clocks:
    required: true
  resets:
    required: true
  pinctrl-0:
    required: true
  pinctrl-names:
    required: true
  clock-frequency:
    default: 100000
    enum: [100000, 400000]
```

## dts/bindings/i2c/realtek,bee-i2c.yaml
```yaml
# Copyright (c) 2026, Realtek Semiconductor Corporation
# SPDX-License-Identifier: Apache-2.0

description: |
  Bee I2C.

compatible: "realtek,bee-i2c"

include: [i2c-controller.yaml, reset-device.yaml, pinctrl-device.yaml]

properties:
  reg:
    required: true

  interrupts:
    required: true

  clocks:
    required: true

  pinctrl-0:
    required: true

  pinctrl-names:
    required: true

  scl-gpios:
    type: phandle-array
    description: |
      GPIO to which the I2C SCL line is connected. Used only for bus recovery
      (CONFIG_I2C_BEE_BUS_RECOVERY): the pin is temporarily muxed to GPIO to
      bit-bang the recovery clocks, then handed back to the I2C controller.

  sda-gpios:
    type: phandle-array
    description: |
      GPIO to which the I2C SDA line is connected. Used only for bus recovery
      (CONFIG_I2C_BEE_BUS_RECOVERY): the pin is temporarily muxed to GPIO to
      bit-bang the recovery clocks, then handed back to the I2C controller.
```

## dts/bindings/i2c/regset-target-base.yaml
```yaml
# SPDX-FileCopyrightText: Copyright The Zephyr Project Contributors
# SPDX-License-Identifier: Apache-2.0

include: [base.yaml, i2c-device.yaml]

properties:
  size:
    type: int
    description: Total register size in bytes

  address-width:
    type: int
    enum: [8, 16]
    description: |
      Number of address bits used to address the EEPROM. If not specified
      the EEPROM is assumed to have a 8-bit address.

  auto-register:
    type: boolean
    description: Automatically register target device on the I2C bus at init time.
```

## dts/bindings/i2c/renesas,ra-i2c-sau.yaml
```yaml
# Copyright (c) 2026 Renesas Electronics Corporation
# SPDX-License-Identifier: Apache-2.0

description: Renesas RA SAU Simplified I2C (IIC Master)

compatible: "renesas,ra-i2c-sau"

include: [i2c-controller.yaml, pinctrl-device.yaml]

properties:
  pinctrl-0:
    required: true

  pinctrl-names:
    required: true

  reg:
    required: true
    description: |
      SAU I2C peripheral instance index.

  sau-channels:
    required: true
    type: phandle-array
    description: |
      SAU channel phandle for this I2C instance.
      Must contain exactly 1 phandle pointing to the underlying SAU channel.

  sda-delay-us:
    type: int
    default: 5
    description: |
      SDA output delay time in microseconds to meet slave device hold/setup time constraints.
      Maps to delay_time in sau_i2c_extended_cfg_t.
```

## dts/bindings/i2c/ti,cc23xx-cc27xx-i2c.yaml
```yaml
# Copyright (c) 2024 Baylibre, SAS
#
# SPDX-License-Identifier: Apache-2.0

description: TI CC23xx/CC27xx I2C node

compatible: "ti,cc23xx-cc27xx-i2c"

include: [i2c-controller.yaml, pinctrl-device.yaml, base.yaml]

properties:
  reg:
    required: true

  interrupts:
    required: true

  pinctrl-0:
    required: true

  pinctrl-names:
    required: true
```

## dts/bindings/i2c/ti,cc35xx-i2c.yaml
```yaml
description: TI CC35XX I2C controller

compatible: "ti,cc35xx-i2c"

include: [i2c-controller.yaml, pinctrl-device.yaml]

properties:
  reg:
    required: true

  interrupts:
    required: true

  pinctrl-0:
    required: true

  pinctrl-names:
    required: true
```

## dts/bindings/i2c/ti,msp432p4xx-i2c.yaml
```yaml
# Copyright (c) 2026 Gail Rojas <gailroco@gmail.com>
# SPDX-License-Identifier: Apache-2.0

description: TI MSP432P4xx eUSCI_B I2C controller

compatible: "ti,msp432p4xx-i2c"

include: [i2c-controller.yaml]

properties:
  reg:
    required: true

  interrupts:
    required: true

  clocks:
    required: true
```

## dts/bindings/i2c/ti,mspm0-i2c.yaml
```yaml
# SPDX-License-Identifier: Apache-2.0

description: TI MSPM0 I2C

compatible: "ti,mspm0-i2c"

include: [i2c-controller.yaml, pinctrl-device.yaml]

properties:
  reg:
    required: true

  interrupts:
    required: true

  pinctrl-0:
    required: true

  pinctrl-names:
    required: true

  merge-buf-size:
    type: int
    default: 32
    description: |
        Size of a buffer that the driver will allocate in RAM to merge
        multiple same direction I2C messages that have no RESTART or STOP
        flag between them (see e.g. the i2c_burst_write() function) into one
        transfer on the bus.

  controller-tx-fifo-threshold:
    type: int
    default: 1
    min: 1
    max: 7
    description: |
        Controller TX FIFO trigger threshold. The controller TXFIFO interrupt
        fires when the TX FIFO contains this many or fewer bytes, prompting
        the driver to refill it during a multi-byte transfer.
        Valid range: 1–7 (must not exceed FIFO depth minus one).

  controller-rx-fifo-threshold:
    type: int
    default: 1
    min: 1
    max: 8
    description: |
        Controller RX FIFO trigger threshold. The controller RXFIFO interrupt
        fires when the RX FIFO contains this many or more bytes, prompting
        the driver to drain it during a multi-byte receive.
        Valid range: 1–8 (must not exceed FIFO depth).
        Note: the target-mode RX FIFO threshold is always 1 regardless of
        this setting, since the Zephyr target callback API delivers one byte
        at a time.
```

## dts/bindings/i2c/ti,omap-i2c.yaml
```yaml
description: TI OMAP I2C Controller
compatible: "ti,omap-i2c"
include: [i2c-controller.yaml, pinctrl-device.yaml]
properties:
  reg:
    description: Base address and size of the I2C registers.
    required: true
  interrupts:
    description: Interrupt specifier for the I2C controller.
    required: true
  clocks:
    description: |
      Module functional/input clock (I2Ci_SYS_CLK) used for PSC/SCLL/SCLH.
      Not the I2C bus bitrate — that is clock-frequency.
      When omitted, the driver assumes 96 MHz (TRM example rate).
  pinctrl-0:
    description: Pin control groups for this I2C instance.
    required: true
  pinctrl-names:
    description: Names for the pin control groups.
    required: true
  clock-frequency:
    description: I2C bus bitrate in Hz (e.g. I2C_BITRATE_STANDARD).
    required: true
```

## dts/bindings/i2c/ti,unicomm-i2c.yaml
```yaml
# Copyright (c) 2026 Texas Instruments Incorporated
# SPDX-License-Identifier: Apache-2.0

description: TI UNICOMM I2C Controller/Target (combined)

compatible: "ti,unicomm-i2c"

include: [base.yaml, pinctrl-device.yaml]

bus: i2c

properties:
  reg:
    required: true

  reg-names:
    required: true

  interrupts:
    required: true

  clocks:
    required: true

  pinctrl-0:
    required: true

  pinctrl-names:
    required: true

  rxfifo-threshold:
    type: int
    description: |
      Trigger level for the RX FIFO. Default is FIFO length, i.e. 16 bytes.

  txfifo-threshold:
    type: int
    description: |
      Trigger level for the TX FIFO. Default is FIFO length, i.e. 16 bytes.

  unicomm-advanced-i2c:
    type: boolean
    description: |
      Whether or not the UNICOMM instance supports automatic
      STOP generation for I2C among other things (refer to TRM).
```

## dts/bindings/i2c/virtio,i2c.yaml
```yaml
# SPDX-FileCopyrightText: Copyright The Zephyr Project Contributors
# SPDX-License-Identifier: Apache-2.0

description: |
  VIRTIO I2C adapter device (ID:34)

compatible: "virtio,i2c"

include: [i2c-controller.yaml, base.yaml]

examples:
  - |
    virtio_mmio0: virtio_mmio@a000000 {
            compatible = "virtio,mmio";
            reg = <0xa000000 0x200>;
            interrupts = <0 16 4>;
            status = "okay";

            virtio_i2c0: virtio-i2c {
                    compatible = "virtio,i2c";
                    #address-cells = <1>;
                    #size-cells = <0>;
                    status = "okay";

                    eeprom0: eeprom@50 {
                            compatible = "atmel,at24";
                            reg = <0x50>;
                            size = <256>;
                            pagesize = <8>;
                            address-width = <8>;
                            timeout = <5>;
                    };
            };
    };
```

## dts/bindings/i2c/xlnx,xps-iic-2.00.a.yaml
```yaml
# Copyright (c) 2023, Calian
# SPDX-License-Identifier: Apache-2.0

description: Xilinx AXI IIC Bus Interface

compatible: "xlnx,xps-iic-2.00.a"

include: [i2c-controller.yaml]

properties:
  reg:
    required: true

  interrupts:
    required: true

  clocks:
    type: phandle-array
    description: |
      Optional AXI input clock (s_axi_aclk). If present, the driver
      programs SCL timing for the configured bus speed using the input
      clock rate. The referenced clock provider node must expose a
      "clock-frequency" property (for example a fixed-clock), as the
      driver reads the input rate from it. If omitted, the FPGA-defined
      SCL frequency is used.

  serial-clk-delay:
    type: int
    min: 0
    default: 0
    description: |
      SCL timing offset in AXI clock cycles.
```

## dts/bindings/i2c/xlnx,xps-iic-2.1.yaml
```yaml
# Copyright (c) 2023, Calian
# SPDX-License-Identifier: Apache-2.0

description: Xilinx AXI IIC Bus Interface

compatible: "xlnx,xps-iic-2.1"

include: [i2c-controller.yaml]

properties:
  reg:
    required: true

  interrupts:
    required: true

  clocks:
    type: phandle-array
    description: |
      Optional AXI input clock (s_axi_aclk). If present, the driver
      programs SCL timing for the configured bus speed using the input
      clock rate. The referenced clock provider node must expose a
      "clock-frequency" property (for example a fixed-clock), as the
      driver reads the input rate from it. If omitted, the FPGA-defined
      SCL frequency is used.

  serial-clk-delay:
    type: int
    min: 0
    default: 0
    description: |
      Additional SCL half-period compensation in AXI input-clock cycles,
      subtracted from the SCL half-period that the driver derives from
      the AXI input clock rate and the bus speed. The value must leave
      a positive half-period, otherwise configuring the bus speed fails
      with -EINVAL. It only has an effect when "clocks" is present;
      otherwise the SCL timing registers are not programmed and the
      FPGA-defined SCL frequency is used.
```

## dts/bindings/i2c/zephyr,i2c-target-tmp103.yaml
```yaml
description: |
  Zephyr I2C target TMP103

  Creates an I2C target device that mimics a TMP103 temperature sensor,
  optionally backed by a real temperature sensor implementing the
  SENSOR_CHAN_DIE_TEMP channel.

  Can be used by a Linux host with the tmp103 driver.

compatible: "zephyr,i2c-target-tmp103"

include: regset-target-base.yaml

properties:
  size:
    min: 4
    max: 4
    default: 4

  sensor:
    type: phandle
    description: Sensor device to use as data source.

examples:
  - |
    zephyr_i2c: &i2c2 {
            tmp103: tmp103@30 {
                    reg = <0x30>;
                    compatible = "zephyr,i2c-target-tmp103";
                    sensor = <&die_temp>;
            };
    };
```

## dts/bindings/i2c/zephyr,native-linux-i2c.yaml
```yaml
# SPDX-FileCopyrightText: 2026 Muhammad Waleed Badar
# SPDX-License-Identifier: Apache-2.0

description: |
  Native Linux I2C controller

  native_sim I2C controller backed by a host i2c-dev node. The host adapter
  must support plain I2C transfers and sets the bus speed: the controller
  only stores the configuration it is given, and returns it from get_config().
  Transfers run on a host thread while simulated time goes on.

compatible: "zephyr,native-linux-i2c"

include: i2c-controller.yaml

properties:
  path:
    type: string
    required: true
    description: |
      Host i2c-dev node, e.g. "/dev/i2c-1". Overridden by the
      --<node name>_path command line option.

examples:
  - |
      / {
          i2c_host: i2c_host {
            compatible = "zephyr,native-linux-i2c";
            path = "/dev/i2c-1";
            #address-cells = <1>;
            #size-cells = <0>;

            sensor@76 {
              compatible = "bosch,bme280";
              reg = <0x76>;
            };
          };
      };
```

## dts/bindings/i2s/espressif,esp32-i2s.yaml
```yaml
description: |
  ESP32 I2S

  On SoCs with a PCM to PDM converter, except the ESP32, I2S0
  transmits the I2S_FMT_DATA_FORMAT_PDM data format as a PDM stream
  on the data output pin. See the pdm-tx-line-mode property for the
  line modes.

  The highest PDM sample rate depends on the I2S clock source: about
  78 kHz with the 160 MHz PLL, 46.9 kHz on the ESP32-H2 and 19.5 kHz
  on the ESP32-P4 revisions before v3.0.

compatible: "espressif,esp32-i2s"

include: [i2s-controller.yaml, pinctrl-device.yaml]

properties:
  reg:
    required: true

  pinctrl-0:
    required: true

  pinctrl-names:
    required: true

  clocks:
    required: true

  interrupts:
    required: true

  interrupt-parent:
    required: true

  unit:
    type: int
    required: true
    description: I2S unit number.
      Possible values are 0,1,.. depending on chip.

  pdm-tx-line-mode:
    type: string
    enum:
      - "codec"
      - "dac"
      - "dac-two-line"
    description: |
      PDM TX line mode. "codec" sends both channels on the data output
      pin with the PDM clock on the WS pin. "dac" sends one channel on
      the data output pin and needs no clock. "dac-two-line" sends the
      second channel on the SD1 output pin. When not set, a one-channel
      stream uses "dac" and a two-channel stream uses "codec".
```

## dts/bindings/i2s/espressif,esp32-lp-i2s.yaml
```yaml
# Copyright (c) 2026 Espressif Systems (Shanghai) CO LTD
# SPDX-License-Identifier: Apache-2.0

description: ESP32-P4 Low-Power I2S controller

compatible: "espressif,esp32-lp-i2s"

include: i2s-controller.yaml

properties:
  reg:
    required: true

  interrupts:
    required: true

  interrupt-parent:
    required: true

  clocks:
    required: true

  bck-pin:
    type: int
    required: true
    description: |
      LP IO number for the bit clock. Valid pins are the LP IO pads, 0 through
      15. The signal is routed through the LP GPIO matrix, not the high-power
      pinmux.

  ws-pin:
    type: int
    required: true
    description: |
      LP IO number for the word-select (frame) clock. Valid pins are the LP IO
      pads, 0 through 15.

  sd-pin:
    type: int
    required: true
    description: |
      LP IO number for the serial data input. Valid pins are the LP IO pads, 0
      through 15.
```
