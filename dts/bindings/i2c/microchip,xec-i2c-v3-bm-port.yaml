## dts/bindings/i2s/infineon,tdm-i2s.yaml
```yaml
# SPDX-FileCopyrightText: Copyright (c) 2026 Infineon Technologies AG,
# SPDX-FileCopyrightText: or an affiliate of Infineon Technologies AG. All rights reserved.
# SPDX-FileCopyrightText: Copyright (c) 2026 Linumiz
#
# SPDX-License-Identifier: Apache-2.0

title: Infineon TDM I2S

description: |
  One TDM structure (TDMx_TDM_STRUCTy, a transmitter and receiver pair) of
  the Infineon TDM/I2S interface, used in I2S mode. Data is moved between
  memory and the TX/RX FIFOs by DMA channels started from the FIFO trigger
  interrupts.

  The interface clock is the clk_hf node in "clocks". The driver selects the
  matching CLK_IF_SRSS input from its index: on CYT4DN clk_hf5, clk_hf6 and
  clk_hf7 feed CLK_IF_SRSS0, 1 and 2.

  Example:

    i2s0: tdm@40818000 {
      compatible = "infineon,tdm-i2s";
      reg = <0x40818000 0x200>;
      interrupt-parent = <&intmux_ch3>;
      interrupts = <753 0>, <752 0>;
      interrupt-names = "rx", "tx";
      clocks = <&clk_hf5>;
      dmas = <&dma0 0>, <&dma0 1>;
      dma-names = "tx", "rx";
      pinctrl-0 = <&p15_6_tdm_i2s0_tx_mck &p15_7_tdm_i2s0_tx_sck
                   &p16_0_tdm_i2s0_tx_fsync &p16_1_tdm_i2s0_tx_sd>;
      pinctrl-names = "default";
    };

compatible: "infineon,tdm-i2s"

include: [i2s-controller.yaml, pinctrl-device.yaml]

properties:
  reg:
    required: true

  interrupts:
    required: true

  interrupt-names:
    required: true
    description: |
      Must be "rx" and "tx".

  clocks:
    required: true
    description: |
      clk_hf node feeding the interface clock (CLK_IF_SRSS input).

  dmas:
    required: true

  dma-names:
    required: true
    description: |
      Must be "tx" and "rx".

  pinctrl-0:
    required: true

  pinctrl-names:
    required: true
```

## dts/bindings/i2s/raspberrypi,pico-i2s-pio.yaml
```yaml
# Copyright (c) 2026 Robin Sachsenweger Ballantyne <makenenjoy@gmail.com>
# SPDX-License-Identifier: Apache-2.0

description: Raspberry Pi Pico PIO I2S

compatible: "raspberrypi,pico-i2s-pio"

include: [i2s-controller.yaml, "raspberrypi,pico-pio-device.yaml"]

properties:
  pinctrl-0:
    required: true
    description: |
      Must name a node containing groups with the names `bclk_pins`, `ws_pins` and one
      or both of `sdout_pins`/`sdin_pins`.

      The GPIO pins for `sdin_pins`, `bclk_pins` and `ws_pins` must be consecutively
      ascending. The PIO state machine's IN_BASE is the `sdin_pins` pin
      and it reads data at IN_BASE + 0, BCLK at IN_BASE + 1 and WS at
      IN_BASE + 2. When configured TX-only, IN_BASE is derived as `bclk_pins` - 1.

      The `bclk_pins`, `ws_pins` and `sdin_pins` groups must also be tagged with
      `input-enable`, so that the pad input buffers are on and the PIO can sample them.

      `sdout_pins` and `sdin_pins` may name the same GPIO to enable loopback which is
      used primarily for testing.

  pinctrl-names:
    required: true

  dmas:
    required: true
    description: |
      TX and/or RX DMA channel specifiers. At least one is required.

      Note: the DREQ slot cell is ignored. raspberrypi,pico-dma.yaml fixes #dma-cells at 3, but the
      driver derives the slot from pio_get_dreq() once the state machine has been dynamically
      allocated during i2s_configure(). Write 0 as the placeholder.
  dma-names:
    required: true
    description: |
      `tx`, `rx`, or both.

examples:
  - |
    &pinctrl {
      pio1_i2s0_default: pio1_i2s0_default {
        sdout_pins {
          pinmux = <PIO1_P16>;
        };

        sdin_pins {
          pinmux = <PIO1_P26>;
          input-enable;
        };

        bclk_pins {
          pinmux = <PIO1_P27>;
          input-enable;
        };

        ws_pins {
          pinmux = <PIO1_P28>;
          input-enable;
        };
      };
    };

    &pio1 {
      status = "okay";

      pio1_i2s0: i2s0 {
        compatible = "raspberrypi,pico-i2s-pio";
        status = "okay";

        pinctrl-0 = <&pio1_i2s0_default>;
        pinctrl-names = "default";

        #address-cells = <1>;
        #size-cells = <0>;

        dmas = <&dma 7 0 0>,
              <&dma 8 0 0>;
        dma-names = "tx", "rx";
      };
    };

    &dma {
      status = "okay";
    };
```

## dts/bindings/i2s/realtek,ameba-i2s.yaml
```yaml
# Copyright (c) 2026 Realtek Semiconductor Corp.
# SPDX-License-Identifier: Apache-2.0

description: AMEBA I2S controller

compatible: "realtek,ameba-i2s"

include: [i2s-controller.yaml, pinctrl-device.yaml]

properties:
  reg:
    required: true

  interrupts:
    required: true

  dmas:
    required: true

  dma-names:
    required: true

  pinctrl-0:
    required: true

  pinctrl-names:
    required: true

  mclk-multiple:
    type: int
    description: |
      MCLK rate as a multiple of the sample rate: MCLK = mclk-multiple * fs.
      Requires mclk-fixed-max to be 0.
    enum:
      - 64
      - 128
      - 256

  mclk-fixed-max:
    type: int
    description: |
      Cap MCLK at this rate in Hz using the largest power-of-two divider that
      stays below it, instead of tracking fs. Set to 0 to use mclk-multiple.
    enum:
      - 20000000
      - 0

  multiio:
    type: boolean
    description: |
      Spread the channels over one data pin per channel pair, instead of
      time-multiplexing them all onto a single pin (TDM).

  clock-mode:
    type: int
    description: |
      Rate in Hz of the SPORT clock source, which both selects the source and
      is the value the BCLK and MCLK dividers are computed from. Use 40000000
      for the crystal oscillator, 98304000 for the I2S PLL on sample rates
      that are a multiple of 4 kHz, and 45158400 for the 44.1 kHz family.
    enum:
      - 40000000
      - 98304000
      - 45158400
```

## dts/bindings/i2s/silabs,usart-i2s.yaml
```yaml
# Copyright (c) 2026 Silicon Laboratories Inc.
# SPDX-License-Identifier: Apache-2.0

title: Silicon Labs Series 2 I2S (Inter-Integrated Circuit Sound)

description: |
  Silicon Labs Series 2 USART in I2S mode. Pins are TX, RX, CLK (bit clock),
  and CS (word select / LRCLK). Enable this compatible on a USART instance only
  in a board or application overlay (not the shared SoC DTSI), since SPI and
  I2S cannot share the same USART.

compatible: "silabs,usart-i2s"

include: [i2s-controller.yaml, pinctrl-device.yaml]

properties:
  reg:
    required: true

  interrupts:
    required: true

  clocks:
    required: true

  silabs,mclk-out:
    type: phandle
    description: |
      Optional phandle to a ``clock-output@N`` child under
      ``silabs,series-clock-output`` that supplies codec MCLK.

  dmas:
    required: true
    description: |
      DMA channels for ``txbl`` (USARTnTXBL), optional ``txblright``
      (USARTnTXBLRIGHT, mono TX), and ``rx`` (USARTnRXDATAV).

  dma-names:
    required: true
    description: |
      Must include ``txbl`` and ``rx``. Add ``txblright`` for mono TX
      (``channels = 1``). Legacy names ``tx`` / ``tx-right`` are accepted.

  silabs,mono-tx-slot:
    type: string
    enum:
      - left
      - right
    default: right
    description: |
      Which mono TX slot carries audio when ``channels = 1`` (the other is
      silence).

examples:
  - |
    /* Optional codec MCLK from CMU CLKOUT0 via silabs,mclk-out. */
    &pinctrl {
      clkout_default: clkout_default {
        group0 {
          pins = <CMU_CLKOUT0_PC1>;
          drive-push-pull;
          output-low;
        };
      };

      usart0_i2s_default: usart0_i2s_default {
        group0 {
          pins = <USART0_TX_PC0>, <USART0_CLK_PC2>, <USART0_CS_PB2>;
          drive-push-pull;
          output-high;
        };

        group1 {
          pins = <USART0_RX_PC1>;
          input-enable;
        };
      };
    };

    &clkout {
      pinctrl-0 = <&clkout_default>;
      pinctrl-names = "default";
      status = "okay";
    };

    &clkout0 {
      clocks = <&exportclk>;
      status = "okay";
    };

    &usart0 {
      compatible = "silabs,usart-i2s";
      status = "okay";
      pinctrl-0 = <&usart0_i2s_default>;
      pinctrl-names = "default";
      silabs,mclk-out = <&clkout0>;
      dmas = <&dma0 DMA_REQSEL_USART0TXBL>,
             <&dma0 DMA_REQSEL_USART0TXBLRIGHT>,
             <&dma0 DMA_REQSEL_USART0RXDATAV>;
      dma-names = "txbl", "txblright", "rx";
    };
```

## dts/bindings/i2s/st,stm32h7-i2s.yaml
```yaml
# Copyright (c) 2018, STMicroelectronics
# SPDX-License-Identifier: Apache-2.0

description: STM32H7 I2S controller

compatible: "st,stm32h7-i2s"

include: st,stm32-i2s-common.yaml

properties:
  st,full-duplex:
    type: boolean
    description: |
      This I2S instance is capable of full duplex: the receiver and the
      transmitter can stream at the same time.

      The driver uses full duplex when both directions are configured at once
      with I2S_DIR_BOTH. The RX and TX streams then share the clock, the format
      and the role, but are started, stopped, drained and dropped independently
      of each other. Configuring the directions one by one keeps the single
      direction behavior. Both the SDI and the SDO pins must be listed in
      pinctrl-0 to use both directions.
```

## dts/bindings/i2s/ti,cc27xx-i2s.yaml
```yaml
# Copyright (c) 2026 Texas Instruments Incorporated
# SPDX-License-Identifier: Apache-2.0

description: |
  TI CC27XX I2S controller

  The I2S peripheral on CC27XX devices supports:
  - Controller and Target modes
  - Dual-phase (I2S, Left/Right Justified) and single-phase (DSP) formats
  - 8-24 bits per word
  - Up to 8 channels per data line (SD0/SD1)
  - Built-in DMA for data transfer
  - Configurable clock dividers (MCLK, BCLK, WCLK)
  - Sample stamping for synchronization

compatible: "ti,cc27xx-i2s"

include: [i2s-controller.yaml, pinctrl-device.yaml]

properties:
  reg:
    required: true

  interrupts:
    required: true

  pin-dir-sd0:
    type: int
    default: 0x02
    description: |
      SD0 (Serial Data 0) audio interface pin direction configuration.

      The I2S interface has two bidirectional serial data pins (SD0 and SD1)
      that can be independently configured as input (RX), output (TX), or
      disabled. This allows flexible board design where the same physical pins
      can be assigned different roles based on the audio codec wiring.

      Typical configurations:
      - Full-duplex audio: SD0 = OUTPUT (TX to codec), SD1 = INPUT (RX from codec)
      - TX only (playback): SD0 = OUTPUT, SD1 = DISABLED
      - RX only (recording): SD0 = DISABLED, SD1 = INPUT
      - Loopback testing: SD0 = OUTPUT, SD1 = INPUT (with external wire connection)

      If not specified, defaults to TI_CC27XX_I2S_PIN_DIR_OUT (0x02) which
      configures SD0 as output for transmit to audio codec.

      Values (from dt-bindings/i2s/ti-cc27xx-i2s.h):
        TI_CC27XX_I2S_PIN_DIR_DISABLED = 0x00
          Pin is not used by I2S peripheral. Use this to save power when only
          one direction is needed (e.g., playback-only or record-only).

        TI_CC27XX_I2S_PIN_DIR_IN = 0x01
          Pin configured as input (RX - receive audio data from codec).
          Used when SoC is recording audio from external codec/microphone.

        TI_CC27XX_I2S_PIN_DIR_OUT = 0x02 (default)
          Pin configured as output (TX - transmit audio data to codec).
          Used when SoC is playing audio to external codec/speaker.

      Hardware note: The actual pin muxing (which physical GPIO pin is used
      for SD0) is configured separately in the pinctrl devicetree node.
      This property only controls the data direction of the I2S peripheral
      once the pin is muxed to I2S function.

  pin-dir-sd1:
    type: int
    default: 0x01
    description: |
      SD1 (Serial Data 1) audio interface pin direction configuration.

      Same as pin-dir-sd0 but for the second serial data pin. The I2S module
      has two independent serial data pins (SD0 and SD1) to support full-duplex
      operation where both transmit and receive can occur simultaneously.

      If not specified, defaults to TI_CC27XX_I2S_PIN_DIR_IN (0x01) which
      configures SD1 as input for receive from audio codec. This default
      pairs with SD0's default (output) for typical full-duplex operation.

      Values: Same as pin-dir-sd0 (see above for detailed descriptions)
        0x00 = TI_CC27XX_I2S_PIN_DIR_DISABLED - Pin not used
        0x01 = TI_CC27XX_I2S_PIN_DIR_IN - Input (RX from codec) - default for SD1
        0x02 = TI_CC27XX_I2S_PIN_DIR_OUT - Output (TX to codec)

      For all constants see dt-bindings/i2s/ti-cc27xx-i2s.h

  startup-delay:
    type: int
    default: 2
    description: Number of WS cycles to wait before the first transfer.

  afclk-source:
    type: int
    default: 0x02
    description: |
      Audio frequency clock (AFCLK) source selection.
      0x00 = CLKREF (Crystal Oscillator: 48 MHz reference clock)
      0x01 = CLKHF (System Clock: 96 MHz HFXT)
      0x02 = CLKAF (AFOSC - Audio Frequency Oscillator: 80/90.3168/98.304 MHz) - default
             Provides zero sample rate error for standard audio rates.

      For all options see dt-bindings/i2s/ti-cc27xx-i2s.h

  afosc-freq:
    type: int
    default: 98304000
    description: |
      AFOSC frequency in Hz. Only used when afclk-source is 1 (CLKAF).
      Valid values:
        80000000 (80 MHz)
        90316800 (90.3168 MHz - for 22.05/44.1 kHz sample rates)
        98304000 (98.304 MHz - for 8/16/24/32/48 kHz sample rates)

  cclk-divider:
    type: int
    default: 40
    description: |
      Frequency divider for the CCLK (MCLK) signal.
      CCLK = AFCLK / cclk-divider.
      Must be >= 2 (hardware limitation: divider of 1 is not allowed).
      Value must be between 2 and 1024 (inclusive).
```
