## dts/bindings/led_strip/realtek,ameba-ledc.yaml
```yaml
# Copyright (c) 2026 Realtek Semiconductor Corp.
# SPDX-License-Identifier: Apache-2.0

description: |
  Realtek Ameba LED controller (LEDC)

  The LEDC generates the one-wire bit waveform for addressable RGB LEDs in
  hardware. Each of the four bit timings below has its own register, so the
  bit period of a 0 code and of a 1 code can differ. The hardware resolution
  is 25 ns (40 MHz).

compatible: "realtek,ameba-ledc"

include: [base.yaml, pinctrl-device.yaml, led-strip.yaml]

properties:
  pinctrl-0:
    required: true

  pinctrl-names:
    required: true

  time-t0h:
    type: int
    required: true
    description: |
      High time of a 0 code in nanoseconds, 25 to 6375 in steps of 25.

  time-t0l:
    type: int
    required: true
    description: |
      Low time of a 0 code in nanoseconds, 25 to 6375 in steps of 25.

  time-t1h:
    type: int
    required: true
    description: |
      High time of a 1 code in nanoseconds, 25 to 6375 in steps of 25.

  time-t1l:
    type: int
    required: true
    description: |
      Low time of a 1 code in nanoseconds, 25 to 6375 in steps of 25.

  reset-delay:
    type: int
    required: true
    description: |
      Low time sent after a frame so that the strip latches the data, in
      microseconds, 1 to 409. It also limits how long the LEDC waits for the
      next pixel while a frame is being sent: if the driver does not refill
      the FIFO within this time, the transfer is aborted. Do not set it much
      lower than the latch time the strip needs.
```

## dts/bindings/lora/rakwireless,rui3.yaml
```yaml
# SPDX-FileCopyrightText: Copyright (c) 2026 RAKwireless Technology Limited
# SPDX-License-Identifier: Apache-2.0

title: RAKwireless RUI3 (RAKwireless Unified Interface V3) LoRa Modem

description: |
  RAKwireless module running the RUI3 firmware, driven over its AT command
  interface in LoRa P2P mode.

  RUI3 is the firmware RAKwireless ships on its WisDuo stamp modules and
  WisBlock Core modules, among them the RAK3172, RAK11720 and RAK4630. It
  answers AT commands on a UART and works either as a LoRaWAN end device or as
  a raw LoRa transceiver. This driver uses the latter and switches the module
  to P2P with AT+NWM=0 when it is not already there.

  The module keeps part of its configuration in flash, so the driver sends a
  command only for a value that differs from the one it last applied, and a
  change of network work mode costs a reboot.

  The RUI3 version the driver expects is a Kconfig option, not a devicetree
  property: the firmware runs on the module and is flashed independently, so
  the driver queries it at init.

compatible: "rakwireless,rui3"

include: uart-device.yaml

properties:
  reset-gpios:
    type: phandle-array
    description: |
      Reset line of the module, active low. Modules whose reset pin is not
      wired to the host leave this out, and the driver then resets the module
      with ATZ instead.
```

## dts/bindings/mbox/allwinner,sunxi-msgbox-riscv.yaml
```yaml
# SPDX-FileCopyrightText: Copyright The Zephyr Project Contributors
# SPDX-License-Identifier: Apache-2.0

description: |
  Allwinner V851S MSGBOX, RISC (E907) side. Two register windows: the local
  (RISC) MSGBOX block for RX and the peer CPUX block for TX.

compatible: "allwinner,sunxi-msgbox-riscv"

include: [base.yaml, mailbox-controller.yaml]

properties:
  reg:
    required: true
  reg-names:
    required: true
    const: ["rx", "tx"]
  interrupts-extended:
    required: true

mbox-cells:
  - channel
```

## dts/bindings/mbox/aspeed,ast2700-mailbox.yaml
```yaml
# Copyright (c) 2026 ASPEED Technology Inc.
# SPDX-License-Identifier: Apache-2.0

description: |
  ASPEED AST2700 mailbox controller. Each node describes a pair of TX and
  RX register blocks for communication with one peer. Each direction has
  four channels with 32 bytes of message data per channel.

  The interrupt signals a message in the RX block. Without it, as on the
  BootMCU, which has no mailbox interrupt, the driver polls the RX block.

compatible: "aspeed,ast2700-mailbox"

include: [base.yaml, mailbox-controller.yaml]

properties:
  reg:
    required: true
    description: TX register block followed by RX register block, each 0x100 bytes.

  reg-names:
    required: true
    description: Names of the two register blocks, in order "tx", "rx".

  "#mbox-cells":
    const: 1

mbox-cells:
  - channel
```

## dts/bindings/memory-controllers/microchip,ebi-g1-memc.yaml
```yaml
# Copyright (c) 2026 Microchip Technology Inc.
# SPDX-License-Identifier: Apache-2.0

description: |
  Microchip External Bus Interface (EBI) G1.

  SAM EBI includes the following hardware peripheral:
    - module name="EBI" id="0" version="0"

examples:
  - |
    Example devicetree configuration:

      pinctrl_nand_default: nand-default {
        group1 {
          pinmux = <PIN_PD9__D0>,
                   <PIN_PD10__D1>,
                   <PIN_PD11__D2>,
                   <PIN_PC21__D3>,
                   <PIN_PC22__D4>,
                   <PIN_PC23__D5>,
                   <PIN_PC24__D6>,
                   <PIN_PD2__D7>,
                   <PIN_PD3__NANDRDY>,
                   <PIN_PD4__GPIO>,
                   <PIN_PD5__NWE_NWR0_NANDWE>,
                   <PIN_PD6__NRD_NANDOE>,
                   <PIN_PD7__A21_NANDALE>,
                   <PIN_PD8__A22_NANDCLE>;
          bias-disable;
        };
      };

      &ebi {
        pinctrl-names = "default";
        pinctrl-0 = <&pinctrl_nand_default>;
        status = "okay";

        cs3: cs@58000000 {
          reg = <0x3 0x0 0x800000>;
          status = "okay";

          smc-tdf-mode;
          smc-write-mode = "nwe";
          smc-read-mode = "nrd";
          smc-bus-width = "8-bit";
          smc-setup-timing = <4 0 0 0>;
          smc-pulse-timing = <10 20 10 20>;
          smc-cycle-timing = <20 20>;
        };
      };

    The above example configure a NAND Flash with default timing mode.
    TDF mode is enabled (and the maximum clock cycle 15 will be set by default).
    The NWE and NRD signals are used to contril write and read operations.
    For SAMA7G54, the clock source of EBI is MCK1 with frenqucy 200MHz,
    so one clock cycle is 1 s / 200MHz = 5 ns
    Setup timing:
      NWE setup time is 4 * 5 ns = 20 ns
      NCS and NRD setup time is 0 ns
    Pulse timing:
      NWE pulse time is 10 * 5 ns = 50 ns
      NCS pulse time in write access is 20 * 5 ns = 100 ns
      NRD pulse time is 10 * 5 ns = 50 ns
      NCS pulse time in read access is 20 * 5 ns = 100 ns
    Cycle timing:
      Total write cycle time is 20 * 5 ns = 100 ns
      Total read cycle time is 20 * 5 ns = 100 ns

compatible: "microchip,ebi-g1-memc"

include:
  - name: base.yaml
  - name: pinctrl-device.yaml
  - name: microchip,smc-g1-memc-timing.yaml

properties:
  reg:
    required: true

  clocks:
    required: true

  smc:
    type: phandle
    required: true
    description: |
      Hold a phandle reference to the smc controller.

  "#address-cells":
    required: true
    const: 2

  "#size-cells":
    required: true
    const: 1
```

## dts/bindings/memory-controllers/microchip,smc-g1-memc-timing.yaml
```yaml
# Copyright (c) 2026 Microchip Technology Inc.
# SPDX-License-Identifier: Apache-2.0

description: |
  Microchip Static Memory Controller (SMC) G1 timing configuration.

child-binding:
  description: |
    Child device nodes are representing devices connected to the EBI/SMC bus.

  properties:
    reg:
      type: array
      required: true
      description: |
        The device's EBI Chip Select number and address.

    smc-configure-bus:
      type: boolean
      description: |
        Indicates that the bus should be configured.

    smc-bus-width:
      type: string
      description: |
        Data bus width.
      enum:
        - "8-bit"
        - "16-bit"

    smc-tdf-mode:
      type: boolean
      description: |
        TDF Optimization Enable.

    smc-tdf-cycles:
      type: int
      default: 15
      description: |
        The number of clock cycles required by the external device to release
        the data after the rising edge of the read controlling signal.
      enum: [0, 1, 2, 3, 4, 5, 6, 7, 8, 9, 10, 11, 12, 13, 14, 15]

    smc-write-mode:
      type: string
      description: |
        Selection of the Control Signal for Write Operation.
        ncs - The Write operation is controller by the NCS signal
        nwe - The Write operation is controlled by the NWE signal
      enum:
        - "ncs"
        - "nwe"

    smc-read-mode:
      type: string
      description: |
        Selection of the Control Signal for Read Operation.
        ncs - The Read operation is controlled by the NCS signal
        nrd - The Read operation is controlled by the NRD signal
      enum:
        - "ncs"
        - "nrd"

    smc-setup-timing:
      type: array
      description: |
        Array[0] is NWE_SETUP[5:0], defines the NWE signal setup length.
        Array[1] is NCS_WR_SETUP[5:0], defines the NCS signal setup length in write access.
        Array[2] is NRD_SETUP[5:0], defines the NRD signal setup length.
        Array[3] is NCS_RD_SETUP[5:0], defines the NCS signal setup length in read access.
        Setup length = (128 * SETUP[5] + SETUP[4:0]) clock cycles

    smc-pulse-timing:
      type: array
      description: |
        Array[0] is NWE_PULSE[6:0], defines the NWE signal pulse length.
        Array[1] is NCS_WR_PULSE[6:0], defines the NCS signal pulse length in write access.
        Array[2] is NRD_PULSE[6:0], defines the NRD signal pulse length.
        Array[3] is NCS_RD_PULSE[6:0], defines the NCS signal pulse length in read access.
        Pulse length = (256 * PULSE[6] + PULSE[5:0]) clock cycles.

    smc-cycle-timing:
      type: array
      description: |
        Array[0] is NWE_CYCLE[8:0], defines the total write cycle length.
        Array[1] is NRD_CYCLE[8:0], defines the total read cycle length.
        Cycle length = (CYCLE[8:7] * 256) + CYCLE[6:0] clock cycles.

    nfc-timings-nfsel:
      type: boolean
      description: |
        NAND Flash Selection.

    nfc-timings-twb:
      type: int
      description: |
        WEN High to REN to Busy
        Write Enable rising edge to Ready/Busy falling edge timing.
        Write Enable to Read/Busy = (TWB[3] * 64) + TWB[2:0] clock cycles.
      enum: [0, 1, 2, 3, 4, 5, 6, 7, 8, 9, 10, 11, 12, 13, 14, 15]

    nfc-timings-trr:
      type: int
      description: |
        Ready to REN Low Delay
        Ready/Busy signal to Read Enable falling edge timing.
        Read to REN = (TRR[3] * 64) + TRR[2:0] clock cycles.
      enum: [0, 1, 2, 3, 4, 5, 6, 7, 8, 9, 10, 11, 12, 13, 14, 15]

    nfc-timings-ocms:
      type: boolean
      description: |
        Off Chip Memory Scrambling Enable.

    nfc-timings-tar:
      type: int
      description: |
        ALE to REN Low Delay
        Address Latch Enable falling edge to Read Enable falling edge timing.
        Address Latch Enable to Read Enable = (TAR[3] * 64) + TAR[2:0] clock cycles.
      enum: [0, 1, 2, 3, 4, 5, 6, 7, 8, 9, 10, 11, 12, 13, 14, 15]

    nfc-timings-tadl:
      type: int
      description: |
        ALE to Data Start
        Last address latch cycle to the first rising edge of WEN for data input.
        Last address latch to first rising edge of WEN = (TADL[3] * 64) + TADL[2:0] clock cycles.
      enum: [0, 1, 2, 3, 4, 5, 6, 7, 8, 9, 10, 11, 12, 13, 14, 15]

    nfc-timings-tclr:
      type: int
      description: |
        CLE to REN Low Delay
        Command Latch Enable falling edge to Read Enable falling edge timing.
        Latch Enable Falling to Read Enable Falling = (TCLR[3] * 64) + TCLR[2:0] clock cycles.
      enum: [0, 1, 2, 3, 4, 5, 6, 7, 8, 9, 10, 11, 12, 13, 14, 15]
```
