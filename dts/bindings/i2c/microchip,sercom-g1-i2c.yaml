## dts/bindings/i2c/microchip,sercom-g1-i2c.yaml
```yaml
# Copyright (c) 2025-2026 Microchip Technology Inc.
# SPDX-License-Identifier: Apache-2.0

title: Microchip SERCOM G1 I2C driver

description: |
  Microchip SERCOM I2C driver bindings.

  Group g1 SERCOM I2C driver supports following hardware peripherals:
    - module name="SERCOM"
          id="U2201" version="3.1.1","5.0.0"
          id="03715" name2="com_sercom_u2201_v6" version="6b0","6c0"

compatible: "microchip,sercom-g1-i2c"

include:
  - name: i2c-controller.yaml
  - name: pinctrl-device.yaml

properties:
  reg:
    required: true

  interrupts:
    required: true

  clocks:
    required: true

  clock-names:
    required: true

  scl-gpios:
    type: phandle-array
    description: |
      GPIO of the SCL pin, used for bus recovery only. The driver drives the
      line low or releases it as an input, so the bus needs external pull-ups.
      Requires CONFIG_I2C_MCHP_SERCOM_G1_BUS_RECOVERY.

  sda-gpios:
    type: phandle-array
    description: |
      GPIO of the SDA pin, used for bus recovery only. The driver drives the
      line low or releases it as an input, so the bus needs external pull-ups.
      Requires CONFIG_I2C_MCHP_SERCOM_G1_BUS_RECOVERY.

  recover-bus-on-init:
    type: boolean
    description: |
      Recover the I2C bus during driver initialization, in case a target
      still holds SDA low, for example a battery-backed RTC after a reset
      of the SoC in the middle of a read. Requires scl-gpios and sda-gpios.

  run-in-standby-en:
    type: int
    enum:
      - 0
      - 1
    default: 1
    description: |
      Enable (1) or disable (0) runstandby mode for SERCOM I2C.

  dmas:
    description: |
      Optional TX & RX dma specifiers.  Each specifier will have a phandle
      reference to the dmac controller, the channel number, and peripheral
      trigger source.

      For example dmas for TX, RX on SERCOM3
         dmas = <&dmac 0 0xb>, <&dmac 0 0xa>;

  dma-names:
    description: |
      Required if the dmas property exists.  This should be "tx" and "rx"
      to match the dmas property.

      For example
         dma-names = "tx", "rx";
```

## dts/bindings/i2c/nxp,pca9547.yaml
```yaml
# Copyright (c) 2026 ecom GmbH
# SPDX-License-Identifier: Apache-2.0

description: NXP PCA9547 8-channel I2C multiplexer

compatible: "nxp,pca9547"

include: ti,tca954x-base.yaml
```

## dts/bindings/i2c/renesas,rx-i2c-sci-b.yaml
```yaml
# Copyright (c) 2026 Renesas Electronics Corporation
# SPDX-License-Identifier: Apache-2.0

description: Renesas RX SCI-B I2C controller

compatible: "renesas,rx-i2c-sci-b"

include: [i2c-controller.yaml, pinctrl-device.yaml]

properties:

  sda-output-delay:
    type: int
    default: 300
    description: |
      SDA Output Delay in nano seconds.

  noise-filter-clock-select:
    type: int
    default: 1
    enum: [1, 2, 3, 4]
    description: |
      Select the on-chip baud rate generator source clock
      division setting for the digital noise filter.

  bit-rate-modulation:
    type: boolean
    description: |
      Enabling bitrate modulation reduces the percent error
      of the actual bitrate with respect to the requested baud rate.
```

## dts/bindings/i2s/silabs,usart-i2s.yaml
```yaml
# Copyright (c) 2026 Silicon Laboratories Inc.
# SPDX-License-Identifier: Apache-2.0

title: Silicon Labs Series 2 I2S (Inter-Integrated Circuit Sound)

description: |
  Silicon Labs Series 2 USART in I2S mode. Pins are TX, RX, CLK (bit clock),
  and CS (word select / LRCLK). Enable this compatible on a USART instance only
  in a board or application overlay (not the shared SoC DTSI), since SPI and
  I2S cannot share the same USART.

  Supports stereo/mono TX and stereo RX with 16-bit words, as I2S controller
  only (clock target options are rejected by the driver).

  ``i2s_configure(I2S_DIR_RX)`` must set ``channels`` to 2; mono RX
  (``channels = 1``) returns ``-EINVAL``. TX may use ``channels = 1`` on the
  same instance together with stereo RX (wire format stays stereo; see the
  driver documentation). Frame clock, word size, and format must match between
  the two streams.

compatible: "silabs,usart-i2s"

include: [i2s-controller.yaml, pinctrl-device.yaml]

properties:
  reg:
    required: true

  interrupts:
    required: true

  clocks:
    required: true

  silabs,mclk-out:
    type: phandle
    description: |
      Optional phandle to a ``clock-output@N`` child under
      ``silabs,series-clock-output`` that supplies codec MCLK.

  dmas:
    required: true
    description: |
      DMA channels for ``txbl`` (USARTnTXBL) and optional ``txblright``
      (USARTnTXBLRIGHT, mono TX) and ``rxdatav`` (USARTnRXDATAV).

  dma-names:
    required: true
    description: |
      Must include ``txbl``. Add ``txblright`` for mono TX (``channels = 1``).
      Add ``rxdatav`` for stereo RX.

  silabs,mono-tx-slot:
    type: string
    enum:
      - left
      - right
    default: right
    description: |
      Which mono TX slot carries audio when ``channels = 1`` (the other is
      silence).

  silabs,slot-width:
    type: int
    enum:
      - 16
      - 32
    default: 16
    description: |
      Bit clocks per channel slot, for both TX and RX. 16 selects W16D16
      (BCLK = 32 x frame clock). 32 selects W32D16 (BCLK = 64 x frame clock)
      for devices that need 64 bit clocks per frame, such as most I2S MEMS
      microphones. ``i2s_config.word_size`` stays 16 either way: RX returns
      the 16 most significant bits of each slot and TX sends zeros after the
      16-bit sample.

examples:
  - |
    /* Optional codec MCLK from CMU CLKOUT0 via silabs,mclk-out. */
    &pinctrl {
      clkout_default: clkout_default {
        group0 {
          pins = <CMU_CLKOUT0_PC1>;
          drive-push-pull;
          output-low;
        };
      };

      usart0_i2s_default: usart0_i2s_default {
        group0 {
          pins = <USART0_TX_PC0>, <USART0_CLK_PC2>, <USART0_CS_PB2>;
          drive-push-pull;
          output-high;
        };

        group1 {
          pins = <USART0_RX_PC1>;
          input-enable;
        };
      };
    };

    &clkout {
      pinctrl-0 = <&clkout_default>;
      pinctrl-names = "default";
      status = "okay";
    };

    &clkout0 {
      clocks = <&exportclk>;
      status = "okay";
    };

    &usart0 {
      compatible = "silabs,usart-i2s";
      status = "okay";
      pinctrl-0 = <&usart0_i2s_default>;
      pinctrl-names = "default";
      silabs,mclk-out = <&clkout0>;
      dmas = <&dma0 DMA_REQSEL_USART0TXBL>,
             <&dma0 DMA_REQSEL_USART0TXBLRIGHT>,
             <&dma0 DMA_REQSEL_USART0RXDATAV>;
      dma-names = "txbl", "txblright", "rxdatav";
    };
```

## dts/bindings/i2s/st,stm32h7-i2s.yaml
```yaml
# Copyright (c) 2018, STMicroelectronics
# SPDX-License-Identifier: Apache-2.0

description: STM32H7 I2S controller

compatible: "st,stm32h7-i2s"

include: st,stm32-i2s-common.yaml

properties:
  st,full-duplex:
    type: boolean
    description: |
      This I2S instance is capable of full duplex: the receiver and the
      transmitter can stream at the same time.

      The driver uses full duplex when both directions are configured, one by
      one, with the same rate, format and role. The RX and TX streams then share
      the clock, the format and the role, and can be started, stopped, drained
      and dropped independently of each other, or together with I2S_DIR_BOTH.
      Directions configured with different parameters keep the single direction
      behavior.
      Both the SDI and the SDO pins must be listed in pinctrl-0 to use both
      directions.
```

## dts/bindings/i2s/ti,am33xx-mcasp-audio.yaml
```yaml
# SPDX-FileCopyrightText: Copyright The Zephyr Project Contributors
# SPDX-License-Identifier: Apache-2.0

description: |
  TI Multichannel Audio Serial Port (McASP)

  The audio serial port of the TI AM62L SoC in I2S/TDM mode. The
  compatible and the property names follow the Linux binding.

  Each serializer (AXRn pin) is a transmitter or a receiver, selected by
  serial-dir. Transmit and receive run synchronously from the transmit
  clock and frame sync generators (ACLKX, AFSX); the receive clock pins are
  not used.

compatible: "ti,am33xx-mcasp-audio"

include: [i2s-controller.yaml, pinctrl-device.yaml]

properties:
  reg:
    required: true
    description: |
      Configuration port ("mpu") first, then data port ("dat"). The audio
      FIFO and the DMA requests are served through the data port.

  reg-names:
    required: true

  interrupts:
    required: true
    description: Transmit and receive interrupts.

  interrupt-names:
    required: true
    description: Must be "tx", "rx".

  clocks:
    required: true
    description: |
      Auxiliary clock (AUXCLK) the bit clock is divided down from in
      controller mode. A single clock, with a one-cell specifier.

  clock-names:
    description: Should be "fck".

  dmas:
    description: |
      Transmit and receive DMA channels. On the AM62L these are BCDMA split
      channels paired with the PDMA that serves the McASP audio FIFO.

  dma-names:
    description: DMA channel names, "tx" and "rx".
    enum: [tx, rx]

  serial-dir:
    type: array
    required: true
    max-len: 16
    description: |
      Mode of each serializer, indexed by serializer number: 0 inactive,
      1 transmit, 2 receive. Entries beyond the array are inactive.
```

## dts/bindings/i3c/snps,designware-i3c.yaml
```yaml
# Copyright (C) 2020 Samsung Electronics Co., Ltd.
# Copyright (C) 2023 Meta Platforms
# SPDX-License-Identifier: Apache-2.0

description: >
    This is a binding for the Synopsys I3C interface

compatible: "snps,designware-i3c"

include: [i3c-controller.yaml, pinctrl-device.yaml]

class: [i3c, i2c]

properties:
  clocks:
    required: true

  secondary:
    type: boolean
    description: |
      Boot as an I3C target. Only honored on hardware synthesized
      dual-role (HW_CAPABILITY DEVICE_ROLE_CONFIG == 3); requires
      CONFIG_I3C_TARGET.

  static-address:
    type: int
    description: |
      Target static address.

  tgt-pid:
    type: array
    description: |
      Target 48-bit Provisioned ID.
      array[0]: PID[47:33] MIPI manufacturer ID.
                PID[32] ID type selector (1'b1 random value, 1'b0 vendor fixed).
      array[1]: PID[31:0] Random value or vendor fixed value.

  bcr:
    type: int
    description: |
      Bus Characteristics Register, used for bus enumeration with ENTDAA and
      determine device role and capabilities of the device on the bus.

  dcr:
    type: int
    description: |
      Device Characteristics Register, used for bus enumeration with ENTDAA.
```

## dts/bindings/ieee802154/telink,b91-zb.yaml
```yaml
# Copyright (c) 2021, Telink Semiconductor
# SPDX-License-Identifier: Apache-2.0

description: Telink B91 IEEE802154 node

compatible: "telink,b91-zb"

include: [base.yaml, ieee802154-radio.yaml]

properties:
  reg:
    required: true

  interrupts:
    required: true
```

## dts/bindings/input/ti,tps6521x-power-button.yaml
```yaml
# SPDX-FileCopyrightText: Copyright The Zephyr Project Contributors
# SPDX-License-Identifier: Apache-2.0

description: |
  TI TPS65214/TPS65215 PMIC power button

  The node is a child of a "ti,tps65214" or "ti,tps65215" node, which needs
  the int-gpios property. The EN/PB/VSENSE pin must be configured as a push
  button by the PMIC NVM; otherwise the device fails to initialise. The
  driver unmasks push-button events on nINT (MASK_INT_FOR_PB).

  Press and release are reported after the PMIC deglitch time (64-128 ms).
  The press that powered the board up is not reported.

  Example:

    pmic@30 {
      compatible = "ti,tps65214";
      reg = <0x30>;
      int-gpios = <&gpio0 5 (GPIO_ACTIVE_LOW | GPIO_PULL_UP)>;

      power-button {
        compatible = "ti,tps6521x-power-button";
        zephyr,code = <INPUT_KEY_POWER>;
      };
    };

compatible: "ti,tps6521x-power-button"

properties:
  zephyr,code:
    type: int
    required: true
    description: Key code to report.
```

## dts/bindings/interrupt-controller/arm,gic-v3-its.yaml
```yaml
# Copyright (c) 2021 BayLibre, SAS
# SPDX-License-Identifier: Apache-2.0

description: GIC v3 Interrupt Translation Service

compatible: "arm,gic-v3-its"

include: base.yaml

properties:
  zephyr,device-id-bits:
    type: int
    min: 1
    max: 16
    default: 16
    description: |
      Number of DeviceID bits provisioned by the driver. This bounds the
      statically reserved Device table. The default covers the full 16-bit
      PCIe RequesterID space. Reduce this value when all DeviceIDs used by
      the platform fit in a narrower range to reduce static memory usage.

  zephyr,device-table-size:
    type: int
    min: 4096
    description: |
      Upper limit in bytes on storage for the direct Device table or the
      indirect root and second-level pages. The default reservation is sized
      for the largest direct table at the configured DeviceID width.
      Platforms with known table geometry can use a smaller limit to reduce
      the reservation. The driver tries supported page sizes and layouts.
      Initialization fails if none fits the reservation.

  reg:
    required: true
```
