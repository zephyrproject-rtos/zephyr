## dts/bindings/interrupt-controller/microchip,eic-g1-intc.yaml
```yaml
# Copyright (c) 2025-2026 Microchip Technology Inc.
# SPDX-License-Identifier: Apache-2.0

title: Microchip EIC G1 device

description: |
  The Microchip G1 External Interrupt Controller (EIC) device provides interrupt
  support for GPIO pins on Microchip G1 group of devices. As the mapping between
  GPIO pins and EIC interrupt lines differs across devices, the devicetree
  properties describes device-specific interrupt capabilities instead of hardcoding
  them.

  The devicetree binding provides the hardware-specific information including:
   - GPIO pins that support external interrupts.
   - GPIO pins that do not support external interrupts.
   - The EIC line of each GPIO pin, as a per-port table.

  Each port's portX-eic-lines table gives the EIC line of its pins, two pins
  per byte.

  Group g1 EIC supports following hardware peripherals:
    - module name="EIC" id="U2254" version="3.0.0"

compatible: "microchip,eic-g1-intc"

include: base.yaml

properties:
  reg:
    required: true
    description: |
      Specifies the base address and size of the register
      block of external interrupt controller.

  interrupts:
    required: true
    description: |
      Specifies the interrupt line in the NVIC

  low-power-mode:
    type: boolean
    description: |
      Enables low power mode for eic peripheral

  porta-unsupported-pins:
    type: int
    default: 0
    description: |
      Each bit in the property denotes a pin number. This shows the pins which
      do not support interrupt for port a.

  portb-unsupported-pins:
    type: int
    default: 0
    description: |
      Each bit in the property denotes a pin number. This shows the pins which
      do not support interrupt for portb.

  portc-unsupported-pins:
    type: int
    default: 0
    description: |
      Each bit in the property denotes a pin number. This shows the pins which
      do not support interrupt for portc.

  portc-supported-pins:
    type: int
    default: 0
    description: |
      Each bit in the property denotes a pin number. This shows the pins which
      support interrupt in portc

  portd-supported-pins:
    type: int
    default: 0
    description: |
      Each bit in the property denotes a pin number. This shows the pins which
      support interrupt in portd

  porte-supported-pins:
    type: int
    default: 0
    description: |
      Each bit in the property denotes a pin number. This shows the pins which
      support interrupt in porte

  portf-supported-pins:
    type: int
    default: 0
    description: |
      Each bit in the property denotes a pin number. This shows the pins which
      support interrupt in portf

  portg-supported-pins:
    type: int
    default: 0
    description: |
      Each bit in the property denotes a pin number. This shows the pins which
      support interrupt in portg

  porta-eic-lines:
    type: uint8-array
    min-len: 16
    max-len: 16
    description: |
      EXTINT line of each port A pin, two pins per byte: byte n holds pin 2n
      in its low nibble and pin 2n + 1 in its high nibble. 16 bytes. Pins
      the port's supported or unsupported mask rejects are not read.

  portb-eic-lines:
    type: uint8-array
    min-len: 16
    max-len: 16
    description: |
      EXTINT line of each port B pin, two pins per byte: byte n holds pin 2n
      in its low nibble and pin 2n + 1 in its high nibble. 16 bytes. Pins
      the port's supported or unsupported mask rejects are not read.

  portc-eic-lines:
    type: uint8-array
    min-len: 16
    max-len: 16
    description: |
      EXTINT line of each port C pin, two pins per byte: byte n holds pin 2n
      in its low nibble and pin 2n + 1 in its high nibble. 16 bytes. Pins
      the port's supported or unsupported mask rejects are not read.

  portd-eic-lines:
    type: uint8-array
    min-len: 16
    max-len: 16
    description: |
      EXTINT line of each port D pin, two pins per byte: byte n holds pin 2n
      in its low nibble and pin 2n + 1 in its high nibble. 16 bytes. Pins
      the port's supported or unsupported mask rejects are not read.

  porte-eic-lines:
    type: uint8-array
    min-len: 16
    max-len: 16
    description: |
      EXTINT line of each port E pin, two pins per byte: byte n holds pin 2n
      in its low nibble and pin 2n + 1 in its high nibble. 16 bytes. Pins
      the port's supported or unsupported mask rejects are not read.

  portf-eic-lines:
    type: uint8-array
    min-len: 16
    max-len: 16
    description: |
      EXTINT line of each port F pin, two pins per byte: byte n holds pin 2n
      in its low nibble and pin 2n + 1 in its high nibble. 16 bytes. Pins
      the port's supported or unsupported mask rejects are not read.

  portg-eic-lines:
    type: uint8-array
    min-len: 16
    max-len: 16
    description: |
      EXTINT line of each port G pin, two pins per byte: byte n holds pin 2n
      in its low nibble and pin 2n + 1 in its high nibble. 16 bytes. Pins
      the port's supported or unsupported mask rejects are not read.

examples:
  - |
    /*
     * The following example shows an EIC node in the SoC devicetree. The
     * *-supported-pins and *-unsupported-pins properties describe the
     * interrupt capabilities of GPIO pins for each port.
     *
     * The portX-eic-lines properties give the EIC line of each pin of a port,
     * two pins per byte, low nibble first.
     *
     * GPIO pins can be configured for interrupt operation using the standard
     * Zephyr GPIO APIs in the same way as any other GPIO pin.
     */
    eic: interrupt-controller@40002800 {
      compatible = "microchip,eic-g1-intc";
      reg = <0x40002800 0x38>;
      interrupts = <3 0>;
      interrupt-controller;
      #interrupt-cells = <2>;
      clocks = <&mclkperiph CLOCK_MCHP_MCLKPERIPH_ID_APBA_EIC>,
               <&gclkperiph CLOCK_MCHP_GCLKPERIPH_ID_EIC>;
      clock-names = "mclk", "gclk";

      porta-unsupported-pins = <0xf4000100>;
      porta-eic-lines = [10 32 54 76 90 ba dc fe 10 32 54 76 dc f0 00 00];

      portb-unsupported-pins = <0x20004300>;
      portb-eic-lines = [10 32 54 76 00 ba dc f0 10 32 54 76 98 ba 0c fe];

      portc-supported-pins = <0xffef>;
      portc-eic-lines = [98 ba d0 fe 10 32 54 76 00 00 00 00 00 00 00 00];
    };
```

## dts/bindings/interrupt-controller/neorv32,firq.yaml
```yaml
# Copyright The Zephyr Project Contributors
# SPDX-License-Identifier: Apache-2.0

description: |
  NEORV32 fast interrupt request (FIRQ) nexus. Maps FIRQ channels 0-15
  to RISC-V CPU interrupt lines 16-31.

compatible: "neorv32,firq"

include: [interrupt-nexus.yaml, base.yaml]
```

## dts/bindings/interrupt-controller/nuvoton,npcm-miwu-int-map.yaml
```yaml
# Copyright (c) 2026 Nuvoton Technology Corporation.
# SPDX-License-Identifier: Apache-2.0

description: NPCM-MIWU group-interrupt mapping child node

compatible: "nuvoton,npcm-miwu-int-map"

properties:
  parent:
    type: phandle
    required: true
    description: parent device node of miwu groups

child-binding:
  description: Child node to present the mapping between MIWU group and interrupt
  properties:
    irq:
      type: int
      required: true
      description: irq for miwu group
    irq-prio:
      type: int
      required: true
      description: irq's priority for miwu group. The valid number is from 0 to 7.
    group-mask:
      type: int
      required: true
      description: group bit-mask for miwu interrupts
    wui-mask:
      type: int
      default: 0xff
      description: |
        Bit mask of the inputs of the groups in group-mask that are routed to
        this interrupt. The default covers all eight inputs. Use a subset when
        the inputs of a group are routed to different interrupts. No callback
        can be registered on an input that no child routes to an interrupt.
    groups:
      type: array
      description: groups shared the same interrupt
```

## dts/bindings/interrupt-controller/ti,sci-intr-out.yaml
```yaml
# Copyright (c) 2026 Dhruv Menon <dhruvmenon1104@gmail.com>
# SPDX-License-Identifier: Apache-2.0

description: |
  One interrupt-router output that peripherals can use as their interrupt
  parent on TI K3.

  Point a device's interrupt-parent here. In that device's interrupts
  property, list the router input number and priority 0. The board or SoC
  already wires this output to a CPU interrupt.

compatible: "ti,sci-intr-out"

include: [interrupt-controller.yaml, base.yaml]

properties:
  reg:
    required: true
    description: Router output number for this line.

  interrupts:
    required: true
    description: CPU interrupt this router output is connected to.

  "#interrupt-cells":
    const: 2

interrupt-cells:
  - irq
  - priority

# Priority must be 0 for peripherals. The CPU interrupt's priority and trigger
# come from this node's interrupts property above.

examples:
  - |
    main_gpio_intr_16: interrupt-controller@10 {
        compatible = "ti,sci-intr-out";
        reg = <16>;
        interrupt-controller;
        #interrupt-cells = <2>;
        interrupt-parent = <&vim>;
        interrupts = <0 104 IRQ_TYPE_LEVEL IRQ_DEFAULT_PRIORITY>;
    };

    main_i2c4: i2c@fe80000 {
        interrupt-parent = <&main_gpio_intr_16>;
        interrupts = <178 0>;   /* router input 178, priority 0 */
    };
```

## dts/bindings/interrupt-controller/ti,sci-intr.yaml
```yaml
# Copyright (c) 2026 Dhruv Menon <dhruvmenon1104@gmail.com>
# SPDX-License-Identifier: Apache-2.0

description: |
  Texas Instruments K3 Interrupt Router managed via TISCI.

  The Interrupt Router muxes M interrupt inputs to N outputs. Configuration of
  the per-output MUXCNTL registers is performed by System Firmware through the
  TISCI resource-management IRQ set/release messages.

  This node is a container for host IR output children (`ti,sci-intr-out`).
  Each child has reg = output index and interrupts = parent VIM/GIC line.
  Peripherals set interrupt parent to that child and pass only the IR input
  number.

compatible: "ti,sci-intr"

include: base.yaml

properties:
  "#address-cells":
    const: 1

  "#size-cells":
    const: 0

  ti,sci:
    type: phandle
    required: true
    description: Phandle to the TISCI system controller node.

  ti,sci-dev-id:
    type: int
    required: true
    description: TISCI device ID of this interrupt router instance.

examples:
  - |
    main_gpio_intr: interrupt-router {
        compatible = "ti,sci-intr";
        #address-cells = <1>;
        #size-cells = <0>;
        ti,sci = <&dmsc>;
        ti,sci-dev-id = <3>;

        main_gpio_intr_16: interrupt-controller@10 {
            compatible = "ti,sci-intr-out";
            reg = <16>;
            interrupt-controller;
            #interrupt-cells = <2>;
            interrupt-parent = <&vim>;
            interrupts = <0 104 IRQ_TYPE_LEVEL IRQ_DEFAULT_PRIORITY>;
        };
    };

    main_i2c4: i2c@fe80000 {
        interrupt-parent = <&main_gpio_intr_16>;
        interrupts = <178 0>;   /* IR input 178; L2 priority cell must be 0 */
    };
```

## dts/bindings/ipc/zephyr,metal-io.yaml
```yaml
# Copyright 2026 Arm Limited and/or its affiliates <open-source-office@arm.com>
# SPDX-License-Identifier: Apache-2.0

description: |
  OpenAMP libmetal I/O mapping. The backing region describes locally accessible
  memory; physmap describes the addresses exchanged with the peer. This binding
  does not configure the MMU, MPU or cache attributes.

compatible: "zephyr,metal-io"

include: base.yaml

properties:
  region:
    type: phandle
    required: true
    description: |
      Backing memory region whose reg property gives its local base address and
      size. The mapping starts at this base, including any protocol headers.

  physmap:
    type: array
    required: true
    description: |
      Base address of each page in the address space used in vring descriptors,
      starting with offset zero of region. Each entry is one 32-bit address,
      converted to metal_phys_addr_t without sign extension. With page-shift
      omitted, provide exactly one base address.
      Otherwise provide one page-aligned address per page, including a final
      partial page. Peers must agree on the address of each shared byte.

  mem-flags:
    type: int
    description: |
      Memory flags passed unchanged to libmetal, or zero when omitted. The
      Zephyr libmetal port does not use these to configure memory attributes.

  page-shift:
    type: int
    description: |
      Log2 of the page size, less than the bit width of metal_phys_addr_t.
      If omitted, the entire region is a single contiguous page (libmetal's
      page_shift = -1 convention). This is not a system page-size default.
```

## dts/bindings/led/led-node.yaml
```yaml
# Copyright (c) 2025 Seagate Technology LLC
# SPDX-License-Identifier: Apache-2.0

# Common fields for LED nodes

properties:
  label:
    type: string
    description: |
      Human readable string describing the LED. It can be used by an
      application to identify this LED or to retrieve its number/index
      (i.e. child node number) on the parent device.

  color-mapping:
    type: array
    description: |
      Channel to color mapping of a multicolor LED. If a LED supports
      several colors, then the color-mapping property can be used to
      describe how the hardware channels and the colors are mapped.

      For example the channel to color mapping of RGB LEDs would be

         color-mapping =
              <LED_COLOR_ID_RED>,
              <LED_COLOR_ID_GREEN>,
              <LED_COLOR_ID_BLUE>;

  default-state:
    type: string
    enum:
      - "on"
      - "off"
      - "keep"
    default: "off"
    description: |
      The initial state of the LED. The "keep" setting will keep the LED at whatever its current
      state is. If not set then the LED will be "off".

  default-brightness:
    type: int
    min: 0
    max: 100
    default: 100
    description: |
      Brightness to be set if LED's default state is on. Used only during initialization.
      If omitted, brightness defaults to the maximum value.
```

## dts/bindings/led/ti,lp5815.yaml
```yaml
# Copyright (c) 2026 Kristina Kisiuk, Aliensense
# SPDX-License-Identifier: Apache-2.0

title: Texas Instruments LP5815 3-channel I2C RGB LED driver

description: |
  The LP5815 drives three LED outputs, each with an 8-bit PWM value and an
  8-bit dot current, and has an animation engine that the driver uses to blink
  the LEDs.

  Each child node is an LED. Its index is the first output it uses, and each
  further color of its color-mapping takes the next output. Two LEDs must not
  share an output.

  A blinking LED goes between off and full PWM, on all its colors. The on and
  off times can be 50 ms to 500 ms in steps of 50 ms, or 1, 2, 4, 6 or 8 s.

compatible: "ti,lp5815"

include: ["i2c-device.yaml", "led-controller.yaml"]

properties:
  max-current-51ma:
    type: boolean
    description: |
      Maximum current of every output: 51 mA with this property, 25.5 mA
      without it.

  dot-current:
    type: array
    required: true
    min: 0
    max: 255
    min-len: 3
    max-len: 3
    description: |
      Current of outputs 0, 1 and 2, each as a part of the maximum current
      from 0 to 255 (255 is the maximum current). An output with 0 gives no
      current, so its LED stays dark.

child-binding:
  properties:
    label:
      required: true

    index:
      required: true

    color-mapping:
      required: true

examples:
  - |
    #include <zephyr/dt-bindings/led/led.h>

    lp5815@2d {
      compatible = "ti,lp5815";
      reg = <0x2d>;
      dot-current = <255 255 255>;

      led_0 {
        label = "RGB LED";
        index = <0>;
        color-mapping = <LED_COLOR_ID_RED LED_COLOR_ID_GREEN LED_COLOR_ID_BLUE>;
      };
    };
```
