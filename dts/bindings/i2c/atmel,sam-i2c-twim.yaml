## dts/bindings/i2c/atmel,sam-i2c-twim.yaml
```yaml
# Copyright (c) 2020 Gerson Fernando Budke <nandojve@gmail.com>
# SPDX-License-Identifier: Apache-2.0

description: |
  Atmel SAM4L Family I2C (TWIM) node

  The Atmel Two-wire Master Interface (TWIM) interconnects components on a
  unique two-wire bus, made up of one clock line and one data line with speeds
  of up to 3.4 Mbit/s, based on a byte-oriented transfer format.  The TWIM is
  always a bus master and can transfer sequential or single bytes.  Multiple
  master capability is supported.  Arbitration of the bus is performed
  internally and relinquishes the bus automatically if the bus arbitration is
  lost.

  When using speeds above standard mode, user may need adjust clock and data
  lines slew and strength parameters.  In general, slew 0 and minimal strength
  is enougth for short buses and light loads.  As reference, the below
  is the lowest power configuration:

    std-clk-slew-lim = <0>;
    std-clk-strength-low = "0.5";
    std-data-slew-lim = <0>;
    std-data-strength-low = "0.5";

    hs-clk-slew-lim = <0>;
    hs-clk-strength-high = "0.5";
    hs-clk-strength-low = "0.5";
    hs-data-slew-lim = <0>;
    hs-data-strength-low = "0.5";

  For best performances, user can tune the slope curves using an osciloscope.
  The tuning should be performed by groups defined <mode>-<line>.  The prefix
  std-<line> configures fast/fast-plus mode speeds and hs-<line> selects the
  high speed mode.  The tune should be performed for both clock and data lines
  on both speed modes.


compatible: "atmel,sam-i2c-twim"

include: i2c-controller.yaml

properties:
    reg:
      required: true

    interrupts:
      required: true

    peripheral-id:
      type: int
      required: true
      description: peripheral ID

    std-clk-slew-lim:
      type: int
      required: true
      description: |
        Slew limit of the TWCK output buffer.  This should be adjusted with
        std-clk-strength-low to fine tune the TWCK slope.
      enum:
        - 0
        - 1
        - 2
        - 3

    std-clk-strength-low:
      type: string
      required: true
      description: |
        Pull-down drive strength of the TWCK output buffer in fast/fast plus
        mode.  This should be adjusted to provide proper TWCK line fall time.
        The value represents the port output current in mA when signal on
        low level.
      enum:
        - "0.5"
        - "1.0"
        - "1.6"
        - "3.1"
        - "6.2"
        - "9.3"
        - "15.5"
        - "21.8"

    std-data-slew-lim:
      type: int
      required: true
      description: |
        Slew limit of the TWD output buffer.  This should be adjusted with
        std-data-strength-low to fine tune the TWD slope.
      enum:
        - 0
        - 1
        - 2
        - 3

    std-data-strength-low:
      type: string
      required: true
      description: |
        Pull-down drive strength of the TWD output buffer in fast/fast plus
        mode.  This should be adjusted to provide proper TWD line fall time.
        The value represents the port output current in mA when signal on
        low level.
      enum:
        - "0.5"
        - "1.0"
        - "1.6"
        - "3.1"
        - "6.2"
        - "9.3"
        - "15.5"
        - "21.8"

    hs-clk-slew-lim:
      type: int
      required: true
      description: |
        Slew limit of the TWCK output buffer in high speed mode.  This
        should be adjusted with both hs-clk-strength-high and
        hs-clk-strength-low to fine tune the TWCK slope.
      enum:
        - 0
        - 1
        - 2
        - 3

    hs-clk-strength-high:
      type: string
      required: true
      description: |
        Pull-up drive strength of the TWCK output buffer in high speed
        mode.  This should be adjusted to provide proper TWCK line rise time.
        The value represents the port output current in mA when signal on
        high level.
      enum:
        - "0.5"
        - "1.0"
        - "1.5"
        - "3.0"

    hs-clk-strength-low:
      type: string
      required: true
      description: |
        Pull-down drive strength of the TWCK output buffer in high speed
        mode.  This should be adjusted to provide proper TWCK line fall time.
        The value represents the port output current in mA when signal on
        low level.
      enum:
        - "0.5"
        - "1.0"
        - "1.6"
        - "3.1"
        - "6.2"
        - "9.3"
        - "15.5"
        - "21.8"

    hs-data-slew-lim:
      type: int
      required: true
      description: |
        Slew limit of the TWD output buffer in high speed mode.  This
        should be adjusted with hs-data-strength-low to fine tune the TWD
        slope.
      enum:
        - 0
        - 1
        - 2
        - 3

    hs-data-strength-low:
      type: string
      description: |
        Pull-down drive strength of the TWD output buffer in high speed
        mode.  This should be adjusted to provide proper TWD line fall time.
        The value represents the port output current in mA when signal on
        low level.
      enum:
        - "0.5"
        - "1.0"
        - "1.6"
        - "3.1"
        - "6.2"
        - "9.3"
        - "15.5"
        - "21.8"

    hs-master-code:
      type: int
      required: true
      description: |
        3-bit code to be prefixed with 0b00001 to form a unique
        8-bit HS-mode master code (0000 1XXX)
      enum:
        - 0   # 000
        - 1   # 001
        - 2   # 010
        - 3   # 011
        - 4   # 100
        - 5   # 101
        - 6   # 110
        - 7   # 111

    pinctrl-0:
      type: phandles
      required: true
      description: |
        GPIO pin configuration for TWCK & TWD signals. We expect that
        the phandles will reference pinctrl nodes. These nodes will
        have a nodelabel that matches the Atmel SoC HAL defines and
        be of the form p<port><pin><periph>_<inst>_<signal>.

        For example the I2C on SAM4L would be
           pinctrl-0 = <&pb0a_twi1_twd1 &pb1a_twi1_twck1>;
```

## dts/bindings/i2c/atmel,sam0-i2c.yaml
```yaml
# Copyright (c) 2019 Derek Hageman <hageman@inthat.cloud>
# Copyright (c) 2024 Gerson Fernando Budke <nandojve@gmail.com>
# SPDX-License-Identifier: Apache-2.0

description: Atmel SAM0 series SERCOM I2C

compatible: "atmel,sam0-i2c"

include:
  - name: i2c-controller.yaml
  - name: pinctrl-device.yaml
  - name: atmel,assigned-clocks.yaml

properties:
  reg:
    required: true

  interrupts:
    required: true

  clocks:
    required: true

  clock-names:
    required: true

  atmel,assigned-clocks:
    required: true

  atmel,assigned-clock-names:
    required: true

  dmas:
    description: |
      Optional TX & RX dma specifiers.  Each specifier will have a phandle
      reference to the dmac controller, the channel number, and peripheral
      trigger source.

      For example dmas for TX, RX on SERCOM3
         dmas = <&dmac 0 0xb>, <&dmac 0 0xa>;

  dma-names:
    description: |
      Required if the dmas property exists.  This should be "tx" and "rx"
      to match the dmas property.

      For example
         dma-names = "tx", "rx";
```

## dts/bindings/i2c/atmosic,atm-i2c.yaml
```yaml
description: Atmosic I2C

compatible: "atmosic,atm-i2c"

include: i2c-controller.yaml

properties:
    reg:
      required: true

    interrupts:
      required: true

    instance:
      type: int
      required: true
      description: I2C instance

    sda-pin:
      type: int
      required: false
      description: SDA pin to use

    scl-pin:
      type: int
      required: false
      description: SCL pin to use

    scl-pullup:
      type: boolean
      required: false
      description: Clock pullup requirement

    sda-pullup:
      type: boolean
      required: false
      description: Data pullup requirement

    clk-stretch:
      type: boolean
      required: false
      description: Set clock stretching
```

## dts/bindings/i2c/bflb,i2c.yaml
```yaml
# Copyright (c) 2024-2025 MASSDRIVER EI (massdriver.space)
# SPDX-License-Identifier: Apache-2.0

description: Bouffalolab I2C interface

compatible: "bflb,i2c"

include: [i2c-controller.yaml, pinctrl-device.yaml]

properties:
  reg:
    required: true

  interrupts:
    required: true

  pinctrl-0:
    required: true

  pinctrl-names:
    required: true
```

## dts/bindings/i2c/brcm,bcm2711-i2c.yaml
```yaml
# Copyright (c) 2026 Muhammad Waleed Badar
# SPDX-License-Identifier: Apache-2.0

description: Broadcom BCM2711 I2C controller

compatible: "brcm,bcm2711-i2c"

include: [i2c-controller.yaml, pinctrl-device.yaml]

properties:
  reg:
    required: true

  interrupts:
    required: true

  clock-frequency:
    required: true

  clocks:
    required: true

  scl-gpios:
    type: phandle-array
    description: |
      GPIO to which the I2C SCL signal is routed. This is only needed for I2C bus recovery
      support.

  sda-gpios:
    type: phandle-array
    description: |
      GPIO to which the I2C SDA signal is routed. This is only needed for I2C bus recovery
      support.
```

## dts/bindings/i2c/brcm,iproc-i2c.yaml
```yaml
# Copyright 2020 Broadcom
# Copyright 2024 Meta Platforms
# SPDX-License-Identifier: Apache-2.0

description: Broadcom iProc I2C controller

compatible: "brcm,iproc-i2c"

include: i2c-controller.yaml

properties:
  reg:
    required: true

  interrupts:
    required: true
```

## dts/bindings/i2c/cdns,i2c-r1p14.yaml
```yaml
# Copyright (c) 2025 Advanced Micro Devices, Inc.
#
# SPDX-License-Identifier: Apache-2.0

description: |
  Cadence I2C controller version 1.4.

  Example I2C device tree node:
    i2c@e0004000 {
        compatible = "cdns,i2c-r1p14";
        clocks = <&clkc 38>;
        interrupts = <GIC_SPI 25 IRQ_TYPE_LEVEL_HIGH>;
        reg = <0xe0004000 0x1000>;
        clock-frequency = <400000>;
        #address-cells = <1>;
        #size-cells = <0>;
        fifo-depth = <8>;
    };

compatible: "cdns,i2c-r1p14"

include: [i2c-controller.yaml, reset-device.yaml]

properties:
  reg:
    required: true

  clocks:
    required: true
    description: Reference Input clock for I2C core.

  interrupts:
    required: true

  clock-frequency:
    description: Desired I2C bus clock frequency in Hz.
    enum: [100000, 400000]

  fifo-depth:
    type: int
    description: Size of the data FIFO in bytes.
    default: 16
    enum: [2, 4, 8, 16, 32, 64, 128, 256]
```

## dts/bindings/i2c/cdns,i2c.yaml
```yaml
# Copyright (c) 2025 Advanced Micro Devices, Inc.
#
# SPDX-License-Identifier: Apache-2.0

description: |
  Cadence I2C controller.

  Example I2C device tree node:
    i2c@e0004000 {
        compatible = "cdns,i2c";
        clocks = <&clkc 38>;
        interrupts = <GIC_SPI 25 IRQ_TYPE_LEVEL_HIGH>;
        reg = <0xe0004000 0x1000>;
        clock-frequency = <400000>;
        #address-cells = <1>;
        #size-cells = <0>;
        fifo-depth = <8>;
    };

compatible: "cdns,i2c"

include: [i2c-controller.yaml, reset-device.yaml]

properties:
  reg:
    required: true

  clocks:
    required: true
    description: Reference Input clock for I2C core.

  interrupts:
    required: true

  clock-frequency:
    required: true
    description: Desired I2C bus clock frequency in Hz.

  fifo-depth:
    type: int
    required: true
    description: Size of the data FIFO in bytes.
```

## dts/bindings/i2c/ene,kb1200-i2c.yaml
```yaml
# Copyright (c) 2024 ENE Technology Inc.
# SPDX-License-Identifier: Apache-2.0

description: ENE I2C/SMB controller

compatible: "ene,kb1200-i2c"

include: [i2c-controller.yaml, pinctrl-device.yaml]

properties:
  reg:
    required: true

  interrupts:
    required: true

  pinctrl-0:
    required: true

  pinctrl-names:
    required: true
```

## dts/bindings/i2c/espressif,esp32-i2c.yaml
```yaml
# Copyright (c) 2019 Mohamed ElShahawi (ExtremeGTX@hotmail.com)
# Copyright (c) 2022 Espressif Systems (Shanghai) Co., Ltd.
# SPDX-License-Identifier: Apache-2.0

description: ESP32 I2C

compatible: "espressif,esp32-i2c"

include: [i2c-controller.yaml, pinctrl-device.yaml]

properties:
  reg:
    required: true

  pinctrl-0:
    required: true

  pinctrl-names:
    required: true

  scl-gpios:
    type: phandle-array
    description: |
      GPIO to which the I2C SCL signal is routed. This is only required
      if the target SoC does not have support in hardware for clearing
      the I2C bus in case of a communication failure

  sda-gpios:
    type: phandle-array
    description: |
      GPIO to which the I2C SDA signal is routed. This is only required
      if the target SoC does not have support in hardware for clearing
      the I2C bus in case of a communication failure

  tx-lsb:
    type: boolean
    description: Set I2C TX data as LSB

  rx-lsb:
    type: boolean
    description: Set I2C RX data as LSB

  scl-timeout-us:
    type: int
    description: |
      Timeout for unchanged SCL during clock stretching of the I2C target in
      microseconds.

      If not set or 0, the timeout is disabled or set to the maximum possible
      value if the MCU does not support disabling the timeout.
```

## dts/bindings/i2c/fsl,imx21-i2c.yaml
```yaml
# Copyright (c) 2018 Linaro Limited
# SPDX-License-Identifier: Apache-2.0

description: i.MX I2C

compatible: "fsl,imx21-i2c"

include: [i2c-controller.yaml, pinctrl-device.yaml, "nxp,rdc-policy.yaml"]

properties:
  reg:
    required: true

  interrupts:
    required: true
```

## dts/bindings/i2c/fsl,imx7d-i2c.yaml
```yaml
# Copyright (c) 2018 Linaro Limited
# SPDX-License-Identifier: Apache-2.0

title: i.MX I2C Controller

description: |
    This is a representation of the i.MX I2C nodes

compatible: "fsl,imx7d-i2c"

include: i2c-controller.yaml

properties:
    reg:
      required: true

    interrupts:
      required: true

    rdc:
     type: int
     required: true
     description: Set the RDC permission for this peripheral
```

## dts/bindings/i2c/gd,gd32-i2c.yaml
```yaml
# Copyright (c) 2021 BrainCo Inc.
# SPDX-License-Identifier: Apache-2.0

description: GigiDevice GD32 I2C

compatible: "gd,gd32-i2c"

include: [i2c-controller.yaml, reset-device.yaml, pinctrl-device.yaml]

properties:
  reg:
    required: true

  interrupts:
    required: true

  resets:
    required: true

  clocks:
    required: true

  pinctrl-0:
    required: true

  pinctrl-names:
    required: true
```

## dts/bindings/i2c/gpio-i2c-switch.yaml
```yaml
# Copyright (c) 2023, Ayush Singh <ayushdevel1325@gmail.com>
# Copyright (c) 2021, Jason Kridner, BeagleBoard.org Foundation
# SPDX-License-Identifier: Apache-2.0

description: |
  GPIO enabled analog switch to isolate devices from an I2C bus

compatible: "gpio-i2c-switch"

include: i2c-controller.yaml

properties:
  "#address-cells":
    required: true
    const: 1
  "#size-cells":
    required: true
    const: 0
  controller:
    type: phandle
    required: true
  gpios:
    type: phandle-array
    required: true
```

## dts/bindings/i2c/gpio-i2c.yaml
```yaml
# Copyright (c) 2020 Vestas Wind Systems A/S
# SPDX-License-Identifier: Apache-2.0

title: I2C via GPIO bitbanging

description: |
  The GPIO pin used for SDA must be configured (through devicetree and pinmux) with suitable flags,
  i.e. as open-collector/open-drain with a pull-up resistor (pull-up can be an external component).

  The SCL pin should be configured in the same manner as the SDA pin, or, if it is known that the
  hardware attached to pin does not attempt I2C clock stretching, then the SCL pin may be configured
  as push/pull.

compatible: "gpio-i2c"

include: i2c-controller.yaml

properties:
  scl-gpios:
    type: phandle-array
    required: true
    description: GPIO to which the SCL pin of the I2C bus is connected.
  sda-gpios:
    type: phandle-array
    required: true
    description: GPIO to which the SDA pin of the I2C bus is connected.
```
