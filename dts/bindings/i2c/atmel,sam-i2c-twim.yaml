## dts/bindings/i2c/i2c-controller.yaml
```yaml
# Copyright (c) 2017 I-SENSE group of ICCS
# SPDX-License-Identifier: Apache-2.0

# Common fields for I2C controllers

include: base.yaml

bus: i2c

properties:
  "#address-cells":
    required: true
    const: 1
  "#size-cells":
    required: true
    const: 0
  clock-frequency:
    type: int
    description: Initial clock frequency in Hz
  sq-size:
    type: int
    default: 4
    description: Size of the submission queue for blocking requests
  cq-size:
    type: int
    default: 4
    description: Size of the completion queue for blocking requests
```

## dts/bindings/i2c/i2c-device.yaml
```yaml
# Copyright (c) 2017, Linaro Limited
# SPDX-License-Identifier: Apache-2.0

# Common fields for I2C devices

include: [base.yaml, power.yaml]

on-bus: i2c

properties:
  reg:
    required: true
    description: device address on i2c bus

  i2c-10-bit-address:
    type: boolean
    description: |
      Enable 10-bit addressing mode for this I2C device.
      When set, the device will use 10-bit addressing instead of the
      default 7-bit addressing. The reg property should contain the
      full 10-bit address value.
```

## dts/bindings/i2c/i2c-mux-device.yaml
```yaml
# Copyright (c) 2023 Google LLC.
# SPDX-License-Identifier: Apache-2.0

description: |
  Generic I2C mux

  Each channel is represented by a separate devicetree child node.
  The channel node can then be used as a standard i2c bus controller
  like in the following simplified example:

      /* The imx3112 node must be a child of an i2c controller */
      mux: imx3112@77 {
          compatible = "renesas,imx3112-i2c";
          reg = <0x77 0x0000 0x00000000>;
          status = "okay";
          #address-cells = <1>;
          #size-cells = <0>;

          mux_i2c@0 {
              compatible: "renesas,imx3112-channel"
              reg = <0>;
              #address-cells = <3>;
              #size-cells = <0>;
              lps22hh0: lps22hh@10 {
                      compatible = "st,lps22hh";
                      reg = <0x10 0x0000 0x00000000>;
              };
          };

          mux_i2c@1 {
            compatible: "renesas,imx3112-channel"
              reg = <1>;
              #address-cells = <3>;
              #size-cells = <0>;
              lps22hh1: lps22hh@10 {
                      compatible = "st,lps22hh";
                      reg = <0x10 0x0000 0x00000000>;
              };
          };
      };

on-bus: i2c

include: [i2c-device.yaml]

child-binding:
  description: Generic switch channel node
  include: [i2c-controller.yaml]
  on-bus: i2c
```

## dts/bindings/i2c/i2c-shell.yaml
```yaml
# Copyright (c) 2022 Google LLC
# SPDX-License-Identifier: Apache-2.0

# I2C Shell

description: |
  When this node is present, "i2c-shell" defines the list of I2C controllers
  visisble to the "i2c" shell command.

  Example usage:
    i2c-shell {
      compatible = "i2c-shell";
      i2c-controllers = <&i2c0_0
                         &i2c1_0
                         &i2c2_0
                         &i2c4_1
                         &i2c5_0
                         &i2c7_0>;
      i2c-controller-names = "I2C_POWER",
                             "I2C_USB_C0_PD",
                             "I2C_USB_C1_PD",
                             "I2C_RTC",
                             "I2C_EEPROM",
                             "I2C_SENSOR";
    };

compatible: "i2c-shell"

include: base.yaml

properties:
    i2c-controllers:
      type: phandles
      required: true
      description: I2C controllers enabled for shell access

    i2c-controller-names:
      type: string-array
      required: true
      description: Friendly name for each I2C controller
```

## dts/bindings/i2c/i2c.yaml
```yaml
#
# Copyright (c) 2017 I-SENSE group of ICCS
#
# SPDX-License-Identifier: Apache-2.0
#

title: I2C Base Structure

description: >
    This binding gives the base structures for all I2C devices

inherits:
    !include base.yaml

child:
    bus: i2c

properties:
    "#address-cells":
      type: int
      category: required
      description: should be 1.
    "#size-cells":
      type: int
      category: required
      description: should be 0.
    clock-frequency :
      type: int
      category: optional
      description: Initial clock frequency in Hz
    label:
      category: required
```

## dts/bindings/i2c/infineon,cat1-i2c.yaml
```yaml
# Copyright (c) 2023 Cypress Semiconductor Corporation (an Infineon company) or
# an affiliate of Cypress Semiconductor Corporation
#
# SPDX-License-Identifier: Apache-2.0

description: |
  Infineon CAT1 I2C driver

  This driver configures the SCB as an I2C device.

  Example devicetree configuration with vl53l0x Time-of-Flight (ToF)
  ranging sensor connected on the bus:

  i2c3: &scb3 {
      compatible = "infineon,cat1-i2c";
      status = "okay";

      #address-cells = <1>;
      #size-cells = <0>;

      pinctrl-0 = <&p6_0_scb3_i2c_scl &p6_1_scb3_i2c_sda>;
      pinctrl-names = "default";

      vl53l0x@29 {
        compatible = "st,vl53l0x";
        reg = <0x29>;
      };
  };

  The pinctrl nodes need to be configured as open-drain and
  input-enable:

  &p6_0_scb3_i2c_scl {
    drive-open-drain;
    input-enable;
  };

  &p6_1_scb3_i2c_sda {
    drive-open-drain;
    input-enable;
  };

compatible: "infineon,cat1-i2c"

include: [i2c-controller.yaml, pinctrl-device.yaml, "infineon,cat1-scb.yaml"]

properties:
  reg:
    type: array
    required: true

  interrupts:
    type: array
    required: true

  pinctrl-0:
    description: |
      PORT pin configuration for SCL, SDA signals.
      We expect that the phandles will reference pinctrl nodes. These
      nodes will have a nodelabel that matches the Infineon SoC Pinctrl
      defines and have following
      format: p<port>_<pin>_<peripheral inst>_<signal>.

      Examples:
        pinctrl-0 = <&p6_0_scb3_i2c_scl &p6_1_scb3_i2c_sda>;
    required: true

  pinctrl-names:
    required: true

  clock-frequency:
    type: int
    description: |
      Frequency that the I2C bus runs
```

## dts/bindings/i2c/infineon,xmc4-i2c.yaml
```yaml
# Copyright (c) 2023 Cypress Semiconductor Corporation (an Infineon company) or
# an affiliate of Cypress Semiconductor Corporation
#
# SPDX-License-Identifier: Apache-2.0

description: Infineon XMC4 I2C

compatible: "infineon,xmc4-i2c"

include: [i2c-controller.yaml, pinctrl-device.yaml]

properties:
  reg:
    type: array
    required: true

  scl-src:
    description: |
      Connects the I2C clock line (USIC DX0 input) to a specific GPIO pin.
      The USIC DX0 input is a multiplexer which connects to different GPIO pins.
      Refer to the XMC4XXX reference manual for the GPIO pin/mux mappings.
    type: string
    required: true
    enum:
      - "DX0A"
      - "DX0B"
      - "DX0C"
      - "DX0D"
      - "DX0E"
      - "DX0F"
      - "DX0G"

  sda-src:
    description: |
      Connects the I2C data line (USIC DX0 input) to a specific GPIO pin.
      The USIC DX0 input is a multiplexer which connects to different GPIO pins.
      Refer to the XMC4XXX reference manual for the GPIO pin/mux mappings.
    type: string
    required: true
    enum:
      - "DX0A"
      - "DX0B"
      - "DX0C"
      - "DX0D"
      - "DX0E"
      - "DX0F"
      - "DX0G"

  interrupts:
    type: array
    required: true
    description: |
      IRQ number and priority to use for interrupt driven by I2C.
      Each USIC must use a certain interrupt range:
      USIC0 = [84, 89]
      USIC1 = [90, 95]
      USIC2 = [96, 101]

  pinctrl-0:
    description: |
      PORT pin configuration for SCL, SDA signals.
      We expect that the phandles will reference pinctrl nodes. These
      nodes will have a nodelabel that matches the Infineon SoC Pinctrl
      defines and have following
      format: <signal>_p<port>_<pin>_<peripheral inst>

      Examples:
        pinctrl-0 = <&i2c_scl_p5_2_u2c0 &i2c_sda_p5_0_u2c0>;
    required: true

  pinctrl-names:
    required: true

  clock-frequency:
    type: int
    description: |
      Frequency that the I2C bus runs
```

## dts/bindings/i2c/infineon,xmc4xxx-i2c.yaml
```yaml
# Copyright (c) 2023 Cypress Semiconductor Corporation (an Infineon company) or
# an affiliate of Cypress Semiconductor Corporation
#
# SPDX-License-Identifier: Apache-2.0

description: |

  Infineon XMC4XXX I2C

  This driver configures the USIC as an I2C device.

  Example devicetree configuration with an adt7420 temperature sensor
  connected on the bus:

  &usic1ch1 {
      compatible = "infineon,xmc4xxx-i2c";
      status = "okay";

      pinctrl-0 = <&i2c_scl_p0_13_u1c1 &i2c_sda_p3_15_u1c1>;
      pinctrl-names = "default";
      scl-src = "DX1B";
      sda-src = "DX0A";
      interrupts = <94 1>;

      #address-cells = <1>;
      #size-cells = <0>;

      clock-frequency = <I2C_BITRATE_STANDARD>;
      adt7420@48 {
          compatible = "adi,adt7420";
          reg = <0x48>;
      };
  };

  The pinctrl nodes need to be configured as open-drain and
  hwctrl should be disabled:

  &i2c_scl_p0_13_u1c1 {
      drive-strength = "strong-sharp-edge";
      drive-open-drain;
      hwctrl = "disabled";
  };

  &i2c_sda_p3_15_u1c1 {
      drive-strength = "strong-soft-edge";
      drive-open-drain;
      hwctrl = "disabled";
  };

compatible: "infineon,xmc4xxx-i2c"

include: [i2c-controller.yaml, pinctrl-device.yaml]

properties:
  reg:
    type: array
    required: true

  scl-src:
    description: |
      Connects the I2C clock line (USIC DX1 input) to a specific GPIO pin.
      The USIC DX1 input is a multiplexer which connects to different GPIO pins.
      Refer to the XMC4XXX reference manual for the GPIO pin/mux mappings.
    type: string
    required: true
    enum:
      - "DX1A"
      - "DX1B"
      - "DX1C"
      - "DX1D"
      - "DX1E"
      - "DX1F"
      - "DX1G"

  sda-src:
    description: |
      Connects the I2C data line (USIC DX0 input) to a specific GPIO pin.
      The USIC DX0 input is a multiplexer which connects to different GPIO pins.
      Refer to the XMC4XXX reference manual for the GPIO pin/mux mappings.
    type: string
    required: true
    enum:
      - "DX0A"
      - "DX0B"
      - "DX0C"
      - "DX0D"
      - "DX0E"
      - "DX0F"
      - "DX0G"

  interrupts:
    required: true
    description: |
      IRQ number and priority to use for interrupt driven by I2C.
      Each USIC must use a certain interrupt range:
      USIC0 = [84, 89]
      USIC1 = [90, 95]
      USIC2 = [96, 101]

  pinctrl-0:
    description: |
      PORT pin configuration for SCL, SDA signals.
      We expect that the phandles will reference pinctrl nodes. These
      nodes will have a nodelabel that matches the Infineon SoC Pinctrl
      defines and have following
      format: i2c_<signal>_p<port>_<pin>_<peripheral inst>

      Examples:
        pinctrl-0 = <&i2c_scl_p5_2_u2c0 &i2c_sda_p5_0_u2c0>;

      The pins should set to open-drain and hwctrl should be disabled.

      &i2c_scl_p5_2_u2c0 {
          drive-strength = "strong-sharp-edge";
          drive-open-drain;
          hwctrl = "disabled";
      };

      In the above example, the pin is both an input and output (as is
      required for I2C setup). It is internally connected to both DX0
      and DOUT0 of USIC2 channel 0. (See XMC4700/4800 reference manual
      page 18-110, Figure 18-50 for more details).
      This limits the number of pins that can be used for the I2C module.

      To get around this pin limitation, it is possible to use pins
      that do not have this internal connection, and instead connect the
      pins externally on the board.
      For example, for the SDA line on USIC2 channel 0, P3.8 may be used
      for DOUT0 and P6.5 for DX0. These type of pinctrl nodes will have
      labels:
      i2c_sda_dout0_p3_8_u2c0 and i2c_sda_dx0_p6_5_u2c0.
      The generalized format is: i2c_<signal>_<type>_p<port>_<pin>_<peripheral inst>

      An example for SCL and SDA signals on the xmc4700:
      pinctrl-0 = <&i2c_sda_dout0_p3_8_u2c0 &i2c_sda_dx0_p6_5_u2c0
                  &i2c_scl_dout1_p3_9_u2c0 &i2c_scl_p5_2_u2c0>;

      Externally P3.8 should be connected to P6.5; P3.9 should be connected
      to P5.2.

      Note that any pins that do not have dout0/dx0 or dout1/dx1 can have either
      function. Thus node i2c_scl_p5_0_u2c0 can be both dout1 and dx1.

      For the pin configurations, the output pins (dout0 and dout1) should be set
      to open-drain while the input pins (dx0 and dx1) should not include this setting.

      &i2c_sda_dout0_p3_8_u2c0 {
          drive-strength = "strong-sharp-edge";
          drive-open-drain;
          hwctrl = "disabled";
      };

      &i2c_scl_dout1_p3_9_u2c0 {
          drive-strength = "strong-sharp-edge";
          drive-open-drain;
          hwctrl = "disabled";
      };

      &i2c_sda_dx0_p6_5_u2c0 {   /* will require USIC setting sda-src = DX0D */
          hwctrl = "disabled";
      };

      &i2c_scl_p5_2_u2c0 {  /* will require USIC scl-src = DX1A */
          hwctrl = "disabled";
      };

    required: true

  pinctrl-names:
    required: true
```

## dts/bindings/i2c/intel,qmsi-i2c.yaml
```yaml
#
# Copyright (c) 2018 Intel Corporation
#
# SPDX-License-Identifier: Apache-2.0
#

title: Intel QMSI i2c

description: >
    This binding gives a base representation of the Intel QMSI i2c

include: i2c-controller.yaml

properties:
    compatible:
      constraint: "intel,qmsi-i2c"

    reg:
      required: true

    interrupts:
      required: true
```

## dts/bindings/i2c/intel,qmsi-ss-i2c.yaml
```yaml
# Copyright (c) 2018 Intel Corporation
# SPDX-License-Identifier: Apache-2.0

title: Intel QMSI SS i2c

description: >
    This binding gives a base representation of the Intel QMSI SS i2c

compatible: "intel,qmsi-ss-i2c"

include: i2c-controller.yaml

properties:
    reg:
      required: true

    interrupts:
      required: true
```
