## dts/bindings/i2c/renesas,smartbond-i2c.yaml
```yaml
description: Renesas SmartBond(tm) I2C

compatible: "renesas,smartbond-i2c"

include: [i2c-controller.yaml, pinctrl-device.yaml]

properties:
  reg:
    required: true

  interrupts:
    required: true

  periph-clock-config:
    type: int
    description: Peripheral clock register configuration (COM domain)
    required: true
```

## dts/bindings/i2c/sensry,sy1xx-i2c.yaml
```yaml
# Copyright (c) 2024 sensry.io
# SPDX-License-Identifier: Apache-2.0

description: Sensry SY1XX I2C Driver node

compatible: "sensry,sy1xx-i2c"

include: [i2c-controller.yaml, pinctrl-device.yaml]

properties:
  pinctrl-0:
    required: true

  pinctrl-names:
    required: true

  instance:
    type: int
    required: true
```

## dts/bindings/i2c/shakti,i2c0.yaml
```yaml
# Copyright (c) 2024 Mindgrove Technologies Pvt. Ltd 
# SPDX-License-Identifier: Apache-2.0

description: Mindgrove Silicon Secure-IoT I2C interface

compatible: "shakti,i2c0"

properties:
  reg:
    type: array
    required: true

  clock_frequency:
    type: int
    required: true

  scl_frequency:
    type: int
    required: true
  
  base:
    type: int
    required: true
  
```

## dts/bindings/i2c/sifive,i2c0.yaml
```yaml
# Copyright (c) 2018 SiFive Inc.
# SPDX-License-Identifier: Apache-2.0

description: SiFive Freedom I2C interface

compatible: "sifive,i2c0"

include: i2c-controller.yaml

properties:
  reg:
    required: true
```

## dts/bindings/i2c/sifli,sf32lb-i2c.yaml
```yaml
# Copyright (c) 2025, Qingsong Gou <gouqs@hotmail.com>
# SPDX-License-Identifier: Apache-2.0

description: Sifli SF32LB I2C controller

compatible: "sifli,sf32lb-i2c"

include: [i2c-controller.yaml, pinctrl-device.yaml]

properties:
  reg:
    required: true

  clocks:
    required: true

  interrupts:
    required: true

  pinctrl-0:
    required: true

  pinctrl-names:
    required: true
```

## dts/bindings/i2c/silabs,gecko-i2c.yaml
```yaml
# Copyright (c) 2018 Diego Sueiro <diego.sueiro@gmail.com>
# SPDX-License-Identifier: Apache-2.0

title: Silicon Labs Series 0-2 I2C (Inter-Integrated Circuit)

description: |
  I2C peripheral on Silicon Labs EFM32 and EFR32 Series 0, 1 and 2.

compatible: "silabs,gecko-i2c"

include: [i2c-controller.yaml, pinctrl-device.yaml]

properties:
  reg:
    required: true

  interrupts:
    required: true

  pinctrl-0:
    required: true

  pinctrl-names:
    required: true
```

## dts/bindings/i2c/silabs,i2c.yaml
```yaml
# Copyright (c) 2025 Silicon Laboratories Inc.
# SPDX-License-Identifier: Apache-2.0

title: Silicon Labs Series 2 I2C (Inter-Integrated Circuit)

description: |
  I2C peripheral on Silicon Labs EFM32 and EFR32 Series 2.

compatible: "silabs,i2c"

include: [i2c-controller.yaml, pinctrl-device.yaml]

properties:
  reg:
    required: true

  interrupts:
    required: true

  pinctrl-0:
    required: true

  pinctrl-names:
    required: true

  zephyr,concat-buf-size:
    type: int
    default: 16
    description: |
      Size of a concatenation buffer that the driver is to use for merging
      multiple I2C messages in the same direction that have no RESTART or STOP
      flag between them (see e.g. the i2c_burst_write() function) into one
      transfer on the bus.

      This property must be provided when interacting with devices that cannot
      tolerate a repeated start and address appearing on the bus between message
      fragments. For many devices a concatenation buffer is not necessary.
```

## dts/bindings/i2c/snps,designware-i2c.yaml
```yaml
# Copyright (c) 2018 Intel Corporation
# SPDX-License-Identifier: Apache-2.0

description: Synopsys DesignWare I2C

compatible: "snps,designware-i2c"

include: [i2c-controller.yaml, pinctrl-device.yaml, pcie-device.yaml, reset-device.yaml]

properties:
  interrupts:
    required: true

  sda-hold-tx:
    description: |
      This property specifies the amount of time that the SDA line is held
      after a transmit operation. The value is in units of I2C clock cycles.
      Valid range is 0 to 0xffff.
    type: int

  sda-hold-rx:
    description: |
      This property specifies the amount of time that the SDA line is held
      after a receive operation. The value is in units of I2C clock cycles.
      Valid range is 0 to 0xff.
    type: int

  lcnt-offset:
    type: int
    description: |
      A fixed offset to apply to the SCL lcnt setting.

  hcnt-offset:
    type: int
    description: |
      A fixed offset to apply to the SCL hcnt setting.

  sda-timeout-value:
    type: int
    default: 30
    description: |
      Describe the SDA stuck at low timeout value, unit in ms

  scl-timeout-value:
    type: int
    default: 30
    description: |
      Describe the SCL stuck at low timeout value, unit in ms

  fs-spike-len:
    type: int
    description: |
      Spike suppression length for Standard-mode (Sm), Fast-mode (Fm),
      and Fast-mode Plus (Fm+) I2C transfers, expressed in units of the
      I2C controller input clock (ic_clk) cycles.

      The I2C-bus specification (UM10204) defines a maximum spike width
      (tSP) of 50 ns for Sm, Fm, and Fm+ modes. This property programs the
      controller to suppress spikes up to the corresponding number of
      ic_clk cycles.

      For example, with an input clock frequency of 100 MHz, a value of
      5 corresponds to a spike width of 50 ns.

  hs-spike-len:
    type: int
    description: |
      Spike suppression length for High-speed (Hs) I2C transfers,
      expressed in units of the I2C controller input clock (ic_clk) cycles.

      The I2C-bus specification (UM10204) defines a maximum spike width
      (tSP) of 10 ns for Hs mode. This property programs the controller to
      suppress spikes up to the corresponding number of ic_clk cycles.

      For example, with an input clock frequency of 100 MHz, a value of
      1 corresponds to a spike width of 10 ns.
```

## dts/bindings/i2c/st,stm32-i2c-v1.yaml
```yaml
# Copyright (c) 2017 I-SENSE group of ICCS
# SPDX-License-Identifier: Apache-2.0

description: STM32 I2C V1 controller

compatible: "st,stm32-i2c-v1"

include: [i2c-controller.yaml, pinctrl-device.yaml]

properties:
  reg:
    required: true

  interrupts:
    required: true

  pinctrl-0:
    required: true

  pinctrl-names:
    required: true

  scl-gpios:
    type: phandle-array
    description: |
      GPIO to which the I2C SCL signal is routed. This is only needed for
      I2C bus recovery support.

  sda-gpios:
    type: phandle-array
    description: |
      GPIO to which the I2C SDA signal is routed. This is only needed for
      I2C bus recovery support.
```

## dts/bindings/i2c/st,stm32-i2c-v2.yaml
```yaml
# Copyright (c) 2017 I-SENSE group of ICCS
# SPDX-License-Identifier: Apache-2.0

description: STM32 I2C V2 controller

compatible: "st,stm32-i2c-v2"

include: [i2c-controller.yaml, pinctrl-device.yaml]

properties:
  reg:
    required: true

  interrupts:
    required: true

  pinctrl-0:
    required: true

  pinctrl-names:
    required: true

  timings:
    type: array
    description: |
        An optional table of pre-computed i2c timing values with the
        matching clock configuration.

        Precise timings values for a given Hardware can be pre-computed
        with a tool like STM32CubeMX or directly from I2C_TIMINGR register
        description.

        Because timing value is valid for a given I2C peripheral clock
        frequency and target I2C bus clock, each timing value must be
        provided with the matching configuration.

        The resulting table entries should look like <periph_clock
        clock-frequency timing>

        For example timings could be defined as

            timings = <64000000 I2C_BITRATE_STANDARD 0x10707DBC>,
                      <64000000 I2C_BITRATE_FAST 0x00603D56>,
                      <56000000 I2C_BITRATE_STANDARD 0x10606DA4>,
                      <56000000 I2C_BITRATE_FAST 0x00501D63>;

  scl-gpios:
    type: phandle-array
    description: |
      GPIO to which the I2C SCL signal is routed. This is only needed for
      I2C bus recovery support.

  sda-gpios:
    type: phandle-array
    description: |
      GPIO to which the I2C SDA signal is routed. This is only needed for
      I2C bus recovery support.

  dmas:
    type: phandle-array
    description: |
      Optional DMA channels used by the I2C peripheral. If specified, these
      channels can be used to handle RX and TX transactions over DMA.

  dma-names:
    type: string-array
    description: |
      Names of the optional DMA channels. Expected values are "tx" for
      the TX channel and "rx" for the RX channel.
```

## dts/bindings/i2c/st,stm32u0-i2c.yaml
```yaml
# Copyright (c) 2024 STMicroelectronics
# SPDX-License-Identifier: Apache-2.0

description: |
        STM32U0 I2C Controller
        This compatibility applies to all I2C hardware blocks corresponding
        to the version available in STM32U0 SoCs.
        This version of the STM32 I2C hardware block can be identified by the
        absence of the SMBHEN and SMBDEN bits in the I2C_CR1 register.
        For example, but not limited to: STM32U0

compatible: "st,stm32u0-i2c"

include: "st,stm32-i2c-v2.yaml"
```

## dts/bindings/i2c/telink,b91-i2c.yaml
```yaml
# Copyright (c) 2021, Telink Semiconductor
# SPDX-License-Identifier: Apache-2.0

description: Telink B91 I2C

include: [i2c-controller.yaml, pinctrl-device.yaml]

compatible: "telink,b91-i2c"

properties:
  reg:
    required: true

  pinctrl-0:
    required: true
```

## dts/bindings/i2c/telink,b9x-i2c.yaml
```yaml
# Copyright (c) 2021-2024, Telink Semiconductor
# SPDX-License-Identifier: Apache-2.0

description: Telink B9x I2C

include: [i2c-controller.yaml, pinctrl-device.yaml]

compatible: "telink,b9x-i2c"

properties:
  reg:
    required: true

  pinctrl-0:
    required: true
```

## dts/bindings/i2c/telink,tlx-i2c.yaml
```yaml
# Copyright (c) 2024, Telink Semiconductor
# SPDX-License-Identifier: Apache-2.0

description: Telink TLx I2C

include: [i2c-controller.yaml, pinctrl-device.yaml]

compatible: "telink,tlx-i2c"

properties:
  reg:
    required: true

  pinctrl-0:
    required: true
```

## dts/bindings/i2c/telink,w91-i2c.yaml
```yaml
# Copyright (c) 2021-2023, Telink Semiconductor
# SPDX-License-Identifier: Apache-2.0

description: Telink W91 I2C

include: [i2c-controller.yaml, pinctrl-device.yaml]

compatible: "telink,w91-i2c"

properties:
  clock-frequency:
    type: int
    description: I2C master clock frequency in Hz
    required: true

  pinctrl-0:
    type: phandles
    required: true
```

## dts/bindings/i2c/ti,cc13xx-cc26xx-i2c.yaml
```yaml
# Copyright (c) 2019 Brett Witherspoon
# SPDX-License-Identifier: Apache-2.0

description: TI CC13xx / CC26xx I2C node

compatible: "ti,cc13xx-cc26xx-i2c"

include: [i2c-controller.yaml, pinctrl-device.yaml, base.yaml]

properties:
  reg:
    required: true

  interrupts:
    required: true
```

## dts/bindings/i2c/ti,cc23x0-i2c.yaml
```yaml
# Copyright (c) 2024 Baylibre, SAS
#
# SPDX-License-Identifier: Apache-2.0

description: TI CC23x0 I2C node

compatible: "ti,cc23x0-i2c"

include: [i2c-controller.yaml, pinctrl-device.yaml, base.yaml]

properties:
  reg:
    required: true

  interrupts:
    required: true

  pinctrl-0:
    required: true

  pinctrl-names:
    required: true
```

## dts/bindings/i2c/ti,cc32xx-i2c.yaml
```yaml
description: TI CC32XX I2C controller

compatible: "ti,cc32xx-i2c"

include: [i2c-controller.yaml, pinctrl-device.yaml]

properties:
  reg:
    required: true

  interrupts:
    required: true

  pinctrl-0:
    required: true

  pinctrl-names:
    required: true
```

## dts/bindings/i2c/ti,tca9544a.yaml
```yaml
# Binding for TI TCA9544A, compatible with NXP PCA9544A

description: Texas Instruments TCA9544A

compatible: "ti,tca9544a"

include: ti,tca954x-base.yaml

child-binding:
  compatible: "ti,tca9544a-channel"
```

## dts/bindings/i2c/ti,tca9546a.yaml
```yaml
#Binding for TI TCA9546A, compatible with NXP PCA9546A

description: Texas Instruments TCA9546A binding

compatible: "ti,tca9546a"

include: ti,tca954x-base.yaml

child-binding:
  compatible: "ti,tca9546a-channel"
```

## dts/bindings/i2c/ti,tca9548a.yaml
```yaml
# Binding for TI TCA9548A, compatible with NXP PCA9548A

description: Texas Instruments TCA9548A binding

compatible: "ti,tca9548a"

include: ti,tca954x-base.yaml

child-binding:
  compatible: "ti,tca9548a-channel"
```

## dts/bindings/i2c/ti,tca954x-base.yaml
```yaml
# Copyright (c) 2020, Innoseis BV
# SPDX-License-Identifier: Apache-2.0

# Common fields for TI TCA954X I2C mux family

description: |
  TCA954x I2C switch

  Each channel is represented by a separate devicetree child node.
  The channel node can then be used as a standard i2c bus controller
  like in the following simplified example:

      /* The tca954x node must be a child of an i2c controller */
      mux: tca9546a@77 {
          compatible = "ti,tca9546a";
          reg = <0x77>;
          status = "okay";
          #address-cells = <1>;
          #size-cells = <0>;
          reset-gpios = <&gpio5 3 GPIO_ACTIVE_LOW>;

          mux_i2c@0 {
              compatible: "ti,tca9546a-channel"
              reg = <0>;
              #address-cells = <1>;
              #size-cells = <0>;

              temp_sens_0: tmp116@49 {
                  compatible = "ti,tmp116";
                  reg = <0x49>;
              };
          };

          mux_i2c@1 {
            compatible: "ti,tca9546a-channel"
              reg = <1>;
              #address-cells = <1>;
              #size-cells = <0>;

              temp_sens_1: tmp116@49 {
                  compatible = "ti,tmp116";
                  reg = <0x49>;
              };
          };
      };

include: [i2c-device.yaml]

properties:
  reset-gpios:
    type: phandle-array
    description: |
      GPIO connected to the controller RESET pin. This pin is active-low.

child-binding:
  description: TCA954x I2C switch channel node
  include: [i2c-controller.yaml]
  on-bus: i2c
```

## dts/bindings/i2c/wch,i2c.yaml
```yaml
# Copyright (c) 2025 Andrei-Edward Popa
# SPDX-License-Identifier: Apache-2.0

description: WCH I2C controller

compatible: "wch,i2c"

include: [i2c-controller.yaml, pinctrl-device.yaml]

properties:
  reg:
    required: true

  clocks:
    required: true

  interrupts:
    required: true

  pinctrl-0:
    required: true

  pinctrl-names:
    required: true
```

## dts/bindings/i2c/xlnx,xps-iic.yaml
```yaml
description: Xilinx PS IIC Bus Interface

compatible: "xlnx,xps-iic"

include: [i2c-controller.yaml]

properties:
  reg:
    required: true

  interrupts:
    required: true
```

## dts/bindings/i2c/zephyr,hid-i2c-device.yaml
```yaml
description: "HID over I2C device (target)"
compatible: "zephyr,hid-i2c-device"
include: base.yaml

properties:
  int-gpios:
    type: phandle-array
    required: true
    description: |
      GPIO input connected to the active the interrupt line connected to the host

  hid-descr-addr:
    type: int
    required: true
    description: |
      The address to use for I2C HID descriptor

  in-report-size:
    type: int
    required: true
    description: |
      The size of the longest input report that the HID device can generate.
      This property is used to determine the buffer length used for transfers.
```
