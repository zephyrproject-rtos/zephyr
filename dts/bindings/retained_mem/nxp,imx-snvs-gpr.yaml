## dts/bindings/retained_mem/nxp,imx-snvs-gpr.yaml
```yaml
# SPDX-FileCopyrightText: 2026 Basalte bv
# SPDX-License-Identifier: Apache-2.0

title: |
  NXP i.MX SNVS Low-Power General Purpose Registers.

description: |
  The SNVS LPGPR bank retains its contents across resets as long as the SNVS
  Low-Power domain is powered (typically via VBAT). A security violation
  detected by the SNVS tamper logic will zeroize this bank.

compatible: "nxp,imx-snvs-gpr"

include: base.yaml
```

## dts/bindings/retained_mem/sifli,sf32lb-rtc-backup.yaml
```yaml
# Copyright (c) 2025 Core Devices LLC
# SPDX-License-Identifier: Apache-2.0

description: SiFli SF32LB RTC backed retained memory area.

compatible: "sifli,sf32lb-rtc-backup"

include: base.yaml

properties:
  reg:
    required: true
```

## dts/bindings/retained_mem/silabs,buram.yaml
```yaml
# Copyright (c) 2025 Silicon Laboratories Inc.
# SPDX-License-Identifier: Apache-2.0

title: Silicon Labs Series 2 BURAM (Back-Up Random Access Memory)

description: |
  The Back-Up RAM (BURAM) is a dedicated 128-byte memory that remains powered when the system enters
  EM4. Upon exit from EM4, the data retained in the BURAM can be accessed by the application
  software.

compatible: "silabs,buram"

include: base.yaml

properties:
  "#address-cells":
    const: 1

  "#size-cells":
    const: 1

  reg:
    required: true
```

## dts/bindings/retained_mem/zephyr,retained-bbram.yaml
```yaml
# Copyright (c) 2025 Nordic Semiconductor ASA, RBR Ltd
# SPDX-License-Identifier: Apache-2.0

description: Uninitialised BBRAM-based retained memory area.

compatible: "zephyr,retained-bbram"

include: base.yaml

properties:
  "#address-cells":
    const: 1

  "#size-cells":
    const: 1
```

## dts/bindings/retained_mem/zephyr,retained-ram.yaml
```yaml
# Copyright (c) 2023 Nordic Semiconductor ASA
# SPDX-License-Identifier: Apache-2.0

description: Unitialised RAM-based retained memory area.

compatible: "zephyr,retained-ram"

include: base.yaml

properties:
  "#address-cells":
    const: 1

  "#size-cells":
    const: 1
```

## dts/bindings/retention/zephyr,device-state-retention.yaml
```yaml
# Copyright (c) 2024 SILA Embedded Solutions GmbH
# SPDX-License-Identifier: Apache-2.0

description: |
  Device state retention, which has a retention area as a parent.

compatible: "zephyr,device-state-retention"

include: base.yaml

on-bus: retention

properties:
  "#address-cells":
    const: 1
    description: |
      The address reg cell is used for the offset in the parent retention area.

  "#size-cells":
    const: 1
    description: |
      The size reg cell defines the size of the storage which is available for
      the states of the drivers.

  device-count:
    type: int
    required: true
    description: |
      The number of devices which can be stored in the retention area.

  reg:
    required: true
```

## dts/bindings/retention/zephyr,retention-driver-state.yaml
```yaml
# Copyright (c) 2024 SILA Embedded Solutions GmbH
# SPDX-License-Identifier: Apache-2.0

description: |
  Driver state retention, which has a retention area as a parent. This is an
  example containing two drivers. The first one stores one byte, the second one
  eight. It is strongly recommended to use a prefix and a checksum for the
  parent retention area to ensure that only valid settings are retained for the
  drivers.

  retention0: retention@0 {
    compatible = "zephyr,retention";
    status = "okay";
    reg = <0x0 0x40>;
    prefix = [04 fa];
    checksum = <1>;

    driver_state1: driver_state@0 {
      compatible = "zephyr,retention-driver-state";
      status = "okay";
      reg = <0x0 0x1>;
    };

    driver_state2: driver_state@1 {
      compatible = "zephyr,retention-driver-state";
      status = "okay";
      reg = <0x1 0x8>;
    };
  };

compatible: "zephyr,retention-driver-state"

include: base.yaml

on-bus: retention

properties:
  "#address-cells":
    const: 1
    description: |
      The address reg cell is used for the offset in the parent retention area.

  "#size-cells":
    const: 1
    description: |
      The size reg cell defines the size of the storage which is available for
      the state of the driver. The driver is responsible of checking, ideally
      during build time, if the available space is sufficient.

  reg:
    required: true
```

## dts/bindings/retention/zephyr,retention.yaml
```yaml
# Copyright (c) 2023 Nordic Semiconductor ASA
# SPDX-License-Identifier: Apache-2.0

description: |
  Retention subsystem area, which has a retained memory parent. Example
  64-byte area with 2-byte prefix and 1-byte checksum with 61 usable bytes
  for user storage:

  sram@2003FFC0 {
    compatible = "zephyr,memory-region", "mmio-sram";
    reg = <0x2003FFC0 64>;
    zephyr,memory-region = "RetainedMem";
    status = "okay";

    retainedmem {
      compatible = "zephyr,retained-ram";
      status = "okay";
      #address-cells = <1>;
      #size-cells = <1>;

      retention0: retention@0 {
        compatible = "zephyr,retention";
        status = "okay";
        reg = <0x0 0x40>;
        prefix = [04 fa];
        checksum = <1>;
      };
    };
  };

compatible: "zephyr,retention"

include: base.yaml

properties:
  "#address-cells":
    const: 1
    description: |
      Address reg cell is for the offset of the area in parent node, can be
      increased if multiple retention partitions are used or parts are
      reserved.

  "#size-cells":
    const: 1
    description: |
      Size reg cell is for the size of the area, which includes sizes of
      prefix and checksum (if enabled).

  reg:
    required: true

  prefix:
    description: |
      An optional magic prefix, which indicates that the data has been set
      (applies to the header of the data, reduces the available user data
      size).
    type: uint8-array

  checksum:
    description: |
      An optional data verification checksum, which indicates that the data is
      valid (appended to the footer of the data, reduces the available user
      data size). Value is size in bytes (0 for none, 1 for 8-bit CRC, 2 for
      16-bit CRC, 4 for 32-bit CRC). Default is to not use a checksum.
    type: int
    default: 0
```

## dts/bindings/rf/ti,cc1101.yaml
```yaml
# Copyright (c) 2021 Leonard Pollak
# SPDX-License-Identifier: Apache-2.0

description: Texas Instruments CC1101 SPI Low-power Sub-1 GHz wireless transceiver

compatible: "ti,cc1101"

include: spi-device.yaml

properties:
  reg:
    required: true

  gdo2-gpios:
    type: phandle-array
    required: true
    description: |
      GPIO connected to GDO2.
      Used to check CHIP_RDY when initializing...
      Used to check start/end of packet in rx/tx...

  gdo0-gpios:
    type: phandle-array
    required: true
    description: |
      GPIO connected to GDO0.
      Configurable interrupt used for:
      The RX FIFO: Asserts when RX FIFO is filled at or above the RX FIFO
      threshold or the end of packet is reached. De-asserts when the RX FIFO is empty.
      The TX FIFO: Asserts when TX FIFO is filled at or above the TX FIFO
      threshold or the end of packet is reached. De-asserts when the TX FIFO is empty.

  initial-config:
    type: uint8-array
    required: true
    description: |
      Configuration Register Array given by SmartRF Studio
      IOCFG0 (0x00) - TEST0 (0x2E)

  initial-patable:
    type: uint8-array
    required: true
    description: |
      PATABLE 0 - 7
```

## dts/bindings/rfid/cr95hf-spi.yaml
```yaml
# Copyright 2025 Conny Marco Menebröcker
# SPDX-License-Identifier: Apache-2.0
description: ST CR95HF RFID driver

compatible: "st,cr95hf"

include: spi-device.yaml

on-bus: spi

properties:
  irq-in-gpios:
    type: phandle-array
    required: true

  irq-out-gpios:
    type: phandle-array
```

## dts/bindings/rfid/cr95hf-uart.yaml
```yaml
# Copyright 2025 Conny Marco Menebröcker
# SPDX-License-Identifier: Apache-2.0
description: ST CR95HF RFID driver

compatible: "st,cr95hf"

on-bus: uart
```

## dts/bindings/rfid/st,cr95hf-spi.yaml
```yaml
# Copyright 2025,2026 Conny Marco Menebröcker
# SPDX-License-Identifier: Apache-2.0
description: ST CR95HF RFID

compatible: "st,cr95hf"

include: spi-device.yaml

properties:
  irq-in-gpios:
    type: phandle-array
    required: true

  irq-out-gpios:
    type: phandle-array

examples:
  - |
    &spi1 {
      pinctrl-0 = <&spi1_sck_pa5 &spi1_miso_pa6 &spi1_mosi_pa7>;
      pinctrl-names = "default";
      status = "okay";
      #address-cells = <1>;
      #size-cells = <0>;
      cs-gpios = <&gpioa 4 GPIO_ACTIVE_LOW>;

      cr95hf: spi-device@0 {
        reg = <0>;
        spi-max-frequency = <50000>;
        compatible = "st,cr95hf";
        status = "okay";
        irq-in-gpios = <&gpioa 2 GPIO_ACTIVE_LOW>;
        irq-out-gpios = <&gpioa 3 GPIO_ACTIVE_LOW>;
      };

      dmas = <&dma1 3 (STM32_DMA_PERIPH_TX | STM32_DMA_PRIORITY_HIGH)>,
        <&dma1 2 (STM32_DMA_PERIPH_RX | STM32_DMA_PRIORITY_HIGH)>;
      dma-names = "tx", "rx";
    };
```

## dts/bindings/rfid/st,cr95hf-uart.yaml
```yaml
# Copyright 2025,2026 Conny Marco Menebröcker
# SPDX-License-Identifier: Apache-2.0
description: ST CR95HF RFID

include: uart-device.yaml

compatible: "st,cr95hf"
```

## dts/bindings/rh850/renesas,rh850-swint.yaml
```yaml
# Copyright (c) 2026 Renesas Electronics Corporation
# SPDX-License-Identifier: Apache-2.0

description: Renesas RH850 SWINT (Software Interrupt)

compatible: "renesas,rh850-swint"

include: base.yaml

properties:
  reg:
    required: true

  interrupts-extended:
    required: true
```

## dts/bindings/riscv/litex,soc-controller.yaml
```yaml
# Copyright 2024 Vogl Electronic GmbH
# SPDX-License-Identifier: Apache-2.0

description: LiteX SoC Controller driver

compatible: "litex,soc-controller"

include: base.yaml

properties:
  reg:
    required: true
```

## dts/bindings/riscv/nordic,nrf-vpr-coprocessor.yaml
```yaml
# Copyright (c) 2024 Nordic Semiconductor ASA
# SPDX-License-Identifier: Apache-2.0

compatible: "nordic,nrf-vpr-coprocessor"

description: |
  VPR coprocessor

  VPR is a RISC-V CPU implementation. VPR instances are exposed to other CPUs as
  peripherals.

include: [base.yaml, pinctrl-device.yaml]

properties:
  execution-memory:
    type: phandle
    description: |
      Memory area from which the VPR code will execute.
      If not specified, the VPR coprocessor will not be launched automatically
      by the nordic_vpr_launcher driver when the node is enabled. In such case,
      the launching is supposed to be done explicitly by the user code, in some
      custom way presumably.

  source-memory:
    type: phandle
    description: |
      Memory area or partition from which the VPR code will be loaded.

  enable-secure:
    type: boolean
    description: |
      Enables setting VPR core's secure attribute to secure.

  enable-dma-secure:
    type: boolean
    description: |
      Enables setting VPR core's DMA secure attribute to secure.
```

## dts/bindings/riscv/openisa,rv32m1-pcc.yaml
```yaml
# Copyright (c) 2018 Foundries.io
# SPDX-License-Identifier: Apache-2.0

description: RV32M1 PCC (Peripheral Clock Control) IP node

compatible: "openisa,rv32m1-pcc"

include: [clock-controller.yaml, base.yaml]

properties:
    reg:
      required: true

    "#clock-cells":
      const: 1

clock-cells:
  - name
```

## dts/bindings/riscv/riscv,cpus.yaml
```yaml
# Copyright (c) 2021 Gerson Fernando Budke <nandojve@gmail.com>
# SPDX-License-Identifier: Apache-2.0

include: cpu.yaml

properties:
  mmu-type:
    description: Memory Management Unit (MMU)
    type: string
    enum:
      - riscv,sv32
      - riscv,sv39
      - riscv,sv48
      - riscv,none

  riscv,isa:
    description: RISC-V instruction set architecture
    required: true
    type: string
    enum:
      - rv32emc
      - rv32imac
      - rv32imafc
      - rv32imafcb
      - rv64imac
      - rv64imafdc
```

## dts/bindings/riscv/riscv,sifive-e24.yaml
```yaml
# Copyright (c) 2021 Gerson Fernando Budke <nandojve@gmail.com>
# SPDX-License-Identifier: Apache-2.0

description: SiFive E24 Standard Core CPU

compatible: "riscv,sifive-e24"

include: riscv,sifive.yaml
```

## dts/bindings/riscv/riscv,sifive-e51.yaml
```yaml
# Copyright (c) 2022 Shawn Nematbakhsh <shawn@rivosinc.com>
# SPDX-License-Identifier: Apache-2.0

description: SiFive E51 Standard Core CPU

compatible: "riscv,sifive-e51"

include: riscv,sifive.yaml
```

## dts/bindings/riscv/riscv,sifive-s7.yaml
```yaml
# Copyright (c) 2022 Shawn Nematbakhsh <shawn@rivosinc.com>
# SPDX-License-Identifier: Apache-2.0

description: SiFive S7 Standard Core CPU

compatible: "riscv,sifive-s7"

include: riscv,sifive.yaml
```

## dts/bindings/rng/adi,max32-trng.yaml
```yaml
# Copyright (c) 2023-2024 Analog Devices, Inc.
# SPDX-License-Identifier: Apache-2.0

description: ADI MAX32XXX TRNG

compatible: "adi,max32-trng"

include: base.yaml

properties:
  clocks:
    required: true
```

## dts/bindings/rng/adi,maxq10xx-trng.yaml
```yaml
# Copyright (c) 2024 Vogl Electronic GmbH
# SPDX-License-Identifier: Apache-2.0

description: ADI MAXQ10XX RNG

compatible: "adi,maxq10xx-trng"

include: base.yaml
```

## dts/bindings/rng/ambiq,puf-trng.yaml
```yaml
# Copyright (c) 2025, Ambiq
# Author: Richard S Wheatley
# SPDX-License-Identifier: Apache-2.0

description: |
    PUF TRNG (True Random Number Generator).

    This module is a non-deterministic random number generator based on a full hardware solution.

compatible: "ambiq,puf-trng"

include: base.yaml

properties:
  reg:
    required: true
```

## dts/bindings/rng/arm,rng.yaml
```yaml
# Copyright (c) Qualcomm Technologies, Inc. and/or its subsidiaries.
# SPDX-License-Identifier: Apache-2.0

# This is a CPU functionality and not associated with any device. The Zephyr
# driver model forces us to bind this to a device tree entry in order to use it
# as entropy source. Therefore, as a workaround, we define this as a
# "zephyr,arm64-rng"-compatible device.
#
# Add a corresponding node under "cpus" in your device tree and choose this
# as "zephyr,entropy".
description: ARM64 FEAT_RNG entropy

compatible: "zephyr,arm64-rng"
```
