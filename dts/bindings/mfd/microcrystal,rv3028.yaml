## dts/bindings/mfd/microcrystal,rv3028.yaml
```yaml
# Copyright (c) 2024 ANITRA system s.r.o.
# Copyright (c) 2026 Janez Ugovsek <janez@ugovsek.info>
# SPDX-License-Identifier: Apache-2.0

description: |
  Micro Crystal RV3028 RTC multifunction device.

  This binding describes the I2C parent device. Functional blocks are
  represented as child nodes.

compatible: "microcrystal,rv3028"

include:
  - name: i2c-device.yaml

properties:
  clkout-frequency:
    type: int
    enum:
      - 32768
      - 8192
      - 1024
      - 64
      - 32
      - 1
    description: |
      Frequency of the CLKOUT signal in Hertz. If omitted, the CLKOUT pin is driven low.

  backup-switch-mode:
    type: string
    required: true
    enum:
      - disabled
      - direct
      - level
    description: |
      Automatic backup switchover function selection:
        - disabled: The switchover function is disabled - only one power supply available (VDD)
        - direct: Direct Switching Mode (DSM): when VDD < VBACKUP, switchover occurs from VDD to
          VBACKUP without requiring VDD to drop below VTH:LSM (2.0 V)
        - level: Level Switching Mode (LSM): when VDD < VTH:LSM (2.0 V) AND VBACKUP > VTH:LSM,
          switchover occurs from VDD to VBACKUP

  trickle-resistor-ohms:
    type: int
    enum:
      - 3000
      - 5000
      - 9000
      - 15000
    description: |
      Enable the trickle charger with provided current-limiting resistance in ohms. The trickle
      charger allows a battery or supercapacitor connected to VBACKUP to be charged.

  int-gpios:
    type: phandle-array
    description: |
      GPIO connected to the RV3028 INT interrupt output. The signal is
      open-drain and active low. It is required when any child device uses
      interrupt-driven alarm, update, timestamp, or counter callbacks.

examples:
  - |
    /* Example node for an RV3028 RTC MFD on the i2c0 bus with all child devices. */
    &i2c0 {
      status = "okay";
      clock-frequency = <I2C_BITRATE_STANDARD>;

      rv3028: rv3028@52 {
        compatible = "microcrystal,rv3028";
        reg = <0x52>;
        int-gpios = <&gpiob 7 (GPIO_PULL_UP | GPIO_ACTIVE_LOW)>;
        backup-switch-mode = "disabled";
        clkout-frequency = <8192>;
        trickle-resistor-ohms = <5000>;
        status = "okay";

        rv3028_rtc: rtc {
          compatible = "microcrystal,rv3028-rtc";
          status = "okay";
        };

      };
    };
```

## dts/bindings/mfd/microcrystal,rv3032-mfd.yaml
```yaml
# Copyright (c) 2025 Baylibre SAS
#
# SPDX-License-Identifier: Apache-2.0
#

description: |
  Microcrystal rv-3032-c7 I2C MFD

  The following example displays the node layout
  with every possible partial driver included.

  rv3032: rv3032c7@51 {
    compatible = "microcrystal,rv3032-mfd";
    reg = <0x51>;
    int-gpios = <&porta 11 (GPIO_PULL_UP | GPIO_ACTIVE_LOW)>;
    evi-gpios = <&porta 10 (GPIO_PULL_UP | GPIO_ACTIVE_LOW)>;
    backup-switch-mode = "disabled";
    always-on;
    status = "okay";

    rtc0: rv3032_rtc {
      compatible = "microcrystal,rv3032";
      status = "okay";
    };

    counter0: rv3032_counter {
      compatible = "microcrystal,rv3032-counter";
      status = "okay";
    };

    temp0: rv3032_temp {
      compatible = "microcrystal,rv3032-temp";
      low-temp = <40>;
      high-temp = <105>;
      status = "okay";
    };
  };

compatible: "microcrystal,rv3032-mfd"

include:
  - name: i2c-device.yaml

properties:
  int-gpios:
    type: phandle-array
    description: |
      GPIO connected to the RV3028 INT interrupt output. This signal is open-drain, active low.

  evi-gpios:
    type: phandle-array
    description: |
      GPIO connected to the RV3028 EVI event/interrupt input. This signal is open-drain, active low.

  always-on:
    type: boolean
    description: |
      AON stand for - Always On. This is not part of rv-3032-c7 chip functionality but
      real use case where main power is kept always on and advanced backup-switch is not
      used as expected.
        - true  : Driver act like power was not interrupted on next device init
        - false : Every boot and execution of driver init function is like fresh boot.
                  alarms are cleaned and device is clean.

  backup-switch-mode:
    type: string
    required: true
    enum:
      - disabled
      - direct
      - level
    description: |
      Automatic backup switchover function selection:
        - disabled: The switchover function is disabled - only one power supply available (VDD)
        - direct: Direct Switching Mode (DSM): when VDD < VBACKUP, switchover occurs from VDD to
          VBACKUP without requiring VDD to drop below VTH:LSM (2.0 V)
        - level: Level Switching Mode (LSM): when VDD < VTH:LSM (2.0 V) AND VBACKUP > VTH:LSM,
          switchover occurs from VDD to VBACKUP

  trickle-resistor-ohms:
    type: int
    enum:
      - 600
      - 2000
      - 7000
      - 12000
    description: |
      Trickle charger series resistance (TCR).
      Ignored if 'trickle-charger-mode' is not present (TCM=00).
      Note: 600 ohms corresponds to TCR=00 (0.6kΩ) in RV3032.

  trickle-charger-mode:
    type: int
    enum:
      - 1750
      - 3000
      - 4500
    description: |
      Trickle Charger Mode (TCM).
        - If this property is not present, the trickle charger is disabled (TCM=00).
        - 1750: TCM=01. In DSM (backup-switch-mode="direct"), VDD is used as the source.
                In LSM (backup-switch-mode="level"), an internal ~1.75 V is used.
        - 3000: TCM=10. Internal charge-pump ~3.0 V, only valid in LSM.
        - 4500: TCM=11. Internal charge-pump ~4.5 V, only valid in LSM.
      Note: In LSM, the 1.75/3.0/4.5 V levels are only generated when VDD > VTH:LSM
      (typ. 2.0 V, max 2.2 V).
```

## dts/bindings/mfd/motorola,mc146818-mfd.yaml
```yaml
# Copyright (c) 2025, Intel Corporation
#
# SPDX-License-Identifier: Apache-2.0

description: |
  Motorola MC146818 MFD

  The following example displays the node layout
  with every possible partial driver included.

  mfd: mfd@70 {
    compatible = "motorola,mc146818-mfd";
    reg = <0x70 0x01 0x71 0x01 0x72 0x01 0x73 0x01>;
    rtc: counter: rtc {
      compatible = "motorola,mc146818";
      interrupts = <8 IRQ_TYPE_LOWEST_EDGE_RISING 3>;
      interrupt-parent = <&intc>;
      alarms-count = <1>;

      status = "okay";
    };

    bbram: bbram {
      compatible = "motorola,mc146818-bbram";
      size = <241>;
      status = "okay";
    };
  };

compatible: "motorola,mc146818-mfd"

include: base.yaml

bus: mc146818-mfd
```

## dts/bindings/mfd/nordic,npm10xx.yaml
```yaml
# Copyright (c) 2026 Nordic Semiconductor
# SPDX-License-Identifier: Apache-2.0

description: Nordic nPM10xx PMIC MFD

include: i2c-device.yaml

compatible: "nordic,npm10xx"

properties:
  host-int-gpios:
    type: phandle-array
    description: |
      Host GPIO for interrupt input. Active level must match that of pmic-int-gpio-config.

  pmic-int-gpio-config:
    type: array
    description: |
      PMIC GPIO config for interrupt output <idx flags>. Index is 0 to 2. Use flags to provide
      additional configuration, for example, GPIO_OPEN_DRAIN.

  pwr-cycle-delay-ms:
    type: int
    enum:
      - 350
      - 250
      - 150
      - 50
    description: Length of the PMIC power cycle in milliseconds.

  longpress-reset-source:
    type: string
    default: "none"
    enum:
      - "none"
      - "gpio"
      - "shphld"
      - "both"
    description: |
      Select long press reset source for the PMIC. Choose one of the following:
        none - no reset source, hardware's default
        gpio - reset button connected to GPIO, choose GPIO number using longpress-reset-gpio
        shphld - reset button connected to SHPHLD pin
        both - reset button connected to both SHPHLD and GPIO pins, choose GPIO number

  longpress-reset-gpio-config:
    type: array
    description: |
      GPIO pin config <idx flags> to use for long press reset in combination with "gpio" or "both"
      reset source.

  longpress-reset-debounce-s:
    type: int
    default: 3
    enum:
      - 3
      - 5
      - 10
      - 20
    description: |
      Duration in seconds the reset button(s) need to be pressed to issue a reset. Defaults to the
      hardware reset value.

  shphld-wakeup-disable:
    type: boolean
    description: Disable the wake up from hibernation functionality of the SHPHLD pin.

  shphld-wakeup-debounce-ms:
    type: int
    enum:
      - 50
      - 100
      - 500
      - 1000
    description: SHPHLD pin wake up debounce in milliseconds.

examples:
  - |
    npm1012: pmic@6a {
      reg = <0x6a>;
      compatible = "nordic,npm10xx";
      host-int-gpios = <&gpio0 4 (GPIO_ACTIVE_LOW | GPIO_PULL_UP)>;
      pmic-int-gpio-config = <2 (GPIO_ACTIVE_LOW | GPIO_OPEN_DRAIN)>;

      regulators {
        compatible = "nordic,npm10xx-regulator";
        /* ... */
      };

      charger {
        compatible = "nordic,npm10xx-charger";
        /* ... */
      };

      sensor {
        compatible = "nordic,npm10xx-adc";
        /* ... */
      };
    };
```

## dts/bindings/mfd/nordic,npm1300.yaml
```yaml
# Copyright (c) 2023, Nordic Semiconductor ASA
# SPDX-License-Identifier: Apache-2.0

description: Nordic nPM1300

compatible: "nordic,npm1300"

include: "nordic,npm13xx-common.yaml"
```

## dts/bindings/mfd/nordic,npm1304.yaml
```yaml
# Copyright (c) 2025 Nordic Semiconductor ASA
# SPDX-License-Identifier: Apache-2.0

description: Nordic nPM1304

compatible: "nordic,npm1304"

include: nordic,npm13xx-common.yaml
```

## dts/bindings/mfd/nordic,npm2100.yaml
```yaml
# Copyright (c) 2024, Nordic Semiconductor ASA
# SPDX-License-Identifier: Apache-2.0

description: Nordic nPM2100

compatible: "nordic,npm2100"

include: i2c-device.yaml

properties:
  reg:
    required: true

  host-int-gpios:
    type: phandle-array
    description: Host pin for interrupt input

  host-int-type:
    type: string
    enum:
    - "edge"
    - "level"
    default: "edge"
    description: |
      Using interrupt level triggering instead of edge triggering
      can reduce power consumption on some platforms at the expense of irq latency.

  pmic-int-pin:
    type: int
    enum:
    - 0
    - 1
    description: Pmic pin number for interrupt output

  pmic-int-flags:
    type: int
    description: |
      GPIO flags for PMIC interrupt output

  shiphold-flags:
    type: int
    description: |
      GPIO flags for shiphold button.
      Defaults to active low with pull-up enabled.

  shiphold-hibernate-wakeup:
    type: boolean
    description: |
      Enable shiphold button to trigger wakeup from hibernate state

  shiphold-longpress:
    type: string
    enum:
    - "ship"
    - "disable"
    - "reset"
    description: |
      Configure behaviour of shiphold button.
      ship: Enter ship mode if SHPHLD is pressed for 2 seconds
      disable: SHPHLD button press has no effect
      reset: Reset PMIC if SHPHLD is pressed for 10 seconds

  shiphold-current:
    type: string
    enum:
    - "disable"
    - "weak"
    - "low"
    - "moderate"
    - "high"
    description: |
      Configure behaviour of shiphold pull-up current
```

## dts/bindings/mfd/nordic,npm6001.yaml
```yaml
# Copyright (c) 2022, Nordic Semiconductor ASA
# SPDX-License-Identifier: Apache-2.0

description: Nordic nPM6001

compatible: "nordic,npm6001"

include: i2c-device.yaml

properties:
  reg:
    required: true

  nordic,ready-high-drive:
    type: boolean
    description: Set drive strength to high for READY pin.

  nordic,nint-high-drive:
    type: boolean
    description: Set drive strength to high for NINT pin.

  nordic,sda-high-drive:
    type: boolean
    description: Set drive strength to high for SDA pin.

  nordic,buck-mode0-input-type:
    type: string
    default: "schmitt"
    enum: ["schmitt", "cmos"]
    description: Input type for BUCK_MODE0 pin. Defaults IC boot-time value.

  nordic,buck-mode0-pull-down:
    type: boolean
    description: Enable pull-down resistor for BUCK_MODE0 pin.

  nordic,buck-mode1-input-type:
    type: string
    default: "schmitt"
    enum: ["schmitt", "cmos"]
    description: Input type for BUCK_MODE1 pin. Defaults IC boot-time value.

  nordic,buck-mode1-pull-down:
    type: boolean
    description: Enable pull-down resistor for BUCK_MODE1 pin.

  nordic,buck-mode2-input-type:
    type: string
    default: "schmitt"
    enum: ["schmitt", "cmos"]
    description: Input type for BUCK_MODE2 pin. Defaults IC boot-time value.

  nordic,buck-mode2-pull-down:
    type: boolean
    description: Enable pull-down resistor for BUCK_MODE2 pin.
```

## dts/bindings/mfd/nuvoton,nct38xx.yaml
```yaml
# Copyright (c) 2023, Google, LLC
# SPDX-License-Identifier: Apache-2.0

description: |
  Nuvoton NCT38xx multi-function device

  The NCT38xx provides a TCPC and an I/O Expander capabilities.

  The TCPC and I/O expander drivers are added to the devicetree
  as children of the nuvoton,nct38xx device.

compatible: "nuvoton,nct38xx"

include: i2c-device.yaml
```

## dts/bindings/mfd/nxp,lp-flexcomm.yaml
```yaml
# Copyright 2024 NXP
#
# SPDX-License-Identifier: Apache-2.0

description: Low Power Flexcomm

compatible: "nxp,lp-flexcomm"

include: [base.yaml]

properties:
  reg:
    required: true

  interrupts:
    required: true
```

## dts/bindings/mfd/nxp,pca9422.yaml
```yaml
# Copyright 2025 NXP
# SPDX-License-Identifier: Apache-2.0

description: |
  NXP PCA9422 PMIC.

  The PCA9422 supports a charger and regulator function via i2c. These
  devices have to be added to the Device Tree as children. While the
  device itself has to be a child of i2c bus.

  An example configuration:

  &lpi2c15 {
    status = "okay";
    clock-frequency = <I2C_BITRATE_FAST>;
    #address-cells = <1>;
    #size-cells = <0>;
    pinctrl-0 = <&pinmux_lpi2c15>;
    pinctrl-names = "default";

    pca9422: pca9422@61 {
      compatible = "nxp,pca9422";
      reg = <0x61>;
      interrupts = <138 0>;

      charger: pca9422_charger {
        compatible = "nxp,pca9422-charger";
        constant-charge-current-max-microamp = <100000>;
        constant-charge-voltage-max-microvolt = <4200000>;
        precharge-current-percent = <16>;
        charge-termination-current-percent = <25>;
        re-charge-threshold-microvolt = <100000>;
        input-current-limit-microamp = <470000>;
        system-voltage-min-threshold-microvolt = <4550000>;
      };

      regulators: pca9422_regulators {
        compatible = "nxp,pca9422-regulator";
        nxp,vsys-uvlo-sel-millivolt = <2700>;

        pca9422_sw1: BUCK1 {
          regulator-boot-on;
          low-power-mode = "Normal";
          enable-mode = "All";
          nxp,active-microvolt = <1000000>;
          nxp,sleep-microvolt = <600000>;
          nxp,standby-microvolt = <1000000>;
        };

        pca9422_ldo1: LDO1 {
          regulator-boot-on;
          enable-mode = "All";
          nxp,active-microvolt = <1800000>;
          nxp,sleep-microvolt = <1800000>;
          nxp,standby-microvolt = <1800000>;
        };
      };
    };
  };

compatible: "nxp,pca9422"

include: i2c-device.yaml

properties:
  reg:
    required: true
  interrupts:
    required: true
```

## dts/bindings/mfd/nxp,pf1550.yaml
```yaml
# Copyright (c) 2024 Arduino SA
# SPDX-License-Identifier: Apache-2.0

description: NXP PF1550

compatible: "nxp,pf1550"

include: i2c-device.yaml

properties:
  reg:
    required: true
```
