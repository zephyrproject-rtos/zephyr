## dts/bindings/mfd/nxp,sc18im704.yaml
```yaml
# Copyright (c), 2023 Basalte bv
# SPDX-License-Identifier: Apache-2.0

description: |
  NXP SC18IM704 UART to I2C/GPIO bridge.

  The SC18IM704 supports both an external I2C and GPIO controller. These
  controllers have to be added to the Device Tree as children. While the
  device itself has to be a child of a UART controller.

  An example configuration:

  &uart0 {
    status = "okay";
    pinctrl-0 = <&uart0_default>;
    pinctrl-names = "default";

    sc18im704: sc18im704 {
      compatible = "nxp,sc18im704";
      status = "okay";
      target-speed = <115200>;
      reset-gpios = <&gpio1 15 (GPIO_ACTIVE_LOW | GPIO_PULL_UP)>;

      i2c_ext: sc18im704_i2c {
        compatible = "nxp,sc18im704-i2c";
        status = "okay";
        #address-cells = <1>;
        #size-cells = <0>;
      };

      gpio_ext: sc18im704_gpio {
        compatible = "nxp,sc18im704-gpio";
        status = "okay";
        gpio-controller;
        #gpio-cells = <2>;
        ngpios = <8>;
      };
    };
  };

compatible: "nxp,sc18im704"

include: uart-device.yaml

properties:
  reset-gpios:
    type: phandle-array
    description:
      Driver reset pin of the bridge.
      If connected directly to the MCU, this pin should be configured
      as active low.

  target-speed:
    type: int
    description:
      UART baudrate which will be requested and to which
      UART interface will be reconfigured during initialization phase.
    enum:
      - 1200
      - 2400
      - 4800
      - 9600
      - 14400
      - 19200
      - 28800
      - 38400
      - 57600
      - 76800
      - 115200
      - 230400
      - 460800

bus: nxp,sc18im704
```

## dts/bindings/mfd/raspberrypi,rp1.yaml
```yaml
# Copyright (c) 2024 Junho Lee <junho@tsnlab.com>
# SPDX-License-Identifier: Apache-2.0

description: RP1 peripheral controller

compatible: "raspberrypi,rp1"

include: base.yaml

properties:
  reg:
    required: false
```

## dts/bindings/mfd/rohm,bd8lb600fs.yaml
```yaml
#
# Copyright (c) 2024 SILA Embedded Solutions GmbH
#
# SPDX-License-Identifier: Apache-2.0
#

description: Rohm BD8LB600FS SPI Gpio Expander MFD

compatible: "rohm,bd8lb600fs"

include: spi-device.yaml

bus: bd8lb600fs

properties:
  reset-gpios:
    type: phandle-array
    required: true
    description: GPIO for reset

  instance-count:
    type: int
    required: true
    default: 1
    enum:
      - 1
      - 2
      - 3
      - 4
    description:
      number of daisy chained instances, defaults to no daisy chaining
```

## dts/bindings/mfd/sifli,sf32lb-rcc.yaml
```yaml
# Copyright (c) 2025 Core Devices LLC
# SPDX-License-Identifier: Apache-2.0

description: |
  SiFli SF32LB RCC (Reset and Clock Control) if a multi-function peripheral in
  charge of reset and clock control for all SoC peripherals. Child nodes are
  used to represent each functional block.

compatible: "sifli,sf32lb-rcc"

include: base.yaml

properties:
  reg:
    required: true
```

## dts/bindings/mfd/ti,tla2528.yaml
```yaml
# Copyright (c) 2026 Leica Geosystems AG
# SPDX-License-Identifier: Apache-2.0

description: Texas Instruments 8 channel 12 bit I2C ADC with GPIOs

compatible: "ti,tla2528"

include: [i2c-device.yaml]

bus: tla2528
```

## dts/bindings/mfd/x-powers,axp192.yaml
```yaml
# Copyright (c) 2023, Martin Kiepfer <mrmarteng@teleschirm.org>
# SPDX-License-Identifier: Apache-2.0

description: X-Powers AXP192

compatible: "x-powers,axp192"

include: i2c-device.yaml

bus: axp192

properties:
  reg:
    required: true

  vbusen-disable:
    type: boolean
    description: |
      This option will disable VBUS power control via N_VBUSEN.
      By default VBUS power supply is chosen via N_VBUSEN pin.
      When disabled, VBUS can by chosen automatically by the pmic
      and there is no need by the host to control N_VBUSEN pin.
      Please refer to datasheet for details (pin state (REG10H[7] = 1).
```

## dts/bindings/mfd/x-powers,axp2101.yaml
```yaml
# Copyright (c) 2024 TOKITA Hiroshi
# SPDX-License-Identifier: Apache-2.0

description: X-Powers AXP2101

compatible: "x-powers,axp2101"

include: i2c-device.yaml

properties:
  reg:
    required: true
```

## dts/bindings/mgmt/zephyr,smp-spi.yaml
```yaml
# Copyright (c) 2026 Zephyr Project Contributors
# SPDX-License-Identifier: Apache-2.0

title: MCUmgr SMP transport over SPI

description: |
  The device operates as an SPI target (peripheral mode) and exchanges raw SMP
  packets with the SPI initiator. A GPIO data-ready line is asserted when a
  response is available for the initiator to clock out.

compatible: "zephyr,smp-spi"

properties:
  spi-dev:
    type: phandle
    required: true
    description: |
      Reference to the SPI peripheral device node to use for SMP communication.
      The SPI device must support peripheral (SPI_OP_MODE_SLAVE) operation.

  data-ready-gpios:
    type: phandle-array
    required: true
    description: |
      GPIO line used to signal the SPI initiator that a response is ready to be
      clocked out. The initiator should monitor this line and start a transfer
      when it is asserted.

examples:
  - |
    smp_spi: smp-spi {
        compatible = "zephyr,smp-spi";
        spi-dev = <&spi1>;
        data-ready-gpios = <&gpio0 10 GPIO_ACTIVE_LOW>;
    };
```

## dts/bindings/mhu/arm,mhu.yaml
```yaml
# Copyright (c) 2019, Linaro Limited
# SPDX-License-Identifier: Apache-2.0

description: ARM MHU (Message Handling Unit)

compatible: "arm,mhu"

include: base.yaml

properties:
  reg:
    required: true

  interrupts:
    required: true
```

## dts/bindings/mipi-dbi/ambiq,mipi-dbi.yaml
```yaml
# Copyright (c) 2025 Ambiq Micro Inc.
#
# SPDX-License-Identifier: Apache-2.0

description: |
  MIPI-DBI Type-B (Intel 8080) parallel interface controller for Ambiq microcontrollers.
  This driver implements the Intel 8080 parallel bus interface.

compatible: "ambiq,mipi-dbi"

include: ["mipi-dbi-controller.yaml", "pinctrl-device.yaml"]

properties:
  hactive:
    type: int
    description: |
      Horizontal active.

  hfp:
    type: int
    description: |
      Horizontal front porch.

  hbp:
    type: int
    description: |
      Horizontal back porch.

  hsync:
    type: int
    description: |
      Horizontal sync length.

  vactive:
    type: int
    description: |
      Vertical active.

  vfp:
    type: int
    description: |
      Vertical front porch.

  vbp:
    type: int
    description: |
      Vertical back porch.

  vsync:
    type: int
    description: |
      Vertical sync length.
```

## dts/bindings/mipi-dbi/bflb,dbi.yaml
```yaml
# Copyright 2025 MASSDRIVER EI (massdriver.space)
# SPDX-License-Identifier: Apache-2.0

description: |
  BFLB MIPI DBI controller
  When used with devices that dont match MIPI DBI properly (eg commands are fully with DC set,
  not DC then data, for example SSD1327), you MUST use cs-gpios and dc-gpio to allow holding the
  lines for command via software and not use hardware DC and CS. Inversely when using devices that
  support D/C properly, you MUST use the hw D/C, and may use hw CS.

compatible: "bflb,dbi"

include: ["mipi-dbi-controller.yaml", "pinctrl-device.yaml"]

properties:
  dmas:
    required: true
    description: |
      TX dma specifier.  Each specifier will have a phandle
      reference to the dma controller, the channel number, and peripheral
      trigger source, which is 20 for DBI: dmas = <&dma0 0 0x14>;

  dma-names:
    required: true
    description: |
      This should be "tx"

  reset-gpios:
    type: phandle-array
    description: |
      SINGLE optional reset GPIO pin.

  cs-gpios:
    type: phandle-array
    description: |
      Optional CS GPIOs (same usage as SPI)

  dc-gpios:
    type: phandle-array
    description: |
      SINGLE optional data/command GPIO
```

## dts/bindings/mipi-dbi/espressif,esp32-lcd-cam-mipi-dbi.yaml
```yaml
# Copyright (c) 2025 Chen Xingyu <hi@xingrz.me>
# SPDX-License-Identifier: Apache-2.0

description: ESP32 LCD-CAM display interface

compatible: "espressif,esp32-lcd-cam-mipi-dbi"

include: mipi-dbi-controller.yaml

properties:
  reset-gpios:
    type: phandle-array
    description: Optional GPIO connected to the panel reset line.

  cs-gpios:
    type: phandle-array
    description: Optional GPIO used to control the panel chip-select line.

child-binding:
  description: Configuration for display connected to the controller
  properties:
    dc-idle-level:
      type: int
      enum: [0, 1]
      description: Physical level on the DC line for idle phase.
      default: 0

    dc-cmd-level:
      type: int
      enum: [0, 1]
      description: Physical level on the DC line for command phase.
      default: 0

    dc-dummy-level:
      type: int
      enum: [0, 1]
      description: Physical level on the DC line for dummy phase.
      default: 0

    dc-data-level:
      type: int
      enum: [0, 1]
      description: Physical level on the DC line for data phase.
      default: 1
```

## dts/bindings/mipi-dbi/mipi-dbi-controller.yaml
```yaml
# Copyright 2023 NXP
# SPDX-License-Identifier: Apache-2.0

# Common fields for MIPI-DBI controllers

include: base.yaml

bus: mipi-dbi

properties:
  clock-frequency:
    type: int
    description: |
      Clock frequency of the SCL signal of the MBI-DBI peripheral, in Hz
  "#address-cells":
    required: true
    const: 1
  "#size-cells":
    required: true
    const: 0
```
