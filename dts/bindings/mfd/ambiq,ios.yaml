## dts/bindings/mfd/infineon,mxcryptolite.yaml
```yaml
# SPDX-FileCopyrightText: Copyright (c) 2026 Infineon Technologies AG,
# SPDX-FileCopyrightText: or an affiliate of Infineon Technologies AG. All rights reserved.
#
# SPDX-License-Identifier: Apache-2.0

description: |
  Infineon MXCRYPTOLITE multi-function device.

  The MXCRYPTOLITE block is a shared hardware crypto engine that provides both
  a True Random Number Generator (TRNG) and AES/SHA-256 cryptographic
  acceleration.  This node is the parent that owns the register base address and
  the shared access mutex.  The individual functions are exposed as child nodes:

    cryptolite0: crypto@52230000 {
            compatible = "infineon,mxcryptolite";
            reg = <0x52230000 0x10000>;

            mxcryptolite_trng {
                    compatible = "infineon,mxcryptolite-trng";
            };

            mxcryptolite_crypto {
                    compatible = "infineon,mxcryptolite-crypto";
            };
    };

compatible: "infineon,mxcryptolite"

include: base.yaml

properties:
  reg:
    required: true
```

## dts/bindings/mfd/infineon,tle9104.yaml
```yaml
#
# Copyright (c) 2024 SILA Embedded Solutions GmbH
#
# SPDX-License-Identifier: Apache-2.0
#

description: Infineon TLE9104 4-channel powertrain switch

compatible: "infineon,tle9104"

include: spi-device.yaml

bus: tle9104

properties:
  en-gpios:
    type: phandle-array
    description: "GPIO for enable"

  resn-gpios:
    type: phandle-array
    description: "GPIO for reset"

  in1-gpios:
    type: phandle-array
    description: "GPIO for controlling OUT1"

  in2-gpios:
    type: phandle-array
    description: "GPIO for controlling OUT2"

  in3-gpios:
    type: phandle-array
    description: "GPIO for controlling OUT3"

  in4-gpios:
    type: phandle-array
    description: "GPIO for controlling OUT4"

  diagnostic-filter-time:
    type: int
    default: 500
    enum:
      - 200
      - 500
      - 1000
      - 2000
    description:
      diagnostic filter time in us,
      default matches power on reset value

  overcurrent-shutdown-delay-time:
    type: int
    default: 60
    enum:
      - 60
      - 120
      - 500
      - 1000
      - 5000
      - 10000
      - 20000
      - 30000
    description:
      overcurrent shutdown delay time in us,
      default matches power on reset value

  overcurrent-shutdown-threshold:
    type: int
    default: 2000
    enum:
      - 1000
      - 2000
      - 3000
      - 4000
    description:
      overcurrent shutdown threshold in mA,
      default matches power on reset value

  parallel-out12:
    type: boolean
    description: Enables parallel mode for OUT1 and OUT2

  parallel-out34:
    type: boolean
    description: Enables parallel mode for OUT3 and OUT4
```

## dts/bindings/mfd/ite,it8801-altctrl.yaml
```yaml
# Copyright (c) 2024 ITE Corporation. All Rights Reserved.
# SPDX-License-Identifier: Apache-2.0

description: ITE IT8801 GPIO controller node

compatible: "ite,it8801-altctrl"

include: base.yaml

altctrl-cells:
  - pin
  - alt_func
```

## dts/bindings/mfd/ite,it8801-mfd-map.yaml
```yaml
# Copyright (c) 2024 ITE Corporation. All Rights Reserved.
# SPDX-License-Identifier: Apache-2.0

description: ITE IT8801 alternate controller node

compatible: "ite,it8801-mfd-map"

child-binding:
  description: Child node to present the mapping of IT8801 altternate function
  properties:
    altctrls:
      type: phandle-array
      required: true
```

## dts/bindings/mfd/ite,it8801-mfd.yaml
```yaml
# Copyright (c) 2024 ITE Corporation. All Rights Reserved.
# SPDX-License-Identifier: Apache-2.0

description: |
  ITE IT8801 ioexpander multi-function device drivers.
  This ioexpander provides a GPIO/PWM/Keyboard function via I2C bus.

  An example configuration using the it8801-common-cfg.dtsi template:

  &i2c4 {
      it8801_mfd: it8801@38 {
          compatible = "ite,it8801-mfd";
          /*
           * SMBus address (7-bit without R/W)
           * SMB_ADDR pin is 0, SMBus address is 0x38
           * SMB_ADDR pin is 1, SMBus address is 0x39
           */
          reg = <0x38>;
          irq-gpios = <&gpioa 1 0>; /* SMB_INT# */
      }

      #include <ite/it8801-common-cfg.dtsi>

      /* sub-devices available at nodelabels:
       * - ioex_it8801_port0
       * - ioex_it8801_port1
       * - ioex_it8801_port2
       * - ioex_it8801_kbd
       * - ioex_it8801_pwm
       */

      &ioex_it8801_kbd {
          kso-mapping = <0 1 20 3 4 5 6 17 18 16 15 11 12>;
          mfdctrl = <&kso18_gp01_default &kso20_gp23_default>;
          row-size = <8>;
          col-size = <13>;
      };

      &ioex_it8801_pwm {
          status = "okay";
      };
  };

compatible: "ite,it8801-mfd"

include: i2c-device.yaml

properties:
  reg:
    required: true

  irq-gpios:
    type: phandle-array
    description: |
      An interrupt can be asserted on SMB_INT# pin to notify
      the host-side since an effective interrupt occurs.
```

## dts/bindings/mfd/m5stack,m5pm1.yaml
```yaml
# Copyright (c) 2026 The Zephyr Project Contributors
# SPDX-License-Identifier: Apache-2.0

description: M5Stack M5PM1 PMIC (Power Management Integrated Circuit)

compatible: "m5stack,m5pm1"

include: i2c-device.yaml

bus: m5pm1

properties:
  reg:
    required: true

  idle-sleep-timeout-seconds:
    type: int
    default: 0
    min: 0
    max: 15
    description: |
      I2C idle-sleep timeout in seconds. After this many seconds of I2C inactivity the PMIC enters
      low-power sleep. 0 (default) disables idle-sleep.
```

## dts/bindings/mfd/maxim,ds3231-mfd.yaml
```yaml
# Copyright (c) 2024 Gergo Vari <work@gergovari.com>
#
# SPDX-License-Identifier: Apache-2.0
#

description: |
  Maxim DS3231 I2C MFD

  The following example displays the node layout
  with every possible partial driver included.

  ds3231: ds3231@68 {
          compatible = "maxim,ds3231-mfd";
          reg = <0x68>;
          status = "okay";

          ds3231_sensor: ds3231_sensor {
                  compatible = "maxim,ds3231-sensor";
                  status = "okay";
          };

          ds3231_rtc: ds3231_rtc {
                  compatible = "maxim,ds3231-rtc";
                  status = "okay";

                  isw-gpios = <&gpio0 25 (GPIO_PULL_UP | GPIO_ACTIVE_LOW)>;
                  freq-32khz-gpios = <&gpio0 33 (GPIO_PULL_UP | GPIO_ACTIVE_LOW)>;
          };
  };

compatible: "maxim,ds3231-mfd"

include:
  - name: i2c-device.yaml
```

## dts/bindings/mfd/maxim,max20335.yaml
```yaml
# Copyright (c) 2023 Grinn
# SPDX-License-Identifier: Apache-2.0

description: Maxim MAX20335

compatible: "maxim,max20335"

include: i2c-device.yaml

properties:
  reg:
    required: true
```

## dts/bindings/mfd/maxim,max31790.yaml
```yaml
# Copyright (c) 2024 SILA Embedded Solutions GmbH
# SPDX-License-Identifier: Apache-2.0

description: Maxim MAX31790 6-channel I2C-bus PWM controller, MFD device

compatible: "maxim,max31790"

include: i2c-device.yaml

bus: max31790

properties:
  reg:
    required: true
```

## dts/bindings/mfd/microchip,atecc508.yaml
```yaml
# Copyright (c) 2024 Vogl Electronic GmbH
# SPDX-License-Identifier: Apache-2.0

description: Microchip ATECC508 I2C

compatible: "microchip,atecc508"

include: microchip,ateccx08-base.yaml
```

## dts/bindings/mfd/microchip,atecc608.yaml
```yaml
# Copyright (c) 2024 Vogl Electronic GmbH
# SPDX-License-Identifier: Apache-2.0

description: Microchip ATECC608 I2C

compatible: "microchip,atecc608"

include: microchip,ateccx08-base.yaml
```

## dts/bindings/mfd/microchip,ateccx08-base.yaml
```yaml
# Copyright (c) 2024 Vogl Electronic GmbH
# SPDX-License-Identifier: Apache-2.0

include: [i2c-device.yaml]

bus: ateccx08

properties:
  wake-delay:
    type: int
    description: Delay in us to wait for the device to wake up. 1500us is the
      minimum value according to the datasheet.
    default: 1500
  retries:
    type: int
    description: number of retries for operations
```

## dts/bindings/mfd/microchip,sam-flexcom.yaml
```yaml
# Copyright (C) 2025 Microchip Technology Inc. and its subsidiaries
#
# SPDX-License-Identifier: Apache-2.0
#

description: Microchip Flexcom (Flexible Serial Communication Unit)

compatible: "microchip,sam-flexcom"

include: base.yaml

properties:
  reg:
    required: true

  mchp,flexcom-mode:
    type: int
    description: Initial operating mode for FLEXCOM

  "#address-cells":
    required: true
    const: 1
  "#size-cells":
    required: true
    const: 1
```
