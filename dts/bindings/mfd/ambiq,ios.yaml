## dts/bindings/mfd/ambiq,ios.yaml
```yaml
# Copyright (c) 2025 Ambiq Micro Inc.
# SPDX-License-Identifier: Apache-2.0

description: Ambiq IOS peripheral (SPI device or I2C target) parent node

compatible: "ambiq,ios"

include: [base.yaml]

properties:
  reg:
    required: true

  interrupts:
    required: true
```

## dts/bindings/mfd/awinic,aw9523b.yaml
```yaml
# Copyright (c) 2024 TOKITA Hiroshi
# SPDX-License-Identifier: Apache-2.0

description: Awinic AW9523B 16 multi-function LED driver and GPIO controller

compatible: "awinic,aw9523b"

include: i2c-device.yaml

bus: aw9523b

properties:
  reg:
    required: true
```

## dts/bindings/mfd/gd,gd32-rcu.yaml
```yaml
# Copyright (c) 2022, Teslabs Engineering S.L.
# Copyright (c) 2025 Meshium
#               Aleksandr Senin <al@meshium.net>
#
# SPDX-License-Identifier: Apache-2.0

title: Gigadevice RCU (Reset and Clock Unit)

description: |
  Gigadevice Reset and Clock Unit (RCU) if a multi-function peripheral in
  charge of reset control (RCTL) and clock control (CCTL) for all SoC
  peripherals. Child nodes are used to represent each functional block.

compatible: "gd,gd32-rcu"

include: base.yaml

properties:
  reg:
    required: true

  gd,ck48m-source:
    type: string
    enum:
      - "irc48m"
      - "pll48m"
    description: |
      Select the CK48M clock source. CK48M is used by TRNG/SDIO/USBFS/USBHS.
      When set to "irc48m", the SoC initialization code enables the IRC48M
      oscillator and selects it as CK48M source.
      When set to "pll48m", the SoC initialization code selects PLL48M as CK48M
      source (see gd,pll48m-source).

  gd,pll48m-source:
    type: string
    enum:
      - "pllq"
      - "pllsaip"
    default: "pllq"
    description: |
      Select the PLL48M source (CK_PLLQ or CK_PLLSAIP) when gd,ck48m-source is
      set to "pll48m". This does not configure PLL/PLLSAI parameters; board
      clock configuration must ensure the selected source provides a valid
      48MHz clock domain.
```

## dts/bindings/mfd/infineon,autanalog-ac-state.yaml
```yaml
# Copyright (c) 2026 Infineon Technologies AG,
# or an affiliate of Infineon Technologies AG.
#
# SPDX-License-Identifier: Apache-2.0

description: |
  Infineon AutAnalog Autonomous Controller (AC) State Transition Table entry.

  Each node with this compatible represents one state in the AC State Transition
  Table (STT).  The node is referenced by phandle from the parent autanalog
  device's ac-states property, which determines the state's index in the table.

  This binding covers all sub-peripheral STT fields: AC, SAR, CTB (×2),
  PTCOMP, and DAC (×2).  All properties default to 0, so only the fields
  relevant to a particular state need to be specified.

  Use constants from <dt-bindings/mfd/infineon-autanalog.h> for condition,
  action, GPIO output, CTB gain, and DAC direction values.

compatible: "infineon,autanalog-ac-state"

properties:
  # --- AC fields ---

  ac-unlock:
    type: int
    default: 0
    description: |
      AC unlock flag (0 or 1).
      When set to 1, the AC is unlocked (allowed to modify config) in this state.

  ac-lp-mode:
    type: int
    default: 0
    description: |
      Low-power mode flag (0 or 1).
      When set to 1, the sub-system enters low-power mode in this state.

  ac-condition:
    type: int
    default: 0
    description: |
      AC condition code. Use IFX_AUTANALOG_AC_COND_* constants
      from <dt-bindings/mfd/infineon-autanalog.h>.
      Default: FALSE (0).

  ac-action:
    type: int
    default: 0
    description: |
      AC action code. Use IFX_AUTANALOG_AC_ACTION_* constants
      from <dt-bindings/mfd/infineon-autanalog.h>.
      Default: STOP (0).

  branch-state:
    type: int
    default: 0
    description: |
      Branch target state index (0-63) within the ac-states list.
      Used when the action is a BRANCH_* or WAIT_FOR type.

  ac-trig-int:
    type: int
    default: 0
    description: |
      Trigger-interrupt flag (0 or 1).
      When set to 1, the AC generates an interrupt on entering this state.

  ac-count:
    type: int
    default: 0
    description: |
      Repetition count (0-4095).
      The actual repetition count is value + 1.

  ac-unlock-gpio-out:
    type: int
    default: 0
    description: |
      GPIO output unlock flag (0 or 1).

  ac-gpio-out:
    type: int
    default: 0
    description: |
      GPIO output mask. Use IFX_AUTANALOG_AC_GPIO_OUT_* constants
      from <dt-bindings/mfd/infineon-autanalog.h>.
      Can be OR'd for multiple outputs (e.g., OUT0 | OUT1 = 0x3).

  # --- SAR fields ---

  sar-unlock:
    type: int
    default: 0
    description: |
      SAR unlock flag (0 or 1).
      When set to 1, the SAR configuration is unlocked in this state.

  sar-enable:
    type: int
    default: 0
    description: |
      SAR enable flag (0 or 1).
      When set to 1, the SAR is enabled in this state.

  sar-trigger:
    type: int
    default: 0
    description: |
      SAR trigger flag (0 or 1).
      When set to 1, the SAR conversion is triggered in this state.

  sar-entry-state:
    type: int
    default: 0
    description: |
      SAR entry state index (0-31).
      Selects the SAR sequencer entry point for this AC state.

  # --- CTB0 fields (op-amp / comparator block 0) ---

  ctb0-unlock:
    type: int
    default: 0
    description: |
      CTB0 unlock flag (0 or 1).
      When 1, CTB0 opamp fields below take effect in this state.

  ctb0-enable-opamp0:
    type: int
    default: 0
    description: CTB0 Opamp0 enable flag (0 or 1).

  ctb0-cfg-opamp0:
    type: int
    default: 0
    description: |
      CTB0 Opamp0 dynamic configuration selector (0-7).
      Selects from the CTB dynamic configuration table.

  ctb0-gain-opamp0:
    type: int
    default: 0
    description: |
      CTB0 Opamp0 gain. Use IFX_AUTANALOG_CTB_OA_GAIN_* constants.

  ctb0-enable-opamp1:
    type: int
    default: 0
    description: CTB0 Opamp1 enable flag (0 or 1).

  ctb0-cfg-opamp1:
    type: int
    default: 0
    description: |
      CTB0 Opamp1 dynamic configuration selector (0-7).

  ctb0-gain-opamp1:
    type: int
    default: 0
    description: |
      CTB0 Opamp1 gain. Use IFX_AUTANALOG_CTB_OA_GAIN_* constants.

  # --- CTB1 fields (op-amp / comparator block 1) ---

  ctb1-unlock:
    type: int
    default: 0
    description: |
      CTB1 unlock flag (0 or 1).
      When 1, CTB1 opamp fields below take effect in this state.

  ctb1-enable-opamp0:
    type: int
    default: 0
    description: CTB1 Opamp0 enable flag (0 or 1).

  ctb1-cfg-opamp0:
    type: int
    default: 0
    description: |
      CTB1 Opamp0 dynamic configuration selector (0-7).

  ctb1-gain-opamp0:
    type: int
    default: 0
    description: |
      CTB1 Opamp0 gain. Use IFX_AUTANALOG_CTB_OA_GAIN_* constants.

  ctb1-enable-opamp1:
    type: int
    default: 0
    description: CTB1 Opamp1 enable flag (0 or 1).

  ctb1-cfg-opamp1:
    type: int
    default: 0
    description: |
      CTB1 Opamp1 dynamic configuration selector (0-7).

  ctb1-gain-opamp1:
    type: int
    default: 0
    description: |
      CTB1 Opamp1 gain. Use IFX_AUTANALOG_CTB_OA_GAIN_* constants.

  # --- PTCOMP0 fields (programmable threshold comparator) ---

  ptcomp0-unlock:
    type: int
    default: 0
    description: |
      PTCOMP0 unlock flag (0 or 1).
      When 1, PTCOMP0 comparator fields below take effect in this state.

  ptcomp0-enable-comp0:
    type: int
    default: 0
    description: PTCOMP0 Comp0 enable flag (0 or 1).

  ptcomp0-dyn-cfg-idx-comp0:
    type: int
    default: 0
    description: |
      PTCOMP0 Comp0 dynamic configuration selector (0-7).

  ptcomp0-enable-comp1:
    type: int
    default: 0
    description: PTCOMP0 Comp1 enable flag (0 or 1).

  ptcomp0-dyn-cfg-idx-comp1:
    type: int
    default: 0
    description: |
      PTCOMP0 Comp1 dynamic configuration selector (0-7).

  # --- DAC0 fields ---

  dac0-unlock:
    type: int
    default: 0
    description: |
      DAC0 unlock flag (0 or 1).
      When 1, DAC0 fields below take effect in this state.

  dac0-enable:
    type: int
    default: 0
    description: DAC0 enable flag (0 or 1).

  dac0-trigger:
    type: int
    default: 0
    description: DAC0 trigger flag (0 or 1).

  dac0-channel:
    type: int
    default: 0
    description: DAC0 channel selector.

  dac0-direction:
    type: int
    default: 0
    description: |
      DAC0 direction. Use IFX_AUTANALOG_DAC_DIR_* constants.

  # --- DAC1 fields ---

  dac1-unlock:
    type: int
    default: 0
    description: |
      DAC1 unlock flag (0 or 1).
      When 1, DAC1 fields below take effect in this state.

  dac1-enable:
    type: int
    default: 0
    description: DAC1 enable flag (0 or 1).

  dac1-trigger:
    type: int
    default: 0
    description: DAC1 trigger flag (0 or 1).

  dac1-channel:
    type: int
    default: 0
    description: DAC1 channel selector.

  dac1-direction:
    type: int
    default: 0
    description: |
      DAC1 direction. Use IFX_AUTANALOG_DAC_DIR_* constants.
```

## dts/bindings/mfd/infineon,autanalog-ctb.yaml
```yaml
# Copyright (c) 2026 Infineon Technologies AG,
# or an affiliate of Infineon Technologies AG.
#
# SPDX-License-Identifier: Apache-2.0

description: |
  Infineon AutAnalog Continuous Time Block (CTB) MFD.

  The CTB provides a pair of opamps (OA0, OA1) that can be configured in
  various topologies: comparator, PGA, TIA, buffer, differential amplifier,
  or open-loop opamp.  Each opamp is represented as a child node with
  compatible "infineon,autanalog-ctb-opamp".

  The CTB sits within the AutAnalog subsystem and is coordinated by the
  Autonomous Controller (AC) State Transition Table (STT).  This MFD driver
  aggregates both opamp children into the single cy_stc_autanalog_ctb_t
  PDL config structure.

compatible: "infineon,autanalog-ctb"

include: [base.yaml]

properties:
  reg:
    required: true

  "#address-cells":
    const: 1

  "#size-cells":
    const: 0

  lp-mode:
    type: boolean
    description: |
      Request Low Power (LP) operation for the AutAnalog subsystem.
      When set, the parent AutAnalog MFD basic-mode STT enters LP operation
      for the AC states. LP mode is also activated if any other AutAnalog
      child peripheral (SAR ADC, DAC, PTCOMP, PRB) sets lp-mode.
      In advanced mode (ac-states), use the per-state ac-lp-mode property
      instead.

examples:
  - |
    /*
     * Use constants from <dt-bindings/opamp/infineon-autanalog-ctb.h>
     */
    ctb0: {
        compatible = "infineon,autanalog-ctb";
        opamp0: opamp@0 {
            compatible = "infineon,autanalog-ctb-opamp";
            reg = <0>;
            power-mode = <IFX_AUTANALOG_CTB_OA_PWR_ULTRA_LOW>;
            topology = <IFX_AUTANALOG_CTB_OA_TOPO_PGA>;
            ninv-inp-pin = <IFX_AUTANALOG_CTB_OA_NINV_PIN_OA0_P0_OA1_P5>;
            functional-mode = "non_inverting";
            out-to-pin;
        };

        opamp1: opamp@1 {
            compatible = "infineon,autanalog-ctb-opamp";
            reg = <1>;
            power-mode = <IFX_AUTANALOG_CTB_OA_PWR_ULTRA_LOW>;
            topology = <IFX_AUTANALOG_CTB_OA_TOPO_BUFFER>;
            out-to-pin;
            functional-mode = "non_inverting";
        };
    };
  - |
    /*
     * Advanced mode: 2 dynamic config slots on opamp@1.
     * Each child node is one slot with named properties.
     */
    ctb0: {
        compatible = "infineon,autanalog-ctb";
        opamp1: opamp@1 {
            compatible = "infineon,autanalog-ctb-opamp";
            reg = <1>;
            power-mode = <IFX_AUTANALOG_CTB_OA_PWR_ULTRA_LOW>;
            topology = <IFX_AUTANALOG_CTB_OA_TOPO_PGA>;
            functional-mode = "non_inverting";

            dyn-cfg-0 {
                ninv-inp-pin = <IFX_AUTANALOG_CTB_OA_NINV_PIN_OA0_P0_OA1_P5>;
                res-inp-ref = <IFX_AUTANALOG_CTB_OA_RES_REF_VSSA>;
                out-to-pin;
            };

            dyn-cfg-1 {
                ninv-inp-pin = <IFX_AUTANALOG_CTB_OA_NINV_PIN_OA0_P1_OA1_P4>;
                res-inp-ref = <IFX_AUTANALOG_CTB_OA_RES_REF_VSSA>;
                out-to-pin;
            };
        };
    };
```

## dts/bindings/mfd/infineon,autanalog-prb.yaml
```yaml
# Copyright (c) 2026 Infineon Technologies AG,
# or an affiliate of Infineon Technologies AG.
#
# SPDX-License-Identifier: Apache-2.0

description: |
  Infineon AutAnalog Programmable Reference Block (PRB) MFD.

  The PRB provides two programmable voltage references (Vref0, Vref1) derived
  from either VBGR (0.9 V) or VDDA (1.8 V max) via a 16-position resistive
  tap divider.  Each reference output is represented as a child regulator node
  with compatible "infineon,autanalog-prb-vref".

  The PRB sits within the AutAnalog subsystem and is coordinated by the
  Autonomous Controller (AC) State Transition Table (STT).  This MFD driver
  aggregates both Vref children into the single cy_stc_autanalog_prb_t PDL
  config structure and manages the shared PRB unlock in the STT.

compatible: "infineon,autanalog-prb"

include: [base.yaml]

properties:
  reg:
    required: true

  "#address-cells":
    const: 1

  "#size-cells":
    const: 0

  lp-mode:
    type: boolean
    description: |
      Request Low Power (LP) operation for the AutAnalog subsystem.
      When set, the parent AutAnalog MFD basic-mode STT enters LP operation
      for the AC states. LP mode is also activated if any other AutAnalog
      child peripheral (SAR ADC, DAC, CTB, PTCOMP) sets lp-mode.
      In advanced mode (ac-states), use the per-state ac-lp-mode property
      instead.

examples:
  - |
    /*
     * Use constants from <dt-bindings/regulator/infineon-autanalog-prb.h>.
     */
    prb0: prb@0 {
        compatible = "infineon,autanalog-prb";
        status = "okay";

        vref0: vref@0 {
            compatible = "infineon,autanalog-prb-vref";
            reg = <0>;
            source = <IFX_AUTANALOG_PRB_SRC_VDDA>;
            tap = <IFX_AUTANALOG_PRB_TAP_7>;
        };

        vref1: vref@1 {
            compatible = "infineon,autanalog-prb-vref";
            reg = <1>;
            source = <IFX_AUTANALOG_PRB_SRC_VDDA>;
            tap = <IFX_AUTANALOG_PRB_TAP_6>;
        };
    };
```
