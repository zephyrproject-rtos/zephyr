## dts/bindings/mfd/infineon,autanalog-ptcomp.yaml
```yaml
# Copyright (c) 2026 Infineon Technologies AG,
# or an affiliate of Infineon Technologies AG.
#
# SPDX-License-Identifier: Apache-2.0

description: |
  Infineon AutAnalog Programmable Threshold Comparator (PTComp) MFD.

  The PTComp provides a pair of comparators (Comp0, Comp1) that compare the
  voltage on one input to the reference on another input.  Each comparator output
  is represented as a child node with compatible "infineon,autanalog-ptcomp-comp".

  The PTComp sits within the AutAnalog subsystem and is coordinated by the
  Autonomous Controller (AC) State Transition Table (STT).  This MFD driver
  aggregates both comparator children into the single cy_stc_autanalog_ptcomp_t
  PDL config structure and manages the shared PTComp unlock in the STT.

compatible: "infineon,autanalog-ptcomp"

include: [base.yaml]

properties:
  reg:
    required: true

  "#address-cells":
    const: 1

  "#size-cells":
    const: 0

  lp-mode:
    type: boolean
    description: |
      Request Low Power (LP) operation for the AutAnalog subsystem.
      When set, the parent AutAnalog MFD basic-mode STT enters LP operation
      for the AC states. LP mode is also activated if any other AutAnalog
      child peripheral (SAR ADC, DAC, CTB, PRB) sets lp-mode.
      In advanced mode (ac-states), use the per-state ac-lp-mode property
      instead.

examples:
  - |
    /*
     * Use constants from <dt-bindings/comparator/infineon-autanalog-ptcomp.h>.
     */
    ptcomp0: ptcomp@0 {
        compatible = "infineon,autanalog-ptcomp";
        status = "okay";

        comp0: comp@0 {
            compatible = "infineon,autanalog-ptcomp-comp";
            reg = <0>;
            power-mode = <IFX_AUTANALOG_PTCOMP_PWR_NORMAL>;
            interrupt-mode = <IFX_AUTANALOG_PTCOMP_INT_EDGE_RISING>;
            positive-mux = <IFX_AUTANALOG_PTCOMP_MUX_GPIO2>;
            negative-mux = <IFX_AUTANALOG_PTCOMP_MUX_PRB_OUT0>;
        };

        comp1: comp@1 {
            compatible = "infineon,autanalog-ptcomp-comp";
            reg = <1>;
            power-mode = <IFX_AUTANALOG_PTCOMP_PWR_NORMAL>;
            positive-mux = <IFX_AUTANALOG_PTCOMP_MUX_GPIO4>;
            negative-mux = <IFX_AUTANALOG_PTCOMP_MUX_PRB_OUT0>;
        };
    };
  - |
    /*
     * Advanced mode: 2 dynamic mux config slots per comparator.
     * Each child node is one slot with named properties.
     */
    ptcomp0: ptcomp@0 {
        compatible = "infineon,autanalog-ptcomp";
        status = "okay";

        comp0: comp@0 {
            compatible = "infineon,autanalog-ptcomp-comp";
            reg = <0>;
            power-mode = <IFX_AUTANALOG_PTCOMP_PWR_NORMAL>;
            interrupt-mode = <IFX_AUTANALOG_PTCOMP_INT_EDGE_RISING>;
            positive-mux = <IFX_AUTANALOG_PTCOMP_MUX_GPIO2>;
            negative-mux = <IFX_AUTANALOG_PTCOMP_MUX_PRB_OUT0>;

            dyn-cfg-0 {
                positive-mux = <IFX_AUTANALOG_PTCOMP_MUX_GPIO2>;
                negative-mux = <IFX_AUTANALOG_PTCOMP_MUX_PRB_OUT0>;
            };

            dyn-cfg-1 {
                positive-mux = <IFX_AUTANALOG_PTCOMP_MUX_GPIO2>;
                negative-mux = <IFX_AUTANALOG_PTCOMP_MUX_DAC0>;
            };
        };

        comp1: comp@1 {
            compatible = "infineon,autanalog-ptcomp-comp";
            reg = <1>;
            power-mode = <IFX_AUTANALOG_PTCOMP_PWR_NORMAL>;
            positive-mux = <IFX_AUTANALOG_PTCOMP_MUX_GPIO4>;
            negative-mux = <IFX_AUTANALOG_PTCOMP_MUX_PRB_OUT0>;

            dyn-cfg-0 {
                positive-mux = <IFX_AUTANALOG_PTCOMP_MUX_GPIO4>;
                negative-mux = <IFX_AUTANALOG_PTCOMP_MUX_PRB_OUT0>;
            };

            dyn-cfg-1 {
                positive-mux = <IFX_AUTANALOG_PTCOMP_MUX_GPIO4>;
                negative-mux = <IFX_AUTANALOG_PTCOMP_MUX_DAC0>;
            };
        };
    };
```

## dts/bindings/mfd/infineon,autanalog.yaml
```yaml
# Copyright (c) 2026 Infineon Technologies AG,
# or an affiliate of Infineon Technologies AG.
#
# SPDX-License-Identifier: Apache-2.0

description: |
  Infineon AutAnalog (Autonomous Analog) Multi-Function Device

  The AutAnalog subsystem is a shared analog peripheral block containing a SAR ADC,
  DACs, Programmable regulator, op-amp (CTB), and a Programmable Threshold
  comparator (PTCOMP), all coordinated by an Autonomous Controller (AC).

  This MFD device manages the shared resources: the Autonomous Controller state
  machine, shared interrupt dispatch, and subsystem initialization. Individual
  peripherals (ADC, DAC, comparator) are child nodes of this device.

  Two usage modes are supported:

  Basic mode (ac-states omitted):
    The driver automatically generates a 3-state SAR single-shot AC sequence.
    SAR fields are populated at compile time when the SAR ADC child node is
    enabled.  No AC configuration is required from the user.

  Advanced mode (ac-states provided):
    The AC State Transition Table (STT) is configured via ac-states, an ordered
    phandle list referencing nodes with compatible "infineon,autanalog-ac-state".
    Each node defines one AC state with full control over SAR, CTB, PTCOMP, and
    DAC sub-peripheral fields.

compatible: "infineon,autanalog"

include: [base.yaml]

properties:
  reg:
    required: true

  interrupts:
    required: true

  "#address-cells":
    const: 1

  "#size-cells":
    const: 1

  ac-states:
    type: phandles
    description: |
      Ordered list of AC state node phandles for advanced mode.  When present,
      the driver uses these nodes to build the full State Transition Table.
      Each referenced node must have compatible "infineon,autanalog-ac-state".

      The AC state nodes should be defined as children of the autanalog node
      so they are co-located with the peripheral they configure.

      When omitted, the driver uses a built-in 3-state SAR single-shot
      sequence (basic mode) and automatically populates SAR fields based on
      the SAR ADC child node status.

examples:
  - |
    /* Example of custom 4-state sequence using SAR.
     * Use constants from <dt-bindings/mfd/infineon-autanalog.h>.
     */

    / {
        /*
        * AC State Transition Table:
        * State 0: Wait for BLOCK_READY, enable SAR, branch to 1
        * State 1: STOP and wait for any reconfiguration request
        * State 2: Wait for SAR_EOS, trigger SAR, branch to 3
        * State 3: Loop back to state 1
        */
        ac_state0: ac-state-0 {
            compatible = "infineon,autanalog-ac-state";
            ac-unlock = <1>;
            ac-condition = <IFX_AUTANALOG_AC_COND_BLOCK_READY>;
            ac-action = <IFX_AUTANALOG_AC_ACTION_WAIT_FOR>;
            branch-state = <1>;
            sar-unlock = <1>;
            sar-enable = <1>;
        };

        ac_state1: ac-state-1 {
            compatible = "infineon,autanalog-ac-state";
            ac-condition = <IFX_AUTANALOG_AC_COND_FALSE>;
            ac-action = <IFX_AUTANALOG_AC_ACTION_STOP>;
            sar-unlock = <1>;
            sar-enable = <1>;
        };

        ac_state2: ac-state-2 {
            compatible = "infineon,autanalog-ac-state";
            ac-condition = <CY_AUTANALOG_STT_AC_CONDITION_SAR_EOS>;
            ac-action = <IFX_AUTANALOG_AC_ACTION_WAIT_FOR>;
            branch-state = <3>;
            sar-unlock = <1>;
            sar-enable = <1>;
            sar-trigger = <1>;
        };

        ac_state3: ac-state-3 {
            compatible = "infineon,autanalog-ac-state";
            ac-condition = <CY_AUTANALOG_STT_AC_CONDITION_TRUE>;
            ac-action = <IFX_AUTANALOG_AC_ACTION_BRANCH_IF_TRUE>;
            branch-state = <1>;   /* loop back to stop state */
            sar-unlock = <1>;
            sar-enable = <1>;
        };
    };

    &autanalog {
        ac-states = <&ac_state0 &ac_state1 &ac_state2 &ac_state3>;
    };
```

## dts/bindings/mfd/infineon,hppass-ac-state.yaml
```yaml
# SPDX-FileCopyrightText: <text>Copyright (c) 2026 Infineon Technologies AG,
# or an affiliate of Infineon Technologies AG. All rights reserved.</text>
#
# SPDX-License-Identifier: Apache-2.0

description: |
  Infineon HPPASS Autonomous Controller (AC) State Transition Table entry.

  Each node with this compatible represents one state in the AC State Transition
  Table (STT).  The node is referenced by phandle from the parent HPPASS
  device's ac-states property, which determines the state's index in the table.

  This binding covers all STT fields: AC core, GPIO output, CSG (×5 slices),
  SAR, and SAR MUX (×4 channels).  All properties default to 0, so only the
  fields relevant to a particular state need to be specified.

  Use constants from <dt-bindings/mfd/infineon-hppass.h> for condition,
  action, GPIO output, and SAR group mask values.

compatible: "infineon,hppass-ac-state"

properties:
  # --- AC core fields ---

  ac-condition:
    type: int
    default: 0
    description: |
      AC condition code. Use IFX_HPPASS_AC_COND_* constants
      from <dt-bindings/mfd/infineon-hppass.h>.
      Default: FALSE (0).

  ac-action:
    type: int
    default: 0
    description: |
      AC action code. Use IFX_HPPASS_AC_ACTION_* constants
      from <dt-bindings/mfd/infineon-hppass.h>.
      Default: STOP (0).

  branch-state-idx:
    type: int
    default: 0
    description: |
      Branch target state index (0-15) within the ac-states list.
      Used when the action is BRANCH_IF_TRUE or BRANCH_IF_FALSE.

  ac-interrupt:
    type: int
    default: 0
    description: |
      Interrupt/trigger flag (0 or 1).
      When set to 1, a pulse trigger or CPU interrupt is generated
      on entering this state (or after the wait condition is met for
      WAIT_FOR actions).

  ac-count:
    type: int
    default: 0
    description: |
      Timer/counter value (1-4096).
      For WAIT_FOR actions this is an interval timer.
      For BRANCH_IF_* actions this is a loop counter.
      A value of 0 disables the timer/counter for this state.

  # --- GPIO output fields ---

  gpio-out-unlock:
    type: int
    default: 0
    description: |
      GPIO output unlock flag (0 or 1).
      When 1, GPIO output mask is applied in this state.

  gpio-out-msk:
    type: int
    default: 0
    description: |
      GPIO output mask. Use IFX_HPPASS_GPIO_OUT_* constants
      from <dt-bindings/mfd/infineon-hppass.h>.
      Can be OR'd for multiple outputs (e.g., GPIO_OUT_0 | GPIO_OUT_1).

  # --- CSG fields (5 slices) ---

  csg0-unlock:
    type: int
    default: 0
    description: CSG slice 0 unlock flag (0 or 1).

  csg0-enable:
    type: int
    default: 0
    description: CSG slice 0 enable flag (0 or 1). Requires csg0-unlock = 1.

  csg0-dac-trig:
    type: int
    default: 0
    description: CSG slice 0 DAC start/update trigger flag (0 or 1).

  csg1-unlock:
    type: int
    default: 0
    description: CSG slice 1 unlock flag (0 or 1).

  csg1-enable:
    type: int
    default: 0
    description: CSG slice 1 enable flag (0 or 1). Requires csg1-unlock = 1.

  csg1-dac-trig:
    type: int
    default: 0
    description: CSG slice 1 DAC start/update trigger flag (0 or 1).

  csg2-unlock:
    type: int
    default: 0
    description: CSG slice 2 unlock flag (0 or 1).

  csg2-enable:
    type: int
    default: 0
    description: CSG slice 2 enable flag (0 or 1). Requires csg2-unlock = 1.

  csg2-dac-trig:
    type: int
    default: 0
    description: CSG slice 2 DAC start/update trigger flag (0 or 1).

  csg3-unlock:
    type: int
    default: 0
    description: CSG slice 3 unlock flag (0 or 1).

  csg3-enable:
    type: int
    default: 0
    description: CSG slice 3 enable flag (0 or 1). Requires csg3-unlock = 1.

  csg3-dac-trig:
    type: int
    default: 0
    description: CSG slice 3 DAC start/update trigger flag (0 or 1).

  csg4-unlock:
    type: int
    default: 0
    description: CSG slice 4 unlock flag (0 or 1).

  csg4-enable:
    type: int
    default: 0
    description: CSG slice 4 enable flag (0 or 1). Requires csg4-unlock = 1.

  csg4-dac-trig:
    type: int
    default: 0
    description: CSG slice 4 DAC start/update trigger flag (0 or 1).

  # --- SAR fields ---

  sar-unlock:
    type: int
    default: 0
    description: |
      SAR unlock flag (0 or 1).
      When 1, SAR enable state is applied in this state.

  sar-enable:
    type: int
    default: 0
    description: |
      SAR enable flag (0 or 1). Requires sar-unlock = 1.
      Normally used with WAIT_FOR + BLOCK_READY condition.

  sar-grp-msk:
    type: int
    default: 0
    description: |
      SAR sequencer group trigger mask. Use IFX_HPPASS_SAR_GRP_* constants
      from <dt-bindings/mfd/infineon-hppass.h>.
      Can be OR'd for multiple groups. Effective when SAR is enabled
      and SAR group trigger source is set to AC.

  # --- SAR MUX fields (4 muxed samplers) ---

  sar-mux0-unlock:
    type: int
    default: 0
    description: SAR mux sampler 0 unlock flag (0 or 1).

  sar-mux0-chan-idx:
    type: int
    default: 0
    description: SAR mux sampler 0 channel selection (0-3).

  sar-mux1-unlock:
    type: int
    default: 0
    description: SAR mux sampler 1 unlock flag (0 or 1).

  sar-mux1-chan-idx:
    type: int
    default: 0
    description: SAR mux sampler 1 channel selection (0-3).

  sar-mux2-unlock:
    type: int
    default: 0
    description: SAR mux sampler 2 unlock flag (0 or 1).

  sar-mux2-chan-idx:
    type: int
    default: 0
    description: SAR mux sampler 2 channel selection (0-3).

  sar-mux3-unlock:
    type: int
    default: 0
    description: SAR mux sampler 3 unlock flag (0 or 1).

  sar-mux3-chan-idx:
    type: int
    default: 0
    description: SAR mux sampler 3 channel selection (0-3).
```
