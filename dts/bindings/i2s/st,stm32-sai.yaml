## dts/bindings/i2s/st,stm32-sai.yaml
```yaml
# Copyright (c) 2024 ZAL Zentrum für Angewandte Luftfahrtforschung GmbH
# SPDX-License-Identifier: Apache-2.0

description: STM32 SAI Block controller

compatible: "st,stm32-sai"

include: i2s-controller.yaml

properties:
  reg:
    required: true
```

## dts/bindings/i2s/zephyr,native-sim-i2s.yaml
```yaml
# Copyright 2026 NXP
# SPDX-License-Identifier: Apache-2.0

description: Native_sim file-backed I2S controller

compatible: "zephyr,native-sim-i2s"

include: base.yaml

properties:
  stream-direction:
    type: string
    required: true
    enum:
      - rx
      - tx
      - both
    description: Select whether the logical native_sim I2S device handles RX or TX.
```

## dts/bindings/i3c/adi,max32-i3c.yaml
```yaml
# Copyright (c) 2019 NXP
# Copyright (c) 2022 Intel Corporation
# Copyright (c) 2024 Analog Devices, Inc.
#
# SPDX-License-Identifier: Apache-2.0

description: ADI MAX32 I3C controller

compatible: "adi,max32-i3c"

include: [i3c-controller.yaml, pinctrl-device.yaml]

properties:
  reg:
    required: true

  interrupts:
    required: true

  i3c-od-scl-hz:
    type: int
    description: |
      Open Drain Frequency for the I3C controller. When undefined, use
      the controller default or as specified by the I3C specification.

  disable-open-drain-high-pp:
    type: boolean
    description: |
      If false, open drain high time is 1 PPBAUD count, which is short
      high and long low.
      If true, open drain high time is same as ODBAUD so that open drain
      clock is 50% duty cycle.
      Default is false.
```

## dts/bindings/i3c/cdns,i3c.yaml
```yaml
# Copyright (c) 2022 Meta Platforms, Inc. and its affiliates.
#
# SPDX-License-Identifier: Apache-2.0

description: Cadence I3C controller

compatible: "cdns,i3c"

include: [i3c-controller.yaml]

properties:
  reg:
    required: true

  interrupts:
    required: true

  input-clock-frequency:
    type: int
    required: true
    description: The controller input clock frequency
```

## dts/bindings/i3c/i3c-controller.yaml
```yaml
# Copyright (c) 2022 Intel Corporation
#
# SPDX-License-Identifier: Apache-2.0

# Fields for I3C Controllers

include: base.yaml

bus: [i3c, i2c]

properties:
  "#address-cells":
    required: true
    const: 3

  "#size-cells":
    required: true
    const: 0

  i3c-scl-hz:
    type: int
    description: |
      Frequency of the SCL signal used for I3C transfers. When undefined,
      use the controller default or as specified by the I3C specification.

  i2c-scl-hz:
    type: int
    description: |
      Frequency of the SCL signal used for I2C transfers. When undefined
      and there are I2C devices attached to the bus, look at the Legacy
      Virtual Register (LVR) of all connected I2C devices to determine
      the maximum allowed frequency.
```

## dts/bindings/i3c/i3c-device.yaml
```yaml
# Copyright (c) 2017, Linaro Limited
# SPDX-License-Identifier: Apache-2.0

# Common fields for I3C devices

include: [base.yaml, power.yaml]

on-bus: i3c

properties:
  reg:
    required: true
    description: |
      Contains 3 fields.

      For I3C devices, the 3 fields are static address, first half
      of Provisioned ID, and the second half of the Provisioned ID.
        1. The static address can be assigned to be the target device's
           dynamic address before Dynamic Address Assignment (DAA)
           starts. Can be zero if static address is not used, and
           target address is determined via DAA.
        2. First half of the Provisioned ID contains the manufacturer
           ID left-shifted by 1, where the manufacturer ID is
           the bits 33-47 (zero-based) of the 48-bit Provisioned ID.
        3. Second half of the Provisioned ID contains the combination of
           the part ID (bits 16-31 of the Provisioned ID) left-shifted
           by 16, and the instance ID (bits 12-15 of the Provisioned ID)
           left-shifted by 12. Basically, this is the lower 32 bits
           of the Provisioned ID.

      Note that the DT node of a I3C target device should be in format
      "<node name>@<address + PID>", e.g. "sensor@4200001234012345678",
      where the PID part is expanded to be a 64-bit integer.

      For I2C devices, the 3 fields are static address, 0x00, and
      value of the Legacy Virtual Register (LVR).
         1. 7-bit address of the I2C device. (Note that 10-bit
            addressing is not supported.)
         2. Always 0x00.
         3. LVR describes the I2C device where,
            * bit[31:8]: unused.
            * bit[7:5]: I2C device index:
                * Index 0: I2C device has a 50 ns spike filter where
                           it is not affected by high frequency on SCL.
                * Index 1: I2C device does not have a 50 ns spike filter
                           but can work with high frequency on SCL.
                * Index 2: I2C device does not have a 50 ns spike filter
                           and cannot work with high frequency on SCL.
                * Other values are reserved.
            * bit[4]: I2C mode indicator:
                * 0: FM+ mode
                * 1: FM mode
            * bit[3:0]: reserved.

      The DT node of a I2C device should be in format
      "<node name>@<address + 00000000 + LVR>",
      e.g. "sensor@5000000000000000FF", where the middle 0x00 and LVR
      are both expanded to 32-bit integers.

  assigned-address:
    type: int
    description: |
      Dynamic address to be assigned to the device.

  supports-setaasa:
    type: boolean
    description: |
      Indicates if the device supports the CCC SETAASA. If true, it will
      be used as an optimization for bus initialization.
```

## dts/bindings/i3c/i3c-mux-device.yaml
```yaml
# Copyright (c) 2022 Google LLC.
# SPDX-License-Identifier: Apache-2.0

description: |
  Generic I3C mux

  Each channel is represented by a separate devicetree child node.
  The channel node can then be used as a standard i3c bus controller
  like in the following simplified example:

      /* The imx3112 node must be a child of an i3c controller */
      mux: imx3112@77 {
          compatible = "renesas,imx3112-i3c";
          reg = <0x77 0xabcd 0x02345678>;
          status = "okay";
          #address-cells = <1>;
          #size-cells = <0>;

          mux_i3c@0 {
              compatible: "renesas,imx3112-channel"
              reg = <0>;
              #address-cells = <3>;
              #size-cells = <0>;
              lps22hh0: lps22hh@10 {
                      compatible = "st,lps22hh";
                      reg = <0x10 0xabcd 0x12345678>;
              };
          };

          mux_i3c@1 {
            compatible: "renesas,imx3112-channel"
              reg = <1>;
              #address-cells = <3>;
              #size-cells = <0>;
              lps22hh1: lps22hh@10 {
                      compatible = "st,lps22hh";
                      reg = <0x10 0xabcd 0x12345678>;
              };
          };
      };

on-bus: i3c

include: [i3c-device.yaml]

child-binding:
  description: Generic switch channel node
  include: [i3c-controller.yaml]
  on-bus: i3c
```

## dts/bindings/i3c/i3c-slave-mqueue.yaml
```yaml
# Copyright (c) 2023 Nuvoton Technology Corporation.
# SPDX-License-Identifier: Apache-2.0

description: NUVOTON I3C MQueue device

compatible: "i3c-slave-mqueue"

include: base.yaml

on-bus: i3c

properties:
    msg-size:
      type: int
      required: true
      description: |
        the size of the single message in byte, used to specify max read/write length

    num-of-msgs:
      type: int
      required: true
      description: |
        number of the messages

    mandatory-data-byte:
      type: int
      required: true
      description: |
        mandatory data byte (MDB), used to specify how slave provide response data
```

## dts/bindings/i3c/intel,sedi-i3c.yaml
```yaml
#
# Copyright (c) 2022-2024 Intel Corporation.
#
# SPDX-License-Identifier: Apache-2.0
#
---
description: Intel SEDI I3C

compatible: "intel,sedi-i3c"

include: base.yaml

properties:
    reg:
      required: true

    interrupts:
      required: true

    ibi_pins:
      type: int
      description: IBI internal pin number.
      required: true

    peripheral-id:
      type: int
      description: peripheral ID
      required: true
...
```

## dts/bindings/i3c/ite,it51xxx-i3cm.yaml
```yaml
# Copyright (c) 2025 ITE Corporation. All Rights Reserved.
# SPDX-License-Identifier: Apache-2.0

description: IT51XXX I3CM controller

compatible: "ite,it51xxx-i3cm"

include: [i3c-controller.yaml, pinctrl-device.yaml]

properties:
  reg:
    required: true

  interrupts:
    required: true

  io-channel:
    required: true
    type: int
    enum: [0, 1, 2, 3]
    description: |
      The it51xxx chip features four i3c io channels and two i3c cotroller
      (i3cm) engines. This property allows the i3cm engine to select the
      desired i3c io channel. To ensure proper i3c functionality, make sure
      that multiple controllers (including the i3cm controller and i3cs
      target engines) are not assigned the same io channel.

  i3c-pp-duty-cycle:
    default: 50
    type: int
    description: |
      The duty cycle of push-pull frequency(unit in percentage).

  i3c-od-scl-hz:
    required: true
    type: int
    description: |
      The open-drain frequency for the i3c controller.

  i3c-scl-hddat:
    type: int
    description: |
      i3c data hold time(0 by default). The time is calculated as:
      t_hddat = (i3c-scl-hddat + 1) * 20.8ns. The range of i3c-scl-hddat is
      [63:0].

  i3c-scl-tcas:
    type: int
    description: |
      i3c clock after start condition(1 by default). The time is calculated as:
      t_cas = (i3c-scl-tcas + 1) * 20.8ns. The maximum value is 255.

  i3c-scl-tcbs:
    type: int
    description: |
      i3c clock before stop condition(0 by default). The time is calculated as:
      t_cbs = (i3c-scl-tcbs + 1) * 20.8ns. The maximum value is 255.

  i3c-scl-tcasr:
    type: int
    description: |
      i3c clock after repeated start condition(1 by default). The time is
      calculated as: t_casr = (i3c-scl-tcasr + 1) * 20.8ns. The maximum value
      is 255.

  i3c-scl-tcbsr:
    type: int
    description: |
      i3c clock before repeated start condition(0 by default). The time is
      calculated as: t_cbsr = (i3c-scl-tcbsr + 1) * 20.8ns. The maximum value
      is 255.

  i2c-scl-hddat:
    type: int
    description: |
      i2c data hold time(0 by default). The time is calculated as:
      t_hddat = (i2c-scl-hddat + 1) * 20.8ns. The range of i3c-scl-hddat is
      [65535:0].
```

## dts/bindings/i3c/ite,it51xxx-i3cs.yaml
```yaml
# Copyright (c) 2025 ITE Corporation. All Rights Reserved.
# SPDX-License-Identifier: Apache-2.0

description: IT51XXX I3CS controller

compatible: "ite,it51xxx-i3cs"

include: [base.yaml, pinctrl-device.yaml]

bus: [i3c, i2c]

properties:
  reg:
    required: true

  interrupts:
    required: true

  extern-enable:
    required: true
    type: array
    description: Extern enable configuration defined as <reg_address bit_mask>

  io-channel:
    required: true
    type: int
    enum: [0, 1, 2, 3]
    description: |
      The it51xxx chip features four i3c io channels and two i3c target (i3cs)
      engines. This property allows the i3cs engine to select the desired i3c
      io channel. To ensure proper i3c functionality, make sure that multiple
      controllers (including the i3cm controller and i3cs target engines) are
      not assigned the same io channel.

  static-address:
    type: int
    description: |
      Target static address.(default: 0x00)

  vendor-info-fields:
    type: int
    description: |
      The vendor info fields(MSB) of get device status(GETSTATUS) CCC.
      (default: 0x00)

  pid-random-value:
    type: int
    description: |
      Set pid[31:0] to a random value. If this property is not set, pid[31:0]
      defaults to a fixed vendor value.

  bcr:
    type: int
    description: |
      Bus Characteristics Register, used for bus enumeration with ENTDAA and
      determine device role and capabilities of the device on the bus.
      (default: 0x0F)

  dcr:
    type: int
    description: |
      Device Characteristics Register, used for bus enumeration with ENTDAA.
      (default: 0x00)

  disable-read-abort:
    type: boolean
    description: |
      Disable 100us read abort mechanism. The i3cs supports the 100us read-abort
      approach described in the section 5.1.2.3 of i3c specification v1.1.1.
      Enabling this property disables the read-abort mechanism.
      (default: false)
```

## dts/bindings/i3c/microchip,mec5-i3c.yaml
```yaml
# Copyright (c) 2024 Microchip Inc.
#
# There are two I3C blocks in the SOC.
#     I3C0 - Primary Host alone.
#     I3C1 - Secondary Host or Target.
# Default mode for the I3C1 is Target.
# But we shall change the mode using DTS.
#
# SPDX-License-Identifier: Apache-2.0

description: Microchip MEC5 I3C controller

compatible: "microchip,mec5-i3c"

include: [i3c-controller.yaml]

properties:
  reg:
    required: true

  interrupts:
    required: true

  pinctrl-0:
    type: phandles
    required: true

  pinctrl-names:
    type: string-array
    required: true

  input-clock-frequency:
    type: int
    required: true
    description: The controller input clock frequency

  i3c1-as-tgt-pid:
    type: array
    description:  |
        I3C1(secondary host) boot as Target by default.
        This property shall be used to set Provisioned ID (PID)
        value for the Target. 48bit required to hold PID.
            Ex., PID -> 0xB0123456789B
                 i3c1-as-tgt-pid = < 0xB012 0x3456789B >

  i3c1-as-tgt-pid-random:
    type: boolean
    description:  |
        I3C1(secondary host) boot as Target by default.
        This property shall be used to set PID Radom value for the Target.
        True if lower 32-bit of Provisioned ID is random.
        This sets the bit 32 of Provisioned ID which means, the lower
        32-bit is random value.

  i3c1-as-tgt-static-addr:
    type: int
    description:  |
        I3C1(secondary host) boot as Target by default.
        This property shall be used to set static address to it.

  i3c1-as-tgt-mrl:
    type: int
    description:  |
        I3C1(secondary host) boot as Target by default.
        This property shall be used to set Target maximum read length(MRL).

  i3c1-as-tgt-mwl:
    type: int
    description:  |
        I3C1(secondary host) boot as Target by default.
        This property shall be used to set Target maximum write length(MWL).
```

## dts/bindings/i3c/nuvoton,nct-i3c-ext-device.yaml
```yaml
# Copyright (c) 2018, 
# SPDX-License-Identifier: Apache-2.0

description: Nuvoton external i3c device to test i3c controller

compatible: "nuvoton,nct-i3c-ext-device"

include: [sensor-device.yaml, i3c-device.yaml]
```
