## dts/bindings/i3c/nuvoton,nct-i3c.yaml
```yaml
# Copyright (c) 2025 Nuvoton Technology Corporation.
# SPDX-License-Identifier: Apache-2.0

description: |
    Nuvoton I3C controller

    Representation:

    /* If CONFIG_I3C_NCT is enabled, the suggested clock configuration is as follows: */
    &pcc {
      clock-frequency = <DT_FREQ_M(96)>; /* OFMCLK runs at 96MHz */
      apb3-prescaler = <1>; /* APB3_CLK runs at 96MHz */
    };

    &i3c0 {
      status = "okay";

      /* I3C clock frequency suggestion = <PP_SCL, OD_SCL, I2C_SCL> */
       * Full speed = <12500000, 4170000, 1000000>
       * Normal speed = <7500000, 1500000, 400000>
       */
      i3c-scl-hz = <12500000>;
      i3c-od-scl-hz = <4170000>;
      i2c-scl-hz = <1000000>;
    };

compatible: "nuvoton,nct-i3c"

include: [i3c-controller.yaml, pinctrl-device.yaml]

properties:
  reg:
    required: true

  interrupts:
    required: true

  pinctrl-0:
    required: true

  pinctrl-names:
    required: true

  i3c-od-scl-hz:
    type: int
    description: |
      Open Drain Frequency for the I3C controller. When undefined, use
      the controller default or as specified by the I3C specification.

  secondary:
    type: boolean
    description: Initialized as a secondary controller.

  static-address:
    type: int
    description: |
      Target static address.

  tgt-pid:
    type: array
    description: |
      Target 48-bit Provisioned ID.
      array[0]: PID[47:33] MIPI manufacturer ID.
                PID[32] ID type selector (i'b1 ramdom value, 1'b0 vendor fixed).
      array[1]: PID[31:0] Random value or vendor fixed value.

  bcr:
    required: true
    type: int
    description: |
      Bus Characteristics Register, used for bus enumeration with ENTDAA and
      determine device role and capabilities of the device on the bus.

  dcr:
    type: int
    description: |
      Device Characteristics Register, used for bus enumeration with ENTDAA.

  maximum-write:
    type: int
    default: 256
    description: |
      Maximum number of bytes that I3C controller may write to I3C target per message.
      Range: 8 to 4095.

  maximum-read:
    type: int
    default: 256
    description: |
      Maximum number of bytes that I3C controller may read from to I3C target per message.
      Range: 8 to 4095.

  ibi-append-pec:
    type: boolean
    description: |
      Append PEC byte to the IBI data.

  priv-xfer-pec:
    type: boolean
    description: |
      Enable this option in slave mode if the i3c want to communicate with data that have PEC.
      The PEC will auto append to the tail of the data when doing private transfer and verify
      the PEC when receiving the data from master.
```

## dts/bindings/i3c/nuvoton,npcm-i3c.yaml
```yaml
# Copyright (c) 2024 Nuvoton Technology Corporation.
# SPDX-License-Identifier: Apache-2.0

description: |
    Nuvoton I3C controller

    Representation:

    /* If CONFIG_I3C_NPCM is enabled, the suggested clock configuration is as follows: */
    &pcc {
      clock-frequency = <DT_FREQ_M(96)>; /* OFMCLK runs at 96MHz */
      apb3-prescaler = <1>; /* APB3_CLK runs at 96MHz */
    };

    &i3c0 {
      status = "okay";

      /* I3C clock frequency suggestion = <PP_SCL, OD_SCL, I2C_SCL> */
       * Full speed = <12500000, 4170000, 1000000>
       * Normal speed = <7500000, 1500000, 400000>
       */
      i3c-scl-hz = <12500000>;
      i3c-od-scl-hz = <4170000>;
      i2c-scl-hz = <1000000>;
    };

compatible: "nuvoton,npcm-i3c"

include: [i3c-controller.yaml, pinctrl-device.yaml]

properties:
  reg:
    required: true

  interrupts:
    required: true

  i3c-od-scl-hz:
    type: int
    description: |
      Open Drain Frequency for the I3C controller. When undefined, use
      the controller default or as specified by the I3C specification.
```

## dts/bindings/i3c/nuvoton,npcx-i3c.yaml
```yaml
# Copyright (c) 2024 Nuvoton Technology Corporation.
# SPDX-License-Identifier: Apache-2.0

description: |
    Nuvoton I3C controller

    Representation:

    /* If CONFIG_I3C_NPCX is enabled, the suggested clock configuration is as follows: */
    &pcc {
      clock-frequency = <DT_FREQ_M(90)>; /* OFMCLK runs at 90MHz */
      core-prescaler = <3>; /* CORE_CLK runs at 30MHz */
      apb1-prescaler = <6>; /* APB1_CLK runs at 15MHz */
      apb2-prescaler = <6>; /* APB2_CLK runs at 15MHz */
      apb3-prescaler = <6>; /* APB3_CLK runs at 15MHz */
      apb4-prescaler = <3>; /* APB4_CLK runs at 30MHz */
    };

    &rst {
      status = "okay";
    };

    &i3c0 {
      status = "okay";

      /* I3C clock frequency suggestion = <PP_SCL, OD_SCL> */
       * Full speed = <12500000, 4170000>
       * Normal speed = <7500000, 1500000>
       */
      i3c-scl-hz = <12500000>;
      i3c-od-scl-hz = <4170000>;

      bcr = <0x67>; /* Set for controller mode */
    };

compatible: "nuvoton,npcx-i3c"

include: [i3c-controller.yaml, pinctrl-device.yaml, reset-device.yaml]

properties:
  reg:
    required: true

  interrupts:
    required: true

  resets:
    required: true

  i3c-od-scl-hz:
    type: int
    description: |
      Open Drain Frequency for the I3C controller. When undefined, use
      the controller default or as specified by the I3C specification.

  instance-id:
    required: true
    type: int
    description: |
      Instance ID of the device, used to specify port number.
      Bit[7:4] module id.
      Bit[3:0] port id.

  secondary:
    type: boolean
    description: Initialized as a secondary controller.

  static-address:
    type: int
    description: |
      Target static address.

  tgt-pid:
    type: array
    description: |
      Target 48-bit Provisioned ID.
      array[0]: PID[47:33] MIPI manufacturer ID.
                PID[32] ID type selector (i'b1 ramdom value, 1'b0 vendor fixed).
      array[1]: PID[31:0] Random value or vendor fixed value.

  bcr:
    required: true
    type: int
    description: |
      Bus Characteristics Register, used for bus enumeration with ENTDAA and
      determine device role and capabilities of the device on the bus.

  dcr:
    type: int
    description: |
      Device Characteristics Register, used for bus enumeration with ENTDAA.

  maximum-write:
    type: int
    default: 4095
    description: |
      Maximum number of bytes that I3C controller may write to I3C target per message.
      Range: 8 to 4095.

  maximum-read:
    type: int
    default: 4095
    description: |
      Maximum number of bytes that I3C controller may read from to I3C target per message.
      Range: 8 to 4095.
```

## dts/bindings/i3c/nxp,mcux-i3c.yaml
```yaml
# Copyright (c) 2019 NXP
# Copyright (c) 2022 Intel Corporation
#
# SPDX-License-Identifier: Apache-2.0

description: NXP MCUX I3C controller

compatible: "nxp,mcux-i3c"

include: [i3c-controller.yaml, pinctrl-device.yaml]

properties:
  reg:
    required: true

  interrupts:
    required: true

  i3c-od-scl-hz:
    type: int
    description: |
      Open Drain Frequency for the I3C controller. When undefined, use
      the controller default or as specified by the I3C specification.

  clk-divider:
    type: int
    description: Main clock divider for I3C
    required: true

  clk-divider-tc:
    type: int
    description: TC clock divider for I3C
    required: true

  clk-divider-slow:
    type: int
    description: Slow clock divider for I3C
    required: true

  disable-open-drain-high-pp:
    type: boolean
    description: |
      If false, open drain high time is 1 PPBAUD count,
      which is short high and long low.
      If true, open drain high time is same as ODBAUD
      so that open drain clock is 50% duty cycle.
      Default is false.
```

## dts/bindings/i3c/nxp,s32-i3c.yaml
```yaml
# Copyright 2022 NXP
# SPDX-License-Identifier: Apache-2.0

description: NXP S32 I3C controller

compatible: "nxp,s32-i3c"

include: [i3c-controller.yaml, pinctrl-device.yaml]

properties:
  reg:
    required: true

  clock-frequency:
    required: true
    type: int
    description: |
      Functional clock (in Hz) for I3C operation.

  interrupts:
    required: true

  i3c-od-scl-hz:
    type: int
    required: false
    description: |
      Open Drain frequency (in Hz) for the I3C controller. The frequency
      is fixed and cannot be changed. This is together with Push-pull and
      I2c frequency which can be set via i3c_configure API to change the
      baudrate at run time.

      When undefined, the default value will be used as specified by the
      I3C specification.
```

## dts/bindings/i3c/renesas,imx3112-i3c.yaml
```yaml
# Copyright (c) 2022 Google LLC.
# SPDX-License-Identifier: Apache-2.0

description: Renesas IMX3112 2:1 Bus multiplexer for I3C/I2C devices

compatible: "renesas,imx3112-i3c"

include: [i3c-mux-device.yaml]

properties:
  has-external-resistor:
    type: boolean
    description: |
      Configures LOCAL_INF_PULLUP_CONF in MR14 of IMX3112 spec.
      Indicates if the mux has an external pullup resistor (with pre-built resistance specs)
      or an internal, configurable, pullup resistor. If has-external-resistor is true,
      resistor-values will be ignored.
  io-voltage:
    type: string
    description: |
      Configures LOCAL_INF_IO_LEVEL in MR15 of IMX3112 spec.
      Indicates the IO voltage level in volts.
      If not present in device tree, will use the spec default
    enum:
      - "1.0"
      - "1.1"
      - "1.2"
      - "1.8"
      - "2.5"
      - "3.3"

child-binding:
  compatible: "renesas,imx3112-channel"
  properties:
    scl-resistance:
      type: string
      description: |
        Configures internal pullup resistance values for the SCL line.
        If has-external-resistor is true, the value will be ignored.
        Represents value in kilo-ohms.
      enum:
        - "0.5"
        - "1.0"
        - "2.0"
        - "4.0"
    sda-resistance:
      type: string
      description: |
        Configures internal pullup resistance values for the SCL line.
        If has-external-resistor is true, the value will be ignored.
        Represents value in kilo-ohms.
      enum:
        - "0.5"
        - "1.0"
        - "2.0"
        - "4.0"
```

## dts/bindings/i3c/renesas,ra-i3c.yaml
```yaml
# Copyright (c) 2025 Renesas Electronics Corporation
# SPDX-License-Identifier: Apache-2.0

description: Renesas RA I3C controller

compatible: "renesas,ra-i3c"

include: [i3c-controller.yaml, pinctrl-device.yaml]

properties:
  channel:
    type: int
    required: true

  reg:
    required: true

  clocks:
    required: true

  clock-names:
    required: true
    enum:
      - "pclk"
      - "tclk"
    description: |
      Clocks must be given corresponding names so that the shim driver can recognize them.
      "pclk": peripheral clock source
      "tclk": transfer clock source

  interrupts:
    required: true

  interrupt-names:
    required: true
    enum:
      - "resp"
      - "rx"
      - "tx"
      - "rcv"
      - "ibi"
      - "eei"
    description: |
      Interrupts must be given corresponding names so that the shim driver can recognize them.
      "resp": Command response interrupt
      "rx": Rx data buffer full interrupt
      "tx": Tx data buffer empty interrupt
      "rcv": Receive status buffer full interrupt
      "ibi": IBI data interrupt
      "eei": Error, timeout and HDR exit interrupt

  pinctrl-0:
    required: true

  pinctrl-names:
    required: true
```

## dts/bindings/i3c/snps,dw-i3c.yaml
```yaml
# Copyright (c) 2023 Intel Corporation
#
# SPDX-License-Identifier: Apache-2.0

description: Synopsys DesignWare I3C node

compatible: "snps,dw-i3c"

include: [i3c-controller.yaml, reset-device.yaml, pinctrl-device.yaml]

properties:
  core-clk:
    required: true
    type: int
```

## dts/bindings/i3c/st,stm32-i3c.yaml
```yaml
# Copyright (c) 2024 EXALT Technologies.
#
# SPDX-License-Identifier: Apache-2.0

description: STM32H5 I3C controller

compatible: "st,stm32-i3c"

include: [i3c-controller.yaml, pinctrl-device.yaml, reset-device.yaml]

properties:
  reg:
    required: true

  interrupts:
    required: true

  pinctrl-names:
    required: true

  resets:
    required: true

  dmas:
    description: |
      Optional DMA channel specifier, required for DMA transactions.

  dma-names:
    description: |
      DMA channel name. If DMA should be used, expected value is "rx" "tx" "tc" "rs".

      For example
         dma-names = "rx", "tx", "tc", "rs";
```

## dts/bindings/i3c/zephyr,i3c-emul.yaml
```yaml
# Copyright (c) 2026 Meta Platforms
# SPDX-License-Identifier: Apache-2.0

description: Zephyr I3C Emulation controller

compatible: "zephyr,i3c-emul"

include: i3c-controller.yaml

properties:
  reg:
    required: true
```
