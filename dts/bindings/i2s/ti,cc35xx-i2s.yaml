## dts/bindings/i2s/zephyr,fake-i2s.yaml
```yaml
# SPDX-FileCopyrightText: Copyright 2026 Nordic Semiconductor ASA
# SPDX-License-Identifier: Apache-2.0

description: |
    A Fake I2S controller for use as either a stub or a mock in Zephyr
    testing.

compatible: "zephyr,fake-i2s"

include: i2s-controller.yaml
```

## dts/bindings/i3c/infineon,i3c.yaml
```yaml
# SPDX-FileCopyrightText: Copyright (c) 2026 Infineon Technologies AG,
# SPDX-FileCopyrightText: or an affiliate of Infineon Technologies AG. All rights reserved.
#
# SPDX-License-Identifier: Apache-2.0

description: Infineon I3C controller (Synopsys DW I3C IP with Infineon wrapper)

compatible: "infineon,i3c"

include: snps,designware-i3c.yaml

properties:
  reg:
    required: true

  interrupts:
    required: true

  target-mode:
    type: boolean
    description: |
      Initialize this I3C instance in target mode instead of controller mode.
      Writes to DEV_OPERATION_MODE do not read back on this integration, so the
      boot role cannot be recovered from that field and is declared here.
```

## dts/bindings/i3c/microchip,xec-i3c.yaml
```yaml
# Copyright (C) 2020 Samsung Electronics Co., Ltd.
# Copyright (C) 2023 Meta Platforms
# Copyright (c) 2026 Microchip Technology Inc.
# SPDX-License-Identifier: Apache-2.0

description: |
    Microchip XEC I3C controller.

    The MEC SoCs integrate the Synopsys DesignWare DWC_mipi_i3c IP behind an
    XEC-specific wrapper, so this binding shares the i3c_dw.c driver with
    snps,designware-i3c. The wrapper adds a HOST_CFG port-select register, and
    routes the interrupt through the XEC Interrupt Aggregator (ECIA)

compatible: "microchip,xec-i3c"

include:
  - name: i3c-controller.yaml
  - name: pinctrl-device.yaml
  - name: microchip,dmec-ecia-girq.yaml

properties:
  reg:
    required: true

  interrupts:
    required: true

  clocks:
    required: true
    description: |
      PCR clock specifier: <&pcr regidx bitpos MCHP_XEC_PCR_CLK_I3C>.
      regidx and bitpos locate this controller's bit in the PCR sleep-enable /
      clock-required / reset-enable registers. The clock ID selects the 192 MHz
      I3C domain reported by the XEC clock control driver, which requires a SoC
      that selects HAS_MCHP_MEC_I3C.

  port-sel:
    type: int
    default: 0
    description: |
      I3C port selection written to HOST_CFG[2:0]. Selects which SoC pad group
      the controller drives. Must agree with the pinctrl-0 pin group.
```

## dts/bindings/i3c/snps,designware-i3c.yaml
```yaml
# Copyright (C) 2020 Samsung Electronics Co., Ltd.
# Copyright (C) 2023 Meta Platforms
# SPDX-License-Identifier: Apache-2.0

description: >
    This is a binding for the Synopsys I3C interface

compatible: "snps,designware-i3c"

include: [i3c-controller.yaml, pinctrl-device.yaml]

class: [i3c, i2c]

properties:
  clocks:
    required: true
```

## dts/bindings/ieee802154/qorvo,dw3000.yaml
```yaml
# Copyright The Zephyr Project Contributors
# SPDX-License-Identifier: Apache-2.0

description: |
  Qorvo DW3000 family of IEEE 802.15.4 HRP UWB transceivers (DW3110, DW3120,
  DW3210 and DW3220).

  The parts share one register map and are told apart by their device ID
  register. The SPI clock may run at up to 36 MHz.

  Example:

    &spi3 {
        dw3000@0 {
            compatible = "qorvo,dw3000";
            reg = <0>;
            spi-max-frequency = <8000000>;
            int-gpios = <&gpio1 2 GPIO_ACTIVE_HIGH>;
            reset-gpios = <&gpio0 25 GPIO_ACTIVE_LOW>;
        };
    };

compatible: "qorvo,dw3000"

include: spi-device.yaml

properties:
  int-gpios:
    type: phandle-array
    required: true
    description: |
      IRQ pin. The transceiver drives it high while an enabled event is
      pending.

  reset-gpios:
    type: phandle-array
    required: true
    description: |
      RSTn pin, active low. The transceiver drives this pin itself and it
      must never be driven high, so the driver either pulls it low or
      leaves it floating.

  wakeup-gpios:
    type: phandle-array
    description: |
      WAKEUP pin, active high. Leave this property out when the pin is tied
      to ground on the board.
```

## dts/bindings/iio/afe/voltage-divider.yaml
```yaml
# Copyright (c) 2019, Peter Bigot Consulting, LLC
# SPDX-License-Identifier: Apache-2.0

title: Voltage Divider

description: |
    Description for a voltage divider, with optional ability to measure
    resistance of the upper leg.

compatible: "voltage-divider"

include: [voltage-divider-common.yaml, sensor-device.yaml]
```

## dts/bindings/input/adsemi,tsm12.yaml
```yaml
# SPDX-FileCopyrightText: Copyright The Zephyr Project Contributors
# SPDX-License-Identifier: Apache-2.0

title: AD Semiconductor TSM12 12-channel capacitive touch sensor

description: |
  Also covers the register- and pin-compatible Si12T from Nanjing Zhongke
  Microelectronics.

  Each channel with an entry in input-codes reports an INPUT_EV_KEY event,
  pressed as soon as the sensor detects a touch of any strength.

compatible: "adsemi,tsm12"

include: i2c-device.yaml

properties:
  int-gpios:
    type: phandle-array
    description: |
      Interrupt line (open drain, active low), asserted when a channel
      detects a touch. The sensor is polled when this property is absent.

  input-codes:
    type: array
    required: true
    min-len: 1
    max-len: 12
    description: |
      Input event key codes (INPUT_KEY_* or INPUT_BTN_*), one per channel
      starting from channel 1. Channels without an entry are disabled.

  threshold-midpoints:
    type: array
    min-len: 1
    max-len: 12
    max: 7
    default: [3, 3, 3, 3, 3, 3, 3, 3, 3, 3, 3, 3]
    description: |
      Middle touch threshold of each channel (ChxM[2:0]), one entry per
      channel starting from channel 1; entries beyond input-codes are
      ignored. Higher values raise the threshold and make the channel less
      sensitive. The default corresponds to the reset value of the register
      field.

  threshold-windows:
    type: string-array
    min-len: 1
    max-len: 12
    enum:
      - "narrow"
      - "wide"
    default: ["wide", "wide", "wide", "wide", "wide", "wide",
              "wide", "wide", "wide", "wide", "wide", "wide"]
    description: |
      Spacing of the light and hard touch thresholds around the middle
      threshold (ChxHL), one entry per channel starting from channel 1;
      entries beyond input-codes are ignored. A touch is reported from the
      light touch threshold on. The default corresponds to the reset value
      of the register field.

      - "narrow": 20% below and above the middle threshold.
      - "wide": 30% below and above the middle threshold, which reports
        lighter touches.

      Example thresholds (capacitance change) with "narrow":

        Midpoint | Light touch | Middle | Hard touch
        ---------|-------------|--------|-----------
            0    |    0.40%    | 0.50%  |   0.60%
            3    |    0.95%    | 1.20%  |   1.45%
            7    |    2.85%    | 3.55%  |   4.30%

examples:
  - |
    #include <zephyr/dt-bindings/gpio/gpio.h>
    #include <zephyr/dt-bindings/input/input-event-codes.h>

    &i2c0 {
      touch@68 {
        compatible = "adsemi,tsm12";
        reg = <0x68>;
        int-gpios = <&gpio0 4 (GPIO_ACTIVE_LOW | GPIO_PULL_UP)>;
        input-codes = <INPUT_BTN_LEFT INPUT_BTN_MIDDLE INPUT_BTN_RIGHT>;
        threshold-windows = "narrow", "narrow", "narrow";
      };
    };
```

## dts/bindings/input/chipsourcetek,axs5106l.yaml
```yaml
# SPDX-FileCopyrightText: Copyright The Zephyr Project Contributors
# SPDX-License-Identifier: Apache-2.0

title: ChipSourceTek AXS5106L self-capacitive touch controller

description: |
  The AXS5106L is a self-capacitive touch controller with an I2C interface.
  It asserts its interrupt line when touch data is available.

compatible: "chipsourcetek,axs5106l"

include: [i2c-device.yaml, touchscreen-common.yaml]

properties:
  irq-gpios:
    type: phandle-array
    description: |
      Interrupt GPIO. Used by the controller to signal that touch data is
      available. Active low.

  reset-gpios:
    type: phandle-array
    description: |
      Reset GPIO. Active low. Leave it unset when the reset line is shared
      with the display controller, as a reset of the touch controller would
      then also reset the display. The display driver resets both
      controllers in that case.
```

## dts/bindings/input/goodix,gt1151.yaml
```yaml
# Copyright (c) 2026 Espressif Systems (Shanghai) Co., Ltd.
# SPDX-License-Identifier: Apache-2.0

description: Goodix GT1151 capacitive touch panel

compatible: "goodix,gt1151"

include: [i2c-device.yaml, touchscreen-common.yaml]

properties:
  irq-gpios:
    type: phandle-array
    description: Interrupt GPIO. Active level depends on the controller configuration.
  reset-gpios:
    type: phandle-array
    description: Reset GPIO used during initialization.
```

## dts/bindings/input/goodix,gt911.yaml
```yaml
# Copyright (c) 2020 NXP
# SPDX-License-Identifier: Apache-2.0

description: GT9xx / GT9xxx capacitive touch panels

compatible: "goodix,gt911"

include: [i2c-device.yaml, touchscreen-common.yaml]

properties:
  irq-gpios:
    type: phandle-array
    description: |
      Interrupt pin. It is held low across the reset sequence to make the
      controller select its primary I2C address. Leave it out on a board that
      does not route the pin. The address is then whatever the panel straps,
      so name the other one in alt-addr. CONFIG_INPUT_GT911_INTERRUPT requires
      this property.
  reset-gpios:
    type: phandle-array
  alt-addr:
    type: int
    description:
      Alternate I2C address for this device. When provided, the driver will
      use probing mode to determine the I2C address rather than setting the
      INT pin low to force a specific address
```

## dts/bindings/input/hynitron,cst3530.yaml
```yaml
# Copyright (c) 2024 Dylan Rowe
# SPDX-License-Identifier: Apache-2.0

description: Hynitron CST3530 touchscreen sensor

compatible: "hynitron,cst3530"

include: [i2c-device.yaml, touchscreen-common.yaml]

properties:
  irq-gpios:
    type: phandle-array
    required: true
    description: |
      The irq signal defaults to active low as produced by the
      sensor. The property value should ensure the flags properly
      describe the signal that is presented to the driver.

  reset-gpios:
    type: phandle-array
    description: |
      The reset signal defaults to active low to the
      sensor. The property value should ensure the flags properly
      describe the signal that is presented to the driver.
```
