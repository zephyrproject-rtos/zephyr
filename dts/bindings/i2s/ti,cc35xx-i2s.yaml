## dts/bindings/input/tsc-keys.yaml
```yaml
# Copyright (c) 2024 Arif Balik <arifbalik@outlook.com>
# SPDX-License-Identifier: Apache-2.0

description: |
  Input driver for STM32 Tocuh Sensing Controller (TSC).

  This node is a st,stm32-tsc grandchild node and applies filters and
  calculations to detect an input event on a group which is the child of
  st,stm32-tsc. For more information see drivers/misc/st,stm32-tsc.yaml

compatible: "tsc-keys"

include:
  - name: base.yaml
    property-allowlist:
      - compatible
      - zephyr,deferred-init
      - label
      - status

properties:
  sampling-interval-ms:
    type: int
    required: true
    description: |
      Sampling interval in milliseconds.
  oversampling:
    type: int
    required: true
    description: |
      Over sampling factor. The driver will take the average of the samples
      taken in the sampling interval and compare it with the previous sample.
      Larger values will reduce the noise but will increase the latency. The
      default value is 10 so the slope will be calculated every
      10 * sampling-interval-ms milliseconds.
  noise-threshold:
    type: int
    required: true
    description: |
      This value will be used to reject the noise for both
      directions of the slope.
  sticky-key-timeout-ms:
    type: int
    required: true
    description: |
      Time in milliseconds to wait before releasing a key. By default a release
      event will be generated after 10 seconds of the last press event if
      the key is still pressed.
  zephyr,code:
    type: int
    required: true
    description: Key code to emit.
  channel-io:
    type: int
    description: |
      Channel I/O within the parent group that this key node owns. Must be a
      single bit also present in the parent group's channel-ios mask.

      When the parent group declares more than one channel I/O (multi-channel
      multiplexing), this property is required so the driver can route the
      acquisition result for each I/O to the correct key. When the parent
      group declares exactly one channel I/O, this property may be omitted and
      the driver derives it from the parent's channel-ios mask.
    enum:
      - 1
      - 2
      - 4
      - 8

examples:
  - |
    #include <zephyr/dt-bindings/input/input-event-codes.h>
    #include <zephyr/dt-bindings/input/stm32-tsc-defines.h>

    /* Single channel I/O per group: channel-io may be omitted. */
    &tsc {
      compatible = "st,stm32-tsc";

      tsc_group6: g6 {
        /* ... */
        ts1 {
          compatible = "tsc-keys";
          sampling-interval-ms = <10>;
          oversampling = <10>;
          noise-threshold = <50>;
          zephyr,code = <INPUT_KEY_0>;
        };
      };
    };

  - |
    #include <zephyr/dt-bindings/input/input-event-codes.h>
    #include <zephyr/dt-bindings/input/stm32-tsc-defines.h>

    /* Multi-channel group: each tsc-keys child owns one channel I/O.
     * The driver multiplexes acquisitions across them.
     */
    &tsc {
      compatible = "st,stm32-tsc";
      st,acquisition-interval-ms = <10>;

      tsc_group2: g2 {
        group = <2>;
        channel-ios = <(TSC_IO2 | TSC_IO3 | TSC_IO4)>;
        sampling-io = <TSC_IO1>;

        ts_a {
          compatible = "tsc-keys";
          channel-io = <TSC_IO2>;
          sampling-interval-ms = <10>;
          oversampling = <10>;
          noise-threshold = <50>;
          zephyr,code = <INPUT_KEY_0>;
        };
        ts_b {
          compatible = "tsc-keys";
          channel-io = <TSC_IO3>;
          sampling-interval-ms = <10>;
          oversampling = <10>;
          noise-threshold = <50>;
          zephyr,code = <INPUT_KEY_1>;
        };
        ts_c {
          compatible = "tsc-keys";
          channel-io = <TSC_IO4>;
          sampling-interval-ms = <10>;
          oversampling = <10>;
          noise-threshold = <50>;
          zephyr,code = <INPUT_KEY_2>;
        };
      };
    };
```

## dts/bindings/input/wch,ch32-tkey.yaml
```yaml
# SPDX-FileCopyrightText: Copyright Michael Hope <michaelh@juju.nz>
# SPDX-License-Identifier: Apache-2.0

description: WCH CH32 Touch Key Detection (TKEY) peripheral

compatible: "wch,ch32-tkey"

include: [base.yaml, pinctrl-device.yaml]

properties:
  reg:
    required: true

  clocks:
    required: true

  interrupts:
    required: false

  poll-period-ms:
    type: int
    min: 1
    default: 20
    description: How often to poll the touch keys in milliseconds.

child-binding:
  description: Touch Key channel child node
  properties:
    channel:
      type: int
      min: 0
      max: 15
      required: true
      description: TKEY channel number.

    zephyr,code:
      type: int
      required: true
      min: 1
      description: Key or button code emitted on touch events.
```

## dts/bindings/input/zephyr,input-double-tap.yaml
```yaml
# Copyright 2024 Kelly Helmut Lord
# SPDX-License-Identifier: Apache-2.0

description: |
  Input double tap pseudo-device

  Listens for key events as an input and produces key events as output
  corresponding to double taps, and optionally to single taps.

  Can optionally be associated to a specific device to listen for events
  only from that device.

  A single tap is reported once the double tap delay expires without a second
  press, and only if the key has been released in the meantime, so that holding
  a key down does not generate a single tap event.

compatible: "zephyr,input-double-tap"

properties:
  input:
    type: phandle
    description: |
      Input device phandle, if not specified listen for input from all devices.

  input-codes:
    type: array
    required: true
    description: |
      Array of input event key codes (INPUT_KEY_* or INPUT_BTN_*).

  single-tap-codes:
    type: array
    description: |
      Array of key codes to be generated for single taps (INPUT_KEY_* or INPUT_BTN_*).

  double-tap-codes:
    type: array
    required: true
    description: |
      Array of key codes to be generated for double taps (INPUT_KEY_* or INPUT_BTN_*).

  double-tap-delay-ms:
    type: int
    required: true
    description: Maximum time delay between taps to register a double tap, in milliseconds.

examples:
  - |
    #include <zephyr/dt-bindings/input/input-event-codes.h>

    double_tap {
            input = <&buttons>;
            compatible = "zephyr,input-double-tap";
            input-codes = <INPUT_KEY_0>, <INPUT_KEY_1>;
            single-tap-codes = <INPUT_KEY_X>, <INPUT_KEY_Y>;
            double-tap-codes = <INPUT_KEY_A>, <INPUT_KEY_B>;
            double-tap-delay-ms = <300>;
    };
```

## dts/bindings/interrupt-controller/arm,gic-v3-its.yaml
```yaml
# Copyright (c) 2021 BayLibre, SAS
# SPDX-License-Identifier: Apache-2.0

description: GIC v3 Interrupt Translation Service

compatible: "arm,gic-v3-its"

include: base.yaml

properties:
  zephyr,device-id-bits:
    type: int
    min: 1
    max: 16
    default: 16
    description: |
      Number of DeviceID bits provisioned by the driver. This bounds the
      statically reserved Device table. The default covers the full 16-bit
      PCIe RequesterID space. Reduce this value when all DeviceIDs used by
      the platform fit in a narrower range to reduce static memory usage.

  reg:
    required: true
```

## dts/bindings/interrupt-controller/arm,versatile-vic.yaml
```yaml
# Copyright (c) 2026 Takayuki Goto
# SPDX-License-Identifier: Apache-2.0

description: ARM PL190 Vectored Interrupt Controller

compatible: "arm,versatile-vic"

include: [interrupt-controller.yaml, base.yaml]

properties:
  reg:
    required: true

  "#interrupt-cells":
    const: 2

interrupt-cells:
  - irq
  - priority
```

## dts/bindings/interrupt-controller/atmel,sam0-eic.yaml
```yaml
description: Atmel SAM0 series External Interrupt Controller

compatible: "atmel,sam0-eic"

include: base.yaml

properties:
  reg:
    required: true

  interrupts:
    required: true

  microchip,debounce-time-us:
    type: int
    description: |
      Requested debounce time in microseconds for all EIC lines.
      This enables the DPRESCALER + DEBOUNCEN hardware debouncer.
      Requires a slow EIC clock (e.g., GCLK1 @ OSCULP32K) configured
      via CONFIG_GPIO_SAM0_HW_DEBOUNCE. The driver calculates the
      best PRESCALER/STATES combination from the actual GCLK frequency.
      Only available on variants with DPRESCALER registers (N-variants,
      SAMD5x/E5x series).
```

## dts/bindings/interrupt-controller/brcm,bcm2712-mip.yaml
```yaml
# Copyright (c) 2026 Process Mission
# SPDX-License-Identifier: Apache-2.0

description: |
  Broadcom BCM2712 MSI interrupt proxy (MIP).

  The MIP receives MSI/MSI-X writes from PCIe endpoints and raises a
  GIC SPI for each write. The vector cell is the hardware channel
  number, used directly as the MSI message data and the MIP mask bit.

  The MIP is an interrupt nexus: `interrupt-map` describes the fixed
  connection from each hardware channel to a GIC SPI. The map defines
  the available channels and their host interrupts for static IRQ
  numbering in Zephyr.

  The Raspberry Pi 5 routes the RP1 south bridge through mip0.

compatible: "brcm,bcm2712-mip"

include: [interrupt-controller.yaml, base.yaml]

properties:
  reg:
    required: true
    description: |
      MIP register block. Only CPU-accessible resources belong in reg; the
      PCIe doorbell address is described by brcm,msi-pci-addr.

  interrupt-map:
    type: compound
    required: true
    description: |
      Maps a hardware channel to the host interrupt controller. Entry
      layout is <channel flags> <controller phandle> <controller specifier>.
      Entries must describe a nonempty, ascending consecutive range of
      channels below brcm,msi-num-spis and consecutive GIC SPIs. The first
      channel may be nonzero. Both sides use edge-triggered interrupts.

  msi-controller:
    type: boolean
    required: true

  brcm,msi-num-spis:
    type: int
    required: true
    description: |
      Number of hardware channels connected to GIC SPIs.
      Hardware channel numbers run from 0 to brcm,msi-num-spis - 1.
      The interrupt-map may expose a consecutive subset of these channels.

  brcm,msi-pci-addr:
    type: array
    required: true
    description: |
      PCIe bus address that endpoints write to in order to raise an MSI, as
      two cells (high, low). This is an address in the PCIe bus address space
      and is not translated through the parent bus ranges.

  brcm,msi-window-size:
    type: int
    required: true
    description: |
      Size in bytes of the doorbell window that the root complex must map
      from brcm,msi-pci-addr to the MIP register block.

interrupt-cells:
  - vector
  - flags
```

## dts/bindings/interrupt-controller/espressif,esp32-cpu-interrupt.yaml
```yaml
# Copyright (c) 2026 Espressif Systems (Shanghai) Co., Ltd.
# SPDX-License-Identifier: Apache-2.0

description: |
  One ESP32 CPU interrupt line that carries several interrupt matrix sources.

  An interrupt nexus, not an interrupt controller, so it adds no interrupt
  level. A consumer names only its matrix source; the map turns that into the
  <line flags irq> specifier of the espressif,esp32-intmux node:

      interrupt-parent = <&cpu_interrupt_5>;
      interrupts = <UART0_INTR_SOURCE>;

  resolves to intmux <5 0 UART0_INTR_SOURCE>, the 0 being the line's flags.

  The line's flags are given once, in ESP_CPU_INTERRUPT(n, flags), and are 0
  or ESP_INTR_FLAG_IRAM: every handler on the line, and everything it calls,
  runs with the flash cache off. A line without it is masked while the flash
  cache is off, and an interrupt raised meanwhile is taken when the line is
  unmasked.

  Write the node with ESP_CPU_INTERRUPT(n, flags) from
  <zephyr/dt-bindings/interrupt-controller/espressif-intmux-common.h>, so that
  "cpu-line" and the line in "interrupt-map" are written once.

compatible: "espressif,esp32-cpu-interrupt"

include: [interrupt-nexus.yaml, base.yaml]

properties:
  "#interrupt-cells":
    const: 1

  "#address-cells":
    const: 0

  cpu-line:
    type: int
    required: true
    description: CPU interrupt line this node stands for.

  interrupt-map-mask:
    required: true

  interrupt-map-pass-thru:
    required: true
```
