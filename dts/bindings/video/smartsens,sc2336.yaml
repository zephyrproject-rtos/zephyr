## dts/bindings/watchdog/lowrisc,opentitan-aontimer-2.0.0.yaml
```yaml
# Copyright The Zephyr Project Contributors
# SPDX-License-Identifier: Apache-2.0

description: |
  OpenTitan Always-On Timer, version 2.0.0.

  Version 2.0.0 widened the wakeup counter to 64 bits, which moved the
  watchdog registers up by 8 bytes. Use lowrisc,opentitan-aontimer for
  version 1.0.

compatible: "lowrisc,opentitan-aontimer-2.0.0"

include: lowrisc,opentitan-aontimer.yaml
```

## dts/bindings/watchdog/lowrisc,opentitan-aontimer.yaml
```yaml
# Copyright (c) 2023 Rivos Inc.
# SPDX-License-Identifier: Apache-2.0

description: |
  OpenTitan Always-On Timer, version 1.0.

  Use lowrisc,opentitan-aontimer-2.0.0 for version 2.0.0 and later, which
  have a different register map.

compatible: "lowrisc,opentitan-aontimer"

include: base.yaml

properties:
  reg:
    required: true

  interrupts:
    required: true

  clock-frequency:
    type: int
    description: AON-Timer frequency
    required: true

  wdog-lock:
    type: boolean
    description: |
      When set, lock watchdog configuration after setup until the next
      reset.
```

## dts/bindings/watchdog/microchip,mss-watchdog.yaml
```yaml
description: Microchip MPFS Watchdog

compatible: "microchip,mpfs-watchdog"

include: base.yaml

properties:
  reg:
    required: true

  reset-capable:
    description: |
      The Microchip MPFS provides 5 watchdogs, of which only one (watchdog 0) is able,
      when properly configured, to cause a system reset. The remaining 4 (1-4) can only
      trigger an interrupt to the E51 core.
    type: boolean

  clock-frequency:
    type: int
    description: AXI clock frequency information (Hz) for watchdog operation.
      The watchdog is fed by the same clock as the AXI, divided by a prescaling factor of 256.
    default: 300000000
```

## dts/bindings/watchdog/microchip,wdt-g1.yaml
```yaml
# Copyright (c) 2025-2026 Microchip Technologies Inc.
# SPDX-License-Identifier: Apache-2.0

title: Microchip Watchdog g1 driver

description: |
  Microchip Watchdog driver bindings.

  Group g1 Watchdog driver supports following hardware peripherals:
    - module name="WDT" id="U2251" version="1.1.0"
    - module name="WDT" id="03611" version="2b0"

compatible: "microchip,wdt-g1"

include: base.yaml

properties:
  reg:
    required: true
    description: |
      Specifies the base address and size of the register block for the watchdog
      timer.

  clocks:
    required: true
    description: |
     Defines the clock sources used by the watchdog timer peripheral.

  clock-names:
    required: true
    description: |
      Names of the clocks referenced in the "clocks" property, used to identify
      the clock sources

  max-installable-timeout-count:
    type: int
    required: true
    description: |
      Specifies the maximum number of timeout counts that can be configured for
      the watchdog timer.

  max-timeout-window:
    type: int
    required: true
    description: |
      Defines the maximum timeout window period for the watchdog timer.
      The value is specified in milliseconds.
      For example, 0x4000 represents 16384 milliseconds.

  max-timeout-window-mode:
    type: int
    required: true
    description: |
      Indicates the maximum timeout period in window mode for the watchdog
      timer.The value is specified in milliseconds.
      For example, 0x8000 represents 32768 milliseconds.

  min-window-limit:
    type: int
    required: true
    description: |
      Indicates the minimum window limit for the watchdog timer in window mode
      The value is specified in milliseconds.
      For example, 0x8 represents 8 milliseconds.

  run-in-standby:
    type: boolean
    description: |
      Enable or disable run-in-standby mode for watchdog timer peripheral.
```

## dts/bindings/watchdog/microchip,wdt-mss.yaml
```yaml
# SPDX-FileCopyrightText: Copyright The Zephyr Project
# SPDX-License-Identifier: Apache-2.0

title: Microchip Polarfire SoC Watchdog MSS driver

description: |
  Microchip Polarfire SoC MSS Watchdog driver bindings.

  This driver configures the watchdog peripherals provided by the Microchip Polarfire SoC MSS.

compatible: "microchip,wdt-mss"

include: base.yaml

properties:
  reg:
    required: true
    description: |
      Specifies the base address and size of the register block for the watchdog
      timer.

  interrupts:
    required: true

  reset-capable:
    description: |
      The Microchip MPFS provides 5 watchdogs, of which only one (watchdog 0) is able,
      when properly configured, to cause a system reset. The remaining 4 (1-4) can only
      trigger an interrupt to the E51 core.
    type: boolean

  clock-frequency:
    type: int
    description: AXI clock frequency information (Hz) for watchdog operation.
      The watchdog is fed by the same clock as the AXI, divided by a prescaling factor of 256.
    default: 300000000
```
