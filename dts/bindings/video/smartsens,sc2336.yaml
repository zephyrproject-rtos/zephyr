## dts/bindings/video/smartsens,sc2336.yaml
```yaml
# Copyright (c) 2026 Espressif Systems (Shanghai) Co., Ltd.
# SPDX-License-Identifier: Apache-2.0

description: |
  SmartSens SC2336 2 Mega-Pixel CMOS image sensor with a 2-lane MIPI CSI-2
  output.

compatible: "smartsens,sc2336"

include: i2c-device.yaml

properties:
  clocks:
    required: true
    description: Input clock of the sensor, which must run at 24 MHz.

  reset-gpios:
    type: phandle-array
    description: |
      GPIO connected to the sensor reset pin. The sensor is held in reset
      while this GPIO is asserted.

  powerdown-gpios:
    type: phandle-array
    description: |
      GPIO connected to the sensor power-down pin. The sensor is powered
      down while this GPIO is asserted.

child-binding:
  child-binding:
    include: video-interfaces.yaml
```

## dts/bindings/video/sony,imx219.yaml
```yaml
description: IMX219 8 Mega-Pixel CMOS image sensor

compatible: "sony,imx219"

include: i2c-device.yaml

properties:
  reset-gpios:
    type: phandle-array
    description: |
      The XCLR pin is asserted to cause a hard reset. The sensor
      receives this as an active-low signal.

child-binding:
  child-binding:
    include: video-interfaces.yaml
```

## dts/bindings/video/st,stm32-dcmi.yaml
```yaml
#
# Copyright (c) 2024 Charles Dias <charlesdias.cd@outlook.com>
#
# SPDX-License-Identifier: Apache-2.0
#

title: STM32 DCMI (Digital Camera Memory Interface)

description: |
    The STM32 DCMI (Digital Camera Memory Interface) allows
    capturing data via a parallel interface (DVP).

compatible: "st,stm32-dcmi"

include: [base.yaml, pinctrl-device.yaml]

properties:
  interrupts:
    required: true

  dmas:
    required: true
    description: |
      The first channel captures from the DCMI peripheral to memory. An optional
      second channel performs memory-to-memory copies, with both addresses
      incrementing. It is needed for frames exceeding the DMA transfer limit on
      controllers without double-buffer mode.

      phandle of DMA controller. The DMA controller should be compatible with
      DMA channel specifier. Specifies a phandle reference to the dma controller,
      the channel number, the slot number, channel configuration and finally features.

      dmas = <&dma1 0 75 (STM32_DMA_PERIPH_TO_MEMORY | STM32_DMA_PERIPH_NO_INC |
              STM32_DMA_MEM_INC | STM32_DMA_PERIPH_8BITS | STM32_DMA_MEM_32BITS |
              STM32_DMA_PRIORITY_HIGH) STM32_DMA_FIFO_FULL>;

      Example with a second channel on an STM32L4+ DMA controller:

      dmas = <&dma1 1 90 (STM32_DMA_PERIPH_TO_MEMORY | STM32_DMA_PERIPH_NO_INC |
              STM32_DMA_MEM_INC | STM32_DMA_PERIPH_32BITS | STM32_DMA_MEM_32BITS |
              STM32_DMA_PRIORITY_HIGH)>,
             <&dma2 1 0 (STM32_DMA_MEMORY_TO_MEMORY | STM32_DMA_PERIPH_INC |
              STM32_DMA_MEM_INC | STM32_DMA_PERIPH_32BITS | STM32_DMA_MEM_32BITS |
              STM32_DMA_PRIORITY_VERY_HIGH)>;
      dma-names = "rx", "m2m";

  dma-names:
    type: string-array
    description: |
      Optional channel names, in order: "rx" for peripheral capture and "m2m"
      for the optional memory-to-memory copy channel.

child-binding:
  child-binding:
    include: video-interfaces.yaml

examples:
  - |
    &dcmi {
      status = "okay";
      pinctrl-0 = <&dcmi_hsync_pa4 &dcmi_pixclk_pa6 &dcmi_vsync_pb7
                   &dcmi_d0_pc6 &dcmi_d1_pc7 &dcmi_d2_pe0 &dcmi_d3_pe1
                   &dcmi_d4_pe4 &dcmi_d5_pd3 &dcmi_d6_pe5 &dcmi_d7_pe6>;
      pinctrl-names = "default";

      port {
        dcmi_ep_in: endpoint {
          remote-endpoint-label = "ov2640_ep_out";
          bus-width = <8>;
          hsync-active = <0>;
          vsync-active = <0>;
          pclk-sample = <1>;
        };
      };
    };
```

## dts/bindings/video/zephyr,native-sim-video-fifo.yaml
```yaml
# Copyright The Zephyr Project Contributors
# SPDX-License-Identifier: Apache-2.0

description: |
  Native simulator video source reading raw frames from a host named pipe (FIFO).

  The application selects the frame format through the video API, and the host
  writer must produce frames of exactly that format.

  See the native_sim board documentation for how to feed the FIFO and for the
  details of the driver behaviour.

compatible: "zephyr,native-sim-video-fifo"

include: base.yaml

properties:
  fifo-path:
    type: string
    description: |
      Path of the host named pipe to read the frames from. The FIFO is created
      if it does not exist yet. Defaults to /tmp/zephyr-<device>-<pid>.fifo. It
      can be overridden at runtime with the --<device>=<path> command line
      option.

  poll-interval-ms:
    type: int
    default: 10
    description: |
      Delay before reading the host FIFO again when it did not provide a
      complete frame, either because no writer is attached or because the
      writer is slower than the driver. This does not limit the frame rate:
      the driver reads again immediately after a frame is completed.
```

## dts/bindings/virtualization/qemu,ivshmem-flat.yaml
```yaml
# Copyright The Zephyr Project Contributors
# SPDX-License-Identifier: Apache-2.0

description: |
  QEMU inter-VM shared memory device without PCI. A local QEMU machine
  wiring patch maps the register and shared memory regions at fixed
  addresses and optionally connects one output IRQ. These addresses and
  the IRQ must match the machine wiring; applications supply an overlay
  rather than relying on the unmodified QEMU board description.

  An ivshmem server is required even without interrupts. INTMASK (0x00)
  and INTSTATUS (0x04) are reserved: reads return zero and writes are
  ignored. They cannot mask, acknowledge, or identify notifications.
  IVPOSITION (0x08) contains the peer ID. DOORBELL (0x0c) takes the peer ID
  in bits 31:16 and the vector in bits 15:0.

compatible: "qemu,ivshmem-flat"

include: base.yaml

properties:
  reg:
    required: true
    description: |
      Two regions: the 0x10-byte memory-mapped registers, followed by the
      nonempty shared memory region. The shared memory size must match
      the QEMU shmem-size property and the ivshmem server configuration.

  reg-names:
    required: true
    description: Must contain "mmr" and "shmem", in that order.

  interrupts:
    description: |
      Optional single receive interrupt. Without it, shared memory,
      peer ID access, and sending notifications remain available, but
      registering a notification handler returns -ENOSYS. Sending and
      receiving notifications require CONFIG_IVSHMEM_DOORBELL.

  num-vectors:
    type: int
    default: 1
    enum: [1]
    description: |
      Number of server notification vectors. The single output IRQ does
      not identify which eventfd vector triggered it, so only vector 0
      is supported. Configure ivshmem-server with -n 1. The device cannot
      report or validate the server's vector count at runtime.
```

## dts/bindings/w1/maxim,ds2484.yaml
```yaml
# Copyright (c) 2022 Caspar Friedrich <c.s.w.friedrich@gmail.com>
# SPDX-License-Identifier: Apache-2.0

description: DS4284 Single-Channel 1-Wire Controller

compatible: "maxim,ds2484"

include: [i2c-device.yaml, w1-controller.yaml]

properties:
  slpz-gpios:
    type: phandle-array
    description: |
      Enable sleep mode, only available on DS4284. Active low.
```

## dts/bindings/w1/w1-master.yaml
```yaml
# Copyright (c) 2022 Thomas Stranger
# SPDX-License-Identifier: Apache-2.0

# Deprecated. Use w1-controller.yaml instead.

include: w1-controller.yaml
```

## dts/bindings/w1/w1-slave.yaml
```yaml
# Copyright (c) 2022, Thomas Stranger
# SPDX-License-Identifier: Apache-2.0

# Deprecated. Use w1-peripheral.yaml instead.

include: w1-peripheral.yaml
```

## dts/bindings/watchdog/adi,max20356-watchdog.yaml
```yaml
# Copyright (c) 2026 Analog Devices, Inc.
# SPDX-License-Identifier: Apache-2.0

description: |
  Analog Devices MAX20356/MAX20358 PMIC watchdog.

  Child node of the MAX20356 MFD parent. Exposes the standard Zephyr watchdog
  API.

  The watchdog is fed by reading the shared Int5 register, so it must own the
  parent's INTB path exclusively: it cannot be armed while any INTB event consumer
  is active, and no consumer can register an interrupt callback while it is armed.
  Registration is refused with -EBUSY in either direction.

compatible: "adi,max20356-watchdog"

include: base.yaml

properties:
  adi,lock-enable:
    type: boolean
    description: |
      Password-lock handling for the WDCntl register (guarded by LockMsk3.WDLck).
      When set the driver wraps every WDCntl write in the LockMsk/LockUnlock
      password sequence, so a watchdog left in its OTP-locked state stays writable
      through that sequence. When unset (default) WDCntl is written directly,
      skipping the password sequence; this requires the register to already be
      unlocked in hardware (the driver does not issue an unlock), otherwise the
      writes are dropped by the chip.
```

## dts/bindings/watchdog/arm,cmsdk-watchdog.yaml
```yaml
description: ARM CMSDK watchdog

compatible: "arm,cmsdk-watchdog"

include: base.yaml

properties:
  reg:
    required: true

  clocks:
    required: true

  resets-soc:
    type: int
    default: 1
    enum:
      - 0
      - 1
    description: |
      1 if a watchdog timeout reset reaches the whole SoC. Defaults to 1 so
      existing CMSDK boards keep accepting WDT_FLAG_RESET_SOC. Set 0 when the
      reset line does not reset the chip (for example it only resets a local
      CPU).

  resets-cpu:
    type: int
    default: 1
    enum:
      - 0
      - 1
    description: |
      1 if a watchdog timeout can reset the local CPU. Defaults to 1 so
      existing CMSDK boards keep accepting WDT_FLAG_RESET_CPU_CORE. Set 0
      when that reset mode is not wired.
```

## dts/bindings/watchdog/atmel,sam0-watchdog.yaml
```yaml
description: Atmel SAM0 watchdog

compatible: "atmel,sam0-watchdog"

include: base.yaml

properties:
  reg:
    required: true

  interrupts:
    required: true

  always-on:
    type: boolean
    description: |
      Enable Always-On mode (CTRLA.ALWAYSON). When set, the watchdog runs
      continuously and can only be disabled by a power-on reset. CONFIG and
      EWCTRL registers become read-only and their settings cannot be changed.

      This bit, once written, cannot be cleared except by a power-on reset.
      It can also be pre-programmed in the NVM User Row (fuse). When the
      fuse is set, this property has no effect — the watchdog is always-on
      regardless of the devicetree.
```

## dts/bindings/watchdog/cdns,wdt-r1p2.yaml
```yaml
# Copyright (c) 2026 David Paul-Beier
# SPDX-License-Identifier: Apache-2.0

description: Cadence watchdog timer (r1p2)

compatible: "cdns,wdt-r1p2"

include: base.yaml

properties:
  reg:
    required: true

  clock-frequency:
    type: int
    required: true
    description: Watchdog input clock frequency in Hz (CPU_1X on the Zynq-7000).
```

## dts/bindings/watchdog/espressif,esp32-rtc-wdt.yaml
```yaml
# Copyright (c) 2026 Espressif Systems (Shanghai) Co., Ltd.
# SPDX-License-Identifier: Apache-2.0

description: |
  ESP32 RTC watchdog timer (RWDT).

  The RTC watchdog runs from the RTC slow clock in the low-power domain.

compatible: "espressif,esp32-rtc-wdt"

include: base.yaml

properties:
  reg:
    required: true

  interrupts:
    required: true

  clocks:
    required: true
```

## dts/bindings/watchdog/espressif,esp32-watchdog.yaml
```yaml
# Copyright (c) 2019, Mohamed ElShahawi
# SPDX-License-Identifier: Apache-2.0

description: |
    ESP32 watchdog.

    ESP32 contains 3x Watchdog timers, 2x Main System Watchdog
    Timer (MWDT), 1x RTC Watchdog Timer (RWDT). This binding covers the
    MWDT. The RWDT uses the espressif,esp32-rtc-wdt binding.

compatible: "espressif,esp32-watchdog"

include: base.yaml

properties:
  reg:
    required: true
```

## dts/bindings/watchdog/infineon,match-wdt-common.yaml
```yaml
# SPDX-FileCopyrightText: Copyright (c) 2026 Linumiz
#
# SPDX-License-Identifier: Apache-2.0

description: |
  Common properties of the Infineon match watchdog timer. A free-running
  counter raises the match flag each time its compared low bits equal the
  match value. Clearing the flag services the watchdog, and the third match
  without a service resets the device.

include: base.yaml

properties:
  reg:
    required: true

  reg-names:
    required: true
    description: |
      "wdt" is the block that holds the counter and match registers. "intr"
      is the system resources interrupt block that holds the match flag.

  clocks:
    required: true
    description: Watchdog counter clock.
```

## dts/bindings/watchdog/infineon,match-wdt-srss-v1.yaml
```yaml
# SPDX-FileCopyrightText: Copyright (c) 2026 Linumiz
#
# SPDX-License-Identifier: Apache-2.0

title: Infineon PSOC 6 match watchdog timer

description: |
  Basic watchdog timer of PSOC 6 devices: a 16-bit counter with an enable
  bit and a register lock in the control register.

compatible: "infineon,match-wdt-srss-v1"

include: infineon,match-wdt-common.yaml
```

## dts/bindings/watchdog/infineon,match-wdt-srsslt.yaml
```yaml
# SPDX-FileCopyrightText: Copyright (c) 2026 Linumiz
#
# SPDX-License-Identifier: Apache-2.0

title: Infineon PSOC 4 match watchdog timer

description: |
  Basic watchdog timer of PSOC 4 devices with the S8SRSSLT system resources
  block. The 16-bit counter cannot be stopped; a disable key turns off the
  watchdog reset.

compatible: "infineon,match-wdt-srsslt"

include: infineon,match-wdt-common.yaml
```

## dts/bindings/watchdog/infineon,match-wdt.yaml
```yaml
# SPDX-FileCopyrightText: Copyright (c) 2026 Linumiz
#
# SPDX-License-Identifier: Apache-2.0

title: Infineon match watchdog timer

description: |
  Basic watchdog timer of CAT1B and PSOC Edge devices: a counter with an
  enable bit and a register lock in the control register, and a second
  match register that sets how many counter bits are compared.

compatible: "infineon,match-wdt"

include: infineon,match-wdt-common.yaml

properties:
  counter-bits:
    type: int
    required: true
    enum: [22, 32]
    description: Width of the watchdog counter in bits.
```

## dts/bindings/watchdog/infineon,tle927x-wdt.yaml
```yaml
# SPDX-FileCopyrightText: Copyright (c) 2026 Deere & Company
# SPDX-FileCopyrightText: Copyright (c) 2026 Linumiz
# SPDX-License-Identifier: Apache-2.0

description: |
  Infineon TLE927x SBC watchdog.

  The watchdog cannot be stopped while the SBC is in Normal mode, so
  wdt_disable() always fails.

  Only the exact hardware periods 10, 20, 50, 100, 200, 500 and 1000 ms are
  accepted for window.max.

  A non-zero window.min selects the window watchdog and must be at least 72%
  of window.max (datasheet 13.2.2 safe trigger area).

compatible: "infineon,tle927x-wdt"

include: base.yaml

on-bus: tle927x

properties:
  max-3-resets:
    type: boolean
    description: |
      Set WD_CTRL.MAX_3_RST. After 3 consecutive watchdog-failure resets the
      SBC stops generating further resets and stays in Normal or Stop mode.
      Leave unset for a safety watchdog that always resets.
```

## dts/bindings/watchdog/infineon,window-wdt.yaml
```yaml
# SPDX-FileCopyrightText: Copyright (c) 2026 Linumiz
#
# SPDX-License-Identifier: Apache-2.0

title: Infineon window watchdog timer

description: |
  Basic watchdog timer with window mode, found on TRAVEO T2G and XMC7000
  devices. Every service restarts the counter at zero. A service before the
  lower limit or no service before the upper limit resets the device, and
  reaching the warning limit raises an interrupt.

  The interrupt is optional. Without it the watchdog can only reset the
  device, and timeouts with a callback are rejected.

compatible: "infineon,window-wdt"

include: base.yaml

properties:
  reg:
    required: true

  clocks:
    required: true
    description: Watchdog counter clock (ILO0).
```
