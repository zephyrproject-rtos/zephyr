## dts/bindings/w1/zephyr,w1-serial.yaml
```yaml
# Copyright (c) 2022 Thomas Stranger
# SPDX-License-Identifier: Apache-2.0

# Properties for the serial 1-Wire master driver:
# No GPIOs need to be configured here, as this is already done in the serial
# driver. Typically 2 IOs are needed, but some microcontrollers have
# the option for a "single-wire Half-duplex" mode, where the TX and RX lines
# are internally connected, such that only a single IO
# needs to be allocated for the 1-Wire communication.

description: 1-Wire master over Zephyr uart

compatible: "zephyr,w1-serial"

include: [uart-device.yaml, w1-master.yaml]

properties:
  overdrive-data-baud:
    type: int
    default: 1000000
    description: |
      Baud rate for overdrive speed data communication. The default value of
      1000000 provides timing of t_low1=1.0us, t_low0=9.0us, t_slot=10.0us.

  overdrive-reset-baud:
    type: int
    default: 115200
    description: |
      Baud rate for overdrive speed reset/presence detection. The default value
      of 115200 provides timing of t_RSTL=52.1us, t_slot=86.8us.

examples:
  - |
    /* Basic Example */
    &uart1 {
        status = "okay";
        current-speed = <115200>;

        w1_bus: w1-bus {
            compatible = "zephyr,w1-serial";
            status = "okay";
        };
    };
  - |
    /* Custom Overdrive settings Example */
    &uart1 {
        status = "okay";
        current-speed = <115200>;

        w1_bus: w1-bus {
            compatible = "zephyr,w1-serial";
            status = "okay";
            overdrive-data-baud = <921600>;
            overdrive-reset-baud = <115200>;
        };
    };
```

## dts/bindings/watchdog/adi,max32-watchdog.yaml
```yaml
# Copyright (c) 2023 Analog Devices, Inc.
# SPDX-License-Identifier: Apache-2.0

description: MAX32XXX watchdog

compatible: "adi,max32-watchdog"

include: base.yaml

properties:
  reg:
    required: true

  clocks:
    required: true

  clock-source:
    type: int
    enum: [0, 1, 2, 3, 4, 5]
    description: |
      Clock source to be used by the WDT peripheral. The following options
      are available:
      - 0: "ADI_MAX32_PRPH_CLK_SRC_PCLK" Peripheral clock
      - 1: "ADI_MAX32_PRPH_CLK_SRC_EXTCLK" External Clock
      - 2: "ADI_MAX32_PRPH_CLK_SRC_IBRO" Internal Baud Rate Oscillator
      - 3: "ADI_MAX32_PRPH_CLK_SRC_ERFO" External Radio Frequency Oscillator
      - 4: "ADI_MAX32_PRPH_CLK_SRC_ERTCO" External Real-Time Clock Oscillator
      - 5: "ADI_MAX32_PRPH_CLK_SRC_INRO" Internal Ring Oscillator
      The target device might not support all option please take a look on
      target device user guide
```

## dts/bindings/watchdog/adi,max42500-watchdog.yaml
```yaml
# Copyright 2025, Analog Devices, Inc
# SPDX-License-Identifier: Apache-2.0

description: |
  Driver for setting up and using the MAX42500 voltage monitor/watchdog.

compatible: "adi,max42500-watchdog"

include: i2c-device.yaml

properties:

  "#address-cells":
    required: true
    const: 1

  "#size-cells":
    required: true
    const: 0

  wdiv:
    type: int
    description: |
      Watchdog clock divider (WDIV) value to adjust window values/calculations.
      If not set, the default value on the device loaded from OTP is used.

  enable-vmpd:
    type: boolean
    description: |
      Enable voltage-monitor power-down, to reduce IC power consumption when
      EN0 is low.

  mode:
    type: string
    enum:
      - default
      - sww
      - challenge_response
    description: |
      Enable watchdog mode to either simple windoweed watchdog or challenge/response.
      A value of "default" will leave whatever mode is loaded from OTP in place.

child-binding:
  description: |
    Configuration for a given input voltage for UV/OV monitoring
  properties:

    reg:
      type: int
      required: true
      description: |
        The specific voltage input channel to configure. Channels 1-5 are single ended,
        6 and 7 are differential.

    nominal-voltage:
      type: int
      description: |
        Channels 1-5 have a nominal voltage set, 6 and 7 are differential and only use UV/OV
        settings

    uv-limit:
      type: int
      required: true
      description: |
        Under voltage limit. For channels 1-5, this is a percentage over the nominal voltage.
        For channels 6 and 7, this is an absolute voltage.

    ov-limit:
      type: int
      required: true
      description: |
        Over voltage limit. For channels 1-5, this is a percentage over the nominal voltage.
        For channels 6 and 7, this is an absolute voltage.

    uvov-trigger-reset:
      type: boolean
      description: |
        Indicate that a UV/OV scenario for the channel should trigger a RESET condition.
```

## dts/bindings/watchdog/ambiq,watchdog.yaml
```yaml
# Copyright (c) 2023 Antmicro <www.antmicro.com>
# SPDX-License-Identifier: Apache-2.0

description: Ambiq Watchdog

compatible: "ambiq,watchdog"

include: base.yaml

properties:
  reg:
    required: true

  clock-frequency:
    type: int
    required: true

  interrupts:
    required: true
```

## dts/bindings/watchdog/andestech,atcwdt200.yaml
```yaml
#
# Copyright (c) 2023, Andes Technology Corporation.
#
# SPDX-License-Identifier: Apache-2.0
#

description: Andes Watchdog driver

compatible: "andestech,atcwdt200"

include: base.yaml

properties:
  reg:
    required: true

  interrupts:
    required: true
```

## dts/bindings/watchdog/arm,crsas-ma2-watchdog.yaml
```yaml
description: Arm Corstone Reference Systems Architecture Specification MA2 System Watchdog

compatible: "arm,crsas-ma2-watchdog"

include: base.yaml

properties:
  reg:
    required: true
    description: |
      CRSAS-MA2 System Watchdog has two 4KB frames. If they
      are contiguous, then this is the base address for the 8KB window
      where the control frame is first and the refresh frame is second.
      If they are not contiguous, then a second set of register
      address+length should be specified for the refresh frame.

  interrupts:
    required: true
    description: |
      Interrupt for both watchdog status signals:
        - Index 0: WS0 (First stage/ Warning interrupt)
        - Index 1: WS1 (Second stage, Reset interrupt) optional
```

## dts/bindings/watchdog/atmel,sam-watchdog.yaml
```yaml
# Copyright (c) 2018, Atmel Corporation
# SPDX-License-Identifier: Apache-2.0

description: ATMEL SAM0 watchdog

compatible: "atmel,sam-watchdog"

include: base.yaml

properties:
    reg:
      required: true

    interrupts:
      required: true

    peripheral-id:
      type: int
      description: peripheral ID
      required: true
```
