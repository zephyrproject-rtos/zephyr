## dts/bindings/video/video-interfaces.yaml
```yaml
# Copyright 2024 NXP
# SPDX-License-Identifier: Apache-2.0

# Common properties for video interface endpoints.

description: |
  A video pipeline usually consists of several devices, e.g. camera sensors, video
  data receivers, video data processors, etc. Data interfaces on these devices are
  described by their child 'port' nodes. Configuration of a port depends on other
  devices in the pipeline and is described by 'endpoint' subnodes.

  If a port can be configured to work with more than one remote device on the same
  bus, an 'endpoint' child node must be provided for each of them. If more than one
  port is present in a device node or there is more than one endpoint at a port, or
  port node needs to be associated with a selected hardware interface, a common
  scheme using '#address-cells', '#size-cells' and 'reg' properties is used.

  All 'port' nodes can be grouped under an optional 'ports' node, which allows to
  specify #address-cells, #size-cells properties independently for the 'port' and
  'endpoint' nodes. For example:

    video_device {
      ...
      ports {
          #address-cells = <1>;
          #size-cells = <0>;

          port@0 {
              ...
              endpoint@0 { ... };
              endpoint@1 { ... };
          };
          port@1 { ... };
      };
    };

  Two 'endpoint' nodes must be linked with each other via their 'remote-endpoint'
  phandles. However, Zephyr does not allow circular dependency, so direct phandle
  references are currently not possible. A 'remote-endpoint-label' string is used
  instead to be able to specify, at least, the label of the peer remote-endpoint.
  For example:

          source: endpoint {
              compatible = "zephyr,video-interfaces";
              remote-endpoint-label = "sink";
          };

          sink: endpoint{
              compatible = "zephyr,video-interfaces";
              remote-endpoint-label = "source";
          };

  This binding contains the most common properties needed to configure an endpoint
  subnode for data exchange with other device. In most cases, properties at the
  peer 'endpoint' node will be identical, however they might be different when
  there is any signal modifications on the bus between two devices, e.g. there are
  logic signal inverters on the lines.

properties:
  remote-endpoint-label:
    required: true
    type: string
    description: |
      Label of the 'remote-endpoint' subnode that interfaces with this endpoint.
      This property is used as a 'work-around' to be able to declare the remote
      endpoint and should be replaced by a "remote-endpoint" phandle property when
      Zephyr devicetree supports circular dependency in the future.

  bus-type:
    type: int
    enum:
      - 1 # MIPI CSI-2 C-PHY
      - 2 # MIPI CSI1
      - 3 # CCP2
      - 4 # MIPI CSI-2 D-PHY
      - 5 # Parallel
      - 6 # BT.656
    description: |
      Data bus type.

  data-shift:
    type: int
    description: |
      On parallel data busses, if bus-width is used to specify the number of
      data lines, data-shift can be used to specify which data lines are used,
      e.g. "bus-width=<8>; data-shift=<2>;" means, that lines 9:2 are used.

  hsync-active:
    type: int
    enum:
      - 0 # low
      - 1 # high
    description: |
      Active state of the HSYNC signal

  vsync-active:
    type: int
    enum:
      - 0 # low
      - 1 # high
    description: |
      Active state of the VSYNC signal.

  pclk-sample:
    type: int
    enum:
      - 0 # falling
      - 1 # rising
      - 2 # both
    description: |
      Sample data on falling, rising or both edges of the pixel clock signal.

  link-frequencies:
    type: array
    description: |
      Allowed data bus frequencies. For MIPI CSI-2, for instance, this is the
      actual frequency of the bus, not bits per clock per lane value.

# For serial bus only
  clock-lane:
    type: int
    description: |
      Physical clock lane index. Position of an entry determines the logical
      lane number, while the value of an entry indicates physical lane, e.g. for
      a MIPI CSI-2 bus we could have "clock-lane = <0>;", which places the
      clock lane on hardware lane 0. This property is valid for serial busses
      only (e.g. MIPI CSI-2).

  data-lanes:
    type: array
    description: |
      An array of physical data lane indexes. Position of an entry determines
      the logical lane number, while the value of an entry indicates physical
      lane, e.g. for 2-lane MIPI CSI-2 bus we could have "data-lanes = <1 2>;",
      assuming the clock lane is on hardware lane 0. If the hardware does not
      support lane reordering, monotonically incremented values shall be used
      from 0 or 1 onwards, depending on whether or not there is also a clock
      lane. This property is valid for serial busses only (e.g. MIPI CSI-2).

# For parallel bus only
  bus-width:
    type: int
    description: |
      Number of data lines actively used, only valid for parallel busses.
```

## dts/bindings/video/zephyr,sw-generator.yaml
```yaml
# Copyright 2024 tinyVision.ai Inc.
# SPDX-License-Identifier: Apache-2.0

compatible: "zephyr,sw-generator"

description: |
  Software-based video pattern generator for testing purpose.
  This generates an image pattern in the RAM buffer passed to it,
  at the specified dimension.

include: base.yaml
```

## dts/bindings/video/zephyr,uvc-device.yaml
```yaml
# Copyright (c) 2024 tinyVision.ai Inc.
# SPDX-License-Identifier: Apache-2.0

description: |
  USB Video Class instance

  The Video Class will present a video endpoint to interconnect with any video
  device. It supports multiple endpoints, each becoming its own video streaming
  interface to the host.

  The devices that are connected will receive calls to all query and configure
  the formats, frame intervals, video controls, and get the feed started via
  their video API. Some of this information is used to generate the USB device
  descriptors sent to the host, with the supported format and controls listed.

  Example for single endpoint connected to mipi0:

    uvc0: uvc {
      compatible = "zephyr,uvc-device";
      port {
        uvc0_ep_in: endpoint {
          remote-endpoint-label = "mipi0_ep_out";
        };
      };
    };

  Example for multiple endpoints connected to mipi0 and mipi1:

    uvc0: uvc {
      compatible = "zephyr,uvc-device";
      port {
        #address-cells = <1>;
        #size-cells = <0>;

        uvc0_ep0_in: endpoint@0 {
          reg = <0x0>;
          remote-endpoint-label = "mipi0_ep_out";
        };

        uvc0_ep1_in: endpoint@1 {
          reg = <0x1>;
          remote-endpoint-label = "mipi1_ep_out";
        };
      };
    };

compatible: "zephyr,uvc-device"

include: base.yaml

on-bus: usb

child-binding:
  child-binding:
    include: video-interfaces.yaml
```

## dts/bindings/video/zephyr,video-emul-imager.yaml
```yaml
# Copyright 2024 tinyVision.ai Inc.
# SPDX-License-Identifier: Apache-2.0

description: Emulated Imager for testing purpose

compatible: "zephyr,video-emul-imager"

include: i2c-device.yaml

child-binding:
  child-binding:
    include: video-interfaces.yaml
```

## dts/bindings/video/zephyr,video-emul-rx.yaml
```yaml
# Copyright 2024 tinyVision.ai Inc.
# SPDX-License-Identifier: Apache-2.0

description: Emulated Video DMA engine for testing purpose

compatible: "zephyr,video-emul-rx"

include: base.yaml

child-binding:
  child-binding:
    include: video-interfaces.yaml
    properties:
      reg:
        type: int
        enum:
          - 0 # for input endpoint
          - 1 # for output endpoint
```

## dts/bindings/video/zephyr,video-sw-generator.yaml
```yaml
# Copyright 2025 tinyVision.ai Inc.
# SPDX-License-Identifier: Apache-2.0

description: Emulated Video test pattern generator

compatible: "zephyr,video-sw-generator"
```

## dts/bindings/video/zephyr,video-sw-pipeline.yaml
```yaml
# Copyright 2025 tinyVision.ai Inc.
# SPDX-License-Identifier: Apache-2.0

description: Emulated Video test pattern pipeline

compatible: "zephyr,video-sw-pipeline"

include: base.yaml

child-binding:
  child-binding:
    include: video-interfaces.yaml
```

## dts/bindings/video_mux/nxp,imx-video-mux.yaml
```yaml
#
# Copyright (c) 2019, Linaro Limited
#
# SPDX-License-Identifier: Apache-2.0
#

description: NXP MCUX video mux for the control between the camera and display

compatible: "nxp,imx-video-mux"

include: base.yaml

properties:
    label:
      required: true
```

## dts/bindings/virtio/virtio,mmio.yaml
```yaml
# Copyright (c) 2025 TOKITA Hiroshi
# SPDX-License-Identifier: Apache-2.0

description: VIRTIO over MMIO

compatible: "virtio,mmio"

include: [base.yaml]
```

## dts/bindings/virtio/virtio,pci.yaml
```yaml
# Copyright (c) 2024 Antmicro <www.antmicro.com>
# SPDX-License-Identifier: Apache-2.0

description: VIRTIO over PCI

compatible: "virtio,pci"

include: [base.yaml, pcie-device.yaml]
```

## dts/bindings/virtio/xen,virtio-mmio-backend.yaml
```yaml
# Copyright (c) 2025 TOKITA Hiroshi
# SPDX-License-Identifier: Apache-2.0

description: Xen Platform Control Registers

compatible: "xen,virtio-mmio-backend"

include: base.yaml

properties:
  reg:
    required: true

  interrupts:
    required: true
```

## dts/bindings/virtualization/qemu,ivshmem.yaml
```yaml
# Copyright (c) 2021 Intel Corporation
# SPDX-License-Identifier: Apache-2.0

description: ivShMem device properties

compatible: "qemu,ivshmem"

include: [base.yaml, pcie-device.yaml]

properties:

  ivshmem-v2:
    type: boolean
    description: |
      Use ivshmem-v2.
      Primarily used for IPC in the Jailhouse hypervisor.
      ivshmem-v2 is not compatible with v1.
```

## dts/bindings/w1/adi,max32-w1.yaml
```yaml
# Copyright (c) 2023-2024 Analog Devices, Inc.
# SPDX-License-Identifier: Apache-2.0

description: ADI MAX32xxx MCUs 1-Wire Master

include: [w1-master.yaml, pinctrl-device.yaml]

compatible: "adi,max32-w1"

properties:
  reg:
    required: true

  clocks:
    required: true

  interrupts:
    required: true

  pinctrl-0:
    required: true

  pinctrl-names:
    required: true

  internal-pullup:
    required: true
    type: int
    enum: [0, 1]
    description: |
      Set this field to enable the internal pullup resistor.
      0 - Internal pullup disabled.
      1 - Internal pullup enabled.

  external-pullup:
    type: int
    enum: [0, 1, 2]
    description: |
      Set this field to enable the external pullup.
      0 - Pullup pin is active high when enabled.
      1 - Pullup pin is active low when enabled.
      2 - Pullup pin is not used for an external pullup.

  long-line-mode:
    type: boolean
    description: |
      Long Line Mode Enable
      Selects alternate timings for 1-Wire communication.
      The recommended setting depends on the length of the wire.
      For lines less than 40 meters, 0 should be used.

      Setting this bit to 0 leaves the write one release,
      the data sampling, and the time-slot recovery times at
      approximately 5us (micro second), 15us, and 7us, respectively.

      Setting this bit to 1 enables long line mode timings during standard mode communications.
      This mode moves the write one release, the data sampling,
      and the time-slot recovery times out to approximately 8us, 22us, and 14us, respectively.

      0 - Standard operation for lines less than 40 meters.
      1 - Long Line mode enabled.
```

## dts/bindings/w1/maxim,ds2477_85_common.yaml
```yaml
# Copyright (c) 2022 Thomas Stranger
# SPDX-License-Identifier: Apache-2.0

# Common Properties for the DS2477 and DS2485 I2C 1-Wire masters:

include: [w1-master.yaml, i2c-device.yaml]

properties:
  switching-threshold:
    type: string
    required: true
    enum:
      - "low"
      - "medium"
      - "high"
      - "off"
    description: |
      Default Low-to-High Switching Threshold.

      Only the following values are allowed:
        low:     0.25 x VCC, no hysteresis
        medium:  0.40 x VCC, no hysteresis (recommended for most configurations)
        high:    0.75 x VCC, with hysteresis
        off:     off (chip reset value)

  active-pull-threshold:
    type: string
    required: true
    enum:
      - "low"
      - "medium"
      - "high"
      - "off"
    description: |
      Default Active Pullup on Threshold configuration.
      For configurations with a single slave a "low" active pull
      threshold is recommended.

      Only the following values are allowed:
        low:     0.25 x VCC (recommended for most configurations)
        medium:  0.40 x VCC
        high:    0.75 x VCC
        off:     off (chip reset value)

  weak-pullup:
    type: string
    required: true
    enum:
      - "extern"
      - "500"
      - "1000"
      - "333"
    description: |
      Default 1-Wire Weak Pullup Resistance in ohms.
      For most configurations with a single slave "1000" ohms are recommended,
      but some devices and multidrop configurations might need a stronger pullup.

      To enter floating condition, it is suggested to switch the weak-pull up
      to extern and disable the switching as well as the active-pull threshold.

      Only the following values are allowed:
        "extern" (chip reset value)
        "500"
        "1000" (recommended for most configurations)
        "333"

  standard-slew:
    type: int
    default: 150
    enum:
      - 50
      - 150
      - 1300
    description: |
      Default slew for standard speed mode in ns. Only the following values are
      allowed:
        50
        150   (default; chip reset value)
        1300

  overdrive-slew:
    type: int
    default: 50
    enum:
      - 50
      - 150
    description: |
      Default slew for overdrive speed mode in ns. Only the following values are
      allowed:
        50    (default; chip reset value)
        150
```

## dts/bindings/w1/maxim,ds2482-800-channel.yaml
```yaml
# Copyright (c) 2022 Caspar Friedrich <c.s.w.friedrich@gmail.com>
# SPDX-License-Identifier: Apache-2.0

description: DS4282-800, 8-Channel 1-Wire Master (Channel driver)

compatible: "maxim,ds2482-800-channel"

include: [w1-master.yaml]

on-bus: ds2482-800
```

## dts/bindings/w1/maxim,ds2482-800.yaml
```yaml
# Copyright (c) 2022 Caspar Friedrich <c.s.w.friedrich@gmail.com>
# SPDX-License-Identifier: Apache-2.0

description: DS4282-800, 8-Channel 1-Wire Master

compatible: "maxim,ds2482-800"

include: [i2c-device.yaml]

bus: ds2482-800
```

## dts/bindings/w1/maxim,ds2485.yaml
```yaml
# Copyright (c) 2022 Thomas Stranger
# SPDX-License-Identifier: Apache-2.0

# Properties for the DS2485 I2C 1-Wire master with memory driver:

description: |
    This is a representation of the Maxim DS2485 I2C 1-Wire master w/ memory

compatible: "maxim,ds2485"

include: ["maxim,ds2477_85_common.yaml", "i2c-device.yaml"]
```

## dts/bindings/w1/zephyr,w1-gpio.yaml
```yaml
# Copyright (c) 2023 Hudson C. Dalpra
# SPDX-License-Identifier: Apache-2.0

description: |
  Zephyr W1 GPIO node

  This defines a one-wire driver through GPIO bit-banging.

  Implementation details:
    - Most drivers require the selected gpio to support open drain, this enables onewire
      devices to lower the signal when the SOC set the signal high.
    - Ensure pullup is strong enough (4.7K according to the specification). Standard pullup in
      SOC are usually weak, and may not be strong enough.

compatible: "zephyr,w1-gpio"

include: [w1-master.yaml]

properties:
  gpios:
    type: phandle-array
    required: true

examples:
  - |

    / {
          w1: w1 {
                   compatible = "zephyr,w1-gpio";
                   /* Configure pin as open-drain with internal pull-up resistor. */
                   gpios = <&gpio0 13 (GPIO_ACTIVE_HIGH | GPIO_OPEN_DRAIN | GPIO_PULL_UP)>;
           };
    };
```
