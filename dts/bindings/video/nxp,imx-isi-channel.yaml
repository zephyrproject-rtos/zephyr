## dts/bindings/video/nxp,imx-isi-channel.yaml
```yaml
# Copyright 2026 NXP
# SPDX-License-Identifier: Apache-2.0

description: NXP i.MX Image Sensing Interface (ISI) channel

compatible: "nxp,imx-isi-channel"

# Note: This is a logical channel node; 'reg' is the channel index, not a MMIO
# address range, so we do not include base.yaml.

properties:
  reg:
    required: true
    type: int
    description: ISI channel index

  interrupts:
    type: array
    required: true

  input-port:
    type: int
    description: |
      ISI input port number for this channel. If omitted, the parent ISI node
      'input-port' value (or its default) is used.

child-binding:
  child-binding:
    child-binding:
      include: video-interfaces.yaml
```

## dts/bindings/video/nxp,imx-isi.yaml
```yaml
# Copyright 2026 NXP
# SPDX-License-Identifier: Apache-2.0

description: NXP i.MX Image Sensing Interface (ISI) core

compatible: "nxp,imx-isi"

include: [base.yaml, pinctrl-device.yaml]

properties:
  reg:
    required: true

  input-port:
    type: int
    default: 0
    description: Default ISI input port number for channels.
```

## dts/bindings/video/nxp,imx-mipi-csi.yaml
```yaml
# Copyright 2026 NXP
# SPDX-License-Identifier: Apache-2.0

description: NXP iMX MIPI CSI Host Controller

compatible: "nxp,imx-mipi-csi"

include: [base.yaml]

properties:
  reg:
    required: true

  phys:
    type: phandle
    required: true
    description: PHY device phandle

child-binding:
  child-binding:
    child-binding:
      include: video-interfaces.yaml
```

## dts/bindings/video/nxp,imx-mipi-csi2.yaml
```yaml
# Copyright 2026 NXP
# SPDX-License-Identifier: Apache-2.0

title: NXP i.MX MIPI CSI-2 Host Controller

description: |
  This binding describes the NXP i.MX MIPI CSI-2 receiver controller.

  The CSI-2 controller is used to capture video streams from an upstream
  CSI-2 compliant source such as a camera sensor or test generator.

  It is integrated into the video pipeline using the devicetree graph
  bindings (ports and endpoints).

  Users must define input and output ports and connect them to the
  corresponding video components.

compatible: "nxp,imx-mipi-csi2"

include: [base.yaml]

properties:
  reg:
    required: true

  phys:
    type: phandle
    required: true
    description: PHY device phandle

child-binding:
  child-binding:
    child-binding:
      include: video-interfaces.yaml

examples:
  - |
    mipi_dphy: dphy@4ad20000 {
        compatible = "nxp,imx95-dphy-rx";
        reg = <0x4ad20000 0x10000>;
        clocks = <&scmi_clk IMX95_CLK_MIPIPHYCFG>;
        clock-names = "phy_cfg";
        power-domains = <&camera_mix>;
        #phy-cells = <0>;
        status = "okay";
    };

    mipi_csi: csi@4ad30000 {
        compatible = "nxp,imx-mipi-csi2";
        reg = <0x4ad30000 0x10000>;
        phys = <&mipi_dphy>;
        clocks = <&scmi_clk IMX95_CLK_CAMAPB>;
        clock-names = "pixel";
        power-domains = <&camera_mix>;
        status = "okay";

        ports {
            #address-cells = <1>;
            #size-cells = <0>;

            port@0 {
                reg = <0>;

                csi_in: endpoint {
                    remote-endpoint = <&gen_ep_out>;
                    bus-type = <VIDEO_BUS_TYPE_CSI2_DPHY>;
                    data-lanes = <1 2 3 4>;
                };
            };
        };
    };

    video_gen: video {
        compatible = "vnd,video-single-port";
        status = "okay";

        port {
            gen_ep_out: endpoint {
                remote-endpoint = <&csi_in>;
            };
        };
    };
```

## dts/bindings/video/nxp,imx95-dphy-rx.yaml
```yaml
# Copyright 2026 NXP
# SPDX-License-Identifier: Apache-2.0

title: NXP i.MX95 MIPI D-PHY RX

description: |
  NXP i.MX95 MIPI D-PHY receiver. Provides the physical layer for the
  MIPI CSI-2 host controller (nxp,imx-mipi-csi2).

  The DPHY is initialized by the CSI-2 controller driver and does not
  require a standalone driver. It is referenced via the phys phandle
  in the CSI-2 node.

compatible: "nxp,imx95-dphy-rx"

include: [base.yaml]

properties:
  reg:
    required: true

  clocks:
    required: true

  clock-names:
    required: true
    description: Must contain "phy_cfg"

  power-domains:
    required: true

  "#phy-cells":
    type: int
    required: true
    const: 0
    description: |
      Number of cells in a PHY specifier. Must be 0 since no additional
      arguments are needed when referencing this PHY.
```

## dts/bindings/video/nxp,jpegdec.yaml
```yaml
#
# Copyright 2026 NXP
#
# SPDX-License-Identifier: Apache-2.0
#

description: The NXP JPEG decoder can decode JPEG/mJPEG compressed frames.

compatible: "nxp,jpegdec"

include: base.yaml

properties:
  reg:
    required: true
```

## dts/bindings/video/nxp,mipi-csi2rx.yaml
```yaml
#
# Copyright 2024 NXP
#
# SPDX-License-Identifier: Apache-2.0
#

description: NXP MIPI CSI-2 Rx interface

compatible: "nxp,mipi-csi2rx"

include: [base.yaml]

child-binding:
  child-binding:
    child-binding:
      include: video-interfaces.yaml
```

## dts/bindings/video/nxp,pngdec.yaml
```yaml
#
# Copyright 2026 NXP
#
# SPDX-License-Identifier: Apache-2.0
#

description: The NXP PNG decoder can decode PNG compressed frames.

compatible: "nxp,pngdec"

include: base.yaml

properties:
  reg:
    required: true
```

## dts/bindings/video/nxp,pxp.yaml
```yaml
#
# Copyright 2025 NXP
#
# SPDX-License-Identifier: Apache-2.0
#

description: NXP MCUX PxP

compatible: "nxp,pxp"

include: base.yaml

properties:
  reg:
    required: true

  interrupts:
    required: true
```

## dts/bindings/video/nxp,video-smartdma.yaml
```yaml
# Copyright 2024 NXP
# SPDX-License-Identifier: Apache-2.0

description: NXP SmartDMA Video Driver

compatible: "nxp,video-smartdma"

include: [base.yaml, pinctrl-device.yaml]

properties:
  vsync-pin:
    required: true
    type: int
    description: |
      GPIO0 pin index to use for VSYNC input. Only pins 0-15 may be used.
  hsync-pin:
    required: true
    type: int
    description: |
      GPIO0 pin index to use for HSYNC input. Only pins 0-15 may be used.
  pclk-pin:
    required: true
    type: int
    description: |
      GPIO0 pin index to use for PCLK input. Only pins 0-15 may be used.

child-binding:
  child-binding:
    include: video-interfaces.yaml
```

## dts/bindings/video/onnn,ap1302.yaml
```yaml
# Copyright 2026 NXP
# SPDX-License-Identifier: Apache-2.0

description: |
  ONNN AP1302 Camera ISP.

  This device is an upstream video subdevice (similar to a V4L2 subdevice in
  Linux). It does not provide a capture queue itself; instead it is controlled
  by the application and streams video to a downstream MIPI CSI-2 receiver.
  The connection is described via port/endpoint nodes using
  remote-endpoint-label.

  Note: This device requires a firmware binary blob provided by ON Semiconductor.
  The firmware is NOT distributed as part of Zephyr. Users must download it
  separately from https://github.com/ONSemiconductor/ap1302_binaries and ensure
  they comply with the "AP1302 Software License Agreement".

compatible: "onnn,ap1302"

include: [i2c-device.yaml, pinctrl-device.yaml]

child-binding:
  child-binding:
    include: video-interfaces.yaml

    properties:
      bus-type:
        required: true

      data-lanes:
        required: true

examples:
  - |
    #include <zephyr/dt-bindings/gpio/gpio.h>

    reserved-memory {
        #address-cells = <1>;
        #size-cells = <1>;
        ranges;

        ap1302_fw_part: ap1302-fw@87000000 {
                reg = <0x87000000 0x00040000>;
                status = "okay";
        };
    };

    ap1302: ap1302@3c {
        compatible = "onnn,ap1302";
        reg = <0x3c>;
        reset-gpios = <&gpio1 10 GPIO_ACTIVE_LOW>;
        isp-en-gpios = <&gpio1 11 GPIO_ACTIVE_HIGH>;
        standby-gpios = <&gpio1 12 GPIO_ACTIVE_HIGH>;
        power-supplies = <&vddio &vdda>;
        firmware-partition = <&ap1302_fw_part>;

        port {
            ap1302_ep_out: endpoint {
                remote-endpoint-label = "csi2rx_ep_in";
                bus-type = <4>; /* MIPI CSI-2 D-PHY */
                data-lanes = <1 2>;
            };
        };
    };

properties:
  reset-gpios:
    type: phandle-array
    required: true
    description: GPIO connected to reset pin

  isp-en-gpios:
    type: phandle-array
    required: true
    description: GPIO isp enable pin

  standby-gpios:
    type: phandle-array
    required: false
    description: GPIO connected to standby pin

  power-supplies:
    type: phandles
    required: false
    description: Power supply regulators in sequence

  firmware-partition:
    type: phandle
    required: true
    description: |
      Phandle to a devicetree node that describes where the AP1302 firmware blob
      is stored, via its `reg` property.

      This can point to a `fixed-partitions` partition node (flash storage) or a
      `reserved-memory` region (e.g. firmware preloaded in DDR).


  clocks:
    type: phandle-array
    required: false
    description: Clock phandle for MCLK

  clock-names:
    type: string-array
    required: false
    description: Clock names
```

## dts/bindings/video/ovti,ov5640.yaml
```yaml
# Copyright 2024 NXP
# SPDX-License-Identifier: Apache-2.0

description: OV5640 CMOS video sensor

compatible: "ovti,ov5640"

include: i2c-device.yaml

properties:
  reset-gpios:
    type: phandle-array
    description: |
      The RESETB pin is asserted to cause a hard reset. The sensor
      receives this as an active-low signal.
  powerdown-gpios:
    type: phandle-array
    description: |
      The PWDN pin is asserted to disable the sensor. The sensor
      receives this as an active-high signal.

child-binding:
  child-binding:
    include: video-interfaces.yaml
```

## dts/bindings/video/ovti,ov5642.yaml
```yaml
# Copyright (c) 2025 Silicon Signals Pvt. Ltd.
# SPDX-License-Identifier: Apache-2.0

description: OV5642 CMOS video sensor

compatible: "ovti,ov5642"

include: i2c-device.yaml

properties:
  reset-gpios:
    type: phandle-array
    description: |
      The RESETB pin is asserted to cause a hard reset. The sensor
      receives this as an active-low signal.
  pwdn-gpios:
    type: phandle-array
    description: |
      The PWDN pin is asserted to disable the sensor. The sensor
      receives this as an active-high signal.

child-binding:
  child-binding:
    include: video-interfaces.yaml
```

## dts/bindings/video/ovti,ov7670.yaml
```yaml
# Copyright 2024 NXP
# SPDX-License-Identifier: Apache-2.0

description: OV7670 CMOS video sensor

compatible: "ovti,ov7670"

properties:
  reset-gpios:
    type: phandle-array
    description: |
      The RESETn pin is asserted to disable the sensor causing a hard
      reset. The sensor receives this as an active-low signal.
  pwdn-gpios:
    type: phandle-array
    description: |
      The PWDN pin is asserted to power down the sensor. The sensor
      receives this as an active high signal

include: i2c-device.yaml
```

## dts/bindings/video/ovti,ov7675.yaml
```yaml
# Copyright 2024, 2026 NXP
# SPDX-License-Identifier: Apache-2.0

description: OV7675 CMOS video sensor

compatible: "ovti,ov7675"

properties:
  reset-gpios:
    type: phandle-array
    description: |
      The RESETn pin is asserted to disable the sensor causing a hard
      reset. The sensor receives this as an active-low signal.
  pwdn-gpios:
    type: phandle-array
    description: |
      The PWDN pin is asserted to power down the sensor. The sensor
      receives this as an active high signal
  pclk-hb-disable:
    type: boolean
    description: |
      If set, PCLK does not toggle during the horizontal blank period.
      When not set, PCLK is free running and continues to toggle during
      horizontal blanking (COM10[5] = 0, default).

include: i2c-device.yaml

child-binding:
  child-binding:
    include: video-interfaces.yaml
```

## dts/bindings/video/ovti,ov7725.yaml
```yaml
# Copyright (c) 2020, FrankLi Limited
# SPDX-License-Identifier: Apache-2.0

description: OV7725 CMOS video sensor

compatible: "ovti,ov7725"

properties:
    reset-gpios:
      type: phandle-array
      required: false
      description: |
        The RESETn pin is asserted to disable the sensor causing a hard
        reset.  The sensor receives this as an active-low signal.

include: i2c-device.yaml
```

## dts/bindings/video/ovti,ov9655.yaml
```yaml
# Copyright 2025 ST Microelectronics
# SPDX-License-Identifier: Apache-2.0

description: OV9655 CMOS video sensor

compatible: "ovti,ov9655"

properties:
  reset-gpios:
    type: phandle-array
    description: |
      The RESETn pin is asserted to disable the sensor causing a hard
      reset. The sensor receives this as an active-low signal.
  pwdn-gpios:
    type: phandle-array
    description: |
      The PWDN pin is asserted to power down the sensor. The sensor
      receives this as an active high signal

include: i2c-device.yaml
```

## dts/bindings/video/raspberrypi,video-pio-dma.yaml
```yaml
# Copyright The Zephyr Project Contributors
# SPDX-License-Identifier: Apache-2.0

# example:
# &pinctrl {
# 	pio0_hm01b0_default: pio0_hm01b0_default {
# 		group1 {
# 			pinmux = <PIO0_P6>,<PIO0_P7>,<PIO0_P8>,<PIO0_P9>,<PIO0_P10>,<PIO0_P11>,<PIO0_P12>;
# 			input-enable;
# 		};
# 	};
# };

# &pio0 {
# 	status = "okay";
# 	video_pio_dma: video_pio_dma{
# 		compatible = "raspberrypi,video-pio-dma";
# 		vsync-gpios = <&gpio0 6 GPIO_ACTIVE_HIGH>;
# 		hsync-gpios = <&gpio0 7 GPIO_ACTIVE_HIGH>;
# 		pclk-gpios = <&gpio0 8 GPIO_ACTIVE_HIGH>;
# 		data-gpios = <&gpio0 9 GPIO_ACTIVE_HIGH>;
# 		pinctrl-0 = <&pio0_hm01b0_default>;
# 		pinctrl-names = "default";
# 		status = "okay";
# 		dma = <&dma>;
#     data-bits = <0x4>;
# 		port {
# 			video_pio_dma_ep_in: endpoint {
# 				remote-endpoint-label = "hm01b0_ep_out";
# 			};
# 		};
# 	};
# };


description: Raspberrypi PIO-DMA Video Driver

compatible: "raspberrypi,video-pio-dma"

include: ["raspberrypi,pico-pio-device.yaml"]

properties:
  vsync-gpios:
    required: true
    type: phandle-array
    description: |
      GPIO to use for VSYNC input.
  hsync-gpios:
    required: true
    type: phandle-array
    description: |
      GPIO to use for HSYNC input.
  pclk-gpios:
    required: true
    type: phandle-array
    description: |
      GPIO to use for PCLK input.
  data-gpios:
    required: true
    type: phandle-array
    description: |
      GPIO to use for PCLK input.
  dma:
    required: true
    type: phandle
    description: |
      DMA device handle to configure with the PIO engine.
  data-bits:
    type: int
    default: 0x1
    description: Camera input data width. 1/4/8 bits
    enum: [1, 4, 8]

child-binding:
  child-binding:
    include: video-interfaces.yaml
```
