## dts/bindings/video/renesas,ra-ceu.yaml
```yaml
# Copyright (c) 2025 Renesas Electronics Corporation
# SPDX-License-Identifier: Apache-2.0

description: Renesas RA Capture Engine Unit Driver (ceu)

compatible: "renesas,ra-ceu"

include: [base.yaml, pinctrl-device.yaml]

properties:
  reg:
    required: true

  clocks:
    required: true

  clock-names:
    required: true
    enum:
      - "pclk"
      - "cam-xclk"

  swap-8bits:
    type: boolean
    description: Bytes may be swapped in 8-bit units

  swap-16bits:
    type: boolean
    description: Bytes may be swapped in 16-bit units

  swap-32bits:
    type: boolean
    description: Bytes may be swapped in 32-bit units

  burst-transfer:
    required: true
    type: int
    enum:
      - 32  # Transfers data to the bus in 32-byte units
      - 64  # Transfers data to the bus in 64-byte units
      - 128 # Transfers data to the bus in 128-byte units
      - 256 # Transfers data to the bus in 256-byte units
    description: |
      Specifies the data transfer unit size to the bus bridge module.

child-binding:
  child-binding:
    include: video-interfaces.yaml

    properties:
      hsync-active:
        required: true

      vsync-active:
        required: true

      pclk-sample:
        required: true

      vsync-sample:
        required: true
        type: int
        enum:
          - 0 # Falling edge
          - 1 # Rising edge
        description: |
          Sample on the falling or rising edge of the vsync signal.

      hsync-sample:
        required: true
        type: int
        enum:
          - 0 # Falling edge
          - 1 # Rising edge
        description: |
          Sample on the falling or rising edge of the hsync signal.

      bus-width:
        required: true
        type: int
        enum:
          - 8   # Use 8 data lines for the parallel interface
          - 16  # Use 16 data lines for the parallel interface
```

## dts/bindings/video/sony,imx335.yaml
```yaml
# Copyright (c) 2025 STMicroelectronics.
# SPDX-License-Identifier: Apache-2.0

description: IMX335 CMOS Solid-state Color Image Sensor

compatible: "sony,imx335"

include: i2c-device.yaml

properties:
  clocks:
    description: Reference Input clock
    required: true

  reset-gpios:
    type: phandle-array
    description: |
      The XCLR pin is asserted to cause a hard reset. The sensor
      receives this as an active-low signal.

child-binding:
  child-binding:
    include: video-interfaces.yaml
```

## dts/bindings/video/st,mipid02.yaml
```yaml
# Copyright (c) 2025 STMicroelectronics.
# SPDX-License-Identifier: Apache-2.0

title: MIPID02 CSI to DVP interface bridge

description: |
    The MIPID02 allows connecting a DVP sensor to a CSI-2–enabled
    camera receiver.

compatible: "st,mipid02"

include: i2c-device.yaml

properties:
  reset-gpios:
    type: phandle-array
    description: |
      The XCLR pin is asserted to cause a hard reset. The sensor
      receives this as an active-low signal.

child-binding:
  child-binding:
    child-binding:
      include: video-interfaces.yaml
```

## dts/bindings/video/st,stm32-dcmipp.yaml
```yaml
#
# Copyright (c) 2025 STMicroelectronics.
#
# SPDX-License-Identifier: Apache-2.0
#

description: |
    STM32 Digital Camera Memory Interface Pixel Processor (DCMIPP).

    Example of node configuration at board level:

    &dcmipp {
      status = "okay";

      ports {
        #address-cells = <1>;
        #size-cells = <0>;

        port@0 {
          reg = <0>;
          dcmipp_ep_in: endpoint {
            remote-endpoint-label = "imx335_ep_out";
            data-lanes = <1 2>;
          };
        };
      };
    };

compatible: "st,stm32-dcmipp"

include: [base.yaml, pinctrl-device.yaml, reset-device.yaml]

properties:
  reg:
    required: true

  clocks:
    required: true

  clock-names:
    required: true

  interrupts:
    required: true

  resets:
    required: true

child-binding:
  child-binding:
    include: video-interfaces.yaml

    properties:
      bus-type:
        required: true
```

## dts/bindings/video/st,stm32-jpeg.yaml
```yaml
#
# Copyright (c) 2025 STMicroelectronics.
#
# SPDX-License-Identifier: Apache-2.0
#

title: STM32 JPEG HW Codec

description: |
    The STM32 JPEG HW codec can decode JPEG compressed frames
    and encode uncompressed frames to the JPEG format.

compatible: "st,stm32-jpeg"

include: [base.yaml, reset-device.yaml]

properties:
  reg:
    required: true

  clocks:
    required: true

  interrupts:
    required: true

  resets:
    required: true
```

## dts/bindings/video/st,stm32-venc.yaml
```yaml
#
# Copyright (c) 2025 STMicroelectronics.
#
# SPDX-License-Identifier: Apache-2.0
#
title: STM32 video encoder (VENC)

description: |
    STMicroelectronics STM32 video encoder peripheral (VENC).

compatible: "st,stm32-venc"

include: [base.yaml, reset-device.yaml]

properties:
  interrupts:
    required: true

  clocks:
    required: true

  resets:
    required: true
```

## dts/bindings/video/st,vd56g3.yaml
```yaml
# SPDX-FileCopyrightText: Copyright The Zephyr Project Contributors
# SPDX-FileCopyrightText: Copyright (c) 2026 LANDROVAL
# SPDX-License-Identifier: Apache-2.0

description: |
  STMicroelectronics VD56G3 / VB56G3 1.5 MP monochrome global shutter
  CMOS image sensor (1124 x 1364) with MIPI CSI-2 D-PHY output (1 or 2 lanes)
  and I2C (CCI) control interface.

  VD56G3 = bare die (sensor as reconstructed wafer).
  VB56G3 = OBGA package.

  External Vertical Timing (VT) sync allows multiple cameras to be operated
  in lock-step:
    - "leader"   : the sensor drives an FSYNC_OUT pulse on one of its 8
                   GPIOs (st,out-sync property).
    - "follower" : the sensor waits for an external pulse on GPIO0 before
                   each frame (st,in-sync property, GPIO0 only).

compatible: "st,vd56g3"

include: i2c-device.yaml

properties:
  clocks:
    description: |
      External input clock (CLKIN) feeding the sensor. Must be in the
      6 MHz - 27 MHz range. The sensor firmware is preconfigured for 12 MHz.
    required: true

  reset-gpios:
    type: phandle-array
    description: |
      XSHUTDOWN pin. Asserted low to keep the device in HW_STANDBY,
      released (high) to start the boot sequence. The driver receives this
      as an active-low signal.

  st,out-sync:
    type: array
    description: |
      List of on-sensor GPIO pin indices (0..7, not a Zephyr ``gpio``
      phandle) to configure as FSYNC_OUT output, pulsed at the start of every
      frame. Used to make this sensor act as a *leader* for one or more
      downstream cameras in a multi-camera array.

  st,in-sync:
    type: boolean
    description: |
      When set, configure on-sensor GPIO0 as VT_SLAVE_MODE input. The sensor
      will then wait for an external sync pulse on GPIO0 before each frame,
      making it act as a *follower*. Only GPIO0 supports this mode.

  st,csi-lane0-polarity-invert:
    type: boolean
    description: |
      Invert the differential polarity (P/N swap) of CSI-2 data lane 0 on the
      sensor side. Useful when the physical routing swaps the lane P/N pairs.

  st,csi-lane1-polarity-invert:
    type: boolean
    description: |
      Invert the differential polarity (P/N swap) of CSI-2 data lane 1 on the
      sensor side.

  st,csi-clock-polarity-invert:
    type: boolean
    description: |
      Invert the differential polarity (P/N swap) of the CSI-2 clock lane on
      the sensor side.

child-binding:
  child-binding:
    include: video-interfaces.yaml
```
