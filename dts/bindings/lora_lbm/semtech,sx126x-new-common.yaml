## dts/bindings/mbox/nordic,nrf-bellboard-remote.yaml
```yaml
# Copyright (c) 2024 Nordic Semiconductor ASA
# SPDX-License-Identifier: Apache-2.0

description: |
  Nordic BELLBOARD

  BELLBOARD provides support for inter-domain software signaling. It implements
  a set of tasks and events intended for signaling within an interprocessor
  communication (IPC) framework. When used in remote mode, the BELLBOARD
  instance is used to trigger events to another core.

  Example definition:

    bellboard: mailbox@deadbeef {
      compatible = "nordic,nrf-bellboard-remote";
      reg = <0xdeadbeef 0x1000>;
      #mbox-cells = <1>;
    };

compatible: "nordic,nrf-bellboard-remote"

include: "nordic,nrf-bellboard-common.yaml"
```

## dts/bindings/mbox/nordic,nrf-bellboard-tx.yaml
```yaml
# Copyright (c) 2024 Nordic Semiconductor ASA
# SPDX-License-Identifier: Apache-2.0

description: |
  Nordic BELLBOARD

  BELLBOARD provides support for inter-domain software signaling. It implements
  a set of tasks and events intended for signaling within an interprocessor
  communication (IPC) framework. When used in the tx mode, the BELLBOARD
  instance is used to trigger events to another core.

  Example definition:

    bellboard: mailbox@deadbeef {
      compatible = "nordic,nrf-bellboard-tx";
      reg = <0xdeadbeef 0x1000>;
      #mbox-cells = <1>;
    };

compatible: "nordic,nrf-bellboard-tx"

include: "nordic,nrf-bellboard-common.yaml"
```

## dts/bindings/mbox/nordic,nrf-vevif-common.yaml
```yaml
# Copyright (c) 2024 Nordic Semiconductor ASA
# SPDX-License-Identifier: Apache-2.0

include: mailbox-controller.yaml

properties:
  nordic,tasks:
    type: int
    required: true
    description: Number of tasks supported by the VEVIF instance.

  nordic,tasks-mask:
    type: int
    required: true
    description: Mask of tasks supported by the VEVIF instance.

mbox-cells:
  - channel
```

## dts/bindings/mbox/nordic,nrf-vevif-event-rx.yaml
```yaml
# Copyright (c) 2024 Nordic Semiconductor ASA
# SPDX-License-Identifier: Apache-2.0

description: |
  Nordic VEVIF (VPR Event Interface) - EVENT RX MODE

  VEVIF provides support for inter-domain software signaling. It implements a set of events
  intended for signaling within the interprocessor communication (IPC) framework.
  When used in the event rx mode, the VEVIF events are used to receive IRQs that are
  triggered by the VPR core.

  Example definition:

    cpuppr_vpr: vpr@deadbeef {
      ...
      cpuflpr_vevif_event_rx: mailbox@0 {
        compatible = "nordic,nrf-vevif-event-rx";
        reg = <0x0 0x1000>;
        interrupts = <76 NRF_DEFAULT_IRQ_PRIORITY>;
        #mbox-cells = <1>;
        nordic,events = <1>;
        nordic,events-mask = <0x00008000>;
      };
    };

compatible: "nordic,nrf-vevif-event-rx"

include: [base.yaml, mailbox-controller.yaml]

properties:
  nordic,events:
    type: int
    required: true
    description: Number of events supported by the VEVIF instance.

  nordic,events-mask:
    type: int
    required: true
    description: Mask of events supported by the VEVIF instance.

  interrupts:
    required: true

  reg:
    required: true

mbox-cells:
  - channel
```

## dts/bindings/mbox/nordic,nrf-vevif-event-tx.yaml
```yaml
# Copyright (c) 2024 Nordic Semiconductor ASA
# SPDX-License-Identifier: Apache-2.0

description: |
  Nordic VEVIF (VPR Event Interface) - EVENT TX MODE

  VEVIF provides support for inter-domain software signaling. It implements a set of events
  intended for signaling within the interprocessor communication (IPC) framework.
  When used in the event tx mode, the VEVIF events are used to trigger IRQs from VPR
  to a remote core.

  Example definition:

    cpuppr_vpr: vpr@deadbeef{
      ...
      cpuflpr_vevif_event_tx: mailbox {
        compatible = "nordic,nrf-vevif-event-tx";
        #mbox-cells = <1>;
        nordic,events = <1>;
        nordic,events-mask = <0x00008000>;
      };
    };

compatible: "nordic,nrf-vevif-event-tx"

include: [base.yaml, mailbox-controller.yaml]

properties:
  nordic,events:
    type: int
    required: true
    description: Number of events supported by the VEVIF instance.

  nordic,events-mask:
    type: int
    required: true
    description: Mask of events supported by the VEVIF instance.

mbox-cells:
  - channel
```
