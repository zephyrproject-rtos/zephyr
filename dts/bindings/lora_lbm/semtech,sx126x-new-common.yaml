## dts/bindings/lora_lbm/semtech,sx126x-new-common.yaml
```yaml
# Copyright (c) 2024 Semtech Corporation
# SPDX-License-Identifier: Apache-2.0

description: Semtech SX126X LoRa radio module

include: spi-device.yaml

properties:
  reset-gpios:
    type: phandle-array
    required: true
    description: |
      GPIO connected to the radio's NRESET signal.

      This signal is open-drain, active-low as interpreted by the modem.

  busy-gpios:
    type: phandle-array
    required: true
    description: |
      GPIO connected to the radio's BUSY signal.

      This signal is high when the radio is ready to accept commands, and
      low when it is processing a command.


  dio1-gpios:
    type: phandle-array
    description: |
      GPIO connected to the radio's DIO1 signal. This GPIO will be used as
      a generic IRQ line from the chip.

  dio2-gpios:
    type: phandle-array
    description: |
      GPIO connected to the radio's DIO2 signal. This GPIO will be used as
      a generic IRQ line from the chip.

      Note that this conflicts with dio2-as-rf-switch.

  dio2-as-rf-switch:
    type: boolean
    description: |
      Use DIO2 to drive an RF switch selecting between the TX and RX paths.

      When enabled, DIO2 goes high when the chip is transmitting.
      Note that this conflicts with dio2-gpios.

  dio3-gpios:
    type: phandle-array
    description: |
      GPIO connected to the radio's DIO3 signal. This GPIO will be used as
      a generic IRQ line from the chip.

      Note that this conflicts with dio3-as-tcxo-enable.

  dio3-as-tcxo-control:
    type: boolean
    description: |
      Use DIO3 to control a TCXO.

      When enabled, DIO3 supplies power to a TCXO when needed. Its voltage is
      controlled by tcxo-voltage.
      Note that this conflicts with dio3-gpios.

  tcxo-voltage:
    type: int
    required: true
    description: |
      Supply voltage on the radio's DIO3, if set as TCXO control.

      See constants SX126X_TCXO_SUPPLY_* in dt-bindings/lora_lbm/sx126x.h.

  tcxo-wakeup-time:
    type: int
    required: true
    description: |
      In milliseconds, the wakeup (or stabilization) time of the TCXO used
      by the radio.

      Set this value to 0 to disable the TCXO management feature.

  xtal-capacitor-value-xta:
    type: int
    description: |
      Internal trimming capacitor value on the radio's XTA pin as register value.

      Values from 0x00 to 0x2F code a capacitance from 11.3pF to 33.4pF, in
      approximative 0.47pF steps, as described in section 4.1.3 of the datasheet.

      Values over 0x2F are not supported. Ignored when a TCXO is configured.

  xtal-capacitor-value-xtb:
    type: int
    description: |
      Internal trimming capacitor value on the radio's XTB pin as register value.

      Values from 0x00 to 0x2F code a capacitance from 11.3pF to 33.4pF, in
      approximative 0.47pF steps, as described in section 4.1.3 of the datasheet.

      Values over 0x2F are not supported. Ignored when a TCXO is configured.

  reg-mode:
    type: int
    required: true
    enum:
      - 0
      - 1
    description: |
      Configuration of the radio's power regulator mode.

      See constants SX126X_REG_MODE_* in dt-bindings/lora_lbm/sx126x.h

  rx-boosted:
    type: boolean
    description: |
      Sets the radio in RX Boosted mode, allowing a ~2dB increased sensitivity,
      at the expense of a ~2mA higher current consumption in RX mode.

  tx-power-offset:
    type: int
    description: |
      Default board-specific TX Power offset in dB. Defaults to 0.

      Can be reconfigured at runtime via radio_utilities_set_tx_power_offset.
```

## dts/bindings/lpm/renesas,ra-lpm-module.yaml
```yaml
# Copyright (c) 2024 MUNIC SA
# SPDX-License-Identifier: Apache-2.0

description: |
  Renesas RA LPM module ID
  The Renesas Low Power Manager module handles starting and stopping
  peripherals, as well as switching between low power modes and speed modes.

properties:
  lpm-id:
    type: int
    required: true
    description: |
      The id of the LPM peripheral as seen by the lpm module.
```

## dts/bindings/lpm/renesas,ra2-lpm.yaml
```yaml
# Copyright (c) 2023-2024 MUNIC SA
# SPDX-License-Identifier: Apache-2.0

include: base.yaml

description: |
  RA2 family LPM

  The Renesas Low Power Manager module handles starting and stopping
  peripherals, as well as switching between low power modes and speed modes.

compatible: "renesas,ra2-lpm"

properties:
  reg:
    required: true
  reg-names:
    required: true
```

## dts/bindings/lps/intel,adsp-lps.yaml
```yaml
# Copyright (c) 2022 Intel Corporation
#
# SPDX-License-Identifier: Apache-2.0

description: Intel Low Power Sequencer

compatible: "intel,adsp-lps"

include: base.yaml

properties:
    reg:
      required: true
```

## dts/bindings/mbox/adi,mbox-max32-sema.yaml
```yaml
# Copyright 2024 Analog Devices, Inc
# SPDX-License-Identifier: Apache-2.0

description: ADI MAX32 SEMA Mailbox

compatible: "adi,mbox-max32-sema"

include: [base.yaml, mailbox-controller.yaml]

properties:
  reg:
    required: true

  interrupts:
    required: true

  msg-payloads:
    type: boolean
    description: Enable 32-bit data payloads, in addition to signaling.

  "#mbox-cells":
    const: 1

mbox-cells:
  - channel
```

## dts/bindings/mbox/ambiq,mbox-ipc.yaml
```yaml
# Copyright (c) 2025 Ambiq Micro Inc.
# SPDX-License-Identifier: Apache-2.0

description: Ambiq Apollo family IPC (MBOX Interprocessor Communication)

compatible: "ambiq,mbox-ipc"

include: [base.yaml, mailbox-controller.yaml]

properties:
  tx-mask:
    type: int
    required: true
    description: TX supported channels mask

  rx-mask:
    type: int
    required: true
    description: RX supported channels mask

  interrupts:
    required: true

mbox-cells:
  - channel
```

## dts/bindings/mbox/andestech,mbox-plic-sw.yaml
```yaml
#
# Copyright (c) 2022, Andes Technology Corporation.
#
# SPDX-License-Identifier: Apache-2.0
#

description: AndesTech MBOX PLIC-SW

compatible: "andestech,mbox-plic-sw"

include: [base.yaml, mailbox-controller.yaml]

properties:
  interrupts:
    required: true

mbox-cells:
  - channel
```

## dts/bindings/mbox/andestech,plic-sw.yaml
```yaml
#
# Copyright (c) 2022, Andes Technology Corporation.
#
# SPDX-License-Identifier: Apache-2.0
#

description: |
  This is a representation of AndesTech PLIC-SW node

compatible: "andestech,plic-sw"

include: [base.yaml, mailbox-controller.yaml]

properties:
  reg:
    required: true

  channel-max:
    type: int
    required: true
    description: Supported channels max

mbox-cells:
  - channel
```

## dts/bindings/mbox/arm,mhuv2.yaml
```yaml
# Copyright (c) 2026, Xsight Labs
#
# SPDX-License-Identifier: Apache-2.0

description: |
  ARM MHUv2 (Message Handling Unit v2) mailbox controller.

  Provides doorbell signalling between processors.

compatible: "arm,mhuv2"

include: [base.yaml, mailbox-controller.yaml]

properties:
  reg:
    required: true
    description: |
      Two register regions: PBX (Postbox) sender registers and MBX
      (Mailbox) receiver registers.

  reg-names:
    required: true
    description: |
      Must contain "send" and "recv", identifying the PBX and MBX
      register regions, respectively.

  interrupts:
    required: true
    description: Single interrupt for the receive side.

mbox-cells:
  - channel

examples:
  - |
    mhu0: mbox@10000000 {
        compatible = "arm,mhuv2";
        reg = <0x10000000 0x10000>,
              <0x10010000 0x10000>;
        reg-names = "send", "recv";
        interrupts = <34 0>;
        #mbox-cells = <1>;
    };
```

## dts/bindings/mbox/brcm,bcm2711-mailbox.yaml
```yaml
description: BCM2711 Mailbox

compatible: "brcm,bcm2711-mailbox"

include: [base.yaml, mailbox-controller.yaml]

properties:
  reg:
    required: true

mbox-cells:
  - channel
```

## dts/bindings/mbox/brcm,bcm2711-mbox.yaml
```yaml
description: Broadcom BCM2711 VideoCore mailbox

compatible: "brcm,bcm2711-mbox"

include: [base.yaml, mailbox-controller.yaml]

properties:
  reg:
    required: true

  interrupts:
    required: true

mbox-cells:
  - channel
```

## dts/bindings/mbox/espressif,mbox-esp32.yaml
```yaml
# Copyright (c) 2024 Felipe Neves
# SPDX-License-Identifier: Apache-2.0

description: ESP32 soft mailbox

compatible: "espressif,mbox-esp32"

include: [base.yaml, mailbox-controller.yaml]

properties:
  reg:
    required: true

  shared-memory:
    required: true
    type: phandle

  shared-memory-size:
    required: true
    type: int

  interrupts:
    required: true

mbox-cells:
  - channel
```

## dts/bindings/mbox/infineon,cat1-mbox-pdl.yaml
```yaml
# Copyright (c) 2026 Linumiz
# SPDX-License-Identifier: Apache-2.0

description: |
  Infineon IPC Unit as Zephyr MBOX.

  This Infineon Mailbox driver implements Multi-Channel Inter-Processor Mailbox (MBOX) API
  around Infineon Inter-processor communication IP block.

compatible: "infineon,cat1-mbox-pdl"

include: [base.yaml, mailbox-controller.yaml]

properties:
  reg:
    type: array
    required: true

  interrupts:
    required: true

mbox-cells:
  - channel
```

## dts/bindings/mbox/infineon,mbox-pipe.yaml
```yaml
# SPDX-FileCopyrightText: Copyright (c) 2026 Infineon Technologies AG,
# SPDX-FileCopyrightText: or an affiliate of Infineon Technologies AG. All rights reserved.
#
# SPDX-License-Identifier: Apache-2.0

description: |
  Infineon MBOX (based on PDL IPC PIPE)

  Infineon MBOX driver implementation based on PDL IPC PIPE layer.
  A pipe is a communication channel between two endpoints.

  On edge family devices, there are two IPC instances (IPC0 and IPC1).
  Each instance supports 16 IPC channels and 8 IPC interrupts.
  PDL driver handles instances by having one channel pool - from 0 to 31,
  where first 16 belong to IPC0 and second 16 channels belong to IPC1.
  Following IPC resources are for application:
    IPC0 CH  - 3 to 7 and 11 to 15
    IPC0 INT - 3 to 5
    IPC1 CH  - 17 to 31
    IPC1 INT - 9 to 15

  The device tree snippet below shows how to enable mbox:
    &ipc0 {
      #ipc-channel-cells = <3>;
      status = "okay";

      mbox0: mbox0 {
         #mbox-cells = <1>;
         compatible = "infineon,mbox-pipe";

         ipc-pipe-ep0-addr = <2>;
         ipc-pipe-ep1-addr = <3>;

         ipc-configs = <&ipc0 8 8 4>, // IPC config for EP0
                       <&ipc0 9 9 4>; // IPC config for EP1
         status = "okay";
      };
    };

  ipc-pipe-epX-addr - address of endpoints (EP0 and EP1). By default system allocates
  8 endpoints (refer to CONFIG_MBOX_INFINEON_IPC_MAX_ENDPOINTS).

  ipc-configs - specifier for IPC configuration, it consists from <&xxx y z j>, where
   &xxx - phandle of IPC instance,
      y - IPC channel number,
      z - IPC interrupt number,
      j - interrupt priority.

  Note: The following resources are reserved by system.
   - endpoints address 0 and 1,
   - IPC channels 0..7,
   - IPC interrupts 0..7.


compatible: "infineon,mbox-pipe"

include: [base.yaml, mailbox-controller.yaml]

properties:

  ipc-configs:
    type: phandle-array
    description: |
      specifier for IPC configuration for Endpoints (EP0 and EP1).
      It includes phandle of IPC instance,  IPC channel number,
      IPC interrupt number and interrupt priority.

  ipc-pipe-ep0-addr:
    type: int
    description: |
      Address of Endpoint 0 (EP0).

  ipc-pipe-ep1-addr:
    type: int
    description: |
      Address of Endpoint 1 (EP1).

mbox-cells:
  - channel
```

## dts/bindings/mbox/linaro,ivshmem-mbox.yaml
```yaml
# Copyright (c) 2024 Felipe Neves
# SPDX-License-Identifier: Apache-2.0

description: Inter VM shared memory based mailbox binding

compatible: "linaro,ivshmem-mbox"

include: base.yaml

properties:

  ivshmem:
    type: phandle
    required: true
    description: ivshmem device node
```

## dts/bindings/mbox/mailbox-controller.yaml
```yaml
# Copyright (c) 2021, Linaro Limited
# SPDX-License-Identifier: Apache-2.0

# Common fields for mailbox / IPM controllers

properties:
    "#mbox-cells":
      type: int
      required: true
      description: Number of items to expect in a Mailbox specifier
```

## dts/bindings/mbox/microchip,mpfs-mailbox.yaml
```yaml
#
# Copyright (c) 2024 Microchip Technology Inc.
#
# SPDX-License-Identifier: Apache-2.0
#
include: [base.yaml, mailbox-controller.yaml]

properties:
  compatible:
    const: microchip,mpfs-mailbox

  reg:
    - items:
        - description: mailbox control registers
        - description: mailbox interrupt registers
        - description: mailbox data registers

  interrupts:
    maxItems: 1

  "#mbox-cells":
    const: 1

required:
  - compatible
  - reg
  - interrupts
  - "#mbox-cells"

additionalProperties: false

examples:
  - |
    soc {
      #address-cells = <2>;
      #size-cells = <2>;
      mbox: mailbox@37020000 {
        compatible = "microchip,mpfs-mailbox";
        reg = <0x37020000 0x58>, <0x2000318C 0x40>,
              <0x37020800 0x100>;
        interrupt-parent = <&L1>;
        interrupts = <96>;
        #mbox-cells = <1>;
      };
    };
```

## dts/bindings/mbox/nordic,mbox-nrf-ipc.yaml
```yaml
# Copyright (c) 2021 Carlo Caione <ccaione@baylibre.com>
# SPDX-License-Identifier: Apache-2.0

description: Nordic nRF family IPC (MBOX Interprocessor Communication)

compatible: "nordic,mbox-nrf-ipc"

interrupt-source: true

include: [base.yaml, mailbox-controller.yaml]

properties:
  tx-mask:
    type: int
    required: true
    description: TX supported channels mask

  rx-mask:
    type: int
    required: true
    description: RX supported channels mask

mbox-cells:
  - channel
```

## dts/bindings/mbox/nordic,nrf-bellboard-common.yaml
```yaml
# Copyright (c) 2024 Nordic Semiconductor ASA
# SPDX-License-Identifier: Apache-2.0

include: [base.yaml, "mailbox-controller.yaml"]

properties:
  reg:
    required: true

mbox-cells:
  - channel
```

## dts/bindings/mbox/nordic,nrf-bellboard-local.yaml
```yaml
# Copyright (c) 2024 Nordic Semiconductor ASA
# SPDX-License-Identifier: Apache-2.0

description: |
  Nordic BELLBOARD

  BELLBOARD provides support for inter-domain software signaling. It implements
  a set of tasks and events intended for signaling within an interprocessor
  communication (IPC) framework. When used in local mode, the BELLBOARD
  instance is used to receive events triggered by other remote cores.

  Example definition:

    bellboard: mailbox@deadbeef {
      compatible = "nordic,nrf-bellboard-local";
      reg = <0xdeadbeef 0x1000>;
      interrupts = <98 NRF_DEFAULT_IRQ_PRIORITY>,
                   <99 NRF_DEFAULT_IRQ_PRIORITY>;
      interrupt-names = "irq2", "irq3";
      nordic,interrupt-mapping = <0x0000000f 2>, <0x000000f0 3>;
      #mbox-cells = <1>;
    };

compatible: "nordic,nrf-bellboard-local"

include: "nordic,nrf-bellboard-common.yaml"

properties:
  interrupts:
    required: true

  interrupt-names:
    required: true

  nordic,interrupt-mapping:
    type: array
    required: true
    description: |
      Set of interrupt mapping pairs. Each pair consists of a bitmask and an
      interrupt identifier. The bitmask is used to indicate which of the 32
      possible events are mapped to the given interrupt. For example, given
      <0x0000000f 2>, the first four events are mapped to interrupt 2
      (irq2).
```
