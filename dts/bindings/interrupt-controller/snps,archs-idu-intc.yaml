## dts/bindings/interrupt-controller/snps,archs-idu-intc.yaml
```yaml
# Copyright (c) 2019, synopsys
# SPDX-License-Identifier: Apache-2.0

description: |
    ARC-HS Interrupt Distribution Unit 2nd-level interrupt controller. Can be
    used in SMP configurations for dynamic IRQ routing and load balancing of
    common/external IRQs towards the core interrupt controller.

compatible: "snps,archs-idu-intc"

include: [interrupt-controller.yaml, base.yaml]

interrupt-cells:
  - irq
  - priority
```

## dts/bindings/interrupt-controller/snps,arcv2-intc.yaml
```yaml
# Copyright (c) 2018, synopsys
# SPDX-License-Identifier: Apache-2.0

description: ARCV2 interrupt controller

compatible: "snps,arcv2-intc"

include: [interrupt-controller.yaml, base.yaml]

properties:
  "#interrupt-cells":
    const: 2

interrupt-cells:
  - irq
  - priority
```

## dts/bindings/interrupt-controller/snps,designware-intc.yaml
```yaml
description: DesignWare programmable interrupt controller

compatible: "snps,designware-intc"

include: [interrupt-controller.yaml, base.yaml]

properties:
  reg:
    required: true

  interrupts:
    required: true

  "#interrupt-cells":
    const: 3

  num-irqs:
    type: int
    required: true
    description: Number of irq the controller manages

interrupt-cells:
  - irq
  - sense
  - priority
```

## dts/bindings/interrupt-controller/st,stm32-exti.yaml
```yaml
description: STMicroelectronics STM32 family External Interrupt Controller

compatible: "st,stm32-exti"

include: [base.yaml, interrupt-controller.yaml]

properties:
  reg:
    required: true

  interrupts:
    required: true

  interrupt-names:
    required: true

  num-lines:
    type: int
    required: true
    description: Number of lines supported by the interrupt controller.

  line-ranges:
    type: array
    required: true
    description: |
      Description of the input lines range for each interrupt line supported
      by the external interrupt controller. For each line a couple of integers is
      provided: the number of the first line of the range start and the length
      of the range.
      As example:
             line-ranges = <0 1>, <1 1>, <2 1>, <3 1>,
                           <4 1>, <5 5>, <10 6>;
      Above property provides event-range for 7 lines.
      5 first lines contain one element
      6th line starts with input line 5 and contains 5 elements (5 to 9)
      7th line starts with inupt line 10 and contains 6 elements (10 to 15)
```

## dts/bindings/interrupt-controller/st,stm32-syscfg-itline.yaml
```yaml
# Copyright (c) 2023, Aurelien Jarno
# SPDX-License-Identifier: Apache-2.0

description: STMicroelectronics STM32 SYSCFG Interrupt Line

compatible: "st,stm32-syscfg-itline"

include: [interrupt-controller.yaml, base.yaml]

properties:
  reg:
    required: true

  interrupts:
    required: true

  "#interrupt-cells":
    const: 2

interrupt-cells:
  - irq
  - priority
```

## dts/bindings/interrupt-controller/st,stm32g0-exti.yaml
```yaml
# Copyright (c) 2023, STMicroelectronics

# SPDX-License-Identifier: Apache-2.0

description: |
        STM32 controller
        This compatible stands for all interrupt-controller blocks with two
        dedicated Rising and Falling interrupt pending registers.

compatible: "st,stm32g0-exti"

include: st,stm32-exti.yaml
```

## dts/bindings/interrupt-controller/st,stm32h7rs-exti.yaml
```yaml
# Copyright (c) 2024, STMicroelectronics

# SPDX-License-Identifier: Apache-2.0

description: |
        STM32H7RS External Interrupt Controller

        This compatible stands for the stm32H7RS interrupt-controller block
        with two dedicated Rising and Falling interrupt pending registers

compatible: "st,stm32h7rs-exti"

include: st,stm32-exti.yaml
```

## dts/bindings/interrupt-controller/swerv,pic.yaml
```yaml
# SPDX-License-Identifier: Apache-2.0

description: SweRV EH1 PIC (Programmable Interrupt Controller)

compatible: "swerv,pic"

include: [interrupt-controller.yaml, base.yaml]

properties:
  reg:
      required: true

  riscv,max-priority:
      type: int
      description: maximum interrupt priority
      required: true

interrupt-cells:
  - irq
  - priority
```

## dts/bindings/interrupt-controller/syntacore,ipic.yaml
```yaml
# Copyright (c) 2023, Syntacore
# SPDX-License-Identifier: Apache-2.0

description: RISC-V Syntacore CPU external interrupt controller

compatible: "syntacore,ipic"

include: [interrupt-controller.yaml, base.yaml]

properties:
  "#interrupt-cells":
    const: 1

interrupt-cells:
  - irq
```

## dts/bindings/interrupt-controller/tcc,tic.yaml
```yaml
# Copyright (c) 2024 Hounjoung Rim <hounjoung@tsnlab.com>
# SPDX-License-Identifier: Apache-2.0

description: Telechips Generic Interrupt Controller 400

compatible: "tcc,tic"

include: base.yaml

properties:
  reg:
    required: true

interrupt-cells:
  - type
  - irq
  - flags
  - priority
```

## dts/bindings/interrupt-controller/ti,am335x-intc.yaml
```yaml
# Copyright (c) 2024 Abe Kohandel <abe.kohandel@gmail.com>
# SPDX-License-Identifier: Apache-2.0

description: TI ARM Interrupt Controller

compatible: "ti,am335x-intc"

include: [interrupt-controller.yaml, base.yaml]

properties:
  reg:
    required: true

interrupt-cells:
  - irq
  - priority
  - flags
```

## dts/bindings/interrupt-controller/ti,tms570-vim.yaml
```yaml
# Copyright (c) 2025 ispace, inc.
# SPDX-License-Identifier: Apache-2.0

description: VIM for TMS570

compatible: "ti,tms570-vim"

include: [interrupt-controller.yaml, base.yaml]


properties:
  # NOTE: Register ranges:
  #        - 0 : VIM control registers
  #        - 1 : VIM ECC related registers
  #        - 2 : VIM RAM
  reg:
    required: true

  "#interrupt-cells":
    const: 2

interrupt-cells:
  - irq
  - priority
```

## dts/bindings/interrupt-controller/ti,vim.yaml
```yaml
# Copyright (C) 2023 BeagleBoard.org Foundation
# Copyright (C) 2023 S Prashanth
#
# SPDX-License-Identifier: Apache-2.0

description: |
  TI Vectored Interrupt Manager is a external interrupt controller
  (TI specific IP) which is compatible with R5F VIC port.

compatible: "ti,vim"

include: base.yaml

properties:
  reg:
    required: true

interrupt-cells:
  - type
  - irq
  - flags
  - priority
```

## dts/bindings/interrupt-controller/unisoc,uwp-intc.yaml
```yaml
# Copyright (c) 2019, Manivannan Sadhasivam
# SPDX-License-Identifier: Apache-2.0

description: UNISOC Core Interrupt Controller

compatible: "unisoc,uwp-intc"

include: [interrupt-controller.yaml, base.yaml]

properties:
    reg:
      required: true

    interrupts:
      required: true

    label:
      required: true

    unisoc,num-irq-priority-bits:
      required: false
      type: int
      description: number of bits of IRQ priorities

interrupt-cells:
  - irq
  - priority
```

## dts/bindings/interrupt-controller/vexriscv,intc0.yaml
```yaml
# Copyright (c) 2018 - 2019 Antmicro <www.antmicro.com>
# SPDX-License-Identifier: Apache-2.0

title: LiteX VexRiscV Interrupt Controller

description: |
    This binding describes LiteX VexRiscV Interrupt Controller

compatible: "vexriscv,intc0"

include: [interrupt-controller.yaml, base.yaml]

properties:
  reg:
      required: true

  riscv,max-priority:
      type: int
      description: maximum interrupt priority
      required: true

  "#interrupt-cells":
      const: 2

interrupt-cells:
  - irq
  - priority
```

## dts/bindings/interrupt-controller/vexriscv-intc0.yaml
```yaml
# Copyright (c) 2018 - 2019 Antmicro <www.antmicro.com>
# SPDX-License-Identifier: Apache-2.0

description: LiteX VexRiscV interrupt controller

compatible: "vexriscv-intc0"

include: [interrupt-controller.yaml, base.yaml]

properties:
  reg:
      required: true

  riscv,max-priority:
      type: int
      description: maximum interrupt priority
      required: true

  "#interrupt-cells":
      const: 2

interrupt-cells:
  - irq
  - priority
```

## dts/bindings/interrupt-controller/wch,ch32v-pfic.yaml
```yaml
# Copyright (c) 2023-2024 Chen Xingyu <hi@xingrz.me>
# SPDX-License-Identifier: Apache-2.0

description: WCH CH32V PFIC

compatible: "wch,ch32v-pfic"

include: [interrupt-controller.yaml, base.yaml]

properties:
  reg:
    required: true

  "#interrupt-cells":
    const: 2

interrupt-cells:
  - irq
  - priority
```

## dts/bindings/interrupt-controller/wch,exti.yaml
```yaml
# Copyright (c) 2025 Michael Hope
# SPDX-License-Identifier: Apache-2.0

description: WCH CH32V003/20x/30x External Interrupt and Event Controller (EXTI)

compatible: "wch,exti"

include: [base.yaml, interrupt-controller.yaml]

properties:
  reg:
    required: true

  interrupts:
    required: true

  num-lines:
    type: int
    required: true
    description: Number of lines supported by the interrupt controller.

  line-ranges:
    type: array
    required: true
    description: |
      Describes how the input lines are grouped into ranges. Each range
      consists of a (starting line, number of lines) pair and map to
      a single interrupt.

      For example:
             line-ranges = <0 1>, <1 1>, <2 1>, <3 1>,
                           <4 1>, <5 5>, <10 6>;

      defines seven ranges where the first five contain one line, the
      sixth starts with line 5 and contains five elements (5 to 9), and
      the last starts with line 10 and contains six elements (10 to 15).
```

## dts/bindings/interrupt-controller/wch,pfic.yaml
```yaml
# Copyright (c) 2024 Michael Hope
# SPDX-License-Identifier: Apache-2.0

description: WCH CH32V00x Programmable Fast Interrupt Controller (PFIC)

compatible: "wch,pfic"

include: [interrupt-controller.yaml, base.yaml]

properties:
  reg:
    required: true

  "#interrupt-cells":
    const: 1

interrupt-cells:
  - irq
```

## dts/bindings/interrupt-controller/xhsc,hc32-extint.yaml
```yaml
# Copyright (C) 2024-2025, Xiaohua Semiconductor Co., Ltd.
# SPDX-License-Identifier: Apache-2.0

description: XHSC HC32 family Interrupt Controller

compatible: "xhsc,hc32-extint"

include: [base.yaml]

properties:
  interrupts:
    required: true

  interrupt-names:
    required: true

  extint-nums:
    type: int
    required: true
    description: Number of extint supported by the interrupt controller.

  extint-chs:
    type: array
    required: true
    description: Description of the external channel for each interrupt vector.
```

## dts/bindings/interrupt-controller/xhsc,hc32-intc.yaml
```yaml
# Copyright (C) 2024-2025, Xiaohua Semiconductor Co., Ltd.
# SPDX-License-Identifier: Apache-2.0

description: XHSC HC32 family Interrupt Controller

compatible: "xhsc,hc32-intc"

include: [base.yaml, interrupt-controller.yaml]

properties:
  reg:
    required: true

  "#interrupt-cells":
    const: 3

interrupt-cells:
  - irq
  - priority
  - int_src
```

## dts/bindings/interrupt-controller/xlnx,intc.yaml
```yaml
# Copyright (c) 2023 Advanced Micro Devices, Inc. (AMD)
# Copyright (c) 2023 Alp Sayin <alpsayin@gmail.com>
# SPDX-License-Identifier: Apache-2.0


description: Xilinx AXI Interrupt Controller

compatible: "xlnx,intc"

include: [interrupt-controller.yaml, base.yaml]

properties:
  reg:
    required: true

  "#interrupt-cells":
    const: 2

interrupt-cells:
  - irq
  - priority
```

## dts/bindings/interrupt-controller/xlnx,xps-intc-1.00.a.yaml
```yaml
#
# Copyright 2026 Advanced Micro Devices, Inc.
#
# SPDX-License-Identifier: Apache-2.0
#

description: |
  Xilinx AXI Interrupt Controller (PG099).

  Hardware capabilities are described on a per-instance basis through
  devicetree properties generated by Vivado. Optional register blocks
  may or may not be present depending on the IP configuration.

compatible: "xlnx,xps-intc-1.00.a"

include: [interrupt-controller.yaml, base.yaml]

properties:
  reg:
    required: true

  "#interrupt-cells":
    const: 2

  xlnx,num-intr-inputs:
    type: int
    required: true
    description: |
      Number of interrupt inputs implemented in this instance (IP parameter
      C_NUM_INTR_INPUTS). Valid range is 1 to 32.

  xlnx,is-fast:
    type: int
    default: 0
    description: |
      Vivado configuration parameter C_HAS_FAST.

      This property is modeled as an integer to match the value generated by
      Vivado (0 = disabled, 1 = enabled).

      Non-zero if the IP was synthesized with fast interrupt support.

      Fast interrupt mode is currently not supported by the Zephyr driver.

  xlnx,has-ipr:
    type: int
    default: 0
    description: |
      Vivado configuration parameter C_HAS_IPR.

      This property is modeled as an integer to match the value generated by
      Vivado (0 = absent, 1 = present).

      Non-zero when the Interrupt Pending Register (IPR) is present.

  xlnx,has-sie:
    type: int
    default: 0
    description: |
      Vivado configuration parameter C_HAS_SIE.

      This property is modeled as an integer to match the value generated by
      Vivado (0 = absent, 1 = present).

      Non-zero when the Set Interrupt Enable (SIE) register is present.

  xlnx,has-cie:
    type: int
    default: 0
    description: |
      Vivado configuration parameter C_HAS_CIE.

      This property is modeled as an integer to match the value generated by
      Vivado (0 = absent, 1 = present).

      Non-zero when the Clear Interrupt Enable (CIE) register is present.

  xlnx,has-ivr:
    type: int
    default: 0
    description: |
      Vivado configuration parameter C_HAS_IVR.

      This property is modeled as an integer to match the value generated by
      Vivado (0 = absent, 1 = present).

      Non-zero when the Interrupt Vector Register (IVR) is present.

interrupt-cells:
  - irq
  - priority


examples:
  - |
    soc {
      #address-cells = <1>;
      #size-cells = <1>;

      axi_intc: interrupt-controller@41200000 {
        compatible = "xlnx,xps-intc-1.00.a";
        reg = <0x41200000 0x1000>;
        interrupt-controller;
        #interrupt-cells = <2>;

        xlnx,has-ipr = <1>;
        xlnx,has-sie = <1>;
        xlnx,has-cie = <1>;
        xlnx,has-ivr = <1>;
        xlnx,num-intr-inputs = <11>;

      };
    };
```

## dts/bindings/interrupt-controller/xtensa,intc.yaml
```yaml
description: Xtensa Core interrupt controller

compatible: "xtensa,core-intc"

include: [interrupt-controller.yaml, base.yaml]

properties:
  reg:
      required: true

  "#interrupt-cells":
      const: 3

interrupt-cells:
  - irq
  - sense
  - priority
```

## dts/bindings/interrupt-controller/xuantie,clic.yaml
```yaml
# Copyright (C) 2017-2024 Alibaba Group Holding Limited
# SPDX-License-Identifier: Apache-2.0

description: XuanTie CLIC interrupt controller

compatible: "xuantie,clic"

include: [interrupt-controller.yaml, base.yaml]

properties:
  reg:
    required: true

  "#interrupt-cells":
    const: 2

interrupt-cells:
  - irq
  - priority
```
