## dts/bindings/interrupt-controller/ite,it51xxx-wuc.yaml
```yaml
# Copyright (c) 2025 ITE Corporation. All Rights Reserved.
# SPDX-License-Identifier: Apache-2.0

description: ITE Wake-Up Controller (WUC)
compatible: "ite,it51xxx-wuc"

include: [base.yaml]

properties:
  reg:
    required: true

  wakeup-controller:
    type: boolean
    description: |
      conveys that this node is a wakeup controller

  hw-either-edge-supported:
    type: boolean
    description: |
      hardware supports either-edge triggering.

  both-edge-trigger:
    type: boolean
    description: |
      Rising-edge or falling-edge triggered is selected.
      This property is ignored if `hw-either-edge-supported`
      is present.

  "#wuc-cells":
    type: int
    required: true
    description: |
      number of items to expect in a wakeup controller specifier
    const: 1

wuc-cells:
  - mask
```

## dts/bindings/interrupt-controller/ite,it8xxx2-intc-v2.yaml
```yaml
# Copyright (c) 2023 ITE Corporation. All Rights Reserved.
# SPDX-License-Identifier: Apache-2.0

description: ITE Interrupt controller
compatible: "ite,it8xxx2-intc-v2"

include: [interrupt-controller.yaml, base.yaml]

properties:
  reg:
    required: true

interrupt-cells:
  - irq
  - flags
```

## dts/bindings/interrupt-controller/ite,it8xxx2-intc.yaml
```yaml
# Copyright (c) 2020 ITE Corporation. All Rights Reserved.
# SPDX-License-Identifier: Apache-2.0

description: ITE Interrupt controller
compatible: "ite,it8xxx2-intc"

include: [interrupt-controller.yaml, base.yaml]

properties:
  reg:
    required: true

interrupt-cells:
  - irq
  - flags
```

## dts/bindings/interrupt-controller/ite,it8xxx2-wuc-map.yaml
```yaml
# Copyright 2022 ITE Corporation
# SPDX-License-Identifier: Apache-2.0

description: ITE Wake-Up Controller (WUC) mapping child node

compatible: "ite,it8xxx2-wuc-map"

child-binding:
    description: Child node to present the mapping between input of WUC and its source device
    properties:
      wucs:
        type: phandle-array
        required: true
```

## dts/bindings/interrupt-controller/ite,it8xxx2-wuc.yaml
```yaml
# Copyright 2022 ITE Corporation
# SPDX-License-Identifier: Apache-2.0

description: ITE Wake-Up Controller (WUC)
compatible: "ite,it8xxx2-wuc"

include: [base.yaml]

properties:
  reg:
    required: true

  "wakeup-controller":
    type: boolean
    required: true
    description: conveys that this node is a wakeup controller

  "#wuc-cells":
    type: int
    required: true
    description: number of items to expect in a wakeup controller specifier
    const: 1

wuc-cells:
  - mask
```

## dts/bindings/interrupt-controller/litex,clic.yaml
```yaml
# Copyright (c) 2025 LiteX Contributors
# SPDX-License-Identifier: Apache-2.0

description: |
  LiteX CLIC (Core Local Interrupt Controller)
  
  This is a custom CLIC implementation for LiteX SoCs with CSR-based
  register access. It provides interrupt management for VexRiscv cores
  with support for up to 64 interrupts, where the first 16 are
  software-controllable via CSR registers.
  
  Note: This implementation has a known limitation with CSRStorage-based
  pending bits that don't auto-clear, requiring software workarounds.

compatible: "litex,clic"

include: [interrupt-controller.yaml, base.yaml]

properties:
  reg:
    required: true
    description: |
      Base address and size of the CLIC memory-mapped registers.
      The register layout includes:
      - 0x0000-0x003F: Interrupt pending bits (CLICINTIP)
      - 0x0040-0x007F: Interrupt enable bits (CLICINTIE)
      - 0x0080-0x00BF: Interrupt attributes (CLICINTATTR)
      - 0x00C0-0x00FF: Interrupt priorities (CLICIPRIO)
      - 0x0100-0x023F: Debug registers (hardware bridge verification)

  "#interrupt-cells":
    const: 2
    description: |
      Number of cells to encode an interrupt specifier.
      - Cell 1: IRQ number (0-63)
      - Cell 2: Interrupt priority (0-255)

  num-interrupts:
    type: int
    default: 64
    description: |
      Number of interrupts supported by this CLIC instance.
      Maximum is 64, but only the first 16 have CSR control.

  priority-bits:
    type: int
    default: 8
    description: |
      Number of bits used for priority encoding (1-8).
      Higher values provide more priority levels.

  nested-interrupts:
    type: boolean
    description: |
      Enable nested interrupt handling support.
      When enabled, the handler will recursively process
      higher priority interrupts that become pending.

interrupt-cells:
  - irq
  - priority
```

## dts/bindings/interrupt-controller/mediatek,adsp_intc.yaml
```yaml
# Copyright 2023 The ChromiumOS Authors
# SPDX-License-Identifier: Apache-2.0

description: MediaTek MT8xxx Audio DSP Interrupt Controller

compatible: "mediatek,adsp_intc"

include: [interrupt-controller.yaml, base.yaml]

properties:
  reg:
    required: true

  interrupts:
    required: true

  "#interrupt-cells":
    const: 3

  status-reg:
    description: Register address of interrupt-is-signaled bits
    type: int
    required: true

  mask:
    description: Mask of valid interrupt bits
    type: int
    required: true

interrupt-cells:
  - irq
  - sense
  - priority
```

## dts/bindings/interrupt-controller/microchip,aic-g1-intc.yaml
```yaml
#
# Copyright (C) 2025-2026 Microchip Technology Inc. and its subsidiaries
#
# SPDX-License-Identifier: Apache-2.0
#

title: Microchip G1 AIC Controller

description: |
  Microchip Advanced Interrupt Controller driver.

  Group G1 AIC driver supports following hardware peripherals:
    - module name="AIC" id="11051" version="K"
    - module name="AIC" id="11051" version="101"

compatible: "microchip,aic-g1-intc"

include: base.yaml

properties:
  reg:
    required: true

  type:
    type: string
    default: "non-secure"
    enum:
      - "non-secure"
      - "secure"
    description: |
      The secure AIC handles the interrupts of the secure embedded peripherals
      and the non-secure AIC handles the interrupts of the non-secure embedded
      peripherals.

interrupt-cells:
  - irq
  - flags
  - priority
```

## dts/bindings/interrupt-controller/microchip,dmec-ecia-girq.yaml
```yaml
description: Microchip DEC/MEC series External Interrupt Aggregator GIRQ

compatible: "microchip,dmec-ecia-girq"

include: base.yaml

properties:
  girqs:
    type: array
    required: true
    description: |
      Many DEC/MEC periperals interrupt signals are direct capable. The signals are
      connected to bits in a GIRQ. Each GIRQ is composed of 5 32-bit registers:
      status(latched or r/w1-c), set-enable, clr-enable, and result (read-only).
      The read-only result register bits are the bitwise AND of status and enable.
      Direct mode routes the individual result register bits to NVIC inputs. If
      direct mode is disable by setting direct mode bit to 0 in the EC subsystem
      interrupt control register then the result register outputs are OR'd together
      and the OR'd result is connected to an NVIC input based on GIRQ number.
      To enable an interrupt a driver must know:
      a. NVIC input number and priority from the interrupts property
      b. GIRQ number and bit position from the girqs property
      The number of entries in interrupts and girqs should be the same in a DT node.
```

## dts/bindings/interrupt-controller/microchip,dspic33-intc.yaml
```yaml
# Copyright (c) 2025 Microchip Technology Inc.
# SPDX-License-Identifier: Apache-2.0

description: Microchip dsPIC33 Interrupt Controller

compatible: "microchip,dspic33-intc"

include: [interrupt-controller.yaml, base.yaml]

properties:
  interrupt-controller:
    type: boolean

  "#interrupt-cells":
    const: 2

  ie-offset:
    type: int
    required: true
    description: Offset (bytes) of the interrupt-enable register block within the controller's base.

  if-offset:
    type: int
    required: true
    description: Offset (bytes) of the interrupt-flag/status register block within the controller's base.

interrupt-cells:
  - irq
  - priority
```

## dts/bindings/interrupt-controller/microchip,pic32cxsg-eic.yaml
```yaml
description: Microchip PIC32CXSG series External Interrupt Controller

compatible: "atmel,sam0-eic"

include: base.yaml

properties:
  reg:
    required: true

  interrupts:
    required: true
```

## dts/bindings/interrupt-controller/microchip,smartfusion2-h2f-irqctrl.yaml
```yaml
# SPDX-FileCopyrightText: Copyright Bavariamatic GmbH
# SPDX-License-Identifier: Apache-2.0

description: SmartFusion2 H2F interrupt controller block

compatible: "microchip,smartfusion2-h2f-irqctrl"

include:
  - microchip,smartfusion2-common.yaml
  - interrupt-controller.yaml

properties:
  "#interrupt-cells":
    const: 1

interrupt-cells:
  - irq
```

## dts/bindings/interrupt-controller/microchip,xec-ecia-girq.yaml
```yaml
description: Microchip XEC series External Interrupt Aggregator GIRQ

compatible: "microchip,xec-ecia-girq"

include: base.yaml

properties:
    reg:
      required: true

    interrupts:
      required: true

    label:
      required: true

    girq-id:
       type: int
       required: true
       description: GIRQ ID number [0, 18]

    sources:
      type: array
      required: true
      description: |
        Bit positions of each source implemented by this GIRQ.
```

## dts/bindings/interrupt-controller/microchip,xec-ecia.yaml
```yaml
description: Microchip XEC series External Interrupt Aggregator Controller

compatible: "microchip,xec-ecia"

include: base.yaml

properties:
  reg:
    required: true

  clocks:
    required: true

  direct-capable-girqs:
    type: array
    required: true
    description: |
      Array of GIRQ numbers in [8, 26] whose result bits can be connected
      directly to the ARM NVIC.
```

## dts/bindings/interrupt-controller/microchip,xec-intc.yaml
```yaml
#
# Copyright (c) 2019 Microchip Technology Inc.
#
# SPDX-License-Identifier: Apache-2.0
#
---
title: XEC INTC
version: 0.1

description: >
    This binding describes the Microchip XEC Interrupt Aggregator

properties:
  compatible:
      category: required
      type: string
      description: compatible strings
      constraint: "microchip,xec-intc"
      generation: define

  reg:
      category: required
      type: int
      description: mmio register space
      generation: define

  label:
      type: string
      category: required
      description: Human readable string naming the device (used by Zephyr for API name)
      generation: define

  interrupts:
      type: array
      category: required
      description: required interrupts
      generation: define

  girq-num:
      type: int
      category: required
      description: required aggregated GIRQ number
      generation: define

"#cells":
  - irq
  - priority
...
```

## dts/bindings/interrupt-controller/mti,cpu-intc.yaml
```yaml
# Copyright (c) 2020 Antony Pavlov <antonynpavlov@gmail.com>
#
# SPDX-License-Identifier: Apache-2.0

description: MIPS CPU interrupt controller

compatible: "mti,cpu-intc"

include: [interrupt-controller.yaml, base.yaml]

properties:
  "#interrupt-cells":
      const: 1

interrupt-cells:
  - irq
```

## dts/bindings/interrupt-controller/neorv32-xirq.yaml
```yaml
description: NEORV32 External Interrupt Controller (XIRQ)

compatible: "neorv32-xirq"

include: [interrupt-controller.yaml, base.yaml]

properties:
  reg:
    required: true

  interrupts:
    required: true

  "#interrupt-cells":
    const: 1

  syscon:
    type: phandle
    required: true
    description: |
      phandle to syscon (NEORV32 SYSINFO) node.

  trigger-type:
    type: int
    required: true
    description: |
      Bitmask indicating trigger type for each interrupt. 0 = level, 1 = edge.
      Same as XIRQ_TRIGGER_TYPE value used in synthesis for XIRQ core.

interrupt-cells:
  - irq
```

## dts/bindings/interrupt-controller/nordic,nrf-clic.yaml
```yaml
# Copyright (c) 2024 Nordic Semiconductor ASA
# SPDX-License-Identifier: Apache-2.0

description: Nordic VPR CLIC

compatible: "nordic,nrf-clic"

include: [interrupt-controller.yaml, base.yaml]

properties:
  reg:
    required: true

  "#interrupt-cells":
    const: 2

interrupt-cells:
  - irq
  - priority
```

## dts/bindings/interrupt-controller/nuclei,eclic.yaml
```yaml
# Copyright (c) 2021, Tokita, Hiroshi
# SPDX-License-Identifier: Apache-2.0

description: Nuclei ECLIC interrupt controller

compatible: "nuclei,eclic"

include: [interrupt-controller.yaml, base.yaml]

properties:
  reg:
    required: true

  "#interrupt-cells":
    const: 2

interrupt-cells:
  - irq
  - priority
```

## dts/bindings/interrupt-controller/nuvoton,nct-miwu-wui-map.yaml
```yaml
# Copyright (c) 2025 Nuvoton Technology Corporation.
# SPDX-License-Identifier: Apache-2.0

description: NCT-MIWU Wake-Up Unit Input (WUI) mapping child node

compatible: "nuvoton,nct-miwu-wui-map"

child-binding:
  description: Child node to present the mapping between input of MIWU and its source device
  properties:
    miwus:
      type: phandle-array
      required: true
```

## dts/bindings/interrupt-controller/nuvoton,nct-miwu.yaml
```yaml
# Copyright (c) 2025 Nuvoton Technology Corporation.
# SPDX-License-Identifier: Apache-2.0

description: Nuvoton, NCT Multi-Input Wake-Up Unit (MIWU) node

compatible: "nuvoton,nct-miwu"

include: [base.yaml]

properties:
  index:
    type: int
    required: true
    description: index of miwu device

  "#miwu-cells":
    type: int
    required: true
    description: Number of items to present a MIWU input source specifier

miwu-cells:
  - group
  - bit
```

## dts/bindings/interrupt-controller/nuvoton,npcm-miwu-int-map.yaml
```yaml
# Copyright (c) 2024 Nuvoton Technology Corporation.
# SPDX-License-Identifier: Apache-2.0

description: NPCM-MIWU group-interrupt mapping child node

compatible: "nuvoton,npcm-miwu-int-map"

properties:
    parent:
        type: phandle
        required: true
        description: parent device node of miwu groups

child-binding:
    description: Child node to present the mapping between MIWU group and interrupt
    properties:
       irq:
          type: int
          required: true
          description: irq for miwu group
       irq-prio:
          type: int
          required: true
          description: irq's priority for miwu group. The valid number is from 0 to 7.
       group-mask:
          type: int
          required: true
          description: group bit-mask for miwu interrupts
       groups:
          type: array
          description: groups shared the same interrupt
```

## dts/bindings/interrupt-controller/nuvoton,npcm-miwu-wui-map.yaml
```yaml
# Copyright (c) 2024 Nuvoton Technology Corporation.
# SPDX-License-Identifier: Apache-2.0

description: NPCM-MIWU Wake-Up Unit Input (WUI) mapping child node

compatible: "nuvoton,npcm-miwu-wui-map"

child-binding:
  description: Child node to present the mapping between input of MIWU and its source device
  properties:
    miwus:
      type: phandle-array
      required: true
```

## dts/bindings/interrupt-controller/nuvoton,npcm-miwu.yaml
```yaml
# Copyright (c) 2024 Nuvoton Technology Corporation.
# SPDX-License-Identifier: Apache-2.0

description: Nuvoton, NPCM Multi-Input Wake-Up Unit (MIWU) node

compatible: "nuvoton,npcm-miwu"

include: [base.yaml]

properties:
  index:
    type: int
    required: true
    description: index of miwu device

  "#miwu-cells":
    type: int
    required: true
    description: Number of items to present a MIWU input source specifier

miwu-cells:
  - group
  - bit
```
