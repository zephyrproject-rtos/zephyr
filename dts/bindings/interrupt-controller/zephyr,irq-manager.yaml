## dts/bindings/ipm/arm,gic-sgi.yaml
```yaml
# Copyright (c) 2022 openEuler
# SPDX-License-Identifier: Apache-2.0

description: ARM SGI (IPM by software generated int)

compatible: "arm,gic-sgi"

include: base.yaml

properties:
    label:
      required: true
```

## dts/bindings/ipm/espressif,esp32-ipm.yaml
```yaml
# Copyright (c) 2022 Espressif Systems
# SPDX-License-Identifier: Apache-2.0

description: ESP32 soft inter processor message

compatible: "espressif,esp32-ipm"

include: base.yaml

properties:
  reg:
    required: true

  shared-memory:
    required: true
    type: phandle

  shared-memory-size:
    required: true
    type: int

  interrupts:
    required: true
```

## dts/bindings/ipm/intel,adsp-mailbox.yaml
```yaml
# Copyright (c) 2020 Intel Corporation
# SPDX-License-Identifier: Apache-2.0

description: INTEL ADSP MAILBOX

compatible: "intel,adsp-mailbox"

include: base.yaml

properties:
  interrupts:
    required: true

  interrupt-parent:
    required: true
```

## dts/bindings/ipm/intel,cavs-idc.yaml
```yaml
# Copyright (c) 2019 Nordic Semiconductor ASA
# SPDX-License-Identifier: Apache-2.0

description: CAVS Intra-DSP Communication (IDC) on Intel SoC

compatible: "intel,cavs-idc"

include: base.yaml

properties:
    interrupts:
      required: true

    interrupt-parent:
      required: true
```

## dts/bindings/ipm/intel,sedi-ipm.yaml
```yaml
# Copyright (c) 2020-2023 Intel Corporation
#
# SPDX-License-Identifier: Apache-2.0

description: INTEL SEDI IPM controller.

compatible: "intel,sedi-ipm"

include: base.yaml

properties:
  reg:
    required: true

  interrupts:
    required: true

  peripheral-id:
    type: int
    required: true
    description: sedi instance id of ipm
```

## dts/bindings/ipm/linaro,ivshmem-ipm.yaml
```yaml
# Copyright (c) 2023 Linaro
# SPDX-License-Identifier: Apache-2.0

description: Inter processor message based on IVSHMEM

compatible: "linaro,ivshmem-ipm"

include: base.yaml

properties:

  ivshmem:
    type: phandle
    required: true
    description: ivshmem device node
```

## dts/bindings/ipm/microchip,miv-ihc-rtl-v2.yaml
```yaml
# Copyright (c) 2024 Microchip Technology Inc
# SPDX-License-Identifier: (GPL-2.0 OR MIT)

description: |
  The Microchip IHC(Inter Hart Communication) mailbox controller is to manage
  messaging between two IHC agents. Each IHC agent owns registers used for
  notification and buffers for message.

compatible: "microchip,miv-ihc-rtl-v2"

include: base.yaml

properties:
  reg:
    type: array
    description: Address and length of the register set for the device
    required: true

  interrupts-parent:
    type: phandle
    description: phandle to the parent interrupt controller

child-binding:
  description: Microchip IHCM (Inter Hart Communication Module) node

  properties:
    reg:
      type: array
      description: Address and length of the register for this IHCM block
      required: true

    interrupts:
      type: array
      description: Interrupt specifier for the IHCM block
      required: true

  child-binding:
    description: Microchip IHCC (Inter Hart Communication Channel) node

    properties:
      reg:
        type: array
        description: Address and length of the register for this IHCC channel
        required: true
```

## dts/bindings/ipm/nordic,nrf-ipc.yaml
```yaml
# Copyright (c) 2019 Nordic Semiconductor ASA
# SPDX-License-Identifier: Apache-2.0

description: Nordic nRF family IPC (Interprocessor Communication)

compatible: "nordic,nrf-ipc"

interrupt-source: true

include: base.yaml

properties:
  reg:
    required: true
```
