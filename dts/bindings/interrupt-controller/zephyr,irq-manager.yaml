## dts/bindings/interrupt-controller/zephyr,irq-manager.yaml
```yaml
# Copyright (c) 2024 Meta Platforms.
# SPDX-License-Identifier: Apache-2.0

description: |
  IRQ manager is a pseudo device that provides APIs to allocate and free IRQs from
  a range of interrupt lines provided by an interrupt controller.

compatible: "zephyr,irq-manager"

include: [base.yaml]

properties:

  interrupts:
    description: Start of the managed IRQs. Only the first argument matters.
    required: true

  nr-irqs:
    type: int
    description: Number of interrupts
    required: true
```

## dts/bindings/iomuxc/nxp,iomuxc.yaml
```yaml
#
# Copyright (c) 2019, Linaro Limited
#
# SPDX-License-Identifier: Apache-2.0
#

description: NXP MCUX iomuc controller

compatible: "nxp,imx-iomuxc"

include: base.yaml

properties:
    label:
      required: true
```

## dts/bindings/ipc/intel,adsp-host-ipc.yaml
```yaml
# Copyright (c) 2022 Intel Corporation
# SPDX-License-Identifier: Apache-2.0

description: Intel ADSP Inter Processor Communication on Intel SoC

compatible: "intel,adsp-host-ipc"

include: base.yaml

properties:
  reg:
    required: true

  interrupts:
    required: true

  interrupt-parent:
    required: true
```

## dts/bindings/ipc/intel,adsp-idc.yaml
```yaml
# Copyright (c) 2022 Intel Corporation
# SPDX-License-Identifier: Apache-2.0

description: Intel ADSP Intra-DSP Communication (IDC)

compatible: "intel,adsp-idc"

include: base.yaml

properties:
  reg:
    required: true

  interrupts:
    required: true

  interrupt-parent:
    required: true
```

## dts/bindings/ipc/ipc-rpmsg-mc.yaml
```yaml
# Copyright (c) 2021 Carlo Caione <ccaione@baylibre.com>
# SPDX-License-Identifier: Apache-2.0

description: IPC service RPMsg multi-core backend

compatible: "ipc-rpmsg-mc"

include: base.yaml

properties:

  target:
    type: string
    required: true
    description: Name of instance, usually the name of the targed domain.

  priority:
    type: int
    required: true
    description: Priority of the work queue.

  ipc_shm:
    type: phandle
    required: true
    description: phandle to the shared memory region for the instance.

  ipm_tx:
    type: phandle
    required: true
    description: phanble to the IPM for TX.

  ipm_rx:
    type: phandle
    required: true
    description: phandle to the IPM for RX.

  ipm_tx_id:
    type: int
    required: true
    description: ID used by the TX IPM.
```

## dts/bindings/ipc/nordic,nrf-ipc.yaml
```yaml
# Copyright (c) 2019 Nordic Semiconductor ASA
# SPDX-License-Identifier: Apache-2.0

description: Nordic nRF family IPC (Interprocessor Communication)

compatible: "nordic,nrf-ipc"

include: base.yaml

properties:
  reg:
    required: true

  interrupts:
    required: true
```

## dts/bindings/ipc/nordic,nrf-ipct-common.yaml
```yaml
# Copyright (c) 2024 Nordic Semiconductor ASA
# SPDX-License-Identifier: Apache-2.0

description: Nordic IPCT (Interprocessor Communication Transceiver)

include: base.yaml

properties:
  reg:
    required: true

  channels:
    type: int
    required: true
    description: Number of channels implemented by the IPCT instance.

  source-channel-links:
    type: array
    description: |
      Mapping of IPCT channels that are mapped between two IPCT instances on
      separate domains, in which a channel on this IPCT node is considered
      the source. This array is then comprised of a 3-integer-wide "unit"
      that defines one connection of the mapping. The format of this unit
      is <source_channel sink_domain_id sink_channel>. Units are sequential
      in the array, therefore requiring the length of this property to be
      a factor of 3.

      For example, if channel 2 is to be mapped to Radio Core (ID: 3) IPCT
      channel 4, then the array "unit" would be <2 NRF_DOMAIN_ID_RADIOCORE 4>
      or <2 3 4>.

  sink-channel-links:
    type: array
    description: |
      Mapping of IPCT channels that are mapped between two IPCT instances on
      separate domains, in which a channel on this IPCT node is considered
      the sink. This array is then comprised of a 3-integer-wide "unit"
      that defines one connection of the mapping. The format of this unit
      is <sink_channel source_domain_id source_channel>. Units are sequential
      in the array, therefore requiring the length of this property to be
      a factor of 3.

      For example, if channel 2 is to be mapped to Radio Core (ID: 3) IPCT
      channel 4, then the array "unit" would be <2 NRF_DOMAIN_ID_RADIOCORE 4>
      or <2 3 4>.
```

## dts/bindings/ipc/nordic,nrf-ipct-global.yaml
```yaml
# Copyright (c) 2024 Nordic Semiconductor ASA
# SPDX-License-Identifier: Apache-2.0

description: Nordic Global IPCT (Interprocessor Communication Transceiver)

compatible: "nordic,nrf-ipct-global"

include: ["nordic,nrf-ipct-common.yaml", "nordic,split-channels.yaml"]

properties:
  global-domain-id:
    required: true
    type: int
    description: |
      Global IPCT instances reside on specific buses within the Global Domain,
      such as fast and slow, which have different IDs that do not match the
      standard Global Domain ID presented in their address.
```

## dts/bindings/ipc/nordic,nrf-ipct-local.yaml
```yaml
# Copyright (c) 2024 Nordic Semiconductor ASA
# SPDX-License-Identifier: Apache-2.0

description: Nordic Local IPCT (Interprocessor Communication Transceiver)

compatible: "nordic,nrf-ipct-local"

include: "nordic,nrf-ipct-common.yaml"

properties:
  interrupts:
    required: true
```

## dts/bindings/ipc/nxp,ipc-rpmsg-lite.yaml
```yaml
# Copyright 2026 NXP
# SPDX-License-Identifier: Apache-2.0

description: |
  RPMsg-Lite IPC Service backend using mailbox-based signaling.

  This binding represents one RPMsg-Lite link (instance). Multiple links
  share a single physical MBOX channel for inter-processor notifications.
  The signaling topology is modelled explicitly:

  - The instance with link-id = <0> owns the physical MBOX channel and
    declares the standard ``mboxes`` / ``mbox-names`` properties.
  - All other instances declare ``notification-parent`` pointing to the
    owning instance, and omit ``mboxes`` / ``mbox-names``.

  Host ipc[0,1] links with Remote ipc[0,1] via the matching link-id values.
  Both sides share a single physical MBOX channel owned by the instance
  that does not have ``notification-parent`` (link-id = <0> in this example).

compatible: "nxp,ipc-rpmsg-lite"

include: [base.yaml, "zephyr,ipc-common.yaml"]

properties:
  link-id:
    required: true
    type: int
    description: |
      Link ID of this instance. Must match the corresponding instance on
      the remote side. Allowed values: [0 .. (DT_NUM_INST_STATUS_OKAY() - 1)].

      The instance with link-id = <0> must own the shared MBOX channel
      (via ``mboxes`` / ``mbox-names``). All other instances must set
      ``notification-parent`` pointing to it.

  notification-parent:
    description: |
      phandle to the sibling nxp,ipc-rpmsg-lite instance that owns the
      shared MBOX notification channel (i.e., the instance with
      link-id = <0>).

      Set this property on every instance except the one that declares
      ``mboxes`` / ``mbox-names`` directly. The driver uses this to
      avoid registering duplicate MBOX callbacks and to route all
      notifications through a single physical channel.
    type: phandle

  mboxes:
    description: |
      phandle to the MBOX controller channels used for inter-processor
      notification. Provide exactly two entries: TX and RX.

      Only the instance with link-id = <0> (the notification owner)
      declares this property. All other instances use
      ``notification-parent`` instead.

  mbox-names:
    description: |
      MBOX channel names. Must be "tx" and "rx", matching the order of
      the ``mboxes`` entries.

  zephyr,buffer-count:
    type: int
    description: |
      Number of TX/RX buffers for this link. Must be a power of 2.
      Both host and remote must use the same value.

examples:
  - |
    /* Host side */
    ipc0: ipc0 {
        compatible = "nxp,ipc-rpmsg-lite";
        memory-region = <&shm_ipc0>;
        mboxes = <&mbox 2>, <&mbox 3>;
        mbox-names = "tx", "rx";
        link-id = <0>;
        role = "host";
        status = "okay";
    };

    ipc1: ipc1 {
        compatible = "nxp,ipc-rpmsg-lite";
        memory-region = <&shm_ipc1>;
        notification-parent = <&ipc0>;
        link-id = <1>;
        role = "host";
        status = "okay";
    };
  - |
    /* Remote side -- link-id values must match the host */
    ipc0: ipc0 {
        compatible = "nxp,ipc-rpmsg-lite";
        memory-region = <&shm_ipc0>;
        mboxes = <&mbox 3>, <&mbox 2>;
        mbox-names = "tx", "rx";
        link-id = <0>;
        role = "remote";
        status = "okay";
    };

    ipc1: ipc1 {
        compatible = "nxp,ipc-rpmsg-lite";
        memory-region = <&shm_ipc1>;
        notification-parent = <&ipc0>;
        link-id = <1>;
        role = "remote";
        status = "okay";
    };
```

## dts/bindings/ipc/zephyr,ipc-common.yaml
```yaml
# Copyright (c) 2021 Carlo Caione <ccaione@baylibre.com>
# Copyright (c) 2024 NXP
# SPDX-License-Identifier: Apache-2.0

description: Common properties shared by Zephyr IPC service backends.

include: base.yaml

properties:
  role:
    description: IPC instance role (host is the master side, remote is the slave side)
    required: true
    type: string
    enum:
      - host
      - remote

  memory-region:
    description: phandle to the shared memory region used by this IPC instance
    required: true
    type: phandle

  zephyr,priority:
    type: array
    description: |
      Work-queue priority for the instance RX thread. This is an array of
      [priority-level, priority-type] where priority-type is PRIO_COOP for
      cooperative or PRIO_PREEMPT for preemptive scheduling.

      Examples:
        zephyr,priority = <1 PRIO_COOP>;    /* K_PRIO_COOP(1)    */
        zephyr,priority = <2 PRIO_PREEMPT>; /* K_PRIO_PREEMPT(2) */

      When this property is missing a default priority of <0 PRIO_PREEMPT> is
      assumed.

  zephyr,buffer-size:
    type: int
    description: |
      Size of the buffer used to send data between host and remote. This
      property must be the same for host and remote. Preferably a multiple
      of the cache line size.
```

## dts/bindings/ipc/zephyr,ipc-icbmsg.yaml
```yaml
#
# Copyright (c) 2023 Nordic Semiconductor ASA
#
# SPDX-License-Identifier: Apache-2.0
#

description: Inter-core messaging backend with dynamically allocated buffers

compatible: "zephyr,ipc-icbmsg"

include: zephyr,ipc-icmsg.yaml

properties:
  tx-blocks:
    description: number of allocable TX blocks
    required: true
    type: int
    min: 1
    max: 32

  rx-blocks:
    description: number of allocable RX blocks
    required: true
    type: int
    min: 1
    max: 32
```

## dts/bindings/ipc/zephyr,ipc-icmsg-me-follower.yaml
```yaml
#
# Copyright (c) 2022 Nordic Semiconductor ASA
#
# SPDX-License-Identifier: Apache-2.0
#

description: Multiendpoint inter core messaging backend in follower role

compatible: "zephyr,ipc-icmsg-me-follower"

include: zephyr,ipc-icmsg.yaml
```

## dts/bindings/ipc/zephyr,ipc-icmsg-me-initiator.yaml
```yaml
#
# Copyright (c) 2022 Nordic Semiconductor ASA
#
# SPDX-License-Identifier: Apache-2.0
#

description: Multiendpoint inter core messaging backend in initiator role

compatible: "zephyr,ipc-icmsg-me-initiator"

include: zephyr,ipc-icmsg.yaml
```

## dts/bindings/ipc/zephyr,ipc-icmsg.yaml
```yaml
#
# Copyright (c) 2022 Nordic Semiconductor ASA
#
# SPDX-License-Identifier: Apache-2.0
#

description: Inter core messaging backend

compatible: "zephyr,ipc-icmsg"

include: base.yaml

properties:
  tx-region:
    description: phandle to the shared memory region used for data transmission
    required: true
    type: phandle

  rx-region:
    description: phandle to the shared memory region used for data reception
    required: true
    type: phandle

  unbound:
    type: string
    enum:
      - disable
      - enable
      - detect
    default: disable
    description: |
      Select unbound() callback mode. The callback can be enabled or disabled with the
      "enable" and "disable" option respectively. This functionality requires session
      number handshake procedure on both sides, so you cannot set "enable" on one side
      and "disable" on the other. The "detect" mode detects if the remote side
      supports handshake procedure and adjusts its behavior accordingly. The
      "detect" mode is possible only if "dcache-alignment" is at least 8 bytes.

  dcache-alignment:
    type: int
    description: |
      Data cache alignment. If any side of the communication uses cache on
      rx-region/tx-region this property must be the biggest value of the
      invalidation or the write-back size for both sides of the communication.
      If no side of the communication uses data cache this property could be
      safely omitted.
      For example:
        Side A: no data cache
        Side B: 32 Bytes write-back size, 16 Bytes invalidation size
        dcache-alignment = <32>; for both

  mboxes:
    description: phandle to the MBOX controller (TX and RX are required)
    required: true

  mbox-names:
    description: MBOX channel names (must be called "tx" and "rx")
    required: true
```

## dts/bindings/ipc/zephyr,ipc-openamp-static-vrings.yaml
```yaml
# Copyright (c) 2021 Carlo Caione <ccaione@baylibre.com>
# SPDX-License-Identifier: Apache-2.0

description: OpenAMP (RPMsg with static VRINGs) backend

compatible: "zephyr,ipc-openamp-static-vrings"

include: [base.yaml, "zephyr,ipc-common.yaml"]

properties:
  mboxes:
    description: phandle to the MBOX controller (TX and RX are required)
    required: true

  mbox-names:
    description: MBOX channel names (must be called "tx" and "rx")
    required: true
```

## dts/bindings/ipc/zephyr,ipc-serial.yaml
```yaml
# SPDX-FileCopyrightText: 2026 Basalte bv
# SPDX-License-Identifier: Apache-2.0

description: |
  IPC service backend over serial (UART) with COBS framing and multi-endpoint
  multiplexing. This allows inter-processor communication between two MCUs
  connected via a UART link, supporting multiple IPC service endpoints on a
  single serial connection.

  Two MCUs communicate over a UART link. Each side runs an ipc-serial instance
  with matching named endpoints (e.g. ``a``, ``b``). Once both sides register
  an endpoint with the same name, the binding is established and data can flow.

  ::

    +------------------+                      +------------------+
    |      MCU A       |                      |      MCU B       |
    |                  |                      |                  |
    |  +------------+  |                      |  +------------+  |
    |  | ipc-serial |--+--TX--------------RX->+--| ipc-serial |  |
    |  |   (UART)   |--+<-RX--------------TX--+--|   (UART)   |  |
    |  +--^------^--+  |                      |  +--^------^--+  |
    |     |      |     |                      |     |      |     |
    |    +-+    +-+    |                      |    +-+    +-+    |
    |    |a|    |b|    |                      |    |a|    |b|    |
    |    +-+    +-+    |                      |    +-+    +-+    |
    +------------------+                      +------------------+

examples:
  - |
    &uart1 {
      ipc_serial: ipc-serial {
        compatible = "zephyr,ipc-serial";
        status = "okay";
      };
    };

compatible: "zephyr,ipc-serial"

include: uart-device.yaml

properties:
  timeout-ms:
    type: int
    default: 0
    description: |
      Timeout in milliseconds for endpoint binding.
      A zero timeout disables waiting for binding on registering an endpoint.
```
