## dts/bindings/interrupt-controller/nuvoton,npcx-miwu-wui-map.yaml
```yaml
# Copyright (c) 2020 Nuvoton Technology Corporation.
# SPDX-License-Identifier: Apache-2.0

description: NPCX-MIWU Wake-Up Unit Input (WUI) mapping child node

compatible: "nuvoton,npcx-miwu-wui-map"

child-binding:
    description: Child node to present the mapping between input of MIWU and its source device
    properties:
       miwus:
            type: phandle-array
            required: true
```

## dts/bindings/interrupt-controller/nuvoton,npcx-miwu.yaml
```yaml
# Copyright (c) 2020 Nuvoton Technology Corporation.
# SPDX-License-Identifier: Apache-2.0

description: Nuvoton, NPCX Multi-Input Wake-Up Unit (MIWU) node

compatible: "nuvoton,npcx-miwu"

include: [base.yaml]

properties:
    index:
        type: int
        required: true
        description: index of miwu device

    "#miwu-cells":
        type: int
        required: true
        description: Number of items to present a MIWU input souce specifier

miwu-cells:
  - group
  - bit
```

## dts/bindings/interrupt-controller/nxp,gint.yaml
```yaml
# Copyright 2026 NXP
# SPDX-License-Identifier: Apache-2.0

description: |
  NXP GINT (Grouped GPIO Input Interrupt) controller

  The GINT module allows multiple GPIO pins to be combined into a single
  interrupt source with flexible logic combination and trigger modes.

  Features:
  - Support for multiple digital pins in grouped interrupt
  - Configurable polarity (active HIGH or active LOW) per pin
  - OR or AND logic combination
  - Edge or level triggered

  Example usage:

    gint0: gint@40002000 {
      compatible = "nxp,gint";
      reg = <0x40002000 0x1000>;
      interrupts = <0 2>;
      port-num = <2>;
      resets = <&reset 0>;
      status = "okay";
    };

compatible: "nxp,gint"

include: [base.yaml, reset-device.yaml]

properties:
  reg:
    required: true
    description: |
      Base address and size of the GINT peripheral register space.

  interrupts:
    required: true
    description: |
      Interrupt line for the GINT controller.

  resets:
    description: |
      Reset controller phandle and specifier for the GINT peripheral.
```

## dts/bindings/interrupt-controller/nxp,irqsteer-intc.yaml
```yaml
description: i.MX DSP interrupt controller

compatible: "nxp,irqsteer-intc"

include: [base.yaml]

properties:
  reg:
    required: true

  nxp,irq-offset:
    type: int
    description: |
      irq offset in isr table for an irqsteer instance.
      e.g There are 1000 irq entries(IRQ0-IRQ999) in isr table.
      IRQ0 - IRQ299 are level1 interrupts(direct interrupts).
      IRQ300 - IRQ500 are level2 interrupts from irqsteer instance 0.
      IRQ501 - IRQ999 are level2 interrupts from irqsteer instance 1.
      So for irqsteer instance 0, irq offset is 300.
      For irqsteer instance 1, irq offset is 501.

  nxp,num-irqs:
    required: true
    type: int
    description: |
      Totoal number of second level interrupt numbers supported by an irqsteer instance.
      e.g. In i.MX943,
      For irqsteerm7, irqsteera55 and irqsteerm33, there are 15 output masters
      (some masters are reserved). 64 input interrupts are connected to one output
      master. So the second level interrupt numbers are 64 x 15 = 960.
```

## dts/bindings/interrupt-controller/nxp,irqsteer-master.yaml
```yaml
description: i.MX IRQ_STEER master

compatible: "nxp,irqsteer-master"

include: [interrupt-controller.yaml, base.yaml]

properties:
  "#interrupt-cells":
    const: 2

  reg:
    required: true

interrupt-cells:
  - irq
  - priority
```

## dts/bindings/interrupt-controller/nxp,irqsteer1-intc.yaml
```yaml
description: i.MX interrupt extended controller

compatible: "nxp,irqsteer1-intc"

include: [base.yaml]

properties:
  reg:
    required: true
```

## dts/bindings/interrupt-controller/nxp,llwu.yaml
```yaml
# Copyright 2026 NXP
# SPDX-License-Identifier: Apache-2.0

description: Low-Leakage Wakeup Unit (LLWU)

compatible: "nxp,llwu"

include: base.yaml

properties:
  reg:
    required: true
```

## dts/bindings/interrupt-controller/nxp,lpc84x-pint.yaml
```yaml
# Copyright (c) 2026 Aerlync Labs Inc.
# SPDX-License-Identifier: Apache-2.0

description: NXP LPC84X PINT

compatible: "nxp,lpc84x-pint"

include: [base.yaml, interrupt-controller.yaml]

properties:
  reg:
    required: true

  clocks:
    required: true

  interrupts:
    required: true

  num-lines:
    type: int
    required: true
    description: |
      Number of interrupt lines supported by PINT interrupt controller.
```

## dts/bindings/interrupt-controller/nxp,pint.yaml
```yaml
description: NXP Pin interrupt and pattern match engine (PINT)

compatible: "nxp,pint"

include: [base.yaml, interrupt-controller.yaml]

properties:
  reg:
    required: true

  interrupts:
    required: true

  num-lines:
    type: int
    required: true
    description: Number of interrupt lines supported by the interrupt controller.

  num-inputs:
    type: int
    required: true
    description: |
      Number of inputs available to the PINT engine. These inputs are typically
      GPIO pins.
```

## dts/bindings/interrupt-controller/nxp,s32-siul2-eirq.yaml
```yaml
# Copyright 2022-2023 NXP
#
# SPDX-License-Identifier: Apache-2.0

description: NXP S32 SIUL2 External Interrupts Request controller

compatible: "nxp,s32-siul2-eirq"

include: [interrupt-controller.yaml, pinctrl-device.yaml, base.yaml]

properties:
  reg:
    required: true

  reg-names:
    required: true

  pinctrl-0:
    required: true

  pinctrl-names:
    required: true

  filter-prescaler:
    type: int
    description: |
      Setting the prescaler which selects the clock for all digital filters.
      Valid range: 0 - 15.

  interrupt-names:
    description: |
      For platforms that external interrupt lines belong to different interrupt
      IDs (i.e. there is no single interrupt handler for all the lines), this
      property is used by the shim driver to determine the ISR name as defined
      by the HAL.

      The naming must follow: <from-line-number>_<to-line-number>, for example:
      interrupt-names = "0_7", "8_15", "16_23", "24_31";

child-binding:
  description: |
    NXP S32 SIUL2 External Interrupt line configuration. For each
    interrupt line that has specific requirements about digital
    glitch filter, a node using this binding must be added, the
    name must be "line_<line_number>". For example:

      line_0: line_0 {
          filter-enable;
          filter-counter = <5>;
      };

    If the controller has no child node, the digital filter will be
    disabled for all external interrupt lines.

  properties:
    filter-enable:
      type: boolean
      required: true
      description: |
        Enable digital glitch filter to filter out glitches on the input pad.

    filter-counter:
      type: int
      required: true
      description: |
        Configuring the filter counter associated with digital glitch filter.
        Valid range: 0 - 15.

interrupt-cells:
  - gpio-pin
  - eirq-line
```

## dts/bindings/interrupt-controller/nxp,s32-wkpu.yaml
```yaml
# Copyright 2023-2024 NXP
# SPDX-License-Identifier: Apache-2.0

description: NXP S32 Wake-up Unit

compatible: "nxp,s32-wkpu"

include: base.yaml

properties:
  reg:
    required: true

child-binding:
  description: |
    NXP S32 WKPU external interrupt configuration. Specific requirements for each
    interrupt line can be specified by adding children nodes to this controller,
    labeled `irq_<irq_number>`. For example:

      irq_0: irq_0 {
          filter-enable;
      };

  properties:
    filter-enable:
      type: boolean
      description: |
        Enable analog glitch filter on the external interrupt pad input.
```

## dts/bindings/interrupt-controller/nxp,siul2-eirq.yaml
```yaml
# Copyright 2022-2025 NXP
#
# SPDX-License-Identifier: Apache-2.0

description: NXP SIUL2 External Interrupts Request controller

compatible: "nxp,siul2-eirq"

include: [interrupt-controller.yaml, pinctrl-device.yaml, base.yaml]

properties:
  reg:
    required: true

  pinctrl-0:
    required: true

  pinctrl-names:
    required: true

  filter-prescaler:
    type: int
    enum: [0, 1, 2, 3, 4, 5, 6, 7, 8, 9, 10, 11, 12, 13, 14, 15]
    description: |
      Interrupt filter clock prescaler. The prescaler is applied to the input
      clock to SIUL2, which is the peripheral clock counter in the SIUL2.
      The prescaled filter clock period is:
        TIRC * (IFCP + 1)
      where:
        * TIRC is the internal oscillator period.
        * IFCP is 0 to 15.

child-binding:
  description: |
    NXP SIUL2 External Interrupt configuration. Specific filter requirements
    for each interrupt can be specified by adding a child node to the interrupt
    controller, labeled `irq_<interrupt-number>`. For example:

      irq_0: irq_0 {
          max-filter-counter = <5>;
      };

    This will enable a digital filter counter on the corresponding interrupt
    pads to filter out glitches on the inputs. The digital filter will be
    disabled for interrupt lines without specified configuration node.

  properties:
    max-filter-counter:
      type: int
      required: true
      enum: [0, 1, 2, 3, 4, 5, 6, 7, 8, 9, 10, 11, 12, 13, 14, 15]
      description: |
        Maximum Interrupt Filter Counter setting. This value configures the
        filter counter associated with the digital glitch filter.
        A value of 0 to 2, sets the filter as an all pass filter.
        A value of 3 to 15, sets the filter period to (TCK * MAXCNT + n * TCK),
        where:
          * n can be in the range 0 to 4, and accounts for the uncertainty
            factor in filter period calculation.
          * TCK is the prescaled filter clock period.

interrupt-cells:
  - gpio-pin
  - eirq-line
```

## dts/bindings/interrupt-controller/nxp,wuu.yaml
```yaml
# Copyright 2025 NXP
# SPDX-License-Identifier: Apache-2.0

description: NXP Wakeup Unit (WUU)

compatible: "nxp,wuu"

include: base.yaml

properties:
  reg:
    required: true
```

## dts/bindings/interrupt-controller/opencores,or1k-pic-level.yaml
```yaml
#
# Copyright (c) 2025 NVIDIA Corporation <jholdsworth@nvidia.com>
#
# SPDX-License-Identifier: Apache-2.0
#

description: OpenRISC CPU interrupt controller

compatible: "opencores,or1k-pic-level"

include: [interrupt-controller.yaml, base.yaml]

properties:
  "#interrupt-cells":
    const: 1

interrupt-cells:
  - irq
```

## dts/bindings/interrupt-controller/openisa,rv32m1-event-unit.yaml
```yaml
# Copyright (c) 2018, Linaro Inc.
# Copyright (c) 2018, Foundries.io
# SPDX-License-Identifier: Apache-2.0

title: RV32M1 Event Unit

description: |
    This binding describes the RV32M1 Event Unit

compatible: "openisa,rv32m1-event-unit"

include: [interrupt-controller.yaml, base.yaml]

properties:
  reg:
      required: true

  "#interrupt-cells":
      const: 1

interrupt-cells:
  - irq
```

## dts/bindings/interrupt-controller/openisa,rv32m1-intmux-ch.yaml
```yaml
# Copyright (c) 2019, Linaro Limited
# SPDX-License-Identifier: Apache-2.0

description: RV32M1 INTMUX channel

compatible: "openisa,rv32m1-intmux-ch"

include: [interrupt-controller.yaml, base.yaml]

properties:
  reg:
      required: true

  interrupts:
      required: true

interrupt-cells:
  - irq
```

## dts/bindings/interrupt-controller/openisa,rv32m1-intmux.yaml
```yaml
# Copyright (c) 2018 Foundries.io
# SPDX-License-Identifier: Apache-2.0

description: RV32M1 INTMUX IP

compatible: "openisa,rv32m1-intmux"

include: base.yaml

properties:
  reg:
      required: true

  label:
      required: true
```

## dts/bindings/interrupt-controller/pulpino,event-unit.yaml
```yaml
#
# Copyright (c) 2018, Linaro Inc.
#
# SPDX-License-Identifier: Apache-2.0
#
---
title: PULPINO Event Unit
id: pulp,pulpino-event-unit
version: 0.1

description: >
    This binding describes the Pulpino Event Unit

properties:
  compatible:
      category: required
      type: string
      description: compatible strings
      constraint: "pulp,pulpino-event-unit"
      generation: define

  reg:
      category: required
      type: int
      description: mmio register space
      generation: define

base_label: PULPINO_EVENT_UNIT

"#cells":
  - irq
...
```

## dts/bindings/interrupt-controller/qcom,hvm-pic.yaml
```yaml
# SPDX-License-Identifier: Apache-2.0
# Copyright (c) Qualcomm Technologies, Inc. and/or its subsidiaries.

description: |
  Qualcomm Hexagon HVM virtual interrupt controller.

  This interrupt controller is managed by the H2 hypervisor.  Interrupt
  enable/disable and acknowledgment are performed via vmintop hypercalls.

compatible: "qcom,hvm-pic"

include: [interrupt-controller.yaml, base.yaml]

properties:
  "#interrupt-cells":
    const: 2
    description: |
      Two cells: the virtual IRQ number and flags.

interrupt-cells:
  - irq
  - flags
```

## dts/bindings/interrupt-controller/raspberrypi,hazard3-intc.yaml
```yaml
description: Hazard3 interrupt controller

compatible: "raspberrypi,hazard3-intc"

include: [interrupt-controller.yaml, base.yaml]

properties:
  "#interrupt-cells":
    const: 2

interrupt-cells:
  - irq
  - priority
```

## dts/bindings/interrupt-controller/refsoc,intc.yaml
```yaml
#
# Copyright (c) 2018, Linaro Limited
#
# SPDX-License-Identifier: Apache-2.0
#
---
title: Reference SoC Interrupt Controller
type: interrupt-controller
version: 0.1

description: >
    This binding describes Reference SoC Interrupt controller

properties:
  compatible:
      category: required
      type: string
      description: compatible strings
      constraint: "refsoc,intc"
      generation: define

  reg:
      category: required
      type: int
      description: mmio register space
      generation: define

  refsoc,num-irq-priority-bits:
      category: required
      type: int
      description: number of bits of IRQ priorities
      generation: define

cell_string: IRQ

"#cells":
  - irq
  - sense
  - priority
...
```
