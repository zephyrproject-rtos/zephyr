## dts/bindings/interrupt-controller/renesas,rh850-ext-irq.yaml
```yaml
# Copyright (c) 2026 Renesas Electronics Corporation
# SPDX-License-Identifier: Apache-2.0

description: Renesas RH850 external interrupt controller

compatible: "renesas,rh850-ext-irq"

include: [interrupt-controller.yaml, base.yaml, pinctrl-device.yaml]

properties:
  "#interrupt-cells":
    const: 2

  trigger-type:
    required: true
    type: string
    description: |
      Indicates the condition that will trigger an interrupt when detected.
    enum:
      - "disable"
      - "rising"
      - "falling"
      - "both_edge"
      - "level_low"
      - "level_high"

  "#irq-cells":
    type: int
    const: 1

irq-cells:
  - pin
```

## dts/bindings/interrupt-controller/renesas,rh850-intc.yaml
```yaml
# Copyright (c) 2026 Renesas Electronics Corporation
# SPDX-License-Identifier: Apache-2.0

description: Renesas RH850 Interrupt controller (INTC)
compatible: "renesas,rh850-intc"

include: [interrupt-controller.yaml, base.yaml]

properties:
  reg:
    required: true

  "#interrupt-cells":
    const: 2

  num-lines:
    type: int
    required: true
    description: Number of interrupt lines supported by the interrupt controller.

interrupt-cells:
  - irq
  - priority
```

## dts/bindings/interrupt-controller/renesas,rx-grp-intc.yaml
```yaml
# Copyright (c) 2021 KT-Elektronik Klaucke und Partner GmbH
# Copyright (c) 2025 Renesas Electronics Corporation
# SPDX-License-Identifier: Apache-2.0

description: Renesas group interrupt
compatible: "renesas,rx-grp-intc"

include: [interrupt-controller.yaml, base.yaml]

properties:
  reg:
    required: true

  reg-names:
    required: true

  "#interrupt-cells":
    const: 2

interrupt-cells:
  - irq
  - priority
```

## dts/bindings/interrupt-controller/renesas,rx-icu.yaml
```yaml
# Copyright (c) 2021 KT-Elektronik Klaucke und Partner GmbH
# Copyright (c) 2024 Renesas Electronics Corporation
# SPDX-License-Identifier: Apache-2.0

description: Renesas ICU Interrupt controller
compatible: "renesas,rx-icu"

include: [interrupt-controller.yaml, base.yaml]

properties:
  reg:
    required: true

  reg-names:
    required: true

  "#interrupt-cells":
    const: 2

interrupt-cells:
  - irq
  - priority
```

## dts/bindings/interrupt-controller/renesas,rz-ext-irq.yaml
```yaml
# Copyright (c) 2024-2025 Renesas Electronics Corporation
# SPDX-License-Identifier: Apache-2.0

description: Renesas RZ external interrupt controller

compatible: "renesas,rz-ext-irq"

include: [base.yaml, pinctrl-device.yaml]

properties:
  trigger-type:
    required: true
    type: string
    description: |
      Indicates the condition that will trigger an interrupt when detected.
    enum:
      - "falling"
      - "rising"
      - "both_edges"
      - "low_level"

  "#irq-cells":
    type: int
    const: 1

irq-cells:
  - pin
```

## dts/bindings/interrupt-controller/renesas,rz-icu-v2.yaml
```yaml
# Copyright (c) 2026 Renesas Electronics Corporation
# SPDX-License-Identifier: Apache-2.0

description: Renesas RZ Interrupt Controller (ICU)
compatible: "renesas,rz-icu-v2"

include: base.yaml

properties:
  reg:
    required: true
```

## dts/bindings/interrupt-controller/renesas,rz-icu.yaml
```yaml
# Copyright (c) 2025 Renesas Electronics Corporation
# SPDX-License-Identifier: Apache-2.0

description: Renesas RZ Interrupt Controller (ICU)
compatible: "renesas,rz-icu"

include: base.yaml

properties:
  reg:
    required: true
```

## dts/bindings/interrupt-controller/renesas,rz-intc-v2.yaml
```yaml
# Copyright (c) 2025 Renesas Electronics Corporation
# SPDX-License-Identifier: Apache-2.0

description: Renesas RZ Interrupt Controller
compatible: "renesas,rz-intc-v2"

include: base.yaml

properties:
  reg:
    required: true

  reg-names:
    required: true

  gpioint-table:
    type: array

  max-gpioint:
    required: true
    type: int
```

## dts/bindings/interrupt-controller/renesas,rz-intc.yaml
```yaml
# Copyright (c) 2025 Renesas Electronics Corporation
# SPDX-License-Identifier: Apache-2.0

description: Renesas RZ Interrupt Controller
compatible: "renesas,rz-intc"

include: base.yaml

properties:
  reg:
    required: true
```

## dts/bindings/interrupt-controller/renesas,rz-tint.yaml
```yaml
# Copyright (c) 2025 Renesas Electronics Corporation
# SPDX-License-Identifier: Apache-2.0

description: Renesas RZ GPIO interrupt (TINT) controller

compatible: "renesas,rz-tint"

include: base.yaml

properties:
  trigger-type:
    required: true
    type: string
    description: |
      Indicates the condition that will trigger an interrupt when detected.
    enum:
      - "rising"
      - "falling"
      - "high_level"
      - "low_level"

  "#irq-cells":
    type: int
    const: 1

irq-cells:
  - pin
```

## dts/bindings/interrupt-controller/riscv,aplic-msi.yaml
```yaml
# Copyright (c) 2025 Synopsys, Inc.
# SPDX-License-Identifier: Apache-2.0

description: RISC-V Advanced Platform-Level Interrupt Controller (APLIC) in MSI mode

compatible: "riscv,aplic-msi"

include: [interrupt-controller.yaml, base.yaml]

properties:
  reg:
    required: true
    description: Base address and size of the APLIC registers

  riscv,num-sources:
    type: int
    required: true
    description: Number of interrupt sources supported by the APLIC

  riscv,max-priority:
    type: int
    description: |
      Maximum priority level supported by the APLIC implementation.
      Present on some platforms (e.g., QEMU virt). Not used by Zephyr yet.

  msi-parent:
    type: phandle
    required: true
    description: Phandle to the IMSIC controller used for MSI delivery

interrupt-cells:
  - irq
  - priority
  - flags
```

## dts/bindings/interrupt-controller/riscv,aplic.yaml
```yaml
# SPDX-FileCopyrightText: Copyright The Zephyr Project Contributors
# SPDX-License-Identifier: Apache-2.0

description: |
  RISC-V Advanced Platform-Level Interrupt Controller (APLIC).

  The APLIC routes wired interrupts in a RISC-V AIA system.  It can operate
  in two delivery modes:

    - MSI mode: interrupts are converted to Message-Signaled Interrupts and
      forwarded to an IMSIC.  Indicated by the presence of 'msi-parent'.
    - Direct delivery mode: interrupts are delivered directly to harts via
      the external interrupt signal (not yet supported by Zephyr).

compatible: "riscv,aplic"

include: [interrupt-controller.yaml, base.yaml]

properties:
  reg:
    required: true
    description: Base address and size of the APLIC registers

  riscv,num-sources:
    type: int
    required: true
    description: Number of interrupt sources supported by the APLIC

  riscv,max-priority:
    type: int
    description: |
      Maximum priority level supported by the APLIC implementation.
      Present on some platforms (e.g., QEMU virt). Not used by Zephyr yet.

  msi-parent:
    type: phandle
    description: |
      Phandle to the IMSIC controller used for MSI delivery.
      When present the driver operates in MSI mode; when absent
      direct delivery mode is assumed.

interrupt-cells:
  - irq
  - priority
  - flags
```

## dts/bindings/interrupt-controller/riscv,clic.yaml
```yaml
# Copyright (c) 2025 Andes Technology Corporation
# SPDX-License-Identifier: Apache-2.0

description: RISC-V core local interrupt controller

compatible: "riscv,clic"

include: [interrupt-controller.yaml, base.yaml]

properties:
  reg:
    required: true

  "#interrupt-cells":
    const: 2

interrupt-cells:
  - irq
  - priority
```

## dts/bindings/interrupt-controller/riscv,clint0.yaml
```yaml
# Copyright (c) 2020, Katsuhiro Suzuki.
# SPDX-License-Identifier: Apache-2.0

description: Common fields for the RISC-V Core-Local interruptor.

include: [interrupt-controller.yaml, base.yaml]

compatible: "riscv,clint0"

properties:
  reg:
      required: true

  "#interrupt-cells":
      const: 1

interrupt-cells:
  - irq
```

## dts/bindings/interrupt-controller/riscv,cpu-intc.yaml
```yaml
# Copyright (c) 2019, Linaro Limited
# SPDX-License-Identifier: Apache-2.0

description: RISC-V CPU interrupt controller

compatible: "riscv,cpu-intc"

include: [interrupt-controller.yaml, base.yaml]

properties:
  "#interrupt-cells":
      const: 1

interrupt-cells:
  - irq
```

## dts/bindings/interrupt-controller/riscv,imsic.yaml
```yaml
# Copyright (c) 2025 Synopsys, Inc.
# SPDX-License-Identifier: Apache-2.0

description: RISC-V Incoming Message-Signaled Interrupt Controller (IMSIC)

compatible: "riscv,imsic"

include: [interrupt-controller.yaml, base.yaml]

properties:
  reg:
    required: true
    description: Base address and size of the IMSIC file

  riscv,num-ids:
    type: int
    required: true
    description: |
      Number of interrupt identities (EIIDs) supported by this IMSIC instance.
      Per RISC-V AIA specification, valid range is 1-2047 (EIID 0 is reserved).

  riscv,hart-id:
    type: int
    required: true
    description: |
      Hart ID associated with this IMSIC instance. Each hart has its own
      IMSIC interrupt file.

interrupt-cells:
  - id
```

## dts/bindings/interrupt-controller/riscv,plic0-priority.yaml
```yaml
# Copyright (c) 2020, Recogni Inc.
# SPDX-License-Identifier: Apache-2.0

# Common fields for the RISC-V platform-local interrupt controller, these 
# add to the normally available `irq` field with the `priority` for each
# interrupt source.

include: [interrupt-controller.yaml, base.yaml]

properties:
  reg:
      required: true

  riscv,max-priority:
      type: int
      description: maximum interrupt priority
      required: true

  "#interrupt-cells":
      const: 2

interrupt-cells:
  - irq
  - priority
```

## dts/bindings/interrupt-controller/riscv,plic0.yaml
```yaml
# Copyright (c) 2018, SiFive Inc.
# SPDX-License-Identifier: Apache-2.0

# Common fields for the RISC-V platform-local interrupt controller

include: [interrupt-controller.yaml, base.yaml]

properties:
  reg:
      required: true

  riscv,max-priority:
      type: int
      description: maximum interrupt priority
      required: true

  "#interrupt-cells":
      const: 2

interrupt-cells:
  - irq
  - priority
```

## dts/bindings/interrupt-controller/sensry,sy1xx-event-unit.yaml
```yaml
# Copyright (c) 2024 sensry.io
# SPDX-License-Identifier: Apache-2.0

description: Sensry sy1xx event unit

compatible: "sensry,sy1xx-event-unit"

include: [interrupt-controller.yaml, base.yaml]

properties:
  reg:
    required: true

  "#interrupt-cells":
    const: 1

interrupt-cells:
  - irq
```

## dts/bindings/interrupt-controller/shakti,plic0.yaml
```yaml
# Copyright (c) 2018, SiFive Inc.
# SPDX-License-Identifier: Apache-2.0

description: Shakti RISCV-V platform-local interrupt controller

compatible: "shakti,plic0"

include: riscv,plic0.yaml

properties:
  riscv,ndev:
    type: int
    description: Number of external interrupts supported
    required: true
  base:
    type: int
    required: true   
  interrupt-shift:
    type: int
    required: false
```

## dts/bindings/interrupt-controller/shared-irq.yaml
```yaml
description: Shared IRQ interrupt dispatcher

compatible: "shared-irq"

include: [interrupt-controller.yaml, base.yaml]

properties:
  interrupts:
      required: true

  label:
      required: true
```

## dts/bindings/interrupt-controller/sifive,clic-draft.yaml
```yaml
# Copyright (c) 2025 MASSDRIVER EI (massdrive.space)
# SPDX-License-Identifier: Apache-2.0

description: RISC-V Core Local Interrupt Controller CLIC Pre-Standard v0.9

compatible: "sifive,clic-draft"

include: [interrupt-controller.yaml, base.yaml]

properties:
  reg:
    required: true

  "#interrupt-cells":
    const: 2

interrupt-cells:
  - irq
  - priority
```

## dts/bindings/interrupt-controller/sifive,clic.yaml
```yaml
# Copyright (c) 2021, Tokita, Hiroshi
# SPDX-License-Identifier: Apache-2.0

description: SiFive CLIC interrupt controller

compatible: "sifive,clic"

include: [interrupt-controller.yaml, base.yaml]

properties:
  reg:
    required: true

  "#interrupt-cells":
    const: 2

interrupt-cells:
  - irq
  - priority
```

## dts/bindings/interrupt-controller/sifive,legacy-clic.yaml
```yaml
# Copyright (c) 2025 MASSDRIVER EI (massdrive.space)
# SPDX-License-Identifier: Apache-2.0

description: Even Older RISC-V core local interrupt controller
  it uses different offsets than the newer memory-mapped legacy CLIC

compatible: "sifive,legacy-clic"

include: [interrupt-controller.yaml, base.yaml]

properties:
  reg:
    required: true

  "#interrupt-cells":
    const: 2

interrupt-cells:
  - irq
  - priority
```

## dts/bindings/interrupt-controller/sifive,plic-1.0.0.yaml
```yaml
# Copyright (c) 2018, SiFive Inc.
# SPDX-License-Identifier: Apache-2.0

description: SiFive RISCV-V platform-local interrupt controller

compatible: "sifive,plic-1.0.0"

include: riscv,plic0.yaml

properties:
  riscv,ndev:
    type: int
    description: Number of external interrupts supported
    required: true

  support-edge-interrupt:
    type: boolean
    description: |
      Indicates that this controller supports edge interrupt.

  isr-offset:
    type: int
    default: 0
    description: |
      Offset for the ISR in multi-instance interrupt controller setup.
      Increase according to the index in the devicetree.
```
