## dts/bindings/interrupt-controller/espressif,esp32-intc.yaml
```yaml
# Copyright (c) 2021 Espressif Systems (Shanghai) Co., Ltd.
# SPDX-License-Identifier: Apache-2.0

description: |
  ESP32 interrupt controller: the CPU interrupt lines (level 1).

  A consumer that has a CPU line to itself points here directly and names the
  line and the interrupt matrix source routed to it:

      interrupt-parent = <&intc>;
      interrupts = <10 SYSTIMER_TARGET2_EDGE_INTR_SOURCE 0>;

  Consumers that share a line point at an espressif,esp32-cpu-interrupt node
  instead, which maps them onto the espressif,esp32-intmux aggregator.

  reg carries the INTMUX register bases the dispatcher reads, per core: the
  MAP (per-source routing) base then the pending-STATUS base. Single-core
  parts provide one pair (map0, status0); dual-core parts add a second pair
  (map1, status1). The STATUS entry size determines the number of
  pending-status words (size / 4).

compatible: "espressif,esp32-intc"

include: [interrupt-controller.yaml, base.yaml]

properties:
  reg:
    required: true

  "#interrupt-cells":
    const: 3

  reserved-lines:
    type: array
    description: |
      CPU interrupt lines kept for users that connect at run time with
      irq_connect_dynamic(), such as the Wi-Fi library, whose handler is not
      known at build time. No devicetree consumer and no
      espressif,esp32-cpu-interrupt node may use a listed line.

interrupt-cells:
  - irq
  - source
  - flags
```

## dts/bindings/interrupt-controller/espressif,esp32-l3-intc.yaml
```yaml
# Copyright (c) 2026 Espressif Systems (Shanghai) Co., Ltd.
# SPDX-License-Identifier: Apache-2.0

description: |
  ESP32 level-3 interrupt aggregator: several status bits of one peripheral
  that share one interrupt matrix source.

  The node is an input of the espressif,esp32-intmux aggregator; its own
  "interrupts" cell names that source through a CPU line node. "bits" lists
  the bits of "status-reg" it serves, and a consumer names an input by its
  index in that list:

      rtc_l3_intc: rtc-l3-intc {
              compatible = "espressif,esp32-l3-intc";
              interrupt-controller;
              #interrupt-cells = <1>;
              interrupt-parent = <&cpu_interrupt_1>;
              interrupts = <RTC_CORE_INTR_SOURCE>;
              status-reg = <0x60008048>;
              bits = <4 6 7 8 10 16 18>;
      };

      xt_wdt: xt_wdt@60021004 {
              interrupt-parent = <&rtc_l3_intc>;
              interrupts = <5>;       /* bits[5] = 16 */
      };

  The list holds at most CONFIG_MAX_IRQ_PER_3RD_LEVEL_AGGREGATOR entries. The
  peripheral driver masks and clears its own bits; irq_disable() of one input
  leaves the shared source routed.

  A handler that shares the source but has no bit in "status-reg" gets an
  ESP_L3_CATCH_ALL entry, listed last. It is called on every interrupt of the
  source, after the inputs before it, so it must check its own peripheral state
  and return when it has nothing to do. On ESP32-H2 the GPIO port driver shares
  GPIO_INTR_SOURCE with the analog comparator, which owns bit 0:

      bits = <0 ESP_L3_CATCH_ALL>;
      ...
      ana_cmpr0 { interrupts = <0>; };
      gpio0 { interrupts = <1>; };

compatible: "espressif,esp32-l3-intc"

include: [interrupt-controller.yaml, base.yaml]

properties:
  "#interrupt-cells":
    const: 1

  status-reg:
    type: int
    required: true
    description: Address of the peripheral interrupt status register.

  bits:
    type: array
    required: true
    description: |
      Status register bit of each input, in input order, or ESP_L3_CATCH_ALL
      for an input without a status bit.

# The first cell must be named "irq": the multi-level DT_IRQN() macros read it.
# It is the input index into "bits".
interrupt-cells:
  - irq
```

## dts/bindings/interrupt-controller/espressif,esp32-lpcore-intc.yaml
```yaml
# Copyright (c) 2026 Espressif Systems (Shanghai) Co., Ltd.
# SPDX-License-Identifier: Apache-2.0

description: |
  ESP32 LP (low-power) core interrupt controller.

  This is deliberately NOT the same binding as "espressif,esp32-intc". The LP core
  has no interrupt matrix: there is nothing to route, no CPU line to pick and no
  priority or flags to program, so a single cell is all an LP-core interrupt needs.
  An LP-core image also builds without any of Zephyr's interrupt machinery -
  INTC_ESP32 is off (see drivers/interrupt_controller/Kconfig.esp32) and
  GEN_ISR_TABLES is off - so nothing is connected at runtime either.

  Handlers are claimed by defining one of the hal_espressif weak symbols
  (ulp_lp_core_sw_intr_handler(), ulp_lp_core_lp_pmu_intr_handler(),
  ulp_lp_core_lp_timer_intr_handler(), ...) declared in ulp_lp_core_interrupts.h.
  The cell in a consumer's "interrupts" property names which LP interrupt that
  handler belongs to; it is documentation and a cross-check, not a parameter that
  any code programs into hardware.

  The meaning of the cell is SoC-specific:

  - ESP32-C6, ESP32-C5 (SOC_LP_CORE_SINGLE_INTERRUPT_VECTOR): the bit position in
    LPPERI.interrupt_source, which the single vector entry demuxes through the
    handler table in lp_core_interrupt.c -
    0 = LP_IO, 1 = LP_I2C, 2 = LP_UART, 3 = LP_TIMER, 4 = modem (unused), 5 = LP_PMU.
    The LP_CORE_*_INTR_SOURCE defines in the per-SoC intmux dt-binding header carry
    these values.

  - ESP32-P4: the slot in the LP core's 32-entry vector table (port/esp32p4/
    vector_table.S), which is directly vectored - 3 = SW, 7 = LP_UART, 11 = LP_SPI,
    17 = LP_I2C, 18 = LP_IO, 25 = LP_PMU, 26 = MAILBOX, 27 = LP_TIMER, 28 = LP_WDT,
    29 = LP_RTC.

  Note that the HP-core interrupt source numbers (PMU_INTR_SOURCE and friends) are
  matrix inputs and are meaningless here; use the LP_CORE_* values.

compatible: "espressif,esp32-lpcore-intc"

include: [interrupt-controller.yaml, base.yaml]

properties:
  reg:
    required: true
    description: |
      Reserved for future use. Unlike "espressif,esp32-intc", where reg carries the
      INTMUX MAP and STATUS bases the multi-level dispatcher reads, nothing consumes
      this address today - there is no interrupt-controller driver on the LP core.

  "#interrupt-cells":
    const: 1

# First cell must be named "irq": the devicetree interrupt macros read it as the
# interrupt number. Here it carries the LP-core interrupt index described above.
interrupt-cells:
  - irq
```

## dts/bindings/interrupt-controller/google,goldfish-pic.yaml
```yaml
# SPDX-License-Identifier: Apache-2.0

description: |
  Google Goldfish programmable interrupt controller.

  A second-level interrupt aggregator: up to 32 device interrupt sources
  are combined onto a single line delivered to the parent controller (on
  QEMU's m68k virt machine, one CPU interrupt level, autovectored). The
  "interrupts" property gives the parent line this PIC is wired to; child
  devices reference this node as their interrupt-parent and their
  "interrupts" cell is the source line (0..31) within the PIC.

compatible: "google,goldfish-pic"

include: [interrupt-controller.yaml, base.yaml]

properties:
  reg:
    required: true

  interrupts:
    required: true

  big-endian:
    type: boolean
    description: |
      MMIO registers use big-endian byte order. If absent, registers use the
      little-endian Goldfish byte order.

  "#interrupt-cells":
    const: 1

interrupt-cells:
  - irq
```

## dts/bindings/interrupt-controller/infineon,aurix-ir.yaml
```yaml
# SPDX-FileCopyrightText: Copyright (c) 2026 Infineon Technologies AG,
# SPDX-FileCopyrightText: or an affiliate of Infineon Technologies AG. All rights reserved.
# SPDX-FileCopyrightText: Copyright (c) 2026 Linumiz
#
# SPDX-License-Identifier: Apache-2.0

description: Infineon AURIX Interrupt Router

compatible: "infineon,aurix-ir"

include: [interrupt-controller.yaml, base.yaml]

properties:
  reg:
    required: true

  "#interrupt-cells":
    const: 2

interrupt-cells:
  - irq
  - priority
```

## dts/bindings/interrupt-controller/infineon,sysintc.yaml
```yaml
# SPDX-FileCopyrightText: Copyright (c) 2026 Linumiz
#
# SPDX-License-Identifier: Apache-2.0

description: |
  Infineon CAT1 CPUSS system interrupt multiplexer.

  The CAT1 CPUSS routes peripheral system interrupts onto NvicMux NVIC
  lines through a programmable multiplexer. This node is a container
  for the individual mux channel nodes (infineon,sysintc-mux).

  Peripherals set their interrupt-parent to a specific mux channel
  child node to select which NvicMux line they are routed to.

  System interrupts have no priority of their own; each takes the priority of
  the NVIC line it is routed to, so changing a line's priority changes it for
  every system interrupt on that line.

  Example:
    cpuss_intc: interrupt-controller@40200000 {
        compatible = "infineon,sysintc";
        reg = <0x40200000 0x10000>;
        #address-cells = <1>;
        #size-cells = <0>;

        intmux_ch0: interrupt-controller@0 {
            compatible = "infineon,sysintc-mux";
            reg = <0>;
            interrupt-controller;
            #interrupt-cells = <2>;
            interrupts = <0 1>;
        };

        intmux_ch1: interrupt-controller@1 {
            compatible = "infineon,sysintc-mux";
            reg = <1>;
            interrupt-controller;
            #interrupt-cells = <2>;
            interrupts = <1 1>;
        };
    };

compatible: "infineon,sysintc"

include: base.yaml

properties:
  reg:
    required: true

  "#address-cells":
    const: 1

  "#size-cells":
    const: 0
```

## dts/bindings/interrupt-controller/mediatek,mt8188-eint.yaml
```yaml
# Copyright (c) 2026 MediaTek Inc.
# SPDX-License-Identifier: Apache-2.0

description: |
  MediaTek MT8188 external interrupt controller.

  Multiplexes the per-pin external interrupt lines onto a single parent
  interrupt.  GPIO banks reference this controller to register for events on
  their pins.

compatible: "mediatek,mt8188-eint"

include: [base.yaml]

properties:
  reg:
    required: true

  interrupts:
    required: true

  num-lines:
    type: int
    required: true
    description: |
      Number of external interrupt lines the block implements, whether or not
      this system uses them all.  The MT8188 implements 225.
```

## dts/bindings/interrupt-controller/microchip,eic-g1-intc.yaml
```yaml
# Copyright (c) 2025-2026 Microchip Technology Inc.
# SPDX-License-Identifier: Apache-2.0

title: Microchip EIC G1 device

description: |
  The Microchip G1 External Interrupt Controller (EIC) device provides interrupt
  support for GPIO pins on Microchip G1 group of devices. As the mapping between
  GPIO pins and EIC interrupt lines differs across devices, the devicetree
  properties describes device-specific interrupt capabilities instead of hardcoding
  them.

  The devicetree binding provides the hardware-specific information including:
   - GPIO pins that support external interrupts.
   - GPIO pins that do not support external interrupts.
   - The EIC line of each GPIO pin, as a per-port table.

  Each port's portX-eic-lines table gives the EIC line of its pins, two pins
  per byte.

  Group g1 EIC supports following hardware peripherals:
    - module name="EIC" id="U2254" version="3.0.0"

compatible: "microchip,eic-g1-intc"

include: base.yaml

properties:
  reg:
    required: true
    description: |
      Specifies the base address and size of the register
      block of external interrupt controller.

  interrupts:
    required: true
    description: |
      Specifies the interrupt line in the NVIC

  low-power-mode:
    type: boolean
    description: |
      Enables low power mode for eic peripheral

  porta-unsupported-pins:
    type: int
    default: 0
    description: |
      Each bit in the property denotes a pin number. This shows the pins which
      do not support interrupt for port a.

  portb-unsupported-pins:
    type: int
    default: 0
    description: |
      Each bit in the property denotes a pin number. This shows the pins which
      do not support interrupt for portb.

  portc-unsupported-pins:
    type: int
    default: 0
    description: |
      Each bit in the property denotes a pin number. This shows the pins which
      do not support interrupt for portc.

  portc-supported-pins:
    type: int
    default: 0
    description: |
      Each bit in the property denotes a pin number. This shows the pins which
      support interrupt in portc

  portd-supported-pins:
    type: int
    default: 0
    description: |
      Each bit in the property denotes a pin number. This shows the pins which
      support interrupt in portd

  porta-eic-lines:
    type: uint8-array
    min-len: 16
    max-len: 16
    description: |
      EXTINT line of each port A pin, two pins per byte: byte n holds pin 2n
      in its low nibble and pin 2n + 1 in its high nibble. 16 bytes. Pins
      the port's supported or unsupported mask rejects are not read.

  portb-eic-lines:
    type: uint8-array
    min-len: 16
    max-len: 16
    description: |
      EXTINT line of each port B pin, two pins per byte: byte n holds pin 2n
      in its low nibble and pin 2n + 1 in its high nibble. 16 bytes. Pins
      the port's supported or unsupported mask rejects are not read.

  portc-eic-lines:
    type: uint8-array
    min-len: 16
    max-len: 16
    description: |
      EXTINT line of each port C pin, two pins per byte: byte n holds pin 2n
      in its low nibble and pin 2n + 1 in its high nibble. 16 bytes. Pins
      the port's supported or unsupported mask rejects are not read.

  portd-eic-lines:
    type: uint8-array
    min-len: 16
    max-len: 16
    description: |
      EXTINT line of each port D pin, two pins per byte: byte n holds pin 2n
      in its low nibble and pin 2n + 1 in its high nibble. 16 bytes. Pins
      the port's supported or unsupported mask rejects are not read.

examples:
  - |
    /*
     * The following example shows an EIC node in the SoC devicetree. The
     * *-supported-pins and *-unsupported-pins properties describe the
     * interrupt capabilities of GPIO pins for each port.
     *
     * The portX-eic-lines properties give the EIC line of each pin of a port,
     * two pins per byte, low nibble first.
     *
     * GPIO pins can be configured for interrupt operation using the standard
     * Zephyr GPIO APIs in the same way as any other GPIO pin.
     */
    eic: interrupt-controller@40001800 {
      compatible = "microchip,eic-g1-intc";
      reg = <0x40001800 0x400>;
      interrupts = <20>;
      interrupt-controller;
      #interrupt-cells = <2>;

      porta-unsupported-pins = <0x00000030>;
      portc-supported-pins = <0x00FF0000>;
      portc-eic-lines = [00 00 00 00 00 00 00 00 10 32 54 76 00 00 00 00];
    };
```

## dts/bindings/interrupt-controller/motorola,m68k-cpu-intc.yaml
```yaml
# SPDX-License-Identifier: Apache-2.0

description: Motorola M68K CPU interrupt controller

compatible: "motorola,m68k-cpu-intc"

include: [interrupt-controller.yaml, base.yaml]

properties:
  "#address-cells":
    const: 0
    description: This interrupt controller does not use address cells.

  "#interrupt-cells":
    const: 1
    description: |
      The single cell is the CPU vector number used for interrupt dispatch.
      Autovectored inputs use M68K_IRQ_AUTOVECTOR(level).

interrupt-cells:
  - irq
```
