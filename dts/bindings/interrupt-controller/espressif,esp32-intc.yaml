## dts/bindings/interrupt-controller/raspberrypi,rp1-intc.yaml
```yaml
# Copyright (c) 2026 Process Mission
# SPDX-License-Identifier: Apache-2.0

description: |
  Raspberry Pi RP1 MSI-X interrupt controller.

  The RP1 exposes one MSI-X vector per internal interrupt source. The
  irq cell contains the RP1 vector number from
  <zephyr/dt-bindings/interrupt-controller/rp1-irq.h>. The controller
  is a nexus for its children: `interrupt-map` translates each RP1
  vector to the MSI controller, which in turn raises a host interrupt.

  The driver locates the RP1 in the configuration space of the PCIe
  root complex that parents this node, programs the MSI-X table and
  unmasks the host side of the MSI proxy.

compatible: "raspberrypi,rp1-intc"

include: [interrupt-controller.yaml, base.yaml]

properties:
  reg:
    required: true
    description: |
      MSI-X CFG register block, i.e. the RP1 PCIe APBS window at
      offset 0x108000.

  msi-parent:
    type: phandle
    required: true
    description: MSI controller that receives the RP1 MSI-X writes.

  interrupt-map:
    type: compound
    required: true
    description: |
      Maps an RP1 vector to the MSI controller. Entry layout is
      <vector flags> <msi-controller phandle> <vector flags>.

interrupt-cells:
  - irq
  - flags
```

## dts/bindings/interrupt-controller/renesas,rh850-feinc.yaml
```yaml
# Copyright (c) 2026 Renesas Electronics Corporation
# SPDX-License-Identifier: Apache-2.0

description: Renesas RH850 FE level Interrupt controller (FEINC)
compatible: "renesas,rh850-feinc"

include: [interrupt-controller.yaml, base.yaml]

properties:
  reg:
    required: true

  reg-names:
    required: true

  "#interrupt-cells":
    const: 1

  num-lines:
    type: int
    required: true
    description: Number of interrupt lines supported by the interrupt controller.

  renesas,pe-id:
    type: int
    required: true
    description: Hardware PEID of the processor element owning this FEINC instance.

interrupt-cells:
  - irq
```

## dts/bindings/interrupt-controller/renesas,rh850-intc1.yaml
```yaml
# Copyright (c) 2026 Renesas Electronics Corporation
# SPDX-License-Identifier: Apache-2.0

description: |
  Renesas RH850 PE-local interrupt controller (INTC1).
  One instance per processor element (PE).

compatible: "renesas,rh850-intc1"

include: [interrupt-controller.yaml, base.yaml]

properties:
  reg:
    required: true

  reg-names:
    required: true

  "#interrupt-cells":
    const: 2

  num-lines:
    type: int
    required: true
    description: Number of interrupt lines handled by this INTC1 instance.

  renesas,pe-id:
    type: int
    required: true
    description: Hardware PEID of the processor element owning this INTC1 instance.

interrupt-cells:
  - irq
  - priority
```

## dts/bindings/interrupt-controller/renesas,rh850-intc2.yaml
```yaml
# Copyright (c) 2026 Renesas Electronics Corporation
# SPDX-License-Identifier: Apache-2.0

description: Renesas RH850 shared interrupt controller (INTC2)
compatible: "renesas,rh850-intc2"

include: [interrupt-controller.yaml, base.yaml]

properties:
  reg:
    required: true

  reg-names:
    required: true

  "#interrupt-cells":
    const: 2

  num-lines:
    type: int
    required: true
    description: Number of interrupt lines supported by the interrupt controller.

interrupt-cells:
  - irq
  - priority
```

## dts/bindings/interrupt-controller/renesas,rh850-intif-intsel.yaml
```yaml
# Copyright (c) 2026 Renesas Electronics Corporation
# SPDX-License-Identifier: Apache-2.0

description: Renesas RH850 Interrupt selection
compatible: "renesas,rh850-intif-intsel"

include: [interrupt-controller.yaml, base.yaml]

properties:
  "#interrupt-cells":
    const: 0

  channel:
    type: int
    required: true
    description: |
      Indicates the number of interrupt selection
```

## dts/bindings/interrupt-controller/renesas,rh850-intif.yaml
```yaml
# Copyright (c) 2026 Renesas Electronics Corporation
# SPDX-License-Identifier: Apache-2.0

description: Renesas RH850 Peripheral Interrupt (INTIF)
compatible: "renesas,rh850-intif"

include: base.yaml

properties:
  reg:
    required: true
```

## dts/bindings/interrupt-controller/renesas,rx-grp-intc-fsp.yaml
```yaml
# Copyright (c) 2026 Renesas Electronics Corporation
# SPDX-License-Identifier: Apache-2.0

description: Renesas group interrupt
compatible: "renesas,rx-grp-intc-fsp"

include: [interrupt-controller.yaml, base.yaml]

properties:
  "#interrupt-cells":
    const: 2

interrupt-cells:
  - irq
  - priority
```

## dts/bindings/interrupt-controller/renesas,rx-icum-grp-irq.yaml
```yaml
# Copyright (c) 2026 Renesas Electronics Corporation
# SPDX-License-Identifier: Apache-2.0

description: Renesas RX ICUM group interrupt controller

compatible: "renesas,rx-icum-grp-irq"

include: [interrupt-controller.yaml, base.yaml]

properties:
  reg:
    required: true
    description: |
      Group interrupt registers, in the order given by reg-names.

  reg-names:
    required: true
    description: |
      Names of the register regions:
        - grp: Group interrupt request register (GRPxxx)
        - gen: Group interrupt request enable register (GENxxx)

  interrupts:
    required: true
    description: |
      Vector number and priority of the group interrupt.

  "#interrupt-cells":
    const: 2

interrupt-cells:
  - irq
  - priority
```

## dts/bindings/interrupt-controller/renesas,rx-icum.yaml
```yaml
# Copyright (c) 2026 Renesas Electronics Corporation
# SPDX-License-Identifier: Apache-2.0

description: Renesas ICUM Interrupt controller
compatible: "renesas,rx-icum"

include: [interrupt-controller.yaml, base.yaml]

properties:
  reg:
    required: true

  reg-names:
    required: true

  "#interrupt-cells":
    const: 2

interrupt-cells:
  - irq
  - priority
```

## dts/bindings/interrupt-controller/st,stm32wb0-gpio-intc.yaml
```yaml
# SPDX-FileCopyrightText: Copyright (c) 2024 STMicroelectronics
# SPDX-License-Identifier: Apache-2.0

title: STM32WB0 GPIO Interrupt Controller

description: |
  GPIO interrupt controller for STM32WB0/STM32WL3 series

  This interrupt controller is configured via registers in SYSCFG.
  It supports both edge- and level-triggered interrupts.

compatible: "st,stm32wb0-gpio-intc"

include: "st,stm32-exti.yaml"
```

## dts/bindings/interrupt-controller/ti,k3-intr-router.yaml
```yaml
# SPDX-License-Identifier: Apache-2.0
# Copyright (c) Dhruv Menon <dhruvmenon1104@gmail.com>

description: Texas Instruments K3 Interrupt Router

compatible: "ti,k3-intr-router"

include: [interrupt-controller.yaml, base.yaml]

properties:
  reg:
    required: true

  interrupt-controller:
    required: true

  "#interrupt-cells":
    const: 1

  ti,num-inputs:
    type: int
    required: true
    description: Total number of input interrupt lines

  ti,num-outputs:
    type: int
    required: true
    description: Total number of output interrupt lines

  ti,output-offset:
    type: int
    default: 0
    description: Starting output line index managed by this core/instance

  ti,preroutes:
    type: array
    description: |
      Array of <output_idx input_idx> pairs pre-configured at boot time.
      For example, <20 162 21 190> pre-routes TIMER0 (162) to output 20,
      and RPMsg/IPC (190) to output 21.
```

## dts/bindings/interrupt-controller/ti,sci-intr-out.yaml
```yaml
# Copyright (c) 2026 Dhruv Menon <dhruvmenon1104@gmail.com>
# SPDX-License-Identifier: Apache-2.0

description: |
  One host-side output of a TI K3 SCI-managed interrupt router (ti,sci-intr).

  Each node represents a fixed IR output index (reg) that is hard-wired to a
  parent VIM/GIC IRQ (interrupts). Peripherals that need the INTROUTER name
  this node as interrupt-parent and pass the IR *input* number:

    main_gpio_intr_16: interrupt-controller@10 {
        compatible = "ti,sci-intr-out";
        reg = <16>;
        interrupt-controller;
        #interrupt-cells = <2>;
        interrupt-parent = <&vim>;
        interrupts = <0 104 IRQ_TYPE_LEVEL IRQ_DEFAULT_PRIORITY>;
    };

    main_i2c4: i2c@fe80000 {
        interrupt-parent = <&main_gpio_intr_16>;
        interrupts = <178 0>;   /* IR input 178; L2 priority cell must be 0 */
    };

  On irq_enable(), the parent ti,sci-intr driver programs TISCI to route the
  IR input onto this output and enables the parent VIM line. Peripheral
  drivers use ordinary IRQ_CONNECT(DT_IRQN(...)) / irq_enable().

compatible: "ti,sci-intr-out"

include: [interrupt-controller.yaml, base.yaml]

properties:
  reg:
    required: true
    description: Interrupt-router output index (host-side dst_host_irq).

  "#interrupt-cells":
    const: 2

interrupt-cells:
  - irq
  - priority
```

## dts/bindings/interrupt-controller/ti,sci-intr.yaml
```yaml
# Copyright (c) 2026 Dhruv Menon <dhruvmenon1104@gmail.com>
# SPDX-License-Identifier: Apache-2.0

description: |
  Texas Instruments K3 Interrupt Router managed via TISCI.

  The Interrupt Router muxes M interrupt inputs to N outputs. Configuration of
  the per-output MUXCNTL registers is performed by System Firmware through the
  TISCI resource-management IRQ set/release messages.

  Expose each host IR output as a child `ti,sci-intr-out` node (reg = output
  index, interrupts = parent VIM/GIC line). Peripherals set interrupt-parent to
  that child and pass only the IR input number (plus a zero priority cell).
  Drivers then use ordinary IRQ_CONNECT / irq_enable; the parent programs the
  TISCI route when the IRQ is enabled.

compatible: "ti,sci-intr"

include: [interrupt-controller.yaml, base.yaml]

properties:
  reg:
    required: true

  interrupt-controller:
    required: true

  "#address-cells":
    const: 1

  "#size-cells":
    const: 0

  ti,sci:
    type: phandle
    required: true
    description: Phandle to the TISCI system controller node.

  ti,sci-dev-id:
    type: int
    required: true
    description: TISCI device ID of this interrupt router instance.

  "#interrupt-cells":
    const: 1

interrupt-cells:
  - irq
```

## dts/bindings/ipc/infineon,ipc.yaml
```yaml
# SPDX-FileCopyrightText: Copyright (c) 2026 Infineon Technologies AG,
# SPDX-FileCopyrightText: or an affiliate of Infineon Technologies AG. All rights reserved.
#
# SPDX-License-Identifier: Apache-2.0

description: |
  Infineon inter-processor communication (IPC) instance.

  An IPC instance groups a set of IPC channels and IPC interrupt structures
  behind a single register block. It is referenced by mailbox controllers
  (see infineon,mbox) to describe which channel and interrupt structure a
  given mailbox channel uses.

compatible: "infineon,ipc"

include: base.yaml

properties:
  reg:
    required: true

  "#ipc-config-cells":
    type: int
    const: 2

  channel-count:
    type: int
    description: |
      Number of IPC channel structures (STRUCT[]) present in this instance.
      Used to bounds-check the channel index of each ipc-configs entry that
      references this instance. When omitted, the full 32-entry range is
      assumed.

  interrupt-count:
    type: int
    description: |
      Number of IPC interrupt structures (INTR_STRUCT[]) present in this
      instance. Used to bounds-check the interrupt index of each ipc-configs
      entry that references this instance. When omitted, the full 32-entry
      range is assumed.

  channel-mask:
    type: int
    description: |
      Bitmask of the IPC channels in this instance that are available to the
      application (bit c set means channel c is usable). Channels whose bit is
      clear are reserved by the system. When omitted, all channels are assumed
      available.

  interrupt-mask:
    type: int
    description: |
      Bitmask of the IPC interrupt structures in this instance that are
      available to the application (bit i set means interrupt structure i is
      usable). When omitted, all interrupt structures are assumed available.

ipc-config-cells:
  - channel
  - interrupt
```

## dts/bindings/ipc/ipc-link-spi.yaml
```yaml
# SPDX-FileCopyrightText: Copyright (c) 2026 Basalte bv
# SPDX-License-Identifier: Apache-2.0

# Common properties of the IPC link backend's SPI transport

include: [spi-device.yaml, ipc-link.yaml]

properties:
  rdy-gpios:
    type: phandle-array
    required: true
    description: |
      Driven by the peripheral, active while it has a transfer armed. The controller waits for it
      to become active before each transaction.

  irq-gpios:
    type: phandle-array
    required: true
    description: |
      Driven by the peripheral, active while it has something to send.

  mtu:
    type: int
    default: 1600
    description: |
      Length of every transaction in bytes, a multiple of 4, the same on both sides: the header
      carries it, and a peer with another size is reported and never connects. A transaction
      holds a 12 byte header, the messages, each with a 4 byte header, and a 2 byte CRC. The
      default fits an Ethernet frame.
```
