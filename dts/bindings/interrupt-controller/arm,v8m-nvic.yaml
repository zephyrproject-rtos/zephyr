## dts/bindings/interrupt-controller/intel,mvic.yaml
```yaml
---
title: Intel Quark D2000 Interrupt Controller
version: 0.1

description: >
    This binding describes the Intel Quark D2000 Interrupt
    Controller

inherits:
    !include base.yaml

properties:
  compatible:
      constraint: "intel,mvic"

  reg:
      category: required

  intel,num-irq-priority-bits:
      category: required
      type: int
      description: number of bits of IRQ priorities
      generation: define

"#cells":
  - irq
  - sense
...
```

## dts/bindings/interrupt-controller/intel,vt-d.yaml
```yaml
# Copyright (c) 2020 Intel Corp.
# SPDX-License-Identifier: Apache-2.0

description: Intel VT-D Interrupt Remapping Controller

compatible: "intel,vt-d"

include: base.yaml

properties:
    reg:
      required: true
```

## dts/bindings/interrupt-controller/interrupt-controller.yaml
```yaml
# Copyright (c) 2019, Linaro Limited
# SPDX-License-Identifier: Apache-2.0

# Common fields for interrupt controllers

properties:
    "interrupt-controller":
      type: boolean
      required: true
      description: Convey's this node is an interrupt controller
    "#interrupt-cells":
      type: int
      required: true
      description: Number of items to expect in an interrupt specifier
```

## dts/bindings/interrupt-controller/interrupt-nexus.yaml
```yaml
# Copyright (c) 2025 TOKITA Hiroshi
# SPDX-License-Identifier: Apache-2.0

# Common fields for interrupt nexus nodes
#
# See 2.4 Interrupts and Interrupt Mapping
# https://devicetree-specification.readthedocs.io/en/latest/chapter2-devicetree-basics.html#interrupts-and-interrupt-mapping
# in the Devicetree Specification

properties:
  interrupt-map:
    type: compound
    required: true

  interrupt-map-mask:
    type: array

  interrupt-map-pass-thru:
    type: array

  "#interrupt-cells":
    type: int
    required: true
    description: Number of items to expect in a interrupt specifier
```

## dts/bindings/interrupt-controller/ite,it51xxx-intc.yaml
```yaml
# Copyright (c) 2025 ITE Corporation. All Rights Reserved.
# SPDX-License-Identifier: Apache-2.0

description: ITE Interrupt controller
compatible: "ite,it51xxx-intc"

include: [interrupt-controller.yaml, base.yaml]

properties:
  reg:
    required: true

interrupt-cells:
  - irq
  - flags
```

## dts/bindings/interrupt-controller/ite,it51xxx-wuc-map.yaml
```yaml
# Copyright (c) 2025 ITE Corporation. All Rights Reserved.
# SPDX-License-Identifier: Apache-2.0

description: ITE Wake-Up Controller (WUC) mapping child node

compatible: "ite,it51xxx-wuc-map"

child-binding:
  description: Child node to present the mapping between input of WUC and its source device
  properties:
    wucs:
      type: phandle-array
      required: true
```
