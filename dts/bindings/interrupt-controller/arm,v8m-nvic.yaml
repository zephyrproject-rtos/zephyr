## dts/bindings/interrupt-controller/arm,v8m-nvic.yaml
```yaml
title: ARMv8-M NVIC Interrupt Controller

description: >
    This binding describes the ARMv8-M Nested Vectored Interrupt Controller.

inherits:
    !include [interrupt-controller.yaml, base.yaml]

properties:
    compatible:
      constraint: "arm,v8m-nvic"

    reg:
      category: required

    arm,num-irq-priority-bits:
      category: required
      type: int
      description: number of bits of IRQ priorities

"#cells":
  - irq
  - priority
```

## dts/bindings/interrupt-controller/brcm,bcm2835-armctrl-ic.yaml
```yaml
# Copyright (c) 2026 Jonathan Elliot Peace <jep@alphabetiq.com>
# SPDX-License-Identifier: Apache-2.0

description: |
  BCM2835 ARMC peripheral interrupt controller -- the "GPU IRQ" side
  of the BCM283x family (Pi 1 / Pi 2 / Pi 3 / Pi Zero family).

  Hangs off the BCM2836 ARM-local intc as a child. Aggregates 64 GPU
  IRQs (PEND1 + PEND2 banks) plus 8 ARMC "basic" IRQs into the GPU
  cascade line of its parent.

  Zephyr exposes this controller's IRQs in a flat range offset by 32
  (the L1 ARM-local intc occupies 0..31, only 0..9 used):
    32..39   = basic bank   (IRQ_BASIC_PENDING bits 0..7)
    64..95   = GPU PEND1    (PEND1 bits 0..31)
    96..127  = GPU PEND2    (PEND2 bits 0..31)
  (See <zephyr/dt-bindings/interrupt-controller/bcm2835-armctrl.h>
  for the symbolic constants, and soc/brcm/bcm2710/soc_irq.c +
  drivers/interrupt_controller/intc_bcm2835_armctrl.c for the
  decode that maps these numbers to the bank-0 shortcut bits +
  PEND1 / PEND2 registers.)

compatible: "brcm,bcm2835-armctrl-ic"

include: [interrupt-controller.yaml, base.yaml]

properties:
  reg:
    required: true

  interrupts:
    description: |
      The single GPU-cascade IRQ on the parent BCM2836 ARM-local intc.
      Present only when this controller is cascaded (BCM2836 / Pi 2+).
      On the BCM2835 (Pi 1 / Zero / Zero W) the ARMC is the root
      interrupt controller, wired directly to the ARM core IRQ line, so
      it has no parent interrupt and this property is omitted.

  interrupt-controller:
    required: true

  "#interrupt-cells":
    const: 3
    description: |
      Cell 0: flat IRQ number from the offset-by-32 ARMC space
              (32..39 basic / 64..95 PEND1 / 96..127 PEND2).
      Cell 1: trigger-type flags (IRQ_TYPE_LEVEL / IRQ_TYPE_EDGE).
      Cell 2: priority -- unused by this controller, kept as a
              fixed third cell for parity with the parent
              brcm,bcm2836-l1-intc binding (see its rationale).

interrupt-cells:
  - irq
  - flags
  - priority
```

## dts/bindings/interrupt-controller/brcm,bcm2836-l1-intc.yaml
```yaml
# Copyright (c) 2026 Jonathan Elliot Peace <jep@alphabetiq.com>
# SPDX-License-Identifier: Apache-2.0

description: |
  BCM2836 / BCM2710 ARM-local interrupt controller (Pi 2 / Pi 3 / Pi Zero 2 W).

  Sits at physical 0x40000000, ABOVE the peripheral base. Routes per-core
  ARM generic timer IRQs, four mailbox IRQs per core (used as IPIs), the
  per-core PMU IRQ, and the cascaded GPU IRQ -- the latter aggregating
  every pending source on the BCM2835 ARMC peripheral interrupt
  controller for whichever core the firmware (or Zephyr) routes the GPU
  IRQ to.

compatible: "brcm,bcm2836-l1-intc"

include: [interrupt-controller.yaml, base.yaml]

properties:
  reg:
    required: true

  interrupt-controller:
    required: true

  "#interrupt-cells":
    const: 3
    description: |
      Cell 0: per-core source.
        0=CNTPSIRQ (secure phys), 1=CNTPNSIRQ (nonsec phys),
        2=CNTHPIRQ (hyp phys),    3=CNTVIRQ   (virtual),
        4..7=MAILBOX0..3,         8=GPU IRQ,  9=PMU.
      Cell 1: trigger-type flags (IRQ_TYPE_LEVEL / IRQ_TYPE_EDGE).
      Cell 2: priority -- unused by this controller (no per-IRQ
              priority register exists), kept as a fixed third cell
              so that the canonical ARM-arch-timer driver's
              DT_IRQ_BY_IDX(node, n, priority) macro resolves.

interrupt-cells:
  - irq
  - flags
  - priority
```

## dts/bindings/interrupt-controller/cdac,thejas32-intc.yaml
```yaml
# Copyright (c) 2026 Anuj Deshpande
# SPDX-License-Identifier: Apache-2.0

description: |
  C-DAC THEJAS32 interrupt controller.

  This is a simple second-level interrupt aggregator that combines the SoC
  peripheral interrupt sources into the RISC-V machine external interrupt
  line. Unlike a RISC-V PLIC it has no per-source priority and no
  claim/complete protocol: it exposes a single enable bitmask and a single
  (enabled and pending) status bitmask. A source is cleared by servicing the
  peripheral that raised it.

compatible: "cdac,thejas32-intc"

include: [interrupt-controller.yaml, base.yaml]

properties:
  reg:
    required: true

  "#interrupt-cells":
    const: 2

interrupt-cells:
  - irq
  - priority
```

## dts/bindings/interrupt-controller/cypress,psoc6-int-mux.yaml
```yaml
# Copyright (c) 2018 Foundries.io
# Copyright (c) 2020 ATL Electronics
# SPDX-License-Identifier: Apache-2.0

description: Cypress Interrupt Multiplex

compatible: "cypress,psoc6-intmux"

include: base.yaml

properties:
  reg:
      required: true

  label:
      required: true
```

## dts/bindings/interrupt-controller/cypress,psoc6-intmux-ch.yaml
```yaml
# Copyright (c) 2019, Linaro Limited
# Copyright (c) 2020, ATL Electronics
# SPDX-License-Identifier: Apache-2.0

description: |
  Cypress Interrupt Multiplex Channel

  see cypress,psoc6-intmux

compatible: "cypress,psoc6-intmux-ch"

include: [interrupt-controller.yaml, base.yaml]

properties:
  reg:
      required: true

  interrupts:
      required: true

interrupt-cells:
  - irq
  - priority
```

## dts/bindings/interrupt-controller/cypress,psoc6-intmux.yaml
```yaml
# Copyright (c) 2018 Foundries.io
# Copyright (c) 2020 ATL Electronics
# SPDX-License-Identifier: Apache-2.0

description: |
  Cypress Interrupt Multiplex

  The PSoC-6 Cortex-M0+ NVIC can handle up to 32 interrupts. This means that
  user can select up to 32 interrupts sources from the 240 possible vectors
  to be processed in the Cortex-M0+ CPU.

  At CPU Sub System (CPUSS) there are 8 special registers (intmux[0~7]) to
  configure the 32 NVIC lines for Cortex-M0+ CPU. Each register handles up to
  4 interrupt sources by grouping intmux channels. These means that each byte
  from intmux[0~7] store a 'vector number' which selects the peripheral
  interrupt source in the multiplexer. The multiplexer is placed before
  Cortex-M0+ NVIC controller. Note that Cortex-M4 have all interrupt sources
  directly connected to NVIC and doesn't require any special configuration.

  On a general view, the below represents the Interrupt Multiplexer
  configuration and how the Cortex-M0+ NVIC sources are organized. Each
  channel chX represents a Cortex-M0+ NVIC line and it stores a vector number.
  The vector number selects the PSoC-6 peripheral interrupt source for the
  Cortex-M0+ NVIC controller line.

  intmux[0] = {ch03, ch02, ch01, ch00}
  intmux[1] = {ch07, ch06, ch05, ch04}
  ...
  intmux[7] = {ch31, ch30, ch29, ch28}

  In pratical terms, the Cortex-M0+ requires user to define all NVIC interrupt
  sources and the proper NVIC interrupt order. With that, the system configures
  the Cortex-M0+ Interrupt Multiplexer and interrupts can be processed.
  More information about it at PSoC-6 Architecture Technical Reference Manual,
  section CPU Sub System (CPUSS) Registers.


  The below fragment configure the GPIO Port 0 to generate an interrupt at
  Cortex-M0+ NVIC:

  At psoc6.dtsi file the gpio_prt0 peripheral had the interrupt source 2:

  gpio_prt0: gpio@40320100 {
    interrupts = <2 1>;
  };

  In order to enable gpio_prt0 interrupt at Cortex-M0+ an interrupt parent
  must be defined at gpio_prt0 node selecting the Interrupt Multiplex Channel.
  This can be defined at <board>_m0.dts file:

  &gpio_prt0 {
    interrupt-parent = <&intmux_ch20>;
  };

  The translation of these two definitions is:
         CH   REGS  INT NUM    CH   CH/REG
  intmux[20 mod 8] |= 0x02 << (20 mod 4);

  These results in Cortex-M0+ NVIC line 20 handling PSoC-6 interrupt source 2.
  The interrupt can be enabled/disable at NVIC at line 20 as usual.

  Notes:
  1) Multiple definitions will generate multiple interrutps
  2) The interrupt sources are shared between Cortex-M0+/M4. These means, can
     trigger action in parallel in both processors.
  3) User can change priority at Cortex-M0+ NVIC by changing interrupt channels
     at interrupt-parent properties.
  4) Only the peripherals used by Cortex-M0+ should be configured.

compatible: "cypress,psoc6-intmux"

include: base.yaml

properties:
  reg:
      required: true

  label:
      required: true
```

## dts/bindings/interrupt-controller/gaisler,irqmp.yaml
```yaml
# Copyright (c) 2020 Cobham Gaisler AB
# SPDX-License-Identifier: Apache-2.0

description: GRLIB Multiprocessor Interrupt Controller

compatible: "gaisler,irqmp"

include: [interrupt-controller.yaml, base.yaml]

properties:
  reg:
    required: true

  eirq:
    type: int
    description: Extended interrupt number (or 0 for none)

  "#interrupt-cells":
    const: 1

interrupt-cells:
  - irq
```

## dts/bindings/interrupt-controller/gd,gd32-exti.yaml
```yaml
description: GigaDevice External Interrupt Controller

compatible: "gd,gd32-exti"

include: [base.yaml, interrupt-controller.yaml]

properties:
  reg:
    required: true

  interrupts:
    required: true

  "#interrupt-cells":
    const: 1

  num-lines:
    type: int
    required: true
    description: Number of lines supported by the interrupt controller.

interrupt-cells:
  - line
```

## dts/bindings/interrupt-controller/gigadevice,gd32-exti.yaml
```yaml
description: GigaDevice GD32 family External Interrupt Controller

compatible: "gigadevice,gd32-exti"

include: base.yaml

properties:
  reg:
    required: true
```

## dts/bindings/interrupt-controller/hazard3,hazard3-intc.yaml
```yaml
description: Hazard3 interrupt controller

compatible: "hazard3,hazard3-intc"

include: [interrupt-controller.yaml, base.yaml]

properties:
  "#interrupt-cells":
    const: 2

interrupt-cells:
  - irq
  - priority
```

## dts/bindings/interrupt-controller/infineon,cat1-intc-mux.yaml
```yaml
# Copyright (c) 2026 Linumiz
# SPDX-License-Identifier: Apache-2.0

description: |
  Infineon CAT1 CPUSS interrupt multiplexer channel.

  Each instance represents one NvicMux NVIC line and acts as a 2nd-level
  interrupt aggregator. The reg property is the NvicMux line index. The
  interrupts property on this node specifies the L1 NVIC IRQ and its
  priority (consumed by the parent ARM NVIC controller).

  Peripherals referencing this node use 2 cells:
    cell 0 (irq)      - system interrupt number (0..CPUSS_SYSTEM_INT_NR-1)
    cell 1 (priority) - unused on the CAT1 CPUSS hardware

  The CAT1 CPUSS multiplexer arbitrates multiple system interrupts onto
  a single NVIC line by reporting the lowest-indexed active source via
  INTx_STATUS; there is no per-system-interrupt priority register. All
  system interrupts routed to the same NvicMux line share that NVIC
  line's priority, which is set on the mux node itself (cell 1 of its
  own interrupts property). The priority cell on peripheral nodes is
  retained only for compatibility with peripheral drivers that pass
  DT_INST_IRQ(n, priority) to IRQ_CONNECT; the value is ignored by the
  interrupt controller driver and should be set to 0.

  Note: NvicMux lines 0-7 are external system-interrupt aggregators. NVIC
  IRQs 8-15 are reserved as Internal/software interrupts and bypass the
  CPUSS mux; they are used directly via the ARM NVIC root controller.

  Example:
    intmux_ch3: interrupt-controller@3 {
        compatible = "infineon,cat1-intc-mux";
        reg = <3>;
        interrupt-controller;
        #interrupt-cells = <2>;
        interrupts = <3 1>;     /* NVIC line 3, priority 1 */
    };

    scb0: serial@40600000 {
        interrupt-parent = <&intmux_ch3>;
        interrupts = <18 0>;    /* sys_irq 18, priority cell unused */
    };

compatible: "infineon,cat1-intc-mux"

include: [interrupt-controller.yaml, base.yaml]

properties:
  reg:
    required: true

  "#interrupt-cells":
    const: 2

interrupt-cells:
  - irq
  - priority
```

## dts/bindings/interrupt-controller/infineon,cat1-intc.yaml
```yaml
# Copyright (c) 2026 Linumiz
# SPDX-License-Identifier: Apache-2.0

description: |
  Infineon CAT1 CPUSS system interrupt multiplexer.

  The CAT1 CPUSS routes peripheral system interrupts onto NvicMux NVIC
  lines through a programmable multiplexer. This node is a container
  for the individual mux channel nodes (infineon,cat1-intc-mux).

  Peripherals set their interrupt-parent to a specific mux channel
  child node to select which NvicMux line they are routed to.

compatible: "infineon,cat1-intc"

include: base.yaml

properties:
  reg:
    required: true

  "#address-cells":
    const: 1

  "#size-cells":
    const: 0
```

## dts/bindings/interrupt-controller/infineon,xmc4xxx-intc.yaml
```yaml
description: Infineon XMC4XXX series Interrupt Controller

compatible: "infineon,xmc4xxx-intc"

include: base.yaml

properties:
  reg:
    required: true

  port-line-mapping:
    type: array
    required: true
    description: |
      An array to store the Event Request Unit (ERU) configuration for a given port/pin
      combintation. The array elements are opaque fields set using the macro
      XMC4XXX_INTC_SET_LINE_MAP(port, pin, eru_src, line);
      eru_src defines where the specific port/pin combination is connected in the ERU.
      line defines the SR line that will be raised by the event.

  interrupts:
    required: true
```

## dts/bindings/interrupt-controller/intel,ace-intc.yaml
```yaml
description: ACE interrupt controller

compatible: "intel,ace-intc"

include: [interrupt-controller.yaml, base.yaml]

properties:
  reg:
      required: true

  interrupts:
      required: true

  "#interrupt-cells":
      const: 3

  num-irqs:
      type: int
      required: true
      description: Number of irq the controller manages

interrupt-cells:
  - irq
  - sense
  - priority
```

## dts/bindings/interrupt-controller/intel,adsp-intc.yaml
```yaml
description: Intel ADSP interrupt controller

compatible: "intel,adsp-intc"

include: [interrupt-controller.yaml, base.yaml]

properties:
  reg:
    required: true

  interrupts:
    required: true

  "#interrupt-cells":
    const: 3

  num-irqs:
    type: int
    required: true
    description: Number of irq the controller manages

interrupt-cells:
  - irq
  - sense
  - priority
```

## dts/bindings/interrupt-controller/intel,cavs-intc.yaml
```yaml
description: CAVS interrupt controller

compatible: "intel,cavs-intc"

include: [interrupt-controller.yaml, base.yaml]

properties:
  reg:
    required: true

  interrupts:
    required: true

  "#interrupt-cells":
    const: 3

interrupt-cells:
  - irq
  - sense
  - priority
```

## dts/bindings/interrupt-controller/intel,ioapic.yaml
```yaml
description: Intel I/O Advanced Programmable Interrupt Controller (APIC)

compatible: "intel,ioapic"

include: [interrupt-controller.yaml, base.yaml]

properties:
  reg:
    required: true

  "#interrupt-cells":
    const: 3

interrupt-cells:
  - irq
  - sense
  - priority
```

## dts/bindings/interrupt-controller/intel,loapic.yaml
```yaml
description: Local Advanced Programmable Interrupt Controller (APIC)

compatible: "intel,loapic"

include: [interrupt-controller.yaml, base.yaml]

properties:
  reg:
    required: true

  "#interrupt-cells":
    const: 3

interrupt-cells:
  - irq
  - sense
  - priority
```
