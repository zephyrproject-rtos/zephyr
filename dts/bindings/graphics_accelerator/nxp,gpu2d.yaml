## dts/bindings/graphics_accelerator/nxp,gpu2d.yaml
```yaml
# Copyright (c) 2026 Felipe Neves ryukokki.felipe@gmail.com
# Copyright 2026 NXP
# SPDX-License-Identifier: Apache-2.0


description: NXP GPU2D graphics accelerator

compatible: "nxp,gpu2d"

include: [reset-device.yaml, base.yaml]

properties:
  reg:
    required: true

  interrupts:
    required: true

  clocks:
    required: true
```

## dts/bindings/haptics/cirrus,cs40l26-base.yaml
```yaml
# Copyright (c) 2026 Cirrus Logic, Inc.
# SPDX-License-Identifier: Apache-2.0

description: CS40L26/27 haptic driver

properties:
  reset-gpios:
    type: phandle-array
    description: Output pin mapped to CS40L26/27 reset pin.

  int-gpios:
    type: phandle-array
    description: Input pin mapped to CS40L26/27 interrupt pin.

  flash-storage:
    type: phandle
    description: Flash storage for CS40L26 data. Must be a phandle to
      a flash device or fixed partition.

  flash-offset:
    type: int
    description: Register offset to store and load CS40L26 data.
```

## dts/bindings/haptics/cirrus,cs40l26-i2c.yaml
```yaml
# Copyright (c) 2026 Cirrus Logic, Inc.
# SPDX-License-Identifier: Apache-2.0

description: CS40L26 haptic driver on I2C bus

compatible: "cirrus,cs40l26"

include: ["i2c-device.yaml", "cirrus,cs40l26-base.yaml"]
```

## dts/bindings/haptics/cirrus,cs40l26-spi.yaml
```yaml
# Copyright (c) 2026 Cirrus Logic, Inc.
# SPDX-License-Identifier: Apache-2.0

description: CS40L26 haptic driver on SPI bus

compatible: "cirrus,cs40l26"

include: ["spi-device.yaml", "cirrus,cs40l26-base.yaml"]
```

## dts/bindings/haptics/cirrus,cs40l27-i2c.yaml
```yaml
# Copyright (c) 2026 Cirrus Logic, Inc.
# SPDX-License-Identifier: Apache-2.0

description: CS40L27 haptic driver on I2C bus

compatible: "cirrus,cs40l27"

include: ["i2c-device.yaml", "cirrus,cs40l26-base.yaml"]
```

## dts/bindings/haptics/cirrus,cs40l27-spi.yaml
```yaml
# Copyright (c) 2026 Cirrus Logic, Inc.
# SPDX-License-Identifier: Apache-2.0

description: SPI-based CS40L27 Haptic Driver

compatible: "cirrus,cs40l27"

include: ["spi-device.yaml", "cirrus,cs40l26-base.yaml"]
```

## dts/bindings/haptics/cirrus,cs40l50-i2c.yaml
```yaml
# Copyright (c) 2026 Cirrus Logic, Inc.
# SPDX-License-Identifier: Apache-2.0

description: I2C-based CS40L50 Haptic Driver

compatible: "cirrus,cs40l50"

include: ["i2c-device.yaml", "cirrus,cs40l5x-base.yaml"]
```

## dts/bindings/haptics/cirrus,cs40l50-spi.yaml
```yaml
# Copyright (c) 2026 Cirrus Logic, Inc.
# SPDX-License-Identifier: Apache-2.0

description: CS40L50 haptic driver on SPI bus

compatible: "cirrus,cs40l50"

include: ["spi-device.yaml", "cirrus,cs40l5x-base.yaml"]
```

## dts/bindings/haptics/cirrus,cs40l50.yaml
```yaml
# Copyright (c) 2024 Cirrus Logic, Inc.
# SPDX-License-Identifier: Apache-2.0

description: |
  Cirrus Logic Haptic Driver IC
  example:
    cs40l50 {
      compatible = "cirrus,cs40l50";
      status = "okay";
    };

compatible: "cirrus,cs40l50"

include: i2c-device.yaml
```

## dts/bindings/haptics/cirrus,cs40l51-i2c.yaml
```yaml
# Copyright (c) 2026 Cirrus Logic, Inc.
# SPDX-License-Identifier: Apache-2.0

description: I2C-based CS40L51 Haptic Driver

compatible: "cirrus,cs40l51"

include: ["i2c-device.yaml", "cirrus,cs40l5x-base.yaml"]
```

## dts/bindings/haptics/cirrus,cs40l51-spi.yaml
```yaml
# Copyright (c) 2026 Cirrus Logic, Inc.
# SPDX-License-Identifier: Apache-2.0

description: SPI-based CS40L51 Haptic Driver

compatible: "cirrus,cs40l51"

include: ["spi-device.yaml", "cirrus,cs40l5x-base.yaml"]
```

## dts/bindings/haptics/cirrus,cs40l52-i2c.yaml
```yaml
# Copyright (c) 2026 Cirrus Logic, Inc.
# SPDX-License-Identifier: Apache-2.0

description: CS40L52 haptic driver on I2C bus

compatible: "cirrus,cs40l52"

include: ["i2c-device.yaml", "cirrus,cs40l5x-base.yaml"]
```

## dts/bindings/haptics/cirrus,cs40l52-spi.yaml
```yaml
# Copyright (c) 2026 Cirrus Logic, Inc.
# SPDX-License-Identifier: Apache-2.0

description: SPI-based CS40L52 Haptic Driver

compatible: "cirrus,cs40l52"

include: ["spi-device.yaml", "cirrus,cs40l5x-base.yaml"]
```

## dts/bindings/haptics/cirrus,cs40l53-i2c.yaml
```yaml
# Copyright (c) 2026 Cirrus Logic, Inc.
# SPDX-License-Identifier: Apache-2.0

description: I2C-based CS40L53 Haptic Driver

compatible: "cirrus,cs40l53"

include: ["i2c-device.yaml", "cirrus,cs40l5x-base.yaml"]
```

## dts/bindings/haptics/cirrus,cs40l53-spi.yaml
```yaml
# Copyright (c) 2026 Cirrus Logic, Inc.
# SPDX-License-Identifier: Apache-2.0

description: CS40L53 haptic driver on SPI bus

compatible: "cirrus,cs40l53"

include: ["spi-device.yaml", "cirrus,cs40l5x-base.yaml"]
```

## dts/bindings/haptics/cirrus,cs40l5x-base.yaml
```yaml
# Copyright (c) 2025 Cirrus Logic, Inc.
# SPDX-License-Identifier: Apache-2.0

description: CS40L5x Haptic Driver

properties:
  reset-gpios:
    type: phandle-array
    required: true
    description: Host GPIO pin mapped to CS40L5x reset pin.

  int-gpios:
    type: phandle-array
    description: Host GPIO pin mapped to CS40L5x interrupt pin.

  trigger-gpios:
    type: phandle-array
    description: Host GPIOs used to trigger haptic effects.

  trigger-mapping:
    type: array
    description: For each host GPIO provided to 'trigger-gpios',
      provide the corresponding CS40L5x GPIO pin number.

  external-boost:
    type: phandle
    description: External boost source. Must be a phandle to a regulator.

  flash-storage:
    type: phandle
    description: Flash storage for CS40L5x data. Must be a phandle to
      a flash device or fixed partition.

  flash-offset:
    type: int
    description: Register offset to store and load CS40L5x data.
```

## dts/bindings/haptics/cirrus,cs40l5x-i2c.yaml
```yaml
# Copyright (c) 2025 Cirrus Logic, Inc.
# SPDX-License-Identifier: Apache-2.0

description: I2C-based CS40L5x Haptic Driver

compatible: "cirrus,cs40l5x"

on-bus: i2c

include: ["i2c-device.yaml", "cirrus,cs40l5x-base.yaml"]
```

## dts/bindings/haptics/cirrus,cs40l5x-spi.yaml
```yaml
# Copyright (c) 2025 Cirrus Logic, Inc.
# SPDX-License-Identifier: Apache-2.0

description: SPI-based CS40L5X Haptic Driver

compatible: "cirrus,cs40l5x"

on-bus: spi

include: ["spi-device.yaml", "cirrus,cs40l5x-base.yaml"]
```

## dts/bindings/haptics/ti,drv2605.yaml
```yaml
# Copyright (c) 2024 Cirrus Logic, Inc.
# SPDX-License-Identifier: Apache-2.0

description: |
  DRV2605 Haptic Driver for ERM and LRA with built-in library and smart-loop
  architecture.

compatible: "ti,drv2605"

include: i2c-device.yaml

properties:
  actuator-mode:
    required: true
    type: string
    enum:
      - "ERM"
      - "LRA"
  feedback-brake-factor:
    type: string
    enum:
      - "1X"
      - "2X"
      - "3X"
      - "4X"
      - "6X"
      - "8X"
      - "16X"
      - "DISABLED"
    default: "3X"
    description: |
      Selects the feedback gain ratio between braking gain and driving gain.
      According to the datasheet, a value of 2 ("3X") is valid for most
      actuators.
  loop-gain:
    type: string
    enum:
      - "LOW"
      - "MEDIUM"
      - "HIGH"
      - "VERY_HIGH"
    default: "HIGH"
    description: |
      Selects a loop gain for the feedback control. According to the datasheet,
      a value of 2 ("HIGH") is valid for most actuators.
  vib-rated-mv:
    type: int
    default: 3200
    description: |
      Sets the reference voltage for full-scale output during closed-loop
      operation. The default value is inherited from ti,drv260x.yaml in Linux.
  vib-overdrive-mv:
    type: int
    default: 3200
    description: |
      Sets a clamp so that the automatic overdrive is bounded. The default
      value is inherited from ti,drv260x.yaml in Linux.
  en-gpios:
    type: phandle-array
    description: GPIO to enable and disable the device.
  in-trig-gpios:
    type: phandle-array
    description: GPIO to trigger ROM waveforms or drive an input signal.
```

## dts/bindings/haptics/titanmec,tm6605.yaml
```yaml
# Copyright (c) 2026 Anuj Deshpande
# SPDX-License-Identifier: Apache-2.0

description: |
  TM6605 Linear Resonant Actuator (LRA) haptic driver from Titan Micro
  Electronics. The chip plays one of 44 pre-programmed effects through an
  LRA and is controlled over a write-only I2C interface (slave address
  0x2D / 7-bit).

compatible: "titanmec,tm6605"

include: i2c-device.yaml

properties:
  default-effect:
    type: int
    default: 47
    description: |
      Effect ID written to the effect-select register when
      haptics_start_output() is called without a prior call to
      tm6605_select_effect(). Defaults to 47 ("Alert").

      See <zephyr/drivers/haptics/tm6605.h> for the full list of valid
      effect IDs. Effect 123 is the sleep command.
```

## dts/bindings/hda/intel,hda-dai.yaml
```yaml
# Copyright (c) 2022 Intel Corporation
#
# SPDX-License-Identifier: Apache-2.0

description: Intel HDA DAI controller

compatible: "intel,hda-dai"

include: base.yaml

properties:
  reg:
    required: true
```

## dts/bindings/hdlc_rcp_if/nxp,hdlc-rcp-if.yaml
```yaml
# Copyright (c) 2024, NXP
# SPDX-License-Identifier: Apache-2.0

description: NXP HDLC RCP interface node

compatible: "nxp,hdlc-rcp-if"

include: base.yaml
```

## dts/bindings/hdlc_rcp_if/spi,hdlc-rcp-if.yaml
```yaml
# Copyright (c) 2025 Basalte bv
# SPDX-License-Identifier: Apache-2.0

description: SPI HDLC RCP interface node

compatible: "spi,hdlc-rcp-if"

include: spi-device.yaml

properties:
  int-gpios:
    type: phandle-array
    required: true
    description: |
      Interrupt GPIO. Used by the RCP to signal data is available. Active low.

  reset-gpios:
    type: phandle-array
    description: |
      Reset GPIO. Used to assert a hardware reset for the RCP. Active low.

  reset-assert-time:
    type: int
    default: 30
    description: The time (in ms) to keep the RCP radio reset active.

  reset-delay:
    type: int
    default: 0
    description: The delay (in ms) after reset de-assertion.
```

## dts/bindings/hdlc_rcp_if/uart,hdlc-rcp-if.yaml
```yaml
# Copyright (c) 2024, DENX Software Engineering GmbH
#               Lukasz Majewski <lukma@denx.de>
# SPDX-License-Identifier: Apache-2.0

description: UART HDLC RCP interface node

compatible: "uart,hdlc-rcp-if"

include: base.yaml
```

## dts/bindings/hwinfo/atmel,sam-rstc.yaml
```yaml
# Copyright (c) 2022 Basalte bv
# SPDX-License-Identifier: Apache-2.0

description: ATMEL SAM Reset controller

compatible: "atmel,sam-rstc"

include: base.yaml

properties:
  reg:
    required: true

  clocks:
    required: true

  user-nrst:
    type: boolean
    description: Allow user reset on external NRST assert.
```
