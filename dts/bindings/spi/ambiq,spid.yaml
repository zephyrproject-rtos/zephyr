## dts/bindings/spi/ambiq,spid.yaml
```yaml
# Copyright (c) 2024 Ambiq <www.ambiq.com>
# SPDX-License-Identifier: Apache-2.0

description: Ambiq SPI Device

compatible: "ambiq,spid"

include: [spi-controller.yaml, pinctrl-device.yaml]

properties:
  int-gpios:
    type: phandle-array
    required: true
    description: |
        GPIO that interrupts the SPI controller to require operation
```

## dts/bindings/spi/andestech,atcspi200.yaml
```yaml
#
# Copyright (c) 2022, Andes Technology Corporation.
#
# SPDX-License-Identifier: Apache-2.0
#

description: |
    This binding gives a representation of Andes ATCSPI200 SPI controller

compatible: "andestech,atcspi200"

include: spi-controller.yaml

properties:
  reg:
    required: true
```

## dts/bindings/spi/apm,aps6404l.yaml
```yaml
# Copyright (c) 2025, Ambiq Micro Inc. <www.ambiq.com>
# SPDX-License-Identifier: Apache-2.0

description: APS6404L PSRAM

compatible: "apm,aps6404l"

include: spi-device.yaml
```

## dts/bindings/spi/arm,pl022.yaml
```yaml
# Copyright (c) 2022 TOKITA Hiroshi <tokita.hiroshi@fujitsu.com>
# SPDX-License-Identifier: Apache-2.0

description: ARM PL022 SPI

compatible: "arm,pl022"

include: [spi-controller.yaml, pinctrl-device.yaml, reset-device.yaml]

properties:
  reg:
    required: true

  clocks:
    required: true
```

## dts/bindings/spi/atmel,sam-qspi.yaml
```yaml
# Copyright (c) 2018, qianfan Zhao
# SPDX-License-Identifier: Apache-2.0

description: Atmel SAM QSPI controller

compatible: "atmel,sam-qspi"

include:
  - name: spi-controller.yaml
  - name: pinctrl-device.yaml

properties:
  reg:
    required: true

  interrupts:
    required: true

  clocks:
    required: true

  lines:
    type: int
    default: 1
    description: |
      QSPI data lines 1, 2, or 4. 1 data line is full-duplex
      MOSI and MISO or half-duplex on MOSI only. Lines set to 2
      or 4 indicate dual or quad I/O modes.
      Defaults to 1 for full duplex driver's support for full-duplex spi.
    enum:
      - 1
      - 2
      - 4
```

## dts/bindings/spi/atmel,sam-spi.yaml
```yaml
# Copyright (c) 2018, qianfan Zhao
# SPDX-License-Identifier: Apache-2.0

description: Atmel SAM SPI controller

compatible: "atmel,sam-spi"

include:
  - name: spi-controller.yaml
  - name: pinctrl-device.yaml

properties:
  reg:
    required: true

  interrupts:
    required: true

  peripheral-id:
    type: int
    description: peripheral ID
    required: true

  loopback:
    type: boolean
    description: |
      Connects TX to RX internally creating a loop back connection. Useful
      for testing.

  dmas:
    description: |
      TX & RX dma specifiers.  Each specifier will have a phandle
      reference to the dma controller, the channel number, and peripheral
      trigger source. The channel number is arbitrary but must not be
      reused. The number of channels available is device dependent.

      For example dmas for TX and RX may look like
         dmas = <&xdmac 1 DMA_PERID_SPI0_TX>, <&xdmac 2 DMA_PERID_SPI0_RX>;

  dma-names:
    description: |
      This should be "tx" and "rx" and should match the order given for
      dmas.

      For example using the example dmas, an example dma-names would be
         dma-names = "tx", "rx";
```

## dts/bindings/spi/atmel,sam0-spi-quadspi.yaml
```yaml
# Copyright (c) 2020, Open Cosmos ltd.
# SPDX-License-Identifier: Apache-2.0

description: Atmel SAM0 QSPI controller

compatible: "atmel,sam0-spi-quadspi"

include: spi-controller.yaml

properties:
    reg:
      required: true

    clocks:
      required: true

    clock-names:
      required: true
      description: |
        This should be "QSPI_AHB_Clock", "QSPI_2X_AHB_Clock", "QSPI_APB_Clock".

        For example
           clock-names = "QSPI_AHB_Clock", "QSPI_2X_AHB_Clock", "QSPI_APB_Clock";
```

## dts/bindings/spi/atmel,sam0-spi.yaml
```yaml
# Copyright (c) 2018, Google LLC.
# Copyright (c) 2024 Gerson Fernando Budke <nandojve@gmail.com>
# SPDX-License-Identifier: Apache-2.0

description: Atmel SAM0 SERCOM SPI controller

compatible: "atmel,sam0-spi"

include:
  - name: spi-controller.yaml
  - name: pinctrl-device.yaml
  - name: atmel,assigned-clocks.yaml

properties:
  reg:
    required: true

  clocks:
    required: true

  clock-names:
    required: true

  atmel,assigned-clocks:
    required: true

  atmel,assigned-clock-names:
    required: true

  dipo:
    type: int
    required: true
    description: Data In Pinout

  dopo:
    type: int
    required: true
    description: Data Out Pinout

  dmas:
    description: |
      Optional TX & RX dma specifiers.  Each specifier will have a phandle
      reference to the dmac controller, the channel number, and peripheral
      trigger source.

      For example dmas for TX, RX on SERCOM3
         dmas = <&dmac 0 0xb>, <&dmac 1 0xa>;

  dma-names:
    description: |
      Required if the dmas property exists.  This should be "tx" and "rx"
      to match the dmas property.

      For example
         dma-names = "tx", "rx";
```

## dts/bindings/spi/atmosic,atm-spi.yaml
```yaml
description: Atmosic SPI

compatible: "atmosic,atm-spi"

include: spi-controller.yaml

properties:
    reg:
      required: true

    interrupts:
      required: false

    instance:
      type: int
      required: true
      description: SPI instance

    dummy_cycles:
      type: int
      required: false
      default: 0
      description: Number of extra shift cycles to help with the turn-around

    cs-pin:
      type: int
      required: true
      description: CS pin to use

    clk-pin:
      type: int
      required: true
      description: CLK pin to use

    mosi-pin:
      type: int
      required: false
      description: MOSI pin to use

    miso-pin:
      type: int
      required: false
      description: MISO pin to use
```

## dts/bindings/spi/bflb,spi.yaml
```yaml
# Copyright (c) 2024-2025 MASSDRIVER EI (massdriver.space)
# SPDX-License-Identifier: Apache-2.0

description: Bouffalolab SPI

compatible: "bflb,spi"

include:
  - name: spi-controller.yaml
  - name: pinctrl-device.yaml

properties:
  reg:
    required: true

  interrupts:
    required: true
```

## dts/bindings/spi/brcm,iproc-qspi.yaml
```yaml
# Copyright (c) 2020 Broadcom
# Copyright (c) 2024 Meta Platforms
# SPDX-License-Identifier: Apache-2.0

description: |
    Broadcom iProc QSPI controller

    The reg property describes two register blocks: one for the memory
    corresponding to the BSPI register range, and another for
    the MSPI register:

        qspi: qspi@6000e000 {
                compatible = "brcm,iproc-qspi";
                reg = <0x6000e000 0x200>, <0x6000e200 0x400>;
                reg-names = "bspi_regs", "mspi_regs";
                ...
        };

compatible: "brcm,iproc-qspi"

include: spi-controller.yaml

properties:
  reg:
    required: true
    description: |
      Define bases and ranges of the associated I/O address spaces.

  reg-names:
    required: true
    description: |
      - "bspi_regs": BSPI register range
      - "mspi_regs": MSPI register range
```

## dts/bindings/spi/cdns,cdns-spi.yaml
```yaml
# Copyright (c) 2025 Advanced Micro Devices, Inc
#
# SPDX-License-Identifier: Apache-2.0

description: Cadence SPI IP node

compatible: "cdns,spi-r1p6"

include: spi-controller.yaml

properties:
  reg:
    required: true

  interrupts:
    required: true

  clocks:
    required: true
    description: Input reference clock for spi core

  cdns,num-ss-bits:
    type: int
    required: true
    enum:
      - 1
      - 2
      - 3
      - 4
    description: Number of slave select bits implemented

  is-decoded-cs:
    type: int
    required: true
    enum:
      - 0
      - 1
    description: Decoded slave implemented or not
```

## dts/bindings/spi/cdns,spi.yaml
```yaml
# Copyright (c) 2024, Meta Platforms
# SPDX-License-Identifier: Apache-2.0

description: Cadence SPI controller

compatible: "cdns,spi"

include: [spi-controller.yaml]

properties:
  reg:
    required: true

  interrupts:
    required: true

  clock-frequency:
    required: true

  clock-frequency-ext:
    type: int

  fifo-width:
    type: int
    required: true
    enum:
      - 8
      - 16
      - 24
      - 32
    description: |
      The total fifo width in bits

  rx-fifo-depth:
    type: int
    required: true
    enum:
      - 8
      - 16
      - 32
      - 64
      - 128
      - 256
    description: |
      The depth of the rx fifo

  tx-fifo-depth:
    type: int
    required: true
    enum:
      - 8
      - 16
      - 32
      - 64
      - 128
      - 256
    description: |
      The depth of the tx fifo
```

## dts/bindings/spi/cypress,psoc6-spi.yaml
```yaml
# Copyright (c) 2021, ATL Electronics
# SPDX-License-Identifier: Apache-2.0

description: Cypress SBC[SPI]

compatible: "cypress,psoc6-spi"

include: [spi-controller.yaml, pinctrl-device.yaml]

properties:
  reg:
    required: true

  interrupts:
    required: true

  peripheral-id:
    type: int
    description: peripheral ID
    required: true

  pinctrl-0:
    type: phandles
    description: |
      Port pin configuration for the various SPI signals that includes
      MISO, MOSI, SCK, and possibly various chip selects signals.  We
      expect that the phandles will reference pinctrl nodes.  These
      nodes will have a nodelabel that matches the Cypress SoC HAL defines
      and be of the form p<port>_<pin>_<periph><inst>_<signal>.

      For example the SPI on PSOC 63 Pioneer Kit would be
         pinctrl-0 = <&p12_0_spi6_mosi &p12_1_spi6_miso &p12_2_spi6_clk &p12_3_spi6_sel0>;

    required: true
```

## dts/bindings/spi/egis,et171-spi.yaml
```yaml
#
# Copyright (c) 2022, Andes Technology Corporation.
# Copyright (c) 2025 Egis Technology Inc.
#
# SPDX-License-Identifier: Apache-2.0
#

description: |
    Egis ET171 SPI controller based on the Andes ATCSPI200 architecture.

compatible: "egis,et171-spi"

include: spi-controller.yaml

properties:
  reg:
    required: true
```

## dts/bindings/spi/ene,kb1200-spi.yaml
```yaml
# Copyright (c) 2024 ENE Technology Inc.
# SPDX-License-Identifier: Apache-2.0

description: ENE, KB1200-SPI controller node

compatible: "ene,kb1200-spi"

include: [spi-controller.yaml, pinctrl-device.yaml]

properties:
  reg:
    required: true

  pinctrl-0:
    required: true

  pinctrl-names:
    required: true
```

## dts/bindings/spi/espressif,esp32-spi.yaml
```yaml
description: |
  ESP32 SPI controller

  Hardware chip select is directly handled via pinctrl. The reg property of
  a child SPI device node corresponds to the hardware CS pin number configured
  in pinctrl. ESP32 supports CS0-CS2, while ESP32-S2/S3/C2/C3/C6/H2 support
  CS0-CS5.

  Alternatively, GPIO-based chip selects can be used via the cs-gpios property.
  When cs-gpios is defined, the hardware CS lines are disabled and the driver
  uses GPIO pins for chip select control. In this case, the reg property of
  child nodes corresponds to the index in the cs-gpios array.

  Example with hardware CS (directly via pinctrl):

    &spi2 {
        pinctrl-0 = <&spim2_default>;  /* Must include CS signal */
        pinctrl-names = "default";

        device@0 {
            reg = <0>;  /* Uses hardware CS0 */
        };
    };

  Example with GPIO CS:

    &spi2 {
        pinctrl-0 = <&spim2_default>;  /* CS signal optional */
        pinctrl-names = "default";
        cs-gpios = <&gpio0 5 GPIO_ACTIVE_LOW>,
                   <&gpio0 6 GPIO_ACTIVE_LOW>;

        device@0 {
            reg = <0>;  /* Uses first GPIO (gpio0 pin 5) */
        };
        device@1 {
            reg = <1>;  /* Uses second GPIO (gpio0 pin 6) */
        };
    };

compatible: "espressif,esp32-spi"

include: [spi-controller.yaml, pinctrl-device.yaml]

properties:
  reg:
    required: true

  pinctrl-0:
    required: true

  pinctrl-names:
    required: true

  half-duplex:
    type: boolean
    description: |
      Enable half-duplex communication mode.

      Transmit data before receiving it, instead of simultaneously

  dummy-comp:
    type: boolean
    description: Enable dummy SPI compensation cycles

  sio:
    type: boolean
    description: |
      Enable 3-wire mode

      Use MOSI for both sending and receiving data

  dma-enabled:
    type: boolean
    description: Enable SPI DMA support

  dma-clk:
    type: int
    description: DMA clock source

  dma-host:
    type: int
    description: DMA Host - 0 -> SPI2, 1 -> SPI3

  clk-as-cs:
    type: boolean
    description: |
      Support to toggle the CS while the clock toggles

      Output clock on CS line if CS is active

  positive-cs:
    type: boolean
    description: Make CS positive during a transaction instead of negative

  use-iomux:
    type: boolean
    description: |
      Some pins are allowed to bypass the GPIO Matrix and use the IO_MUX
      routing mechanism instead, this avoids extra routing latency and makes
      possible the use of operating frequencies higher than 20 MHz.

      Refer to SoC's Technical Reference Manual to check which pins are
      allowed to use this routing path.

  cs-setup-time:
    type: int
    description: |
      Chip select setup time setting, see TRF for SOC for details of
      timing applied.

  cs-hold-time:
    type: int
    description: |
      Chip select hold time setting, see TRF for SOC for details of
      timing applied.

  line-idle-low:
    type: boolean
    description: |
      Default MISO and MOSI pins GPIO level when idle. Defaults to high by default.
```

## dts/bindings/spi/gaisler,spictrl.yaml
```yaml
# Copyright (c) 2025 Frontgrade Gaisler AB
# SPDX-License-Identifier: Apache-2.0

description: GRLIB SPICTRL

compatible: "gaisler,spictrl"

include: spi-controller.yaml

properties:
  reg:
    required: true

  interrupts:
    required: true

  cs-output:
    type: int
    required: true
    description: |
      Use SPICTRL chip select SLVSEL0..SLVSEL31.
```

## dts/bindings/spi/gaisler,spimctrl.yaml
```yaml
# Copyright (c) 2023 Frontgrade Gaisler AB
# SPDX-License-Identifier: Apache-2.0

description: GRLIB SPIMCTRL

compatible: "gaisler,spimctrl"

include: spi-controller.yaml

properties:
  reg:
    required: true

  interrupts:
    required: true
```

## dts/bindings/spi/gd,gd32-spi.yaml
```yaml
# Copyright (c) 2021 BrainCo Inc.
# SPDX-License-Identifier: Apache-2.0

description: GigaDevice GD32 SPI

compatible: "gd,gd32-spi"

include: [spi-controller.yaml, reset-device.yaml, pinctrl-device.yaml]

properties:
  reg:
    required: true

  interrupts:
    required: true

  resets:
    required: true

  clocks:
    required: true

  pinctrl-0:
    required: true

  pinctrl-names:
    required: true
```

## dts/bindings/spi/infineon,cat1-spi-pdl.yaml
```yaml
# Copyright (c) 2025 Infineon Technologies AG,
# or an affiliate of Infineon Technologies AG.
#
# SPDX-License-Identifier: Apache-2.0

description: Infineon CAT1 SPI

compatible: "infineon,cat1-spi-pdl"

include: infineon,cat1-spi.yaml
```

## dts/bindings/spi/infineon,cat1-spi.yaml
```yaml
# Copyright (c) 2022 Cypress Semiconductor Corporation (an Infineon company) or
# an affiliate of Cypress Semiconductor Corporation
#
# SPDX-License-Identifier: Apache-2.0

description: Infineon CAT1 SPI

compatible: "infineon,cat1-spi"

include: [spi-controller.yaml, pinctrl-device.yaml]

properties:
  reg:
    required: true

  interrupts:
    required: true

  pinctrl-0:
    required: true
```
