## dts/bindings/spi/intel,sedi-spi.yaml
```yaml
#
# Copyright (c) 2023 Intel Corporation.
#
# SPDX-License-Identifier: Apache-2.0
#

description: Intel SEDI SPI controller

compatible: "intel,sedi-spi"

include: spi-controller.yaml

properties:
  reg:
    required: true

  interrupts:
    required: true

  peripheral-id:
    type: int
    description: Peripheral Instance ID
    required: true
```

## dts/bindings/spi/ite,it51xxx-spi.yaml
```yaml
# Copyright (c) 2025 ITE Corporation. All Rights Reserved.
# SPDX-License-Identifier: Apache-2.0

description: IT51XXX SPI

compatible: "ite,it51xxx-spi"

include: [spi-controller.yaml, pinctrl-device.yaml]

properties:
  reg:
    required: true

  interrupts:
    required: true

  pinctrl-names:
    required: true

  pinctrl-0:
    type: phandles
    required: true
```

## dts/bindings/spi/ite,it8xxx2-spi.yaml
```yaml
# Copyright (c) 2024 ITE Corporation. All Rights Reserved.
# SPDX-License-Identifier: Apache-2.0

description: IT8XXX2 SPI

compatible: "ite,it8xxx2-spi"

include: [spi-controller.yaml, pinctrl-device.yaml]

properties:
  reg:
    required: true

  interrupts:
    required: true

  pinctrl-names:
    required: true

  pinctrl-0:
    type: phandles
    required: true
```

## dts/bindings/spi/ite,it8xxx2-sspi.yaml
```yaml
# Copyright (c) 2020 ITE Corporation. All Rights Reserved.
# SPDX-License-Identifier: Apache-2.0

description: IT8XXX2 SPI

compatible: "ite,it8xxx2-sspi"

include: spi-controller.yaml

properties:
    reg:
      required: true

    interrupts:
      required: true
```

## dts/bindings/spi/litex,spi-litespi.yaml
```yaml
description: LiteX SPI LiteSPI Controller

compatible: "litex,spi-litespi"

include: spi-controller.yaml

properties:
  reg:
    required: true
```

## dts/bindings/spi/litex,spi.yaml
```yaml
# Copyright (c) 2019 Antmicro <www.antmicro.com>
# SPDX-License-Identifier: Apache-2.0

description: LiteX SPI

compatible: "litex,spi"

include: spi-controller.yaml

properties:
  reg:
    required: true

  data-width:
    type: int
    description: |
      Maximum data width of the SPI controller in bits.
    default: 8

  max-cs:
    type: int
    description: |
      Maximum number of chip selects supported by the SPI controller.
    default: 1
```

## dts/bindings/spi/lowrisc,opentitan-spi.yaml
```yaml
# Copyright (c) 2023, Rivos Inc.
# SPDX-License-Identifier: Apache-2.0

description: OpenTitan SPI controller

compatible: "lowrisc,opentitan-spi"

include: [spi-controller.yaml, pinctrl-device.yaml]

properties:
  reg:
    required: true
```

## dts/bindings/spi/microchip,flexcom-g1-spi.yaml
```yaml
# Copyright (c) 2026 Microchip Technology Inc.
# SPDX-License-Identifier: Apache-2.0

description: |
  Microchip FLEXCOM SPI

  Group G1 FLEXCOM SPI includes the following hardware peripherals:
    - module name="FLEXCOM" id="11268" version="237"

examples:
  - |
    Example devicetree configuration:

      &pinctrl {
        pinctrl_spi11_default: spi11_default {
          group1 {
            pinmux = <PIN_PB3__FLEXCOM11_IO0>,
                     <PIN_PB4__FLEXCOM11_IO1>,
                     <PIN_PB5__FLEXCOM11_IO2>,
                     <PIN_PB6__GPIO>; /* GPIO CS */
            bias-pull-up;
          };
        };
      };

      spi11: spi@400 {
        pinctrl-0 = <&pinctrl_spi11_default>;
        pinctrl-names = "default";
        dmas = <&dma0 0 28>,
               <&dma0 1 27>;
        dma-names = "tx", "rx";
        cs-gpios = <&piob 6 GPIO_ACTIVE_LOW>;
        status = "okay";
      };

compatible: "microchip,flexcom-g1-spi"

include:
  - name: spi-controller.yaml
  - name: pinctrl-device.yaml

properties:
  reg:
    required: true

  clocks:
    required: true

  clock-names:
    required: true

  loopback:
    type: boolean
    description: |
      Connects TX to RX internally creating a loop back connection. Useful
      for testing.

  dmas:
    description: |
      TX & RX dma specifiers.  Each specifier will have a phandle
      reference to the dma controller, the channel number, and peripheral
      trigger source. The channel number is arbitrary but must not be
      reused. The number of channels available is device dependent.

  dma-names:
    description: |
      This should be "tx" and "rx" and should match the order given for
      dmas.
```

## dts/bindings/spi/microchip,mec5-qspi-device.yaml
```yaml
# Copyright (c) 2025, Microchip Technology Inc.
# SPDX-License-Identifier: Apache-2.0

# Microchip QSPI controller SPI additional timing setting specific to SPI flash devices.

include: [spi-device.yaml]

properties:
  dcsckon:
    type: int
    description: |
      Delay in QSPI main clocks from CS# assertion to first clock edge.
      If not present use hardware default value. Refer to chip documention
      for QMSPI input clock frequency.

  dckcsoff:
    type: int
    description: |
      Delay in QSPI main clocks from last clock edge to CS# de-assertion.
      If not presetn use hardware default value. Refer to chip documention
      for QSPI input clock frequency.

  dldh:
    type: int
    description: |
      Delay in QSPI main clocks from CS# de-assertion to driving HOLD#
      and WP#. If not present use hardware default value. Refer to chip
      documention for QSPI input clock frequency.

  dcsda:
    type: int
    description: |
      Delay in QSPI main clocks from CS# de-assertion to CS# assertion.
      If not present use hardware default value. Refer to chip documention
      for QSPI input clock frequency.

  ctrl-tap:
    type: int
    description: Select control tap point. Values are in [0, 255].

  clock-tap:
    type: int
    description: |
      Select clock tap point to offset any off chip delays. Values are in [0, 255].
```

## dts/bindings/spi/microchip,mec5-qspi.yaml
```yaml
# Copyright (c) 2024, Microchip Technology Inc.
# SPDX-License-Identifier: Apache-2.0

description: Microchip MEC5 series QSPI controller

compatible: "microchip,mec5-qspi"

include: ["spi-controller.yaml", "pinctrl-device.yaml", "microchip,dmec-ecia-girq.yaml"]

properties:
  reg:
    required: true

  pinctrl-0:
    required: true

  pinctrl-names:
    required: true
```

## dts/bindings/spi/microchip,mpfs-qspi.yaml
```yaml
# Copyright (c) 2022 Microchip Technology Inc.
# SPDX-License-Identifier: Apache-2.0

description: Microchip Polarfire SOC QSPI controller

compatible: "microchip,mpfs-qspi"

include: spi-controller.yaml

properties:
  reg:
    required: true

  interrupts:
    required: true
```

## dts/bindings/spi/microchip,mpfs-spi.yaml
```yaml
# Copyright (c) 2022 Microchip Inc.
# SPDX-License-Identifier: Apache-2.0

description: Microchip Polarfire SOC SPI controller

compatible: "microchip,mpfs-spi"

include: [spi-controller.yaml, reset-device.yaml]

properties:
  reg:
    required: true

  interrupts:
    required: true
```

## dts/bindings/spi/microchip,pic32cxsg-spi.yaml
```yaml
# Copyright (c) 2024 Microchip
# SPDX-License-Identifier: Apache-2.0

description: Microchip PIC32CXSG SERCOM SPI controller

compatible: "microchip,pic32cxsg-spi"

include:
  - name: spi-controller.yaml
  - name: pinctrl-device.yaml

properties:
  reg:
    required: true

  clocks:
    required: true

  clock-names:
    required: true

  dipo:
    type: int
    required: true
    description: Data In Pinout

  dopo:
    type: int
    required: true
    description: Data Out Pinout

  dmas:
    description: |
      Optional TX & RX dma specifiers.  Each specifier will have a phandle
      reference to the dmac controller, the channel number, and peripheral
      trigger source.

      For example dmas for TX, RX on SERCOM3
         dmas = <&dmac 0 0xb>, <&dmac 1 0xa>;

  dma-names:
    description: |
      Required if the dmas property exists.  This should be "tx" and "rx"
      to match the dmas property.

      For example
         dma-names = "tx", "rx";
```

## dts/bindings/spi/microchip,sercom-g1-spi.yaml
```yaml
# Copyright (c) 2026 Microchip Technology Inc.
# SPDX-License-Identifier: Apache-2.0

description: |
  Microchip SERCOM SPI

  Group G1 SERCOM SPI includes the following hardware peripherals:
    - module name="SERCOM" id="U2201" version="5.0.0"

compatible: "microchip,sercom-g1-spi"

include:
  - name: spi-controller.yaml
  - name: pinctrl-device.yaml

properties:
  reg:
    required: true

  clocks:
    required: true

  clock-names:
    required: true

  dipo:
    type: int
    required: true
    description: |
      Data In Pinout

  dopo:
    type: int
    required: true
    description: |
      Data Out Pinout

  dmas:
    description: |
      Optional TX & RX dma specifiers.  Each specifier will have a phandle
      reference to the dmac controller, the channel number, and peripheral
      trigger source.

      For example dmas for TX, RX on SERCOM3
         dmas = <&dmac 0 0xb>, <&dmac 1 0xa>;

  dma-names:
    description: |
      Required if the dmas property exists.  This should be "tx" and "rx"
      to match the dmas property.

      For example
         dma-names = "tx", "rx";
```

## dts/bindings/spi/microchip,xec-gpspi.yaml
```yaml
# Copyright (c) 2022, Microchip Technology Inc.
# SPDX-License-Identifier: Apache-2.0

description: Microchip XEC GP-SPI controller

compatible: "microchip,xec-gpspi"

include: [spi-controller.yaml, pinctrl-device.yaml]

properties:
  reg:
    required: true

  girqs:
    type: array
    required: true
    description: |
      An array of integers encoding each interrupt signal connection.
      This information includes the aggregated GIRQ number, GIRQ bit
      position, aggregated GIRQ NVIC connection, and direct NVIC
      connection of the GIRQ bit.

  pcrs:
    type: array
    required: true
    description: |
      A two entry integer array containing the QMSPI PCR sleep register
      index and bit position.

  pinctrl-0:
    required: true

  pinctrl-names:
    required: true
```

## dts/bindings/spi/microchip,xec-qmspi-full-duplex.yaml
```yaml
# Copyright (c) 2018, Google LLC.
# Copyright (c) 2022, Microchip Technology Inc.
# SPDX-License-Identifier: Apache-2.0

description: Microchip XEC QMSPI controller with local DMA

compatible: "microchip,xec-qmspi-full-duplex"

include: [microchip-xec-qmspi-v2.yaml]
```

## dts/bindings/spi/microchip,xec-qmspi-ldma.yaml
```yaml
# Copyright (c) 2018, Google LLC.
# Copyright (c) 2021, Microchip Technology Inc.
# SPDX-License-Identifier: Apache-2.0

description: Microchip XEC QMSPI controller with local DMA

compatible: "microchip,xec-qmspi-ldma"

include: ["spi-controller.yaml", "pinctrl-device.yaml", "microchip,dmec-ecia-girq.yaml"]

properties:
  reg:
    required: true

  interrupts:
    required: true

  pinctrl-0:
    required: true

  pinctrl-names:
    required: true

  pcr:
    type: int
    required: true
    description: |
      Integer encoding the PCR register index and bit position
      of this I2C controller.

  dcsda:
    type: int
    description: |
      Delay in units of 10 ns from CS# de-assertion to CS# assertion.
      If not present use hardware default value of 6.

  ctrl-taps:
    type: array
    description: |
      An array of integers representing the control tap points for
      each of the two chip selects. Each value is in [0, 255]. 0 is HW default.
      This property may only be required for 96 MHz operation and is
      board layout dependent. Refer to the data sheet for control tap description.

  clock-taps:
    type: array
    description: |
      An array of integers representing the clock tap points for
      each of the two chip selects. Each value is in [0, 255]. 0 is HW default.
      This property may only be required for 96 MHz operation and is
      board layout dependent. Refer to data sheet for details.
```

## dts/bindings/spi/microchip,xec-qmspi-v2.yaml
```yaml
# Copyright (c) 2021, Microchip Technology Inc.
# SPDX-License-Identifier: Apache-2.0

description: Microchip XEC QMSPI controller V2

compatible: "microchip,xec-qmspi-v2"

include: spi-controller.yaml

properties:
    reg:
      required: true

    interrupts:
      required: true

    port_sel:
      type: int
      required: true
      description: SPI Port 0 or 1.

    lines:
      type: int
      required: true
      description: QMSPI lines 1, 2, or 4

    chip_select:
      type: int
      required: true
      description: Use QMSPI CS0# or CS1#

    dcsckon:
      type: int
      required: true
      description: |
        Delay in system clocks from CS# assertion to first clock edge

    dckcsoff:
      type: int
      required: true
      description: |
        Delay in system clocks from last clock edge to CS# de-assertion

    dldh:
      type: int
      required: true
      description: |
        Delay in system clocks from CS# de-assertion to driving HOLD# and WP#

    dcsda:
      type: int
      required: true
      description: |
        Delay in system clocks from CS# de-assertion to CS# assertion

    girqs:
      type: array
      required: true
      description: |
        QMSPI GIRQ number and bit position

    pcrs:
      type: array
      required: true
      description: |
        PCR register index and bit position for QMSPI clock control

    "#girq-cells":
      type: int
      const: 2

    "#pcr-cells":
      type: int
      const: 2

pcr-cells:
    - regidx
    - bitpos

girq-cells:
    - girqnum
    - bitpos
```

## dts/bindings/spi/microchip,xec-qmspi.yaml
```yaml
# Copyright (c) 2018, Google LLC.
# SPDX-License-Identifier: Apache-2.0

description: Microchip XEC QMSPI controller

compatible: "microchip,xec-qmspi"

include: spi-controller.yaml

properties:
    reg:
      required: true

    port_sel:
      type: int
      required: true
      description: SPI Port 0 or 1.

    rxdma:
      type: int
      required: true
      description: Receive DMA channel

    txdma:
      type: int
      required: true
      description: Transmit DMA channel

    lines:
      type: int
      required: true
      description: QMSPI lines 1, 2, or 4

    chip_select:
      type: int
      required: true
      description: Use QMSPI CS0# or CS1#

    dcsckon:
      type: int
      required: true
      description: Delay in system clocks from CS# assertion to first clock edge

    dckcsoff:
      type: int
      required: true
      description: Delay in system clocks from last clock edge to CS# de-assertion

    dldh:
      type: int
      required: true
      description: Delay in system clocks from CS# de-assertion to driving HOLD# and WP#

    dcsda:
      type: int
      required: true
      description: Delay in system clocks from CS# de-assertion to CS# assertion
```
