## dts/bindings/spi/st,stm32-spi.yaml
```yaml
# Copyright (c) 2018, I-SENSE group of ICCS
# SPDX-License-Identifier: Apache-2.0

description: STM32 SPI controller

compatible: "st,stm32-spi"

include: st,stm32-spi-common.yaml
```

## dts/bindings/spi/st,stm32h7-spi.yaml
```yaml
# Copyright (c) 2022, Linaro Limited
# SPDX-License-Identifier: Apache-2.0

description: |
        STM32H7 SPI controller.

        This compatible stands for all SPI hardware blocks matching the
        version available in STM32H7 SoCs.
        This version of STM32 SPI hardware block could be identified by the
        presence of a dedicated interrupt enable register (IER).
        For instance, but not limited  to: STM32MP1, STM32U5

compatible: "st,stm32h7-spi"

include: st,stm32-spi-common.yaml

properties:
  midi-clock:
    type: int
    default: 0
    description: |
      (Master Inter-Data Idleness) minimum clock inserted
      between two consecutive data frames.

  mssi-clock:
    type: int
    default: 0
    description: |
      (Master SS Idleness) minimum clock inserted between
      start and first data transaction.

  fifo-enable:
    type: boolean
    description: Enable the SPI FIFO usage for performance improvement.

  fifo-size:
    type: int
    required: true
    description: Size of the Tx and Rx FIFOs (in bytes).

  fifo-max-transfer-size:
    type: int
    required: true
    description: Maximal transfer size (in bytes) when FIFO is used.

  fifo-threshold:
    type: int
    default: 1
    enum:
      - 1
      - 2
      - 3
      - 4
      - 5
      - 6
      - 7
      - 8
      - 9
      - 10
      - 11
      - 12
      - 13
      - 14
      - 15
      - 16
    description: |
      Threshold level for the Tx and Rx FIFOs (in bytes).
      This value defines the maximum number of bytes in a single packet. It is
      recommended that the size of a packet does not exceed half of the FIFO size.
```

## dts/bindings/spi/st,stm32u5-spi.yaml
```yaml
# Copyright (c) 2022, Linaro Limited
# SPDX-License-Identifier: Apache-2.0

description: |
        STM32U5 SPI controller.

        The stm32u5 spi has some slight differences compared to the stm32h7 spi,
        which in the ec_host_cmd_backend_spi_stm32.c means it does not work.

compatible: "st,stm32u5-spi"

include: st,stm32-spi-common.yaml
```

## dts/bindings/spi/telink,b91-spi.yaml
```yaml
# Copyright (c) 2021, Telink Semiconductor
# SPDX-License-Identifier: Apache-2.0

description: Telink B91 SPI

include: spi-controller.yaml

compatible: "telink,b91-spi"

properties:
    reg:
        required: true

    peripheral-id:
      type: string
      required: true
      enum:
        - "PSPI_MODULE"
        - "HSPI_MODULE"

    pinctrl-0:
      type: phandles
      required: true

    cs0-pin:
      type: string
      required: true
      enum:
        - "0"
        - "PSPI_CSN_PC4"
        - "PSPI_CSN_PC0"
        - "PSPI_CSN_PD0"
        - "HSPI_CSN_PA1"
        - "HSPI_CSN_PB6"

    cs1-pin:
      type: string
      required: false
      enum:
        - "0"
        - "PSPI_CSN_PC4"
        - "PSPI_CSN_PC0"
        - "PSPI_CSN_PD0"
        - "HSPI_CSN_PA1"
        - "HSPI_CSN_PB6"

    cs2-pin:
      type: string
      required: false
      enum:
        - "0"
        - "PSPI_CSN_PC4"
        - "PSPI_CSN_PC0"
        - "PSPI_CSN_PD0"
        - "HSPI_CSN_PA1"
        - "HSPI_CSN_PB6"
```

## dts/bindings/spi/telink,b92-spi.yaml
```yaml
# Copyright (c) 2023-2024, Telink Semiconductor
# SPDX-License-Identifier: Apache-2.0

description: Telink B92 SPI

include: [spi-controller.yaml, pinctrl-device.yaml]

compatible: "telink,b92-spi"

properties:
  reg:
    required: true

  peripheral-id:
    type: string
    required: true
    enum:
      - "LSPI_MODULE"
      - "GSPI_MODULE"

  pinctrl-0:
    required: true

  cs0-pin:
    type: string
    required: true
    enum:
      - "0"
      - "LSPI_CSN_PE0_PIN"
      - "GPIO_PA1"
      - "GPIO_PB6"

  cs1-pin:
    type: string
    enum:
      - "0"
      - "LSPI_CSN_PE0_PIN"
      - "GPIO_PA1"
      - "GPIO_PB6"

  cs2-pin:
    type: string
    enum:
      - "0"
      - "LSPI_CSN_PE0_PIN"
      - "GPIO_PA1"
      - "GPIO_PB6"
```

## dts/bindings/spi/telink,tl321x-spi.yaml
```yaml
# Copyright (c) 2023, Telink Semiconductor
# SPDX-License-Identifier: Apache-2.0

description: Telink TL321X SPI

include: spi-controller.yaml

compatible: "telink,tl321x-spi"

properties:
  reg:
    required: true

  peripheral-id:
    type: string
    required: true
    enum:
      - "LSPI_MODULE"
      - "GSPI_MODULE"

  pinctrl-0:
    type: phandles
    required: true

  cs0-pin:
    type: string
    required: true
    enum:
      - "0"
      - "LSPI_CSN_PE0_PIN"
      - "GPIO_PA1"
      - "GPIO_PB6"

  cs1-pin:
    type: string
    enum:
      - "0"
      - "LSPI_CSN_PE0_PIN"
      - "GPIO_PA1"
      - "GPIO_PB6"

  cs2-pin:
    type: string
    enum:
      - "0"
      - "LSPI_CSN_PE0_PIN"
      - "GPIO_PA1"
      - "GPIO_PB6"
```

## dts/bindings/spi/telink,tl721x-spi.yaml
```yaml
# Copyright (c) 2024, Telink Semiconductor
# SPDX-License-Identifier: Apache-2.0

description: Telink TL721X SPI

include: [spi-controller.yaml, pinctrl-device.yaml]

compatible: "telink,tl721x-spi"

properties:
  reg:
    required: true

  peripheral-id:
    type: string
    required: true
    enum:
      - "LSPI_MODULE"
      - "GSPI_MODULE"

  pinctrl-0:
    required: true

  cs0-pin:
    type: string
    required: true
    enum:
      - "0"
      - "LSPI_CSN_PE0_PIN"
      - "GPIO_PF3"
      - "GPIO_PB6"

  cs1-pin:
    type: string
    enum:
      - "0"
      - "LSPI_CSN_PE0_PIN"
      - "GPIO_PF3"
      - "GPIO_PB6"

  cs2-pin:
    type: string
    enum:
      - "0"
      - "LSPI_CSN_PE0_PIN"
      - "GPIO_PF3"
      - "GPIO_PB6"
```

## dts/bindings/spi/telink,w91-spi.yaml
```yaml
# Copyright (c) 2024, Telink Semiconductor
# SPDX-License-Identifier: Apache-2.0

description: Telink W91 SPI

include: [spi-controller.yaml, pinctrl-device.yaml]

compatible: "telink,w91-spi"

properties:
  pinctrl-0:
    type: phandles
    required: true

  instance-id:
    type: int
    required: true
```

## dts/bindings/spi/ti,cc13xx-cc26xx-spi.yaml
```yaml
# Copyright (c) 2019 Brett Witherspoon
# SPDX-License-Identifier: Apache-2.0

description: TI SimpleLink CC13xx / CC26xx SPI controller

compatible: "ti,cc13xx-cc26xx-spi"

include: [spi-controller.yaml, pinctrl-device.yaml, base.yaml]

properties:
  reg:
    required: true
```

## dts/bindings/spi/ti,cc23x0-spi.yaml
```yaml
# Copyright (c) 2024 BayLibre, SAS
# SPDX-License-Identifier: Apache-2.0

description: TI SimpleLink CC23x0 SPI controller

compatible: "ti,cc23x0-spi"

include: [spi-controller.yaml, pinctrl-device.yaml, base.yaml]

properties:
  reg:
    required: true

  interrupts:
    required: true

  pinctrl-0:
    required: true

  pinctrl-names:
    required: true

  dmas:
    description: |
      Optional TX & RX DMA specifiers. Each specifier will have a phandle
      reference to the DMA controller, the channel number, and the peripheral
      trigger source.

      Example for channels 0/1 with spi0txtrg/spi0rxtrg trigger sources:
        dmas = <&dma 0 0>, <&dma 1 1>;

  dma-names:
    description: |
      Required if the dmas property exists. This should be "tx" and "rx"
      to match the dmas property.

      Example:
        dma-names = "tx", "rx";
```

## dts/bindings/spi/ti,mspm0-spi.yaml
```yaml
# Copyright (c) 2026 Linumiz
# SPDX-License-Identifier: Apache-2.0

description: |
   Texas Instruments MSPM0 SERIAL PERIPHERAL INTERFACE (SPI).

compatible: "ti,mspm0-spi"
include: [spi-controller.yaml, pinctrl-device.yaml]

properties:
  reg:
    required: true

  pinctrl-0:
    required: true

  clocks:
    required: true

  ti,clk-div:
    type: int
    default: 1
    enum:
      - 1
      - 2
      - 3
      - 4
      - 5
      - 6
      - 7
      - 8
```

## dts/bindings/spi/ti,omap-mcspi.yaml
```yaml
# Copyright 2025 Texas Instruments
# SPDX-License-Identifier: Apache-2.0

description: TI Multi Channel SPI controller for OMAP and K3 SoCs

compatible: "ti,omap-mcspi"

include: [spi-controller.yaml, pinctrl-device.yaml]

properties:
  reg:
    required: true

  ti,spi-num-cs:
    type: int
    default: 1
    description: |
      Number of chipselects supported by controller

  ti,d1-miso-d0-mosi:
    type: boolean
    description: |
      Sets d0 as MOSI and d1 as MISO if true, vice versa otherwise.
```

## dts/bindings/spi/wch,spi.yaml
```yaml
# Copyright (c) 2025 MASSDRIVER EI (massdriver.space)
# SPDX-License-Identifier: Apache-2.0

description: WCH SPI

compatible: "wch,spi"

include: [spi-controller.yaml, pinctrl-device.yaml]

properties:
  reg:
    required: true

  clocks:
    required: true

  pinctrl-0:
    required: true

  pinctrl-names:
    required: true
```

## dts/bindings/spi/xlnx,xps-spi-2.00.a.yaml
```yaml
# Copyright (c) 2020 Henrik Brix Andersen <henrik@brixandersen.dk>
# SPDX-License-Identifier: Apache-2.0

description: Xilinx AXI Quad SPI IP node

compatible: "xlnx,xps-spi-2.00.a"

include: spi-controller.yaml

# Property names correspond to a subset of those generated by
# https://github.com/Xilinx/device-tree-xlnx

properties:
  reg:
    required: true

  interrupts:
    required: true

  xlnx,num-ss-bits:
    type: int
    required: true
    enum:
      - 1
      - 2
      - 3
      - 4
    description: |
      Number of slave select bits implemented

  xlnx,num-transfer-bits:
    type: int
    required: true
    enum:
      - 8
      - 16
      - 32
    description: |
      Number of bits per transfer

  xlnx,startup-block:
    type: boolean
    description: |
      Indicates the core is instantiated with the STARTUP block option, as is
      typically used when interfacing with the FPGA's configuration flash
      device. In this configuration the SPI clock is routed through the
      STARTUP block rather than normal signal routing.
      In this case, a workaround is required to issue a dummy
      transaction to the SPI flash device to ensure the STARTUP block is
      disengaged and allow the SPI core to control the CCLK line properly.
      The dummy READ_ID transaction will be issued to chip select 0.

  fifo-size:
    type: int
    description: |
      FIFO size configured in SPI core. 0 indicates no FIFO.
      If not specified, 0 is assumed.
      Used to optimize TX/RX read handling. If the FIFO size is 0, the driver
      will check for FIFO full/empty after every word.
```

## dts/bindings/spi/xlnx,zynq-qspi.yaml
```yaml
# Copyright (c) 2026 Simon Maurer <mail@maurer.systems>
# SPDX-License-Identifier: Apache-2.0

description: Xilinx Zynq 7000 Quad SPI Flash Controller

compatible: "xlnx,zynq-qspi"

include: spi-controller.yaml

properties:
  reg:
    required: true

  interrupts:
    required: true

  clock-frequency:
    required: true
```

## dts/bindings/spi/xlnx,zynqmp-qspi-1.0.yaml
```yaml
# Copyright (c) 2025 Calian Ltd
# SPDX-License-Identifier: Apache-2.0

description: Xilinx ZynqMP Quad SPI interface

compatible: "xlnx,zynqmp-qspi-1.0"

include: spi-controller.yaml

properties:
  reg:
    required: true

  interrupts:
    required: true

  clock-frequency:
    description: SPI reference clock frequency in Hz
    type: int
    required: true

  shared-data-bus:
    type: boolean
    description: |
      Indicates that both "lower" and "upper" chip selects are used with
      the "lower" data bus, rather than each using a dedicated data bus.
```

## dts/bindings/spi/zephyr,spi-emul-controller.yaml
```yaml
# Copyright 2020 Google LLC
# SPDX-License-Identifier: Apache-2.0

description: Zephyr SPI Emulation controller

compatible: "zephyr,spi-emul-controller"

include: spi-controller.yaml

properties:
  reg:
    required: true
```

## dts/bindings/sram/mmio-sram.yaml
```yaml
# Copyright (c) 2018, Linaro Limited
# SPDX-License-Identifier: Apache-2.0

description: Generic on-chip SRAM

compatible: "mmio-sram"

include: base.yaml

properties:
  reg:
    required: true
```

## dts/bindings/sram/rapidsi,ocm.yaml
```yaml
# Copyright (c) 2014, Rapid Silicon
# SPDX-License-Identifier: Apache-2.0

description: Generic on-chip Memory

compatible: "rapidsi,ocm"

include: base.yaml

bus: simple_bus

properties:
  reg:
    required: false
```

## dts/bindings/sram/sifive,dtim0.yaml
```yaml
# Copyright (c) 2019 Antmicro <www.antmicro.com>
# SPDX-License-Identifier: Apache-2.0

description: SiFive Data Tightly-Integrated Memory

compatible: "sifive,dtim0"

include: base.yaml

properties:
  reg:
    required: true
```

## dts/bindings/stepper/adi/adi,tmc2130-spi-step-dir.yaml
```yaml
# SPDX-FileCopyrightText: Copyright (c) 2025 Navimatix GmbH
# SPDX-License-Identifier: Apache-2.0

description: |
  Analog Devices TMC2130 stepper motor driver.
  Implements only the Step Dir Interface with SPI driver configuration. The Standalone and
  (pure) Spi Driver Interfaces are not supported.

  Example:
  stepper_motor: tmc2130@0 {
    compatible = "adi,tmc2130-spi-step-dir";
    reg = <0>;
    spi-max-frequency = <DT_FREQ_M(1)>; /* Maximum SPI bus frequency */

    dir-gpios = <&arduino_header 14 0>;
    step-gpios = <&arduino_header 15 0>;
    en-gpios  = <&mikroe_stepper_gpios 0 GPIO_ACTIVE_LOW>;
    counter = <&counter2>;
    irun = <20>;
    ihold = <20>;
    stealth-chop-enabled;
  };

compatible: "adi,tmc2130-spi-step-dir"

include:
  - name: stepper-controller.yaml
  - name: spi-device.yaml
  - name: adi,trinamic-gconf.yaml
    property-allowlist:
      - i-scale-analog
  - name: adi,trinamic-common.yaml
    property-allowlist:
      - ihold
      - irun
      - iholddelay
      - tpwmthrs
      - tpowerdown


properties:
  dual-edge-step:
    type: boolean
    description: |
      If present, the stepper motor controller supports dual edge step signals.
      This means that the step signal can be toggled on both the rising and falling edge.

  stealth-chop-enabled:
    type: boolean
    description: |
      Enables stealth-chop for lower motor noise and vibrations at lower speeds. Note that some
      motors have issues with a combination of stealth-chop and high current, forcing a reduction
      of irun
```

## dts/bindings/stepper/adi/adi,tmc2130.yaml
```yaml
# SPDX-FileCopyrightText: Copyright (c) 2025 Navimatix GmbH
# SPDX-License-Identifier: Apache-2.0

description: |
  Analog Devices TMC2130 stepper motor driver.
  Implements only the Step Dir Interface with SPI driver configuration.

  Example:
  &spi0 {
    stepper_motor: tmc2130@0 {
      compatible = "adi,tmc2130";
      reg = <0>;
      spi-max-frequency = <DT_FREQ_M(1)>; /* Maximum SPI bus frequency */

      dir-gpios = <&arduino_header 14 0>;
      step-gpios = <&arduino_header 15 0>;
      en-gpios  = <&mikroe_stepper_gpios 0 GPIO_ACTIVE_LOW>;
      counter = <&counter2>;
      irun = <20>;
      ihold = <20>;
      en-pwm-mode;
    };
  };

compatible: "adi,tmc2130"

include:
  - name: stepper-controller.yaml
  - name: spi-device.yaml
  - name: adi,trinamic-gconf.yaml
    property-allowlist:
      - i-scale-analog
      - en-pwm-mode
  - name: adi,trinamic-velocity-control.yaml
    property-allowlist:
      - ihold
      - irun
      - iholddelay
      - tpwmthrs
      - tpowerdown


properties:
  dual-edge-step:
    type: boolean
    description: |
      If present, the stepper motor controller supports dual edge step signals.
      This means that the step signal can be toggled on both the rising and falling edge.
```
