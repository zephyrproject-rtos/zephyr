## dts/bindings/stepper/adi/adi,tmc2209.yaml
```yaml
# SPDX-FileCopyrightText: Copyright (c) 2024 Fabian Blatz <fabianblatz@gmail.com>
# SPDX-License-Identifier: Apache-2.0

description: |
  Analog Devices TMC2209 stepper motor driver.

compatible: "adi,tmc2209"

include:
  - name: stepper-driver.yaml
  - name: step-dir-timing.yaml

properties:
  step-width-ns:
    default: 100

  m0-gpios:
    type: phandle-array
    description: Microstep configuration pin MS1.

  m1-gpios:
    type: phandle-array
    description: Microstep configuration pin MS2.

  dual-edge-step:
    type: boolean
    description: |
      If present, the stepper motor controller supports dual edge step signals.
      This means that the step signal can be toggled on both the rising and falling edge.

examples:
  - |
    tmc2209: tmc2209 {
        compatible = "adi,tmc2209";
        enable-gpios = <&gpio0 0 GPIO_ACTIVE_HIGH>;
        m0-gpios = <&gpio0 1 GPIO_ACTIVE_HIGH>;
        m1-gpios = <&gpio0 2 GPIO_ACTIVE_HIGH>;
    }
```

## dts/bindings/stepper/adi/adi,tmc5041.yaml
```yaml
# SPDX-FileCopyrightText: Copyright (c) 2024 Carl Zeiss Meditec AG
# SPDX-License-Identifier: Apache-2.0

description: |
  Analog Devices TMC5041 Stepper Motor Controller

  Example:

    #include <zephyr/dt-bindings/stepper/adi/tmc5041_reg.h>

    &spi0 {
        /* SPI bus options here, not shown */

        /* Dual controller/driver for up to two 2-phase bipolar stepper motors */
        tmc5041: tmc5041@0 {
            compatible = "adi,tmc5041";
            reg = <0>;
            spi-max-frequency = <DT_FREQ_M(24)>; /* Maximum SPI bus frequency */

            #address-cells = <1>;
            #size-cells = <0>;

            poscmp-enable; test-mode; lock-gconf; /* ADI TMC Global configuration flags */
            clock-frequency = <DT_FREQ_M(16)>; /* Internal/External Clock frequency */

            motor: motor@0 {
                status = "okay";
                reg = <0>;

                /* common stepper controller settings */
                invert-direction;
                micro-step-res = <256>;

                /* ADI TMC stallguard settings specific to TMC5041 */
                activate-stallguard2;
                stallguard-velocity-check-interval-ms=<100>;
                stallguard2-threshold=<9>;
                stallguard-threshold-velocity=<500000>;

                /* ADI TMC ramp generator as well as current settings */
                vstart = <10>;
                a1 = <20>;
                v1 = <30>;
                d1 = <40>;
                vmax = <50>;
                amax = <60>;
                dmax = <70>;
                tzerowait = <80>;
                vhigh = <90>;
                vcoolthrs = <100>;
                ihold = <1>;
                irun = <2>;
                iholddelay = <3>;
            };
        };
    };


compatible: "adi,tmc5041"

include:
  - name: spi-device.yaml
  - name: adi,trinamic-gconf.yaml
    property-allowlist:
      - poscmp-enable
      - shaft1
      - shaft2
      - test-mode
      - lock-gconf

properties:
  "#address-cells":
    default: 1
    const: 1

  "#size-cells":
    default: 0
    const: 0

  clock-frequency:
    type: int
    required: true
    description: |
      The frequency of the clock signal provided to the TMC5041.
      This is used for real world conversion.

      Hint: µstep velocity v[Hz] µsteps / s v[Hz] = v[5041] * ( fCLK[Hz]/2 / 2^23 )
            where v[5041] is the value written to the TMC5041.

child-binding:
  include:
    - name: stepper-controller.yaml
    - name: base.yaml
      property-allowlist:
        - reg
    - name: adi,trinamic-ramp-generator.yaml
      property-allowlist:
        - vstart
        - a1
        - v1
        - amax
        - vmax
        - dmax
        - d1
        - vstop
        - tzerowait
        - vhigh
        - vcoolthrs
        - ihold
        - irun
        - iholddelay
    - name: adi,trinamic-stallguard.yaml
      property-allowlist:
        - activate-stallguard2
        - stallguard2-threshold
        - stallguard-threshold-velocity
        - stallguard-velocity-check-interval-ms
```

## dts/bindings/stepper/adi/adi,tmc50xx.yaml
```yaml
# SPDX-FileCopyrightText: Copyright (c) 2024 Carl Zeiss Meditec AG
# SPDX-License-Identifier: Apache-2.0

description: |
  Analog Devices TMC50XX Stepper Motor Controller

compatible: "adi,tmc50xx"

include:
  - name: spi-device.yaml
  - name: adi,trinamic-gconf.yaml
    property-allowlist:
      - poscmp-enable
      - test-mode
      - lock-gconf

properties:
  clock-frequency:
    type: int
    required: true
    description: |
      The frequency of the clock signal provided to the TMC50XX.
      This is used for real world conversion.

      Hint: µstep velocity v[Hz] µsteps / s v[Hz] = v[50xx] * ( fCLK[Hz]/2 / 2^23 )
            where v[50xx] is the value written to the TMC50XX.

  shaft1:
    type: boolean
    description: |
      Inverse motor 1 direction

  shaft2:
    type: boolean
    description: |
      Inverse motor 2 direction

child-binding:
  include:
    - name: base.yaml
      property-allowlist:
        - reg

examples:
  - |
    &spi0 {
        /* SPI bus options here, not shown */

        /* Dual controller/driver for up to two 2-phase bipolar stepper motors */
        tmc50xx: tmc50xx@0 {
            compatible = "adi,tmc50xx";
            reg = <0>;
            spi-max-frequency = <DT_FREQ_M(8)>; /* Maximum SPI bus frequency */

            poscmp-enable; test-mode; lock-gconf; /* ADI TMC Global configuration flags */
            clock-frequency = <DT_FREQ_M(16)>; /* Internal/External Clock frequency */

            tmc50xx_0_stepper_driver: tmc50xx_0_stepper_driver {
              idx = <0>;
              compatible = "adi,tmc50xx-stepper-drv";
              micro-step-res = <256>;
              /* ADI TMC stallguard settings specific to TMC50XX */
              stallguard2-threshold=<30>;
            };

            tmc50xx_0_motion_controller: tmc50xx_0_motion_controller {
              idx = <0>;
              compatible = "adi,tmc50xx-stepper";
              vstart = <1000>;
              vstop = <10>;
              a1 = <10000>;
              v1 = <50000>;
              d1 = <14000>;
              vmax = <900000>;
              amax = <50000>;
              dmax = <7000>;
              tzerowait = <100>;
              vhigh = <900000>;
              vcoolthrs = <900000>;
              ihold = <1>;
              irun = <10>;
              iholddelay = <1>;
              activate-stallguard2;
              stallguard-velocity-check-interval-ms=<1000>;
              stallguard-threshold-velocity=<200000>;
            };
        };
    };
```
