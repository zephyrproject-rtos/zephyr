## dts/bindings/spi/silabs,eusart-spi.yaml
```yaml
title: |
  Silicon Labs Series 2 EUSART (Enhanced Universal Synchronous/Asynchronous Receiver/Transmitter)

description: |
  EUSART (Enhanced Universal Synchronous/Asynchronous Receiver/Transmitter) peripheral for
  Silicon Labs Series 2 SoCs used in SPI mode.

  The TX signal is SDO in controller mode and SDI in peripheral mode, while the RX signal is SDI in
  controller mode and SDO in peripheral mode. The CS signal may be configured in pinctrl or as a
  GPIO pin in controller mode. It must be configured in pinctrl in peripheral mode.

examples:
  - |
    /* Controller mode with GPIO CS and DMA */
    &pinctrl {
            eusart1_default: eusart1_default {
                    group0 {
                            pins = <EUSART1_TX_PC1>, <EUSART1_SCLK_PC3>;
                            drive-push-pull;
                            output-high;
                    };

                    group1 {
                            pins = <EUSART1_RX_PC2>;
                            input-enable;
                    };
            };
    };

    &eusart1 {
            compatible = "silabs,eusart-spi";
            #address-cells = <1>;
            #size-cells = <0>;
            pinctrl-0 = <&eusart1_default>;
            pinctrl-names = "default";
            cs-gpios = <&gpioc 0 GPIO_ACTIVE_LOW>;
            dmas = <&dma0 DMA_REQSEL_EUSART1TXFL>, <&dma0 DMA_REQSEL_EUSART1RXFL>;
            dma-names = "tx", "rx";
            status = "okay";

            sensor@0 {
                    compatible = "vnd,spi-device";
                    reg = <0>;
                    spi-max-frequency = <DT_FREQ_M(1)>;
            };
    };

  - |
    /* Peripheral mode with CS through pinctrl, TX is SDI, RX is SDO */
    &pinctrl {
            eusart1_default: eusart1_default {
                    group0 {
                            pins = <EUSART1_RX_PC0>;
                            drive-push-pull;
                            output-high;
                    };

                    group1 {
                            pins = <EUSART1_TX_PC1>, <EUSART1_SCLK_PC3>, <EUSART1_CS_PC2>;
                            input-enable;
                    };
            };
    };

    &eusart1 {
            compatible = "silabs,eusart-spi";
            pinctrl-0 = <&eusart1_default>;
            pinctrl-names = "default";
            dmas = <&dma0 DMA_REQSEL_EUSART1TXFL>, <&dma0 DMA_REQSEL_EUSART1RXFL>;
            dma-names = "tx", "rx";
            status = "okay";
    };

compatible: "silabs,eusart-spi"

include: [spi-controller.yaml, pinctrl-device.yaml]

properties:
  reg:
    required: true

  interrupts:
    required: true

  pinctrl-0:
    required: true

  pinctrl-names:
    required: true

  clocks:
    required: true
```

## dts/bindings/spi/st,stm32-spi-subghz.yaml
```yaml
# Copyright (c) 2021 Fabio Baltieri
# SPDX-License-Identifier: Apache-2.0

description: STM32 SUBGHZ SPI controller

compatible: "st,stm32-spi-subghz"

include:
  - name: st,stm32-spi-common.yaml
    property-blocklist:
      - pinctrl-0
      - pinctrl-names
```

## dts/bindings/spi/ti,cc23x0-cc27xx-spi.yaml
```yaml
# Copyright (c) 2024 BayLibre, SAS
# SPDX-License-Identifier: Apache-2.0

description: TI SimpleLink CC23x0_CC27xx SPI node

compatible: "ti,cc23x0-cc27xx-spi"

include: [spi-controller.yaml, pinctrl-device.yaml, base.yaml]

properties:
  reg:
    required: true

  interrupts:
    required: true

  pinctrl-0:
    required: true

  pinctrl-names:
    required: true

  clock-id:
    type: int
    required: true
    description: |
      CLKCTL peripheral clock gate ID for this SPI instance.
      Use CLKCTL_SPI0 (0x400) for SPI instance 0 or CLKCTL_SPI1 (0x800)
      for SPI instance 1.

  dmas:
    description: |
      Optional TX & RX DMA specifiers. Each specifier will have a phandle
      reference to the DMA controller, the channel number, and the peripheral
      trigger source.

      Example for channels 0/1 with spi0txtrg/spi0rxtrg trigger sources:
        dmas = <&dma 0 0>, <&dma 1 1>;

  dma-names:
    description: |
      Required if the dmas property exists. This should be "tx" and "rx"
      to match the dmas property.

      Example:
        dma-names = "tx", "rx";
```

## dts/bindings/spi/ti,cc35xx-spi.yaml
```yaml
# Copyright (c) 2025-2026 Conclusive Engineering
# SPDX-License-Identifier: Apache-2.0

description: TI SimpleLink CC35xx

compatible: "ti,cc35xx-spi"

include: [spi-controller.yaml, pinctrl-device.yaml, base.yaml]

properties:
  reg:
    required: true

  interrupts:
    required: true

  pinctrl-0:
    required: true

  pinctrl-names:
    required: true

  dmas:
    description: |
      Optional TX & RX dma specifiers used by async SPI.
      The dmas are referenced in the SPI node using the following syntax:

      dmas = <&dma 0 CC35XX_DMA_SET_CONFIG(CC35xx_DMA_PERIPH_SPI_0)>,
             <&dma 1 CC35XX_DMA_SET_CONFIG(CC35xx_DMA_PERIPH_SPI_0)>;
      where the first entry is for the TX, and the second for RX.

      The parameters in the dma entry are: dma device phandle, dma channel, dma_peripheral

  dma-names:
    description: |
      Required if the dmas property exists. Should be set to "tx" and "rx"
      to match the dmas property.

      For example
         dma-names = "tx", "rx";
```

## dts/bindings/spi/ti,unicomm-spi.yaml
```yaml
# Copyright (c) 2026 Texas Instruments Incorporated
# SPDX-License-Identifier: Apache-2.0

description: TI Unicomm SPI controller

compatible: "ti,unicomm-spi"

include: [spi-controller.yaml, pinctrl-device.yaml, base.yaml]

properties:
  reg:
    required: true

  interrupts:
    required: true

  clocks:
    required: true

  pinctrl-0:
    required: true

  pinctrl-names:
    required: true

  tx-fifo-threshold:
    type: int
    default: 4
    description: |
      TX FIFO interrupt threshold (IFLS.TXIFLSEL field, bits [2:0]).
      The RIS.TX interrupt fires when the number of entries in the TX FIFO
      falls to or below this threshold, allowing the driver to refill before
      the FIFO runs completely empty.
      Valid encoding (hardware-defined, 16-entry FIFO):
        0 = >= 12 entries free (fire when <= 4 remain)
        1 = >= 8  entries free (fire when <= 8 remain, half-empty)
        2 = >= 4  entries free (fire when <= 12 remain)
        3 = >= 2  entries free (fire when <= 14 remain)
        4 = >= 1  entry  free  (fire when <= 15 remain, almost full)
        5 = FIFO empty (all entries moved to shift register)
      Default 4 keeps the TX FIFO well-fed with minimal interrupt rate.

  rx-fifo-threshold:
    type: int
    default: 0
    description: |
      RX FIFO interrupt threshold (IFLS.RXIFLSEL field, bits [6:4]).
      The RIS.RX interrupt fires when the number of entries in the RX FIFO
      reaches or exceeds this threshold.
      Valid encoding (hardware-defined, 16-entry FIFO):
        0 = >= 1  entry  (fire as soon as any byte is available, not-empty)
        1 = >= 4  entries
        2 = >= 8  entries (half-full)
        3 = >= 12 entries
        4 = >= 14 entries
        5 = FIFO full
      Default 0 (not-empty) gives lowest latency; raise for fewer interrupts.
```

## dts/bindings/spi/virtio,spi.yaml
```yaml
# SPDX-FileCopyrightText: Copyright The Zephyr Project Contributors
# SPDX-License-Identifier: Apache-2.0

description: |
  VIRTIO SPI controller device (ID:45)

compatible: "virtio,spi"

include: [spi-controller.yaml]

examples:
  - |
    virtio_mmio0: virtio_mmio@a000000 {
            compatible = "virtio,mmio";
            reg = <0xa000000 0x200>;
            interrupts = <0 16 4>;
            status = "okay";

            virtio_spi0: virtio-spi {
                    compatible = "virtio,spi";
                    #address-cells = <1>;
                    #size-cells = <0>;
                    status = "okay";
            };
    };
```

## dts/bindings/spi/xlnx,versal-qspi-1.0.yaml
```yaml
# Copyright (c) 2026 Space Cubics, Inc.
# SPDX-License-Identifier: Apache-2.0

description: AMD Xilinx Versal Quad SPI interface

compatible: "xlnx,versal-qspi-1.0"

include: spi-controller.yaml

properties:
  reg:
    required: true

  interrupts:
    required: true

  clock-frequency:
    description: SPI reference clock frequency in Hz
    type: int
    required: true

  shared-data-bus:
    type: boolean
    description: |
      Indicates that both "lower" and "upper" chip selects are used with
      the "lower" data bus, rather than each using a dedicated data bus.
```

## dts/bindings/spi/zephyr,spi-bitbang.yaml
```yaml
# Copyright 2021 Marc Reilly, Creative Product Design
# SPDX-License-Identifier: Apache-2.0

description: Zephyr SPI Bitbang driver

compatible: "zephyr,spi-bitbang"

include: spi-controller.yaml

properties:
  clk-gpios:
    type: phandle-array
    required: true
    description: |
      Clock gpio info

  sdo-gpios:
    type: phandle-array
    description: |
      SDO gpio info. Output pin for Serial Data Out.
      If this is not provided then the driver will transmit 0s

  sdi-gpios:
    type: phandle-array
    description: |
      SDI gpio info. Input pin for Serial Data In.
      If this is not provided the driver will read 0s

  mosi-gpios:
    type: phandle-array
    deprecated: true
    description: |
      Deprecated. Use sdo-gpios instead.

  miso-gpios:
    type: phandle-array
    deprecated: true
    description: |
      Deprecated. Use sdi-gpios instead.
```

## dts/bindings/sram/andestech,dlm.yaml
```yaml
# Copyright (c) 2026, Andes Technology Corporation.
# SPDX-License-Identifier: Apache-2.0

description: |
  Andes Data Local Memory dedicated address spaces that is independent of
  the memory subsystem. Accesses to DLM bypass the cache and memory
  subsystems to achieve minimal latency.

  DLM supports load/store data accesses. When the DLM address range overlaps
  with system bus (AHB/AXI) address spaces, these accesses are serviced by
  DLM with higher priority than the corresponding system bus accesses.

compatible: "andestech,dlm"

include: base.yaml

properties:
  reg:
    required: true
```

## dts/bindings/sram/andestech,ilm.yaml
```yaml
# Copyright (c) 2026, Andes Technology Corporation.
# SPDX-License-Identifier: Apache-2.0

description: |
  Andes Instruction Local Memory dedicated address spaces that is independent
  of the memory subsystem. Accesses to ILM bypass the cache and memory
  subsystems to achieve minimal latency.

  ILM supports instruction fetches and load/store data accesses. When
  the ILM address range overlaps with system bus (AHB/AXI) address
  spaces, these accesses are serviced by ILM with higher priority than
  the corresponding system bus accesses.

compatible: "andestech,ilm"

include: base.yaml

properties:
  reg:
    required: true
```

## dts/bindings/sram/infineon,psoc4hvms-sram.yaml
```yaml
# SPDX-FileCopyrightText: Copyright (c) 2026 Infineon Technologies AG,
# SPDX-FileCopyrightText: or an affiliate of Infineon Technologies AG. All rights reserved.
#
# SPDX-License-Identifier: Apache-2.0

description: Infineon PSOC4 HVMS on-chip SRAM

compatible: "infineon,psoc4hvms-sram"

include: base.yaml

properties:
  reg:
    required: true

  infineon,sram-ecc:
    type: boolean
    description: |
      Keep the SRAM error correction and detection (ECC) enabled. The whole SRAM is
      written at reset to generate valid ECC, except after a reset that preserves the
      SRAM (e.g. a watchdog reset).

      When not set, the SRAM ECC is turned off and uninitialized SRAM can be read
      without a fault.
```

## dts/bindings/stepper/adi/adi,tmc2241-base.yaml
```yaml
# Copyright (c) 2026
# SPDX-License-Identifier: Apache-2.0

description: |
  Common properties for ADI/Trinamic TMC2241 (bus-agnostic base).
  Driver-only variant of TMC5241 - identical GCONF/CHOPCONF/COOLCONF/DRVSTATUS
  layout, no ramp generator block.

include:
  - name: adi,trinamic-gconf.yaml
    property-allowlist:
      - en-pwm-mode

properties:
  clock-frequency:
    type: int
    required: true
    description: External/internal clock frequency in Hz (fCLK).

  shaft:
    type: boolean
    description: Reverse motor direction (GCONF bit 4).

  fast-standstill:
    type: boolean
    description: GCONF bit 1.

  tcoolthrs:
    type: int
    default: 0
    description: |
      TCOOLTHRS (0x14). The StallGuard stall output on DIAG0 is only enabled
      while TCOOLTHRS >= TSTEP, where TSTEP is the measured time between
      microsteps in fCLK cycles. The reset value 0 keeps the stall output
      disabled, so set this to a value at or above the TSTEP (register 0x12)
      read while the motor runs at the slowest speed where stall detection is
      wanted. 0 leaves the register at its reset value.

  sg4-threshold:
    type: int
    default: 0
    description: |
      StallGuard4 stall threshold (SG4_THRS, 0x74, 8 bits), used when
      StealthChop is enabled (en-pwm-mode). Per the datasheet the chip
      compares SG4_RESULT against twice this value, and a stall is flagged
      while SG4_RESULT is at or below that. Tune it so that 2x this value
      sits between the SG4_RESULT seen while the motor runs unloaded (minimum)
      and while it is blocked (SG4_RESULT can be read at 0x75). StallGuard
      needs a fast enough motor speed to produce a usable signal; the
      datasheet suggests roughly 1 revolution per second or more. Requires
      tcoolthrs to be >= TSTEP at that speed. 0 leaves the register at its
      reset value.

  multistep-filt:
    type: boolean
    description: |
      GCONF bit 3. TMC2241-only field (reserved on TMC5241). Filters
      step pulses for correct StealthChop/StallGuard operation at
      high step rates.

  diag0-gpios:
    type: phandle-array
    description: |
      Optional DIAG0 interrupt pin, used for stall/fault (DRVSTATUS)
      events only - TMC2241 has no RAMPSTAT.
```

## dts/bindings/stepper/adi/adi,tmc2241-spi.yaml
```yaml
# Copyright (c) 2026
# SPDX-License-Identifier: Apache-2.0

description: |
  ADI/Trinamic TMC2241 Stepper Motor Driver, driver-only (no ramp generator), SPI mode

compatible: "adi,tmc2241"

include: [spi-device.yaml, "adi,tmc2241-base.yaml"]

properties:
  reg:
    required: true

examples:
  - |
    &spi0 {
        tmc2241: tmc2241@0 {
            compatible = "adi,tmc2241";
            reg = <0>;
            spi-max-frequency = <DT_FREQ_M(8)>;
            diag0-gpios = <&gpio0 0 GPIO_ACTIVE_HIGH>; /* driver configures DIAG0 push-pull */

            /* Common settings from base binding */
            clock-frequency = <DT_FREQ_M(16)>; /* Internal/External Clock frequency */
            en-pwm-mode, shaft; /* ADI TMC Global configuration flags */

            tmc2241_stepper_driver: stepper-driver {
              compatible = "adi,tmc5241-stepper-driver";
              micro-step-res = <256>;
              /* ADI TMC stallguard settings specific to TMC2241 */
              stallguard2-threshold = <9>;
            };
        };
    };
```
