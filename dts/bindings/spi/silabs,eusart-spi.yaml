## dts/bindings/stepper/adi/adi,tmc2241-uart.yaml
```yaml
# Copyright (c) 2026
# SPDX-License-Identifier: Apache-2.0

description: |
  ADI/Trinamic TMC2241 Stepper Motor Driver, driver-only (no ramp generator),
  single-wire UART mode

compatible: "adi,tmc2241"

include: [uart-device.yaml, "adi,tmc2241-base.yaml"]

properties:
  sw-sel-gpios:
    type: phandle-array
    description: |
      GPIO connected to the SW_SEL pin of TMC2241.
      Must be set HIGH for UART mode operation.
      If not provided, it's assumed SW_SEL is hardwired to VCC/HIGH.

  uart-device-addr:
    type: int
    description: |
      UART device address for TMC2241 in UART mode.
    min: 0
    max: 253

examples:
  - |
    &uart2 {
        current-speed = <115200>;
        status = "okay";

        tmc2241: tmc2241 {
            compatible = "adi,tmc2241";
            sw-sel-gpios = <&gpiob 0x01 GPIO_ACTIVE_HIGH>;

            /* Common settings from base binding */
            clock-frequency = <DT_FREQ_M(12)>;
            en-pwm-mode;
            shaft;

            tmc2241_stepper_driver: stepper-driver {
                compatible = "adi,tmc5241-stepper-driver";
                micro-step-res = <256>;

                /* ADI TMC stallguard settings specific to TMC2241 */
                stallguard2-threshold = <9>;
            };
        };
    };
```

## dts/bindings/stepper/adi/adi,tmc2300.yaml
```yaml
# SPDX-FileCopyrightText: Copyright (c) 2026 Swarovski Optik AG & Co. KG
# SPDX-License-Identifier: Apache-2.0

description: |
  Analog Devices TMC2300 low voltage stepper motor driver, UART controlled.

  The TMC2300 is a STEP/DIR driver which is configured via its single wire
  UART interface (PDN_UART). This binding requires the UART controlled
  stepper mode, i.e. pin STEPPER tied to VIO and pin MODE tied to GND. The
  UART node address is selected by the pins MS1_AD0 (LSB) and MS2_AD1 (MSB).

  Connect PDN_UART to the MCU RX pin and, via a 1k resistor, to the MCU TX
  pin. All transmitted bytes are echoed on RX.

  Motion is generated by a separate STEP/DIR stepper controller, e.g.
  zephyr,gpio-step-dir-stepper-ctrl, referencing this node via its
  stepper-driver property.

  Note: all registers are reset to their power-up defaults when VIO/NSTDBY
  is pulled low. The driver detects this via GSTAT and restores the
  configuration on the next enable.

compatible: "adi,tmc2300"

include:
  - name: uart-device.yaml
  - name: stepper-driver.yaml
    property-allowlist:
      - micro-step-res
      - en-gpios
  - name: step-dir-timing.yaml

properties:
  uart-device-addr:
    type: int
    required: true
    description: |
      UART node address as selected by the pins MS1_AD0 (bit 0) and MS2_AD1
      (bit 1).
    enum:
      - 0
      - 1
      - 2
      - 3

  en-gpios:
    description: |
      GPIO driving the EN pin. Several TMC2300 may share one EN line by
      using the same GPIO: it stays high as long as at least one of them is
      enabled. Each driver is additionally switched via CHOPCONF.enabledrv.

  step-width-ns:
    default: 120
    description: |
      Minimum STEP high and low time (tSH, tSL) is 120 ns.

  dual-edge-step:
    type: boolean
    description: |
      Step on both edges of the STEP signal (CHOPCONF.dedge). The STEP
      filter (GCONF.multistep_filt) is disabled in this mode, as both are
      not compatible.

  extcap:
    type: boolean
    description: |
      An external capacitor is attached between VCP and VS (GCONF.extcap).

  ihold:
    type: int
    default: 8
    description: |
      Standstill current (0=1/32 ... 31=32/32). Reset default is 8.
    min: 0
    max: 31

  irun:
    type: int
    default: 31
    description: |
      Motor run current (8=9/32 ... 31=32/32). Values below 8 are not
      recommended. Full scale RMS current is
      325 mV / (RSENSE + 30 mOhm) / sqrt(2). Reset default is 31.
    min: 0
    max: 31

  iholddelay:
    type: int
    default: 1
    description: |
      Delay per current reduction step from IRUN to IHOLD in multiples of
      2^18 clocks. 0: instant power down. Reset default is 1.
    min: 0
    max: 15

  tpowerdown:
    type: int
    default: 20
    description: |
      Delay from standstill detection to motor current power down in
      multiples of 2^18 clocks (about 0 to 5.6 s). A minimum of 2 is
      required for automatic tuning of StealthChop PWM_OFS_AUTO. Reset
      default is 20.
    min: 0
    max: 255

examples:
  - |
    &usart1 {
        current-speed = <115200>;
        status = "okay";

        tmc2300: tmc2300 {
            compatible = "adi,tmc2300";
            uart-device-addr = <0>;
            micro-step-res = <32>;
            en-gpios = <&gpioe 15 GPIO_ACTIVE_HIGH>;
            irun = <16>;
            ihold = <8>;
        };
    };

    / {
        stepper_ctrl: stepper-ctrl {
            compatible = "zephyr,gpio-step-dir-stepper-ctrl";
            step-gpios = <&gpiof 8 GPIO_ACTIVE_HIGH>;
            dir-gpios = <&gpioi 1 GPIO_ACTIVE_HIGH>;
            stepper-driver = <&tmc2300>;
        };
    };
```

## dts/bindings/stepper/adi/adi,tmc522x-i2c.yaml
```yaml
# SPDX-FileCopyrightText: Copyright (c) 2026 Cherrence Sarip <Cherrence.sarip@analog.com>
# SPDX-License-Identifier: Apache-2.0

description: Trinamic TMC522x stepper motor controller (I2C variant - TMC5222)

compatible: "adi,tmc522x"

include: [i2c-device.yaml, "adi,tmc522x-base.yaml"]

examples:
  - |
    &i2c0 {
        tmc5222: tmc5222@60 {
            compatible = "adi,tmc522x";
            reg = <0x60>;

            clock-frequency = <DT_FREQ_M(16)>; /* Internal oscillator */

            tmc5222_stepper_driver: stepper-driver {
                compatible = "adi,tmc522x-stepper-driver";
                idx = <0>;
                stallguard2-threshold = <5>;
                irun = <31>;
                ihold = <16>;
            };

            tmc5222_motion_controller: motion-controller {
                compatible = "adi,tmc522x-stepper-ctrl";
                idx = <0>;

                /* Ramp generator settings */
                vstart = <10>;
                a1 = <20>;
                v1 = <30>;
                amax = <60>;
                vmax = <50>;
                dmax = <70>;
                d1 = <40>;
                vstop = <10>;

                /* Second phase (six-point ramp) */
                a2 = <60>;
                v2 = <40>;
                d2 = <70>;
            };
        };
    };
```

## dts/bindings/stepper/adi/adi,tmc522x-stepper-ctrl.yaml
```yaml
# SPDX-FileCopyrightText: Copyright (c) 2026 Cherrence Sarip <Cherrence.sarip@analog.com>
# SPDX-License-Identifier: Apache-2.0

compatible: "adi,tmc522x-stepper-ctrl"

include:
  - name: adi,trinamic-ramp-generator.yaml
    property-allowlist:
      - vstart
      - a1
      - v1
      - amax
      - vmax
      - dmax
      - d1
      - vstop
      - a2
      - v2
      - d2

properties:
  idx:
    type: int
    required: true
    description: |
      Motor index (0-based). For TMC522x with single motor, use 0.
```

## dts/bindings/stepper/adi/adi,tmc5241-base.yaml
```yaml
# Copyright (c) 2026
# SPDX-License-Identifier: Apache-2.0

description: |
  Common properties for ADI/Trinamic TMC5241 (bus-agnostic base).
  GCONF layout differs from tmc51xx/tmc50xx, so only en-pwm-mode is reused
  from adi,trinamic-gconf.yaml via property-allowlist; shaft/fast-standstill
  are declared here directly instead.

include:
  - name: adi,trinamic-gconf.yaml
    property-allowlist:
      - en-pwm-mode

properties:
  clock-frequency:
    type: int
    required: true
    description: |
      External/internal clock frequency in Hz (fCLK). Used by
      tmc5xxx_calculate_velocity_from_hz_to_fclk() for Hz<->fclk ramp math.

  shaft:
    type: boolean
    description: Reverse motor direction (GCONF bit 4).

  fast-standstill:
    type: boolean
    description: GCONF bit 1. Timeout for standstill detection is reduced from 2^20 to 2^18 clocks.

  diag0-gpios:
    type: phandle-array
    description: |
      Optional DIAG0 interrupt pin. When wired, RAMPSTAT/DRVSTATUS events are
      interrupt-driven instead of polled at the Kconfig-configured interval
      (see Kconfig.tmc_rampgen_template).
```

## dts/bindings/stepper/adi/adi,tmc5241-spi.yaml
```yaml
# Copyright (c) 2026
# SPDX-License-Identifier: Apache-2.0

description: |
  ADI/Trinamic TMC5241 Stepper Motor Controller (SPI mode)

compatible: "adi,tmc5241"

include: [spi-device.yaml, "adi,tmc5241-base.yaml"]

properties:
  reg:
    required: true

examples:
  - |
    &spi0 {
        tmc5241: tmc5241@0 {
            compatible = "adi,tmc5241";
            reg = <0>;
            spi-max-frequency = <DT_FREQ_M(8)>;
            diag0-gpios = <&gpio0 0 GPIO_ACTIVE_HIGH>; /* driver configures DIAG0 push-pull */

            /* Common settings from base binding */
            clock-frequency = <DT_FREQ_M(16)>; /* Internal/External Clock frequency */
            en-pwm-mode, shaft; /* ADI TMC Global configuration flags */

            tmc5241_stepper_driver: stepper-driver {
              compatible = "adi,tmc5241-stepper-driver";
              micro-step-res = <256>;
              /* ADI TMC stallguard settings specific to TMC5241 */
              stallguard2-threshold = <9>;
            };

            tmc5241_stepper_ctrl: stepper-ctrl {
              compatible = "adi,tmc5241-stepper-ctrl";

              /* ADI TMC ramp generator as well as current settings */
              vstart = <10>;
              a1 = <20>;
              v1 = <30>;
              d1 = <40>;
              vmax = <50>;
              amax = <60>;
              dmax = <70>;
              tzerowait = <80>;
              thigh = <90>;
              tcoolthrs = <100>;
              tpwmthrs = <110>;
              tpowerdown = <120>;
              ihold = <1>;
              irun = <2>;
              iholddelay = <3>;
            };
        };
    };
```

## dts/bindings/stepper/adi/adi,tmc5241-stepper-ctrl.yaml
```yaml
# Copyright (c) 2026
# SPDX-License-Identifier: Apache-2.0

description: |
  ADI/Trinamic TMC5241 "stepper-ctrl" child node - implements Zephyr's
  stepper_ctrl.h motion controller API. TMC5241 only: never instantiated
  under an adi,tmc2241 parent (no ramp generator hardware to back it).

compatible: "adi,tmc5241-stepper-ctrl"

include:
  - name: adi,trinamic-ramp-generator.yaml
    property-allowlist:
      - vstart
      - a1
      - v1
      - amax
      - vmax
      - dmax
      - d1
      - vstop
      - tzerowait
      - thigh
      - tcoolthrs
      - tpwmthrs
      - tpowerdown
      - ihold
      - irun
      - iholddelay
```

## dts/bindings/stepper/adi/adi,tmc5241-stepper-driver.yaml
```yaml
# Copyright (c) 2026
# SPDX-License-Identifier: Apache-2.0

description: |
  ADI/Trinamic TMC5241/TMC2241 "stepper-driver" child node - implements
  Zephyr's stepper.h hardware driver API. Identical for both parent chips
  (CHOPCONF/COOLCONF/DRVSTATUS layout matches), so this binding and its
  driver source (tmc5241_stepper_driver.c) are shared.

compatible: "adi,tmc5241-stepper-driver"

include:
  - name: stepper-driver.yaml
  - name: adi,trinamic-stallguard.yaml
    property-allowlist:
      - stallguard2-threshold

properties:
  toff:
    type: int
    default: 5
    description: |
      CHOPCONF.TOFF [3:0], off time / driver enable setting (0 = disabled).
      Must be a DT property, not hardcoded - stepper_enable() restores this
      value, stepper_disable() writes 0.
```

## dts/bindings/stepper/adi/adi,tmc5241-uart.yaml
```yaml
# Copyright (c) 2026
# SPDX-License-Identifier: Apache-2.0

description: |
  ADI/Trinamic TMC5241 Stepper Motor Controller (UART single-wire mode)

  This binding supports the single-wire UART mode where:
  - SWIOP is connected to the MCU's UART TX/RX pin
  - SWION should be connected to half the IO level voltage (1.65V for 3.3V systems)
  - SW_SEL must be HIGH (either via GPIO control or hardwired)

compatible: "adi,tmc5241"

include: [uart-device.yaml, "adi,tmc5241-base.yaml"]

properties:
  sw-sel-gpios:
    type: phandle-array
    description: |
      GPIO connected to the SW_SEL pin of TMC5241.
      Must be set HIGH for UART mode operation.
      If not provided, it's assumed SW_SEL is hardwired to VCC/HIGH.

  uart-device-addr:
    type: int
    description: |
      UART device address for TMC5241 in UART mode.
    min: 0
    max: 253

examples:
  - |
    &uart2 {
        current-speed = <115200>;
        status = "okay";

        tmc5241: tmc5241 {
            compatible = "adi,tmc5241";
            sw-sel-gpios = <&gpiob 0x01 GPIO_ACTIVE_HIGH>;

            /* Common settings from base binding */
            clock-frequency = <DT_FREQ_M(12)>;
            en-pwm-mode;
            shaft;

            tmc5241_stepper_driver: stepper-driver {
                compatible = "adi,tmc5241-stepper-driver";
                micro-step-res = <256>;

                /* ADI TMC stallguard settings specific to TMC5241 */
                stallguard2-threshold = <9>;
            };

            tmc5241_stepper_ctrl: stepper-ctrl {
              compatible = "adi,tmc5241-stepper-ctrl";

              /* ADI TMC ramp generator as well as current settings */
              vstart = <10>;
              a1 = <20>;
              v1 = <30>;
              d1 = <40>;
              vmax = <50>;
              amax = <60>;
              dmax = <70>;
              tzerowait = <80>;
              thigh = <90>;
              tcoolthrs = <100>;
              tpwmthrs = <110>;
              tpowerdown = <120>;
              ihold = <1>;
              irun = <2>;
              iholddelay = <3>;
            };
        };
    };
```

## dts/bindings/syscon/aesc,syscon.yaml
```yaml
#
# SPDX-FileCopyrightText: 2026 Aesc Silicon
#
# SPDX-License-Identifier: Apache-2.0
#

title: Aesc Silicon System Controller

description: |
  Read-only system controller exposing the platform identity, the silicon
  revision, the build date, the reference clock frequency and a feature
  bitmap. The register layout is identical on every Aesc Silicon platform;
  the platform itself is encoded in the identity register.

compatible: "aesc,syscon"

include: [syscon.yaml]
```

## dts/bindings/syscon/nuvoton,npcm-scfg.yaml
```yaml
# Copyright (c) 2024 Nuvoton Technology Corporation.
# SPDX-License-Identifier: Apache-2.0

description: |
  Nuvoton NPCM System Configuration (SCFG) register block.

  Holds pin multiplexing (DEVALTx), pull-up/down enables, low-voltage selects, reset control,
  and strap status. Several drivers share it, each through its own phandle.

compatible: "nuvoton,npcm-scfg"

include: syscon.yaml
```

## dts/bindings/syscon/ti,am13e-sysctl.yaml
```yaml
# SPDX-FileCopyrightText: Copyright (c) 2026 Texas Instruments
# SPDX-License-Identifier: Apache-2.0

description: TI AM13E System Control (SYSCTL) register module

compatible: "ti,am13e-sysctl"

include: syscon.yaml

properties:
  "#pwren-cells":
    type: int
    const: 2
    description: Number of items in a PWREN specifier (<offset bit>).

pwren-cells:
  - offset
  - bit
```
