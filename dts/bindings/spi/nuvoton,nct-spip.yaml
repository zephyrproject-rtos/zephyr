## dts/bindings/spi/nxp,s32-spi.yaml
```yaml
# Copyright 2022 NXP
# SPDX-License-Identifier: Apache-2.0

description: NXP S32 SPI controller

compatible: "nxp,s32-spi"

include: [spi-controller.yaml, pinctrl-device.yaml]

properties:
  reg:
    required: true

  interrupts:
    required: true

  num-cs:
    type: int
    required: true
    description: |
      The number of the Chip Select signals.

  clock-frequency:
    type: int
    required: true
    description: |
      Module clock frequency in Hz.

  pinctrl-0:
    required: true

  pinctrl-names:
    required: true

  slave:
    type: boolean
    description: |
      Select if the SPI module is intended to be used in slave mode.

  spi-sck-cs-delay:
    type: int
    description: |
      A delay in nanoseconds between the stop of clock signal and
      deactivating Chip Select at the stop of transfer. If CS remains
      asserted between transfer, this delay will be inserted between transfer.
      If not set, the minimum supported delay is used.
      This value will affect to all inner CS signals of SPI module when active.
      This value will not be applied for CS lines controlled by GPIO.

  spi-cs-sck-delay:
    type: int
    description: |
      A delay in nanoseconds between activating Chip Select and the start
      of clock signal at the start of transfer. If CS remains asserted
      between transfer, this delay will be inserted between transfer.
      If not set, the minimum supported delay is used.
      This value will affect to all inner CS signals of SPI module when active.
      This value will not be applied for CS lines controlled by GPIO.

  spi-cs-cs-delay:
    type: int
    description: |
      A delay in nanoseconds between deactivating Chip Select at the stop
      of previous transfer and activating Chip Select at the start of
      next transfer. If CS remains asserted between transfer, this delay
      will not be inserted.
      If not set, the minimum supported delay is used.
      This value will affect to all inner CS signals of SPI module when active.
      This value will not be applied for CS lines controlled by GPIO.
```

## dts/bindings/spi/nxp,sc18is606.yaml
```yaml
description: |
  SC18IS60S6 I2C to SPI Bridge with Selectable GPIOs

compatible: "nxp,sc18is606"
include: [spi-controller.yaml, i2c-device.yaml]
properties:
  reg:
    required: true
```

## dts/bindings/spi/nxp,xspi.yaml
```yaml
# Copyright 2024 NXP
# SPDX-License-Identifier: Apache-2.0

description: NXP XSPI controller

compatible: "nxp,xspi"

include: [spi-controller.yaml, pinctrl-device.yaml]

properties:
  reg:
    required: true

  interrupts:
    required: true

child-binding:
  description: NXP XSPI port

  include: nxp,xspi-device.yaml
```

## dts/bindings/spi/opencores,spi-simple.yaml
```yaml
# Copyright (c) 2019 Western Digital Corporation or its affiliates
# SPDX-License-Identifier: Apache-2.0

description: OpenCores Simple SPI controller

compatible: "opencores,spi-simple"

include: spi-controller.yaml

properties:
    reg:
      required: true
```

## dts/bindings/spi/openisa,rv32m1-lpspi.yaml
```yaml
# Copyright (c) 2019, Karsten Koenig <karsten.koenig.030@gmail.com>
# SPDX-License-Identifier: Apache-2.0

description: OpenISA LPSPI controller

compatible: "openisa,rv32m1-lpspi"

include: spi-controller.yaml

properties:
    reg:
      required: true

    interrupts:
      required: true
```

## dts/bindings/spi/quicklogic,eos-s3-spi.yaml
```yaml
# Copyright (c) 2020 Antmicro <www.antmicro.com>
# SPDX-License-Identifier: Apache-2.0

description: QuickLogic SPI controller

compatible: "quicklogic,eos-s3-spi"

include: [spi-controller.yaml, pinctrl-device.yaml]

properties:
    reg:
      required: true

    interrupts:
      required: true
```

## dts/bindings/spi/raspberrypi,pico-spi.yaml
```yaml
description: Raspberry Pi Pico SPI

compatible: "raspberrypi,pico-spi"

include: "arm,pl022.yaml"
```

## dts/bindings/spi/realtek,ameba-spi.yaml
```yaml
# Copyright (c) 2026 Realtek Semiconductor Corp.
# SPDX-License-Identifier: Apache-2.0

description: Ameba SPI

compatible: "realtek,ameba-spi"

include: [spi-controller.yaml, pinctrl-device.yaml]

properties:
  reg:
    required: true

  clocks:
    required: true

  interrupts:
    required: true

  pinctrl-0:
    required: true

  pinctrl-names:
    required: true

  rtk,spi-default-cs:
    type: int
    description: |
      set default cs state
```

## dts/bindings/spi/realtek,rts5817-spi.yaml
```yaml
# Copyright (c) 2026 Realtek Semiconductor, Inc.
# SPDX-License-Identifier: Apache-2.0

description: |
  Realtek RTS5817 SPI wrapper node.

  The RTS5817 SPI block is built on top of a Synopsys DesignWare SSI core
  with an additional master control block that drives DMA-based transfers.
  This node represents the master control block; the underlying DW SSI
  core is described by a separate snps,designware-spi node referenced via
  the "dw-spi-dev" phandle.

compatible: "realtek,rts5817-spi"

include: [spi-controller.yaml, pinctrl-device.yaml]

properties:
  reg:
    required: true
    description: |
      Master control register block.

  dw-spi-dev:
    type: phandle
    required: true
    description: |
      Phandle to the underlying snps,designware-spi node that provides the
      DW SSI register block, clock and MMIO mapping for the inner core.

  interrupts:
    required: true
```

## dts/bindings/spi/realtek,rts5912-spi.yaml
```yaml
# Copyright (c) 2025, Realtek, SIBG-SD7
# SPDX-License-Identifier: Apache-2.0

description: REALTEK rts5912 spi controller

compatible: "realtek,rts5912-spi"

include: [spi-controller.yaml, pinctrl-device.yaml]

properties:
  reg:
    required: true

  pinctrl-names:
    required: true

  pinctrl-0:
    type: phandles
    required: true
```

## dts/bindings/spi/realtek,rts5912-spim.yaml
```yaml
# Copyright (c) 2025, Realtek, SIBG-SD7
# SPDX-License-Identifier: Apache-2.0

description: REALTEK rts5912 spi master

compatible: "realtek,rts5912-spim"

include: [spi-controller.yaml, pinctrl-device.yaml]

properties:
  reg:
    required: true

  pinctrl-names:
    required: true

  pinctrl-0:
    type: phandles
    required: true
```
