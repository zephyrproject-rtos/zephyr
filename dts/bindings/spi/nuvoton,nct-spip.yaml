## dts/bindings/spi/nuvoton,nct-spip.yaml
```yaml
# Copyright (c) 2025 Nuvoton Technology Corporation.
# SPDX-License-Identifier: Apache-2.0

description: Nuvoton, NCT SPI controller.

compatible: "nuvoton,nct-spip"

include: [spi-controller.yaml, pinctrl-device.yaml]

properties:
  reg:
    required: true
```

## dts/bindings/spi/nuvoton,npcm-spip.yaml
```yaml
# Copyright (c) 2024 Nuvoton Technology Corporation.
# SPDX-License-Identifier: Apache-2.0

description: Nuvoton, NPCM SPI controller.

compatible: "nuvoton,npcm-spip"

include: [spi-controller.yaml, pinctrl-device.yaml]

properties:
  reg:
    required: true
```

## dts/bindings/spi/nuvoton,npcx-spi-fiu.yaml
```yaml
# Copyright (c) 2021 Nuvoton Technology Corporation.
# SPDX-License-Identifier: Apache-2.0

description: Nuvoton, NPCX-SPI-FIU controller node

compatible: "nuvoton,npcx-spi-fiu"

include: [spi-controller.yaml]

properties:
  reg:
    required: true
  clocks:
    required: true
```

## dts/bindings/spi/nuvoton,npcx-spip.yaml
```yaml
# Copyright (c) 2024 Nuvoton Technology Corporation.
# SPDX-License-Identifier: Apache-2.0

description: Nuvoton, NPCX SPI controller.

compatible: "nuvoton,npcx-spip"

include: [spi-controller.yaml, pinctrl-device.yaml]

properties:
  reg:
    required: true
```

## dts/bindings/spi/nuvoton,numaker-spi.yaml
```yaml
# Copyright (c) 2023 Nuvoton Technology Corporation.
# SPDX-License-Identifier: Apache-2.0

description: Nuvoton, NuMaker SPI controller

compatible: "nuvoton,numaker-spi"

include: [spi-controller.yaml, reset-device.yaml, pinctrl-device.yaml]

properties:
  reg:
    required: true

  interrupts:
    required: true

  resets:
    required: true

  clocks:
    required: true
```

## dts/bindings/spi/nuvoton,numaker-usci-spi.yaml
```yaml
# Copyright (c) 2026 Nuvoton Technology Corporation.
# SPDX-License-Identifier: Apache-2.0

description: Nuvoton, NuMaker USCI SPI controller

compatible: "nuvoton,numaker-usci-spi"

include: [spi-controller.yaml, reset-device.yaml, pinctrl-device.yaml]

properties:
  reg:
    required: true

  interrupts:
    required: true

  resets:
    required: true

  clocks:
    required: true
```

## dts/bindings/spi/nxp,dspi.yaml
```yaml
# Copyright (c) 2018, NXP
# SPDX-License-Identifier: Apache-2.0

description: NXP DSPI controller

compatible: "nxp,dspi"

include: ["spi-controller.yaml", "pinctrl-device.yaml"]

properties:
  reg:
    required: true

  interrupts:
    required: true

  clocks:
    required: true

  pcs-sck-delay:
    type: int
    description: |
      Delay in nanoseconds from the chip select assert to the first clock
      edge. If not set, the minimum supported delay is used.

  sck-pcs-delay:
    type: int
    description: |
      Delay in nanoseconds from the last clock edge to the chip select
      deassert. If not set, the minimum supported delay is used.

  transfer-delay:
    type: int
    description: |
      Delay in nanoseconds from the chip select deassert to the next chip
      select assert. If not set, the minimum supported delay is used.

  pinctrl-0:
    required: true

  nxp,rx-tx-chn-share:
    type: boolean
    description: If the edma channel shared with tx and rx

  ctar:
    type: int
    description: |
      ctar register selection range form 0-1 for master mode, 0 for slave mode

  sample-point:
    type: int
    description: |
      Controls when the DSPI master samples SIN in the Modified Transfer Format.
      This field is valid only when the CPHA bit in the CTAR register is 0.

  continuous-sck:
    type: boolean
    description: |
      continuous SCK enable. Note that the continuous SCK is only
      supported for CPHA = 1.

  rx-fifo-overwrite:
    type: boolean
    description: |
      receive FIFO overflow overwrite enable. If ROOE = 0, the incoming
      data is ignored and the data from the transfer that generated the overflow
      is also ignored. If ROOE = 1, the incoming data is shifted to the
      shift register.

  modified-timing-format:
    type: boolean
    description: |
      Enables a modified transfer format to be used if true.

  tx-fifo-size:
    type: int
    description: |
      tx fifo size

  rx-fifo-size:
    type: int
    description: |
      rx fifo size
```

## dts/bindings/spi/nxp,flexio-spi.yaml
```yaml
# Copyright (c) 2024, STRIM, ALC
# SPDX-License-Identifier: Apache-2.0

description: NXP FlexIO SPI controller

compatible: "nxp,flexio-spi"

include: [spi-controller.yaml, "pinctrl-device.yaml"]

properties:
  sdo-pin:
    type: int
    required: true
    description: |
      Pin select for data output.

  sdi-pin:
    type: int
    required: true
    description: |
      Pin select for data input.

  sck-pin:
    type: int
    required: true
    description: |
      Pin select for clock.
```

## dts/bindings/spi/nxp,imx-ecspi.yaml
```yaml
# Copyright (c) 2024 Basalte bv
# SPDX-License-Identifier: Apache-2.0

description: NXP i.MX ECSPI controller

compatible: "nxp,imx-ecspi"

include: ["spi-controller.yaml", "pinctrl-device.yaml"]

properties:
  reg:
    required: true

  interrupts:
    required: true

  clocks:
    required: true
```

## dts/bindings/spi/nxp,imx-flexspi.yaml
```yaml
# Copyright 2018-2023, 2025 NXP
# SPDX-License-Identifier: Apache-2.0

description: NXP FlexSPI controller

compatible: "nxp,imx-flexspi"

include: [spi-controller.yaml, pinctrl-device.yaml]

properties:
  reg:
    required: true
    description: |
      FlexSPI controller register space and AHB memory windows.
      reg[0]: FlexSPI controller registers
      reg[1]: AHB flash memory windows for XIP

  port-count:
    type: int
    default: 4
    description: Number of FlexSPI ports supported by this controller

  ahb-port-bases:
    type: array
    description: |
      AHB base addresses for each FlexSPI port (0-3).
      Specify the AHB window base address for each port directly.
      Use 0 for unused ports.
      Example: <0x18000000 0 0x38000000 0> means:
        - Port 0: 0x18000000
        - Port 1: unused (0)
        - Port 2: 0x38000000
        - Port 3: unused (0)
      If omitted, falls back to legacy single window behavior.

  interrupts:
    required: true

  ahb-bufferable:
    type: boolean
    description: |
      Enable AHB bufferable write access by setting register field
      AHBCR[BUFFERABLEEN].

  ahb-cacheable:
    type: boolean
    description: |
      Enable AHB cacheable read access by setting register field
      AHBCR[CACHEABLEEN].

  ahb-prefetch:
    type: boolean
    description: |
      Enable AHB read prefetch by setting register field AHBCR[PREFETCHEN].

  ahb-read-addr-opt:
    type: boolean
    description: |
      Remove burst start address alignment limitation by setting register
      field AHBCR[READADDROPT].

  combination-mode:
    type: boolean
    description: |
      Combine port A and port B data pins to support octal mode access by
      setting register field MCR0[COMBINATIONEN].

  sck-differential-clock:
    type: boolean
    description: |
      Enable/disable SCKB pad use as SCKA differential clock output,
      when enabled, Port B flash access is not available.

  rx-clock-source:
    type: int
    default: 0
    enum:
      - 0 # Loopback internally
      - 1 # Loopback from DQS pad
      - 2 # Loopback from SCK pad
      - 3 # External input from DQS pad
    description: |
      Source clock for flash read. See the RXCLKSRC field in register MCR0.
      The default corresponds to the reset value of the register field.

  rx-clock-source-b:
    type: int
    default: 0
    enum:
      - 0 # Loopback internally
      - 1 # Loopback from DQS pad
      - 2 # Loopback from SCK pad
      - 3 # External input from DQS pad
    description: |
      Source clock for flash read on port B. Only supported by some instances
      of this IP. See the RXCLKSRC_B field in register MCR2.
      The default corresponds to the reset value of the register field.

  rx-buffer-config:
    type: array
    description: |
      Array of tuples to configure AHB RX buffers. Format is the following:
      <prefetch priority master_id buf_size>. Pass multiple tuples to configure
      multiple RX buffers (up to maximum supported by SOC).
      The tuple fields correspond to the following register bitfields:
      prefetch: AHBRXBUFxCRx[PREFETCH]
      priority: AHBRXBUFxCRx[PRIORITY]
      master_id: AHBRXBUFxCRx[MSTRID]
      buf_size: AHBRXBUFxCRx[BUFSZ]

  ahb-boundary:
    type: string
    default: "no-boundary"
    enum:
      - "no-boundary"
      - "1024"
      - "512"
      - "256"
    description: |
      Sets the AHB read/write boundary. Only supported by some versions of
      the FLEXSPI IP. When set, all memory accesses that cross an address
      boundary of the specified size will be divided into smaller sub accesses.

child-binding:
  description: NXP FlexSPI port

  include: nxp,imx-flexspi-device.yaml
```

## dts/bindings/spi/nxp,imx-lpspi.yaml
```yaml
# Copyright (c) 2018,2023 NXP
# SPDX-License-Identifier: Apache-2.0

description: NXP i.MX LPSPI controller

compatible: "nxp,imx-lpspi"

include: ["spi-controller.yaml", "pinctrl-device.yaml"]

properties:
  reg:
    required: true

  interrupts:
    required: true

  clocks:
    required: true

  pcs-sck-delay:
    type: int
    description: |
      Delay in nanoseconds from the chip select assert to the first clock
      edge. If not set, the minimum supported delay is used.

  sck-pcs-delay:
    type: int
    description: |
      Delay in nanoseconds from the last clock edge to the chip select
      deassert. If not set, the minimum supported delay is used.

  transfer-delay:
    type: int
    description: |
      Delay in nanoseconds from the chip select deassert to the next chip
      select assert. If not set, the minimum supported delay is used.

  data-pin-config:
    type: string
    enum:
      - "sdi-in,sdo-out"
      - "sdi-in,sdi-out"
      - "sdo-in,sdo-out"
      - "sdo-in,sdi-out"
    default: "sdi-in,sdo-out"
    description: |
      Configures which pins (SDO and SDI) are used for input and output data
      during single bit transfers.
```

## dts/bindings/spi/nxp,kinetis-dspi.yaml
```yaml
# Copyright (c) 2018, NXP
# SPDX-License-Identifier: Apache-2.0

description: NXP Kinetis DSPI controller

compatible: "nxp,kinetis-dspi"

include: spi-controller.yaml

properties:
    reg:
      required: true

    interrupts:
      required: true

    clocks:
      required: true

    pcs-sck-delay:
      type: int
      required: false
      description: |
        Delay in nanoseconds from the chip select assert to the first clock
        edge. If not set, the minimum supported delay is used.

    sck-pcs-delay:
      type: int
      required: false
      description: |
        Delay in nanoseconds from the last clock edge to the chip select
        deassert. If not set, the minimum supported delay is used.

    transfer-delay:
      type: int
      required: false
      description: |
        Delay in nanoseconds from the chip select deassert to the next chip
        select assert. If not set, the minimum supported delay is used.

    pinctrl-0:
      type: phandles
      required: true

    nxp,rx-tx-chn-share:
      type: boolean
      required: false
      description: If the edma channel shared with tx and rx

    ctar:
      type: int
      required: false
      description: |
        ctar register selection range form 0-1 for master mode, 0 for slave mode

    sample-point:
      type: int
      required: false
      description: |
        Controls when the DSPI master samples SIN in the Modified Transfer Format.
        This field is valid only when the CPHA bit in the CTAR register is 0.

    continuous-sck:
      type: boolean
      required: false
      description: |
        continuous SCK enable. Note that the continuous SCK is only
        supported for CPHA = 1.

    rx-fifo-overwrite:
      type: boolean
      required: false
      description: |
        receive FIFO overflow overwrite enable. If ROOE = 0, the incoming
        data is ignored and the data from the transfer that generated the overflow
        is also ignored. If ROOE = 1, the incoming data is shifted to the
        shift register.

    modified-timing-format:
      type: boolean
      required: false
      description: |
        Enables a modified transfer format to be used if true.

    tx-fifo-size:
      type: int
      required: false
      description: |
        tx fifo size

    rx-fifo-size:
      type: int
      required: false
      description: |
        rx fifo size
```

## dts/bindings/spi/nxp,lpc-spi.yaml
```yaml
# Copyright (c) 2019, NXP
# SPDX-License-Identifier: Apache-2.0

description: NXP LPC SPI controller

compatible: "nxp,lpc-spi"

include: [spi-controller.yaml, "nxp,lpc-flexcomm.yaml"]

properties:
    pre-delay:
      type: int
      required: false
      description: |
        Delay in nanoseconds inserted between chip select assert to the first
        clock edge. If not set, no additional delay is inserted.

    post-delay:
      type: int
      required: false
      description: |
        Delay in nanoseconds inserted between the last clock edge to the chip
        select deassert. If not set, no additional delay is inserted.

    frame-delay:
      type: int
      required: false
      description: |
        Delay in nanoseconds inserted between data frames when chip select is
        asserted and the EOF flag is set. If not set, no additional delay is
        inserted.

    transfer-delay:
      type: int
      required: false
      description: |
        Delay in nanoseconds inserted between transfers when chip select is
        deasserted. If not set, no additional delay is inserted.
```

## dts/bindings/spi/nxp,lpspi.yaml
```yaml
# Copyright (c) 2018,2023 NXP
# SPDX-License-Identifier: Apache-2.0

description: NXP LPSPI controller

compatible: "nxp,lpspi"

include: ["spi-controller.yaml", "pinctrl-device.yaml"]

properties:
  reg:
    required: true

  clocks:
    required: true

  pcs-sck-delay:
    type: int
    description: |
      Delay in nanoseconds from the chip select assert to the first clock
      edge.
      If not set, the minimum supported delay is used.

  sck-pcs-delay:
    type: int
    description: |
      Delay in nanoseconds from the last clock edge to the chip select
      deassert.
      If not set, the minimum supported delay is used.

  transfer-delay:
    type: int
    description: |
      Delay in nanoseconds between last SCK edge of a transfer word and the
      first SCK edge of the next transfer word.
      If not set, the minimum supported delay is used.

  data-pin-config:
    type: string
    enum:
      - "sdi-in,sdo-out"
      - "sdi-in,sdi-out"
      - "sdo-in,sdo-out"
      - "sdo-in,sdi-out"
    default: "sdi-in,sdo-out"
    description: |
      Configures which pins (SDO and SDI) are used for input and output data
      during single bit transfers.

  tristate-output:
    type: boolean
    description:
      Configures whether or not the output data is tristated between accesses
      (when PCS is negated). If set, the output will be tristated when PCS is negated,
      otherwise the output line retains the last value when PCS is negated.

  rx-fifo-size:
    type: int
    required: true
    description: |
      Max number of words in the RX fifo on this instance of the LPSPI.

  tx-fifo-size:
    type: int
    required: true
    description: |
      Max number of words in the TX/Command fifo on this instance of the LPSPI.
```
