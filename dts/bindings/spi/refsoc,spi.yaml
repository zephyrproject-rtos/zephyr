## dts/bindings/spi/st,stm32-spi-common.yaml
```yaml
# Copyright (c) 2018, I-SENSE group of ICCS
# SPDX-License-Identifier: Apache-2.0

# Common fields for STM32 SPI peripherals.

include: [spi-controller.yaml, pinctrl-device.yaml]

properties:
  reg:
    required: true

  interrupts:
    required: true

  pinctrl-0:
    required: true

  pinctrl-names:
    required: true

  ioswp:
    type: boolean
    description: Swap SPI MOSI and MISO pins

  st,spi-data-width:
    type: string
    required: true
    enum:
      - "full-4-to-32-bit"
      - "full-4-to-16-bit"
      - "limited-8-16-bit"
    description: |
      Indicates the data width supported by the SPI instance.
      - full-4-to-32-bit: supports data width from 4 to 32 bits
      - full-4-to-16-bit: supports data width from 4 to 16 bits
      - limited-8-16-bit: supports only 8 and 16-bit data widths

  st,soft-nss:
    type: boolean
    description: |
      Force operation in "Soft NSS" mode without CS/NSS pin.

      This is useful in situations where the SPI interface
      is connected to a single controller or peripheral and
      does not require CS/NSS for proper operation.

      This property is overridden by the `cs-gpios` property:
      if provided, SPI instance also operates in "Soft NSS"
      mode, but GPIO CS pins are used during transactions.

      If neither this property nor `cs-gpios` are provided,
      the SPI instance operates in "Hard NSS" mode.
```

## dts/bindings/spi/st,stm32-spi-fifo.yaml
```yaml
# Copyright (c) 2018, I-SENSE group of ICCS
# SPDX-License-Identifier: Apache-2.0

description: STM32 SPI controller with embedded Rx and Tx FIFOs

compatible: "st,stm32-spi-fifo"

include: st,stm32-spi-common.yaml
```

## dts/bindings/spi/st,stm32-spi-host-cmd.yaml
```yaml
# Copyright (c) 2023 Google LLC
# SPDX-License-Identifier: Apache-2.0

description: |
        Host Command version of STM32 SPI controller.
        All properties are the same, but a different driver is used.

compatible: "st,stm32-spi-host-cmd"

include: st,stm32-spi.yaml
```
