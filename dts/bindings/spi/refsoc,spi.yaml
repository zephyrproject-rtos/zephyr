## dts/bindings/spi/refsoc,spi.yaml
```yaml
#
# Copyright (c) 2018, Linaro Limited
#
# SPDX-License-Identifier: Apache-2.0
#
---
title: REFSOC SPI
version: 0.1

description: >
    This binding gives a base representation of the REFSOC SPI controller

inherits:
    !include spi.yaml

properties:
    compatible:
      constraint: "refsoc,spi"

    reg:
      type: array
      description: mmio register space
      generation: define
      category: required

    interrupts:
      type: array
      category: required
      description: required interrupts
      generation: define

    interrupt-names:
      type: stringlist
      category: optional
      description: readable string describing the interrupts
      generation: define

...
```

## dts/bindings/spi/renesas,ra-spi-sci.yaml
```yaml
# Copyright (c) 2025 Renesas Electronics Corporation
# SPDX-License-Identifier: Apache-2.0

description: Renesas RA SCI SPI controller

compatible: "renesas,ra-spi-sci"

include: [spi-controller.yaml, pinctrl-device.yaml]

properties:
  channel:
    type: int
    required: true
```

## dts/bindings/spi/renesas,ra-spi.yaml
```yaml
# Copyright (c) 2024 Renesas Electronics Corporation
# SPDX-License-Identifier: Apache-2.0

description: Renesas RA SPI controller

compatible: "renesas,ra-spi"

include: [spi-controller.yaml, pinctrl-device.yaml]

properties:
  channel:
    type: int
    required: true

  reg:
    required: true

  tx-dtc:
    type: boolean

  rx-dtc:
    type: boolean

  pinctrl-0:
    required: true

  pinctrl-names:
    required: true

  interrupts:
    required: true

  interrupt-names:
    required: true
```

## dts/bindings/spi/renesas,rx-rspi.yaml
```yaml
# Copyright (c) 2025 Renesas Electronics Corporation
# SPDX-License-Identifier: Apache-2.0

description: Renesas RX RSPI

compatible: "renesas,rx-rspi"

include: [spi-controller.yaml, pinctrl-device.yaml]

properties:
  reg:
    required: true

  channel:
    type: int
    required: true
    description: |
      The index of SPI channel

  ssl-assert:
    type: int
    default: 0
    enum:
      - 0
      - 1
      - 2
      - 3
    description: |
      Slave select to be asserted during transfer operation

  interrupts:
    required: true

  pinctrl-0:
    required: true

  pinctrl-names:
    required: true
```

## dts/bindings/spi/renesas,rz-rspi.yaml
```yaml
# Copyright (c) 2024 Renesas Electronics Corporation
# SPDX-License-Identifier: Apache-2.0

description: |
  RENESAS RZ SPI

  Example of devicetree configuration

   &spi0 {
          compatible = "renesas,rz-rspi";
          reg = <0x400aa000 0x24>;
          interrupts = <358 0>, <359 0>, <360 0>;
          interrupt-names = "error", "rx", "tx";
          channel = <0>;
          #address-cells = <1>;
          #size-cells = <0>;
          status = "okay";
    }

  Example of devicetree configuration(use DMA)

   &spi0 {
          compatible = "renesas,rz-rspi";
          reg = <0x400aa000 0x24>;
          interrupts = <358 0>, <359 0>, <360 0>;
          interrupt-names = "error", "rx", "tx";
          channel = <0>;
          #address-cells = <1>;
          #size-cells = <0>;
          status = "okay";
          dmas = <&dma0 0 RZ_DMA_PERIPH_TO_MEM>, <&dma0 5 RZ_DMA_MEM_TO_PERIPH>;
          dma-names = "rx", "tx";
    }

    RZ_DMA_PERIPH_TO_MEM, RZ_DMA_MEM_TO_PERIPH are DMA usual configuration, see renesas_rz_dma.h


compatible: "renesas,rz-rspi"

include: [spi-controller.yaml, pinctrl-device.yaml]

properties:
  reg:
    required: true

  interrupts:
    required: true

  interrupt-names:
    required: true

  channel:
    type: int
    required: true
```

## dts/bindings/spi/renesas,rz-spi-b.yaml
```yaml
# Copyright (c) 2025 Renesas Electronics Corporation
# SPDX-License-Identifier: Apache-2.0

description: RENESAS RZ SPI B

compatible: "renesas,rz-spi-b"

include: [spi-controller.yaml, pinctrl-device.yaml]

properties:
  reg:
    required: true

  interrupts:
    required: true

  interrupt-names:
    required: true

  channel:
    type: int
    required: true

  clk-src:
    type: int
    required: true
    enum:
    - 0
    - 1
    description: |
      Select clock source supplied to calculate bitrate
      - 0: SCISPICLK
      - 1: PCLK
```

## dts/bindings/spi/renesas,rz-spi.yaml
```yaml
# Copyright (c) 2025 Renesas Electronics Corporation
# SPDX-License-Identifier: Apache-2.0

description: RENESAS RZ SPI

compatible: "renesas,rz-spi"

include: [spi-controller.yaml, pinctrl-device.yaml]

properties:
  reg:
    required: true

  interrupts:
    required: true

  interrupt-names:
    required: true

  channel:
    type: int
    required: true

  clk-src:
    type: int
    required: true
    enum:
    - 0
    - 1
    - 2
    - 3
    - 4
    description: |
      Select clock source supplied to calculate bitrate
      - 0: SPI0ASYNCCLK
      - 1: SPI1ASYNCCLK
      - 2: SPI2ASYNCCLK
      - 3: SPI3ASYNCCLK
      - 4: PCLKM
```

## dts/bindings/spi/renesas,smartbond-spi.yaml
```yaml
# Copyright (c) 2022 Renesas Electronics Corporation
# SPDX-License-Identifier: Apache-2.0

description: Renesas SmartBond(tm) SPI

compatible: "renesas,smartbond-spi"

include: [spi-controller.yaml, pinctrl-device.yaml]

properties:
  reg:
    required: true

  interrupts:
    required: true

  periph-clock-config:
    type: int
    description: Peripheral clock register configuration (COM domain)
    required: true
```

## dts/bindings/spi/sensry,sy1xx-spi.yaml
```yaml
# Copyright (c) 2024 sensry.io
# SPDX-License-Identifier: Apache-2.0

description: Sensry SY1xx SPI

compatible: "sensry,sy1xx-spi"

include: [spi-controller.yaml, pinctrl-device.yaml]

properties:
  reg:
    required: true

  pinctrl-0:
    required: true

  instance:
    type: int
    required: true
```

## dts/bindings/spi/shakti,spi.yaml
```yaml
# Copyright (c) 2018, SiFive Inc.
# SPDX-License-Identifier: Apache-2.0

description: |
  shakti SPI controller.

  Note: First instance of the Sifive SPI controller (spi0) must be kept
  disabled if used to access SPI Flash ROM. Failing to do so could result in
  crashes during boot time.

compatible: "shakti,spi"

include:
  - name: spi-controller.yaml

properties:
  reg:
    type: array
    required: true

  sclk_configure:
    type: array
    required: true

  comm_configure:
    type: array
    required: true

  clock-frequency:
    type: int
    required: true
  
  cs-gpios:
    required: true
```

## dts/bindings/spi/sifive,spi0.yaml
```yaml
# Copyright (c) 2018, SiFive Inc.
# SPDX-License-Identifier: Apache-2.0

description: |
  Sifive SPI controller.

  Note: First instance of the Sifive SPI controller (spi0) must be kept
  disabled if used to access SPI Flash ROM. Failing to do so could result in
  crashes during boot time.

compatible: "sifive,spi0"

include: [spi-controller.yaml, pinctrl-device.yaml]

properties:
  reg:
    required: true
```

## dts/bindings/spi/sifli,sf32lb-spi.yaml
```yaml
# Copyright (c) 2025, Qingsong Gou <gouqs@hotmail.com>
# SPDX-License-Identifier: Apache-2.0

description: |
  SiFLI SPI controller for SF32LB family of MCUs.

compatible: "sifli,sf32lb-spi"

include: [spi-controller.yaml, pinctrl-device.yaml]

properties:
  reg:
    required: true

  clocks:
    required: true

  interrupts:
    required: true

  pinctrl-0:
    required: true

  pinctrl-names:
    required: true
```

## dts/bindings/spi/silabs,gecko-spi-eusart.yaml
```yaml
description: GECKO EUSART SPI

compatible: "silabs,gecko-spi-eusart"

include: [spi-controller.yaml, pinctrl-device.yaml]

properties:
  reg:
    required: true

  interrupts:
    required: true

  pinctrl-0:
    required: true

  pinctrl-names:
    required: true

  clocks:
    required: true
```

## dts/bindings/spi/silabs,gecko-spi-usart.yaml
```yaml
description: GECKO USART SPI

compatible: "silabs,gecko-spi-usart"

include: [spi-controller.yaml, pinctrl-device.yaml]

properties:
  reg:
    required: true

  interrupts:
    required: true

  peripheral-id:
    type: int
    description: peripheral ID

  # Note: Not all SoC series support setting individual pin location. If this
  # is a case all location-* properties need to have identical value.

  location-rx:
    type: array
    description: RX pin configuration defined as <location port pin>

  location-tx:
    type: array
    description: TX pin configuration defined as <location port pin>

  location-clk:
    type: array
    description: CLK pin configuration defined as <location port pin>
```

## dts/bindings/spi/silabs,gspi.yaml
```yaml
description: Silabs GSPI
compatible: "silabs,gspi"

include: [spi-controller.yaml, pinctrl-device.yaml]

properties:
  reg:
    required: true

  interrupts:
    required: true
```

## dts/bindings/spi/silabs,si32-spi.yaml
```yaml
# Copyright (c) 2024 GARDENA GmbH
#
# SPDX-License-Identifier: Apache-2.0

description: Si32 SPI

compatible: "silabs,si32-spi"

include: [spi-controller.yaml, pinctrl-device.yaml]

properties:
  reg:
    required: true

  interrupts:
    required: true

  clocks:
    required: true
```

## dts/bindings/spi/silabs,siwx91x-gspi.yaml
```yaml
description: Silabs GSPI
compatible: "silabs,siwx91x-gspi"

include: [spi-controller.yaml, pinctrl-device.yaml]

properties:
  reg:
    required: true

  interrupts:
    required: true
```

## dts/bindings/spi/silabs,usart-spi.yaml
```yaml
title: Silicon Labs Series 2 USART (Universal Synchronous/Asynchronous Receiver/Transmitter)

description: |
  USART (Universal Synchronous/Asynchronous Receiver/Transmitter) peripheral for
  Silicon Labs Series 2 SoCs used in SPI mode.

compatible: "silabs,usart-spi"

include: [spi-controller.yaml, pinctrl-device.yaml]

properties:
  reg:
    required: true

  interrupts:
    required: true

  peripheral-id:
    type: int
    description: peripheral ID

  # Note: Not all SoC series support setting individual pin location. If this
  # is a case all location-* properties need to have identical value.

  location-rx:
    type: array
    description: RX pin configuration defined as <location port pin>

  location-tx:
    type: array
    description: TX pin configuration defined as <location port pin>

  location-clk:
    type: array
    description: CLK pin configuration defined as <location port pin>
```

## dts/bindings/spi/snps,designware-spi.yaml
```yaml
# Copyright (c) 2018 Synopsys, Inc. All rights reserved.
# SPDX-License-Identifier: Apache-2.0

description: Synopsys DesignWare SPI node

compatible: "snps,designware-spi"

include: [spi-controller.yaml, pinctrl-device.yaml]

properties:
  reg:
    required: true

  interrupts:
    required: true

  aux_reg:
    description: |
      This value is used for auxiliary register access. For
      other platform, this value should be default 0.
    type: boolean

  fifo-depth:
    type: int
    description: |
      RX/TX FIFO depth. Corresponds to the SSI_TX_FIFO_DEPTH
      and SSI_RX_FIFO_DEPTH of the DesignWare Synchronous
      Serial Interface. Depth ranges from 2-256.
```

## dts/bindings/spi/spi-controller.yaml
```yaml
# Copyright (c) 2018, I-SENSE group of ICCS
# SPDX-License-Identifier: Apache-2.0

# Common fields for SPI controllers

include: base.yaml

bus: spi

properties:
  clock-frequency:
    type: int
    description: |
      Clock frequency the SPI peripheral is being driven at, in Hz.
  "#address-cells":
    required: true
    const: 1
  "#size-cells":
    required: true
    const: 0
  cs-gpios:
    type: phandle-array
    description: |
      An array of chip select GPIOs to use. Each element
      in the array specifies a GPIO. The index in the array
      corresponds to the child node that the CS gpio controls.

      Example:

        spi@... {
                cs-gpios = <&gpio0 23 GPIO_ACTIVE_LOW>,
                              <&gpio1 10 GPIO_ACTIVE_LOW>,
                              ...;

                spi-device@0 {
                        reg = <0>;
                        ...
                };
                spi-device@1 {
                        reg = <1>;
                        ...
                };
                ...
        };

      The child node "spi-device@0" specifies a SPI device with
      chip select controller gpio0, pin 23, and devicetree
      GPIO flags GPIO_ACTIVE_LOW. Similarly, "spi-device@1" has CS GPIO
      controller gpio1, pin 10, and flags GPIO_ACTIVE_LOW. Additional
      devices can be configured in the same way.

      If unsure about the flags cell, GPIO_ACTIVE_LOW is generally a safe
      choice for a typical "CSn" pin. GPIO_ACTIVE_HIGH may be used if
      intervening hardware inverts the signal to the peripheral device or
      the line itself is active high.

      If this property is not defined, no chip select GPIOs are set.
      SPI controllers with dedicated CS pins do not need to define
      the cs-gpios property.
  overrun-character:
    type: int
    description: |
      The overrun character (ORC) is used when all bytes from the TX buffer
      are sent, but the transfer continues due to RX.
```

## dts/bindings/spi/spi-device.yaml
```yaml
# Copyright (c) 2018, I-SENSE group of ICCS
# SPDX-License-Identifier: Apache-2.0

# Common fields for SPI devices

include: [base.yaml, power.yaml]

on-bus: spi

properties:
  reg:
    required: true
  spi-max-frequency:
    type: int
    required: true
    description: Maximum clock frequency of device's SPI interface in Hz
  duplex:
    type: int
    default: 0
    description: |
      Duplex mode, full or half. By default it's always full duplex thus 0
      as this is, by far, the most common mode.
      Use the macros not the actual enum value, here is the concordance
      list (see dt-bindings/spi/spi.h)
        0    SPI_FULL_DUPLEX
        2048 SPI_HALF_DUPLEX
    enum:
      - 0
      - 2048
  frame-format:
    type: int
    default: 0
    description: |
      Motorola or TI frame format. By default it's always Motorola's,
      thus 0 as this is, by far, the most common format.
      Use the macros not the actual enum value, here is the concordance
      list (see dt-bindings/spi/spi.h)
        0     SPI_FRAME_FORMAT_MOTOROLA
        32768 SPI_FRAME_FORMAT_TI
    enum:
      - 0
      - 32768
  spi-cpol:
    type: boolean
    description: |
      SPI clock polarity which indicates the clock idle state.
      If it is used, the clock idle state is logic high; otherwise, low.
  spi-cpha:
    type: boolean
    description: |
      SPI clock phase that indicates on which edge data is sampled.
      If it is used, data is sampled on the second edge; otherwise, on the first edge.
  spi-hold-cs:
    type: boolean
    description: |
      In some cases, it is necessary for the master to manage SPI chip select
      under software control, so that multiple spi transactions can be performed
      without releasing it. A typical use case is variable length SPI packets
      where the first spi transaction reads the length and the second spi transaction
      reads length bytes.
```

## dts/bindings/spi/spi.yaml
```yaml
#
# Copyright (c) 2018, I-SENSE group of ICCS
#
# SPDX-License-Identifier: Apache-2.0
#

title: SPI Base Structure

description: >
    This binding gives the base structures for all SPI devices

inherits:
    !include base.yaml

child:
    bus: spi

properties:
    clock-frequency:
      type: int
      category: optional
      description: Clock frequency the SPI peripheral is being driven at
    "#address-cells":
      category: required
      description: should be 1.
    "#size-cells":
      category: required
      description: should be 0.
    label:
      category: required
    cs-gpios:
      type: compound
      category: optional
```
