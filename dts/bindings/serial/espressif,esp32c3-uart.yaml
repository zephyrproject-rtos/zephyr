## dts/bindings/serial/infineon,xmc4xxx-uart.yaml
```yaml
description: INFINEON XMC4XXX UART

compatible: "infineon,xmc4xxx-uart"

include: [uart-controller.yaml, pinctrl-device.yaml]

properties:
  reg:
    required: true

  input-src:
    description: |
      Connects the UART receive line (USIC DX0 input) to a specific GPIO pin.
      The USIC DX0 input is a multiplexer which connects to different GPIO pins.
      Refer to the XMC4XXX reference manual for the GPIO pin/mux mappings. DX0G
      is the loopback input line.
    type: string
    required: true
    enum:
      - "DX0A"
      - "DX0B"
      - "DX0C"
      - "DX0D"
      - "DX0E"
      - "DX0F"
      - "DX0G"

  pinctrl-0:
    required: true

  pinctrl-names:
    required: true

  fifo-start-offset:
    description: |
      Each USIC0..2 has a fifo that is shared between two channels. For example,
      usic0ch0 and usic0ch1 will share the same fifo. This parameter defines an offset
      where the tx and rx fifos will start. When sharing the fifo, the user must properly
      define the offset based on the configuration of the other channel. The fifo has a
      capacity of 64 entries. The tx/rx fifos are created on fifo-xx-size aligned
      boundaries.

    required: true
    type: int

  fifo-tx-size:
    description: |
      Fifo size used for buffering transmit bytes. A value of 0 implies that
      the fifo is not used while transmitting. transmitting. If the UART is used in async mode
      then fifo-tx-size should be set to 0.
    required: true
    type: int
    enum:
      - 0
      - 2
      - 4
      - 8
      - 16
      - 32
      - 64

  fifo-rx-size:
    description: |
      Fifo size used for buffering received bytes. A value of 0 implies that
      the fifo is not used while receiving. If the UART is used in async mode
      then fifo-rx-size should be set to 0.
    required: true
    type: int
    enum:
      - 0
      - 2
      - 4
      - 8
      - 16
      - 32
      - 64

  interrupts:
    description: |
      IRQ number and priority to use for interrupt driven UART.
      USIC0..2 have their own interrupt range as follows:
      USIC0 = [84, 89]
      USIC1 = [90, 95]
      USIC2 = [96, 101]

  dmas:
    description: |
      Optional TX & RX dma specifiers used by async UART.

      The dmas are referenced in the UART node using the following syntax:
      dmas = <&dma1 1 0 XMC4XXX_SET_CONFIG(10,6)>, <&dma1 2 0 XMC4XXX_SET_CONFIG(11,6)>;
      where the first entry is for the TX, and the second for RX.

      The parameters in the dma entry are: dma device phandle, dma channel, dma priority (0 is
      lowest and 7 is highest), and an opaque entry for the dma line routing parameters set
      by the macro XMC4XXX_SET_CONFIG(line, request_source). Use the following steps to properly
      select parameters line, request_source:
      1. Select a dma device and a free dma channel.
      1. Select a free dma line. dma0 device can only connect to lines [0, 7] and
         dma1 can connect to lines [8, 11].
      2. For a given interrupt, calculate the service request (SR) number. Note the following
         simple mapping: in USIC0 interrupt 84->SR0, interrupt 85->SR1, ... etc.
         In USIC1, interrupt 90->SR0, 91->SR1, etc.
      3. Select request_source from Table "DMA Request Source Selection" in XMC4XXX reference
         manual.

      For example, say we select interrupt 85 on USIC0, dma0, channel 3, priority 4, and line 7.
      The interrupt would map to SR1. From Table "DMA Request Source Selection", request_source
      would need to be set to 10 and the dts entry would be:
      dma = <&dma0 3 4 XMC4XXX_SET_CONFIG(7,10) ... >;

  dma-names:
    description: |
      Required if the dmas property exists. Should be set to "tx" and "rx"
      to match the dmas property.

      For example
         dma-names = "tx", "rx";
```

## dts/bindings/serial/intel,lw-uart.yaml
```yaml
description: Intel Lightweight UART

compatible: "intel,lw-uart"

include: uart-controller.yaml

properties:
  reg:
    required: true
    description: Base address of the uart controller.

  current-speed:
    required: true
    description: Default baudrate of the uart controller.

  fixed-baudrate:
    type: boolean
    description: |
      Baud rate cannot be changed by software (Divisor register is not writable)

  stop-bits:
    description: |
      Sets the number of stop bits. Defaults to standard of 1 if not specified.
    default: "1"

  data-bits:
    description: |
      Sets the number of data bits. Defaults to standard of 8 if not specified.
    default: 8
```

## dts/bindings/serial/intel,lw_uart.yaml
```yaml
description: Intel Lightweight UART

compatible: "intel,lw-uart"

include: uart-controller.yaml

properties:
  reg:
    required: true
    description: Base address of the uart controller.

  current-speed:
    required: true
    description: Default baudrate of the uart controller.

  fixed-baudrate:
    type: boolean
    description: |
      Baud rate cannot be changed by software (Divisor register is not writable)
```

## dts/bindings/serial/intel,pse-uart.yaml
```yaml
# Copyright (c) 2021 Intel Corporation
#
# SPDX-License-Identifier: Apache-2.0
---
description: INTEL PSE UART

compatible: "intel,pse-uart"

include: uart-controller.yaml

properties:
    reg:
      type: array
      description: mmio register space
      required: true

    interrupts:
      type: array
      description: required interrupts
      required: true

    current-speed:
       type: int
       required: true
       description: Initial baud rate setting for UART

    pinctrl-\d+:
      type: array
      description: pinmux information for RX, TX, CTS, RTS
      required: false

    hw_flow_control:
      type : array
      description: hardware flow control setting
      required: true

    peripheral-id:
      type: int
      description: peripheral ID
      required: true

...
```

## dts/bindings/serial/intel,qmsi-uart.yaml
```yaml
# Copyright (c) 2017 Intel Corporation
# SPDX-License-Identifier: Apache-2.0

title: Intel QMSI Uart

description: >
    This binding gives a base representation of the INTEL QMSI UART

compatible: "intel,qmsi-uart"

include: uart-controller.yaml

properties:
    reg:
      required: true

    interrupts:
      required: true
```

## dts/bindings/serial/intel,sedi-uart.yaml
```yaml
# Copyright (c) 2023 Intel Corporation
#
# SPDX-License-Identifier: Apache-2.0

description: INTEL SEDI UART

compatible: "intel,sedi-uart"

include: uart-controller.yaml

properties:
  reg:
    required: true

  interrupts:
    required: true

  peripheral-id:
    type: int
    description: peripheral ID
    required: true
```

## dts/bindings/serial/intel,xscale-uart.yaml
```yaml
description: Intel XScale PXA UART

compatible: "intel,xscale-uart"

include: ns16550.yaml
```

## dts/bindings/serial/ite,it51xxx-uart.yaml
```yaml
# Copyright (c) 2025 ITE Corporation. All Rights Reserved.
# SPDX-License-Identifier: Apache-2.0

description: ITE, IT51XXX-UART node

compatible: "ite,it51xxx-uart"

include: [uart-controller.yaml]

properties:
  reg:
    required: true

  wucctrl:
    type: phandles
    description: |
      WUC groups internal and external inputs, and asserts wake-up
      signals to INTC that allows the CPU to exit a Doze/Deep
      Doze/Sleep mode.

  clocks:
    required: true
```

## dts/bindings/serial/ite,it8xxx2-uart.yaml
```yaml
# Copyright (c) 2021 ITE Corporation. All Rights Reserved.
# SPDX-License-Identifier: Apache-2.0

description: ITE, IT8XXX2-UART node

compatible: "ite,it8xxx2-uart"

include: [uart-controller.yaml, pinctrl-device.yaml]

properties:
  reg:
    required: true

  port-num:
    type: int
    required: true
    description: Ordinal identifying the port

  gpios:
    type: phandle-array
    required: true

  uart-dev:
    type: phandle
    required: true
    description: Get the handle of the UART device

  pinctrl-0:
    required: true

  pinctrl-names:
    required: true
```

## dts/bindings/serial/litex,uart.yaml
```yaml
# Copyright (c) 2018 - 2019 Antmicro <www.antmicro.com>
# SPDX-License-Identifier: Apache-2.0

description: LiteX UART

compatible: "litex,uart"

include: uart-controller.yaml

properties:
  reg:
    required: true

  interrupts:
    required: true

  rx-fifo-rx-we:
    type: boolean
    description: |
      If true, the RX FIFO read will also remove that item from the FIFO.
      Set this property if the uart_rx_fifo_rx_we parameter in LiteX is
      set to true.
```

## dts/bindings/serial/litex,uart0.yaml
```yaml
# Copyright (c) 2018 - 2019 Antmicro <www.antmicro.com>
# SPDX-License-Identifier: Apache-2.0

title: LiteX UART

description: |
    This binding gives a base representation of the LiteX UART

compatible: "litex,uart0"

include: uart-controller.yaml

properties:
    reg:
      required: true

    interrupts:
      required: true
```

## dts/bindings/serial/lowrisc,opentitan-uart.yaml
```yaml
# Copyright (c) 2023, Rivos Inc.
# SPDX-License-Identifier: Apache-2.0

description: OpenTitan UART

compatible: "lowrisc,opentitan-uart"

include: [uart-controller.yaml, pinctrl-device.yaml]

properties:
  reg:
    required: true
```

## dts/bindings/serial/microchip,dbgu-g1-uart.yaml
```yaml
# Copyright (C) 2025-2026 Microchip Technology Inc. and its subsidiaries
#
# SPDX-License-Identifier: Apache-2.0
#

title: Microchip DBGU UART controller

description: |
  Microchip DBGU (Debug Unit) UART driver.

  Group g1 DBGU UART driver supports following hardware peripherals:
    - module name="DBGU" id="6059" version="212"

compatible: "microchip,dbgu-g1-uart"

include:
  - name: uart-controller.yaml
  - name: pinctrl-device.yaml

properties:
  reg:
    required: true

  interrupts:
    required: true

  clocks:
    required: true
```

## dts/bindings/serial/microchip,dspic33-uart.yaml
```yaml
# Copyright (c) 2025 Microchip Technology Inc.
# SPDX-License-Identifier: Apache-2.0

description: Microchip dsPIC33 UART controller

compatible: "microchip,dspic33-uart"

include: [uart-controller.yaml, pinctrl-device.yaml]

properties:
  reg:
    required: true
    type: array
    description: Register address and size for the UART peripheral

  clock-frequency:
    type: int
    required: true
    description: Clock frequency for the UART peripheral

  interrupts:
    required: true
    type: array
    description: Interrupt specifiers for RX, TX, and error interrupts

  interrupt-names:
    type: string-array
    description: Interrupt names "rx", "tx", "err"

  interrupt-parent:
    type: phandle
    description: Parent interrupt controller

  current-speed:
    required: true
    type: int
    description: Baud rate for the UART

  pinctrl-0:
    required: true
    description: Pin control group for default state

  pinctrl-names:
    required: true
    description: Pin control state names

  status:
    type: string
    description: Device status
```
