## dts/bindings/serial/wch,usart.yaml
```yaml
description: WCH CH32V00x UART

compatible: "wch,usart"

include: [uart-controller.yaml, pinctrl-device.yaml, reset-device.yaml]

properties:
  reg:
    required: true
```

## dts/bindings/serial/xen,hvc-consoleio.yaml
```yaml
description: Xen Dom0/Dom0less Platform HVC ConsoleIO

compatible: "xen,hvc-consoleio"

include: uart-controller.yaml
```

## dts/bindings/serial/xen,hvc-uart.yaml
```yaml
description: Xen Platform HVC UART

compatible: "xen,hvc-uart"

include: uart-controller.yaml
```

## dts/bindings/serial/xhsc,hc32-uart.yaml
```yaml
# Copyright (C) 2024-2025, Xiaohua Semiconductor Co., Ltd.
# SPDX-License-Identifier: Apache-2.0

compatible: "xhsc,hc32-uart"

include: [uart-controller.yaml, pinctrl-device.yaml]

properties:
  reg:
    required: true

  clocks:
    required: true

  interrupts:
    required: false

  interrupt-names:
    required: false

  pinctrl-0:
    required: true

  pinctrl-names:
    required: true

description: HC32 USART controller
```

## dts/bindings/serial/xhsc,hc32-usart.yaml
```yaml
# Copyright (c) 2026 Liu Changjie <liucj1228@outlook.com>
# SPDX-License-Identifier: Apache-2.0

description: XHSC HC32 USART

compatible: "xhsc,hc32-usart"

include: uart-controller.yaml

properties:
  reg:
    required: true

  current-speed:
    required: true

  pinctrl-0:
    type: phandles
    required: true

  pinctrl-names:
    type: string-array
    required: true

  fcg3-periph:
    type: int
    required: true
    description: FCG3 peripheral clock mask for this USART instance.
```

## dts/bindings/serial/xlnx,uartps.yaml
```yaml
description: Xilinx PS UART

compatible: "xlnx,xuartps"

include: uart-controller.yaml

properties:
    reg:
      required: true
```

## dts/bindings/serial/xlnx,xps-uartlite-1.00.a.yaml
```yaml
description: Xilinx UART Lite IP

compatible: "xlnx,xps-uartlite-1.00.a"

include: uart-controller.yaml

properties:
    reg:
      required: true
```

## dts/bindings/serial/xlnx,xuartps.yaml
```yaml
description: Xilinx PS UART

compatible: "xlnx,xuartps"

include: "cdns,uart.yaml"
```

## dts/bindings/serial/xtensa,esp32-uart.yaml
```yaml
title: ESP32 Uart

description: >
    This binding gives a base representation of the ESP32 UART

compatible: "xtensa,esp32-uart"

include: uart-controller.yaml

properties:
    reg:
      required: true

    interrupts:
      category: optional

    clocks:
      category: required

    tx-pin:
      type: int
      description: TX pin
      category: required

    rx-pin:
      type: int
      description: RX pin
      category: required

    rts-pin:
      type: int
      description: RTS pin
      category: optional

    cts-pin:
      type: int
      description: CTS pin
      category: optional
```

## dts/bindings/serial/xuantie,uart0.yaml
```yaml
# Copyright (C) 2017-2024 Alibaba Group Holding Limited
# SPDX-License-Identifier: Apache-2.0

description: XuanTie UART

compatible: "xuantie,uart0"

include: [uart-controller.yaml, pinctrl-device.yaml]

properties:
  reg:
    required: true

  interrupts:
    required: true
```

## dts/bindings/serial/zephyr,cp210x-uart.yaml
```yaml
# Copyright (c) 2025 Sergey Matsievskiy
# SPDX-License-Identifier: Apache-2.0

description: USB CP210X UART

compatible: "zephyr,cp210x-uart"

include: uart-controller.yaml

on-bus: usb

properties:
  tx-fifo-size:
    type: int
    default: 1024
    description: |
      Size of the virtual CP210X UART TX FIFO

  rx-fifo-size:
    type: int
    default: 1024
    description: |
      Size of the virtual CP210X UART RX FIFO

  label:
    description: |
      The string defined by the label property is also used for the USB
      interface string descriptor.
```

## dts/bindings/serial/zephyr,native-posix-uart.yaml
```yaml
# Copyright (c) 2019, Jan Van Winkel (jan.van_winkel@dxplore.eu)
# SPDX-License-Identifier: Apache-2.0

description: Native POSIX UART

compatible: "zephyr,native-posix-uart"

include: uart-controller.yaml
```

## dts/bindings/serial/zephyr,native-pty-uart.yaml
```yaml
# Copyright (c) 2019, Jan Van Winkel (jan.van_winkel@dxplore.eu)
# SPDX-License-Identifier: Apache-2.0

description: Native PTY UART

compatible: "zephyr,native-pty-uart"

include: uart-controller.yaml

properties:
  on-stdinout:
    type: boolean
    description: |
      Connect this PTY UART instance to the stdin & stdout of the calling shell/terminal which
      invoked the native executable. This is good enough for automated testing, or when feeding
      from a file/pipe.
      NOTE: Only one PTY UART can be connected to the stdin/out. If this property is set in several,
      it will only apply to whichever is instantiated first. Note that if
      CONFIG_UART_NATIVE_PTY_0_ON_STDINOUT is set this property is effectively ignored.
      It is discouraged to use this property with the shell interactively: The default terminal
      configuration is not appropriate for Zephyr's shell interactive use and several shell
      functions like autocomplete or the history search will appear faulty.
```

## dts/bindings/serial/zephyr,native-tty-uart.yaml
```yaml
description: Native TTY UART

include: uart-controller.yaml

compatible: "zephyr,native-tty-uart"
bus: uart

properties:
  serial-port:
    type: string
    description: |
      Full path to the serial port device, such as "/dev/ttyUSB0" or
      "/dev/ttyACM0".
  current-speed:
    description: |
      Initial baud rate setting for UART. Only a fixed set of baud rates are
      selectable on these devices.
    enum:
      - 1200
      - 1800
      - 2400
      - 4800
      - 9600
      - 19200
      - 38400
      - 57600
      - 115200
      - 230400
      - 460800
      - 500000
      - 576000
      - 921600
      - 1000000
      - 1152000
      - 1500000
      - 2000000
      - 2500000
      - 3000000
      - 3500000
      - 4000000
```

## dts/bindings/serial/zephyr,nus-uart.yaml
```yaml
# Copyright (c) 2024 Croxel, Inc.
# SPDX-License-Identifier: Apache-2.0

description: UART over NUS (Bluetooth LE)

compatible: "zephyr,nus-uart"

properties:
  tx-fifo-size:
    type: int
    default: 1024
    description: |
      Size of the virtual UART TX FIFO

  rx-fifo-size:
    type: int
    default: 1024
    description: |
      Size of the virtual UART RX FIFO
```

## dts/bindings/serial/zephyr,uart-bitbang.yaml
```yaml
# Copyright (c) 2025 Joel Guittet
# SPDX-License-Identifier: Apache-2.0

description: Zephyr UART Bitbang driver

compatible: "zephyr,uart-bitbang"

include:
  - name: uart-controller.yaml
    property-blocklist:
      - clock-frequency

properties:
  tx-gpios:
    type: phandle-array
    description: |
      Tx gpio info.

  rx-gpios:
    type: phandle-array
    description: |
      Rx gpio info.

  de-gpios:
    type: phandle-array
    description: |
      RS485 driver enable gpio info.

  tx-timer:
    type: phandle
    description: |
      Reference to a TIMER instance to handle Tx data.
      Tx timer and Rx timer can be the same instance in the case of half-duplex
      communications (no transmission and reception of data at the same time).

  rx-timer:
    type: phandle
    description: |
      Reference to a TIMER instance to handle Rx data.
      Tx timer and Rx timer can be the same instance in the case of half-duplex
      communications (no transmission and reception of data at the same time).

  tx-fifo-size:
    type: int
    default: 64
    description: |
      Size of the Tx ring buffer.

  rx-fifo-size:
    type: int
    default: 64
    description: |
      Size of the Rx ring buffer.

  msb:
    type: boolean
    description: |
      Indicate data are transferred Most Significant Bit (MSB) first.

  hw-rs485-flow-control:
    type: boolean
    description: |
      Set to enable DE (driver enable) signal, which can be used to enable
      the driver of an external RS-485 transceiver. Note hw-flow-control
      should be set to false.
```

## dts/bindings/serial/zephyr,uart-bridge.yaml
```yaml
# Copyright 2025 Google LLC
# SPDX-License-Identifier: Apache-2.0

title: UART bridge

description: |
  Bridges data between two serial devices, for example a USB CDC-ACM serial
  port and an hardware UART.

  The device node must specify exactly two peer phandles for the two serial
  devices to be bridged together. Example configuration:

  uart-bridge {
           compatible = "zephyr,uart-bridge";
           peers = <&cdc_acm_uart0 &uart1>;
  };

compatible: "zephyr,uart-bridge"

properties:
  peers:
    type: phandles
    description: Peer device nodes, must contain two phandles
```

## dts/bindings/serial/zephyr,uart-dtr.yaml
```yaml
description: |
  DTR output for a UART.

  This driver wraps an existing UART device and adds DTR (Data Terminal Ready) functionality
  which follows the runtime power state.

  When UART is powered, the DTR signal is asserted (logical high),
  and when the UART is powered down, the DTR signal is de-asserted (logical low).
  This allows a remote end to detect whether the UART is powered or not and manage
  its own power state accordingly.

  The driver acts as a child node of the actual UART. The application should use the DTR UART device
  which will manage the DTR signal and forward all UART operations to the parent UART.

  Example where DTR state follows the runtime power state of another device that uses UART:
  &uart1 {
          zephyr,pm-device-runtime-auto;
          dtr_uart: dtr_uart {
                  compatible = "zephyr,uart-dtr";
                  dtr-gpios = <&gpio0 15 GPIO_ACTIVE_LOW>;
                  zephyr,pm-device-runtime-auto;

                  modem: modem {
                          /* Can be any device that uses UART and supports PM_DEVICE_RUNTIME */
                          zephyr,pm-device-runtime-auto;
                  };
          };
  };

  In the example above, zephyr,pm-device-runtime-auto is used to enable runtime power
  management for devices when they are initialized.
  DTR GPIO is typically active low but this depends on the HW design.


compatible: "zephyr,uart-dtr"

include: base.yaml

on-bus: uart
bus: uart

properties:
  dtr-gpios:
    type: phandle-array
    required: true
    description: |
      DTR (Data Terminal Ready) GPIO pin.
```

## dts/bindings/serial/zephyr,uart-emul-link.yaml
```yaml
# SPDX-FileCopyrightText: 2026 Basalte bv
# SPDX-License-Identifier: Apache-2.0

description: UART Emulator link

compatible: "zephyr,uart-emul-link"

properties:
  uarts:
    type: phandles
    required: true
```

## dts/bindings/services/service.yaml
```yaml
# Copyright (c) 2020 Intel Corporation
# SPDX-License-Identifier: Apache-2.0

# Common fields for all services

properties:
    compatible:
        type: string-array
        required: true
        description: compatible strings

    status:
        type: string
        required: true
        description: indicates the operational status of a service
        enum:
           - "okay"
           - "disabled"

    reg:
        type: array
        description: register space
        required: false
```

## dts/bindings/services/zephyr,uart-console.yaml
```yaml
# Copyright (c) 2020 Intel Corporation
# SPDX-License-Identifier: Apache-2.0

description: Zephyr generic UART console service

include: [service.yaml]

compatible: "zephyr,uart-console"

properties:
    uart:
        type: phandle
        required: true
        description: phandle to uart node
```

## dts/bindings/settings/zephyr,settings,fcb.yaml
```yaml
# Copyright (C) 2022 Marcin Niestroj
# SPDX-License-Identifier: Apache-2.0

description: |
  Settings using FCB backend.

compatible: "zephyr,settings,fcb"

include: "zephyr,settings-common.yaml"

properties:
  partition:
    type: phandle
    required: true
    description: |
      Flash partition used for NVS storage, e.g. <&storage_partition>.

  sector-count:
    type: int
    required: true
    description: |
      Number of sectors to allocate in the settings FCB. A smaller number is
      used if the flash hardware cannot support this value.
```

## dts/bindings/settings/zephyr,settings,file.yaml
```yaml
# Copyright (C) 2022 Marcin Niestroj
# SPDX-License-Identifier: Apache-2.0

description: |
  Settings using File backend.

compatible: "zephyr,settings,file"

include: "zephyr,settings-common.yaml"

properties:
  path:
    type: string
    required: true
    description: |
      Path to file storing settings, e.g. "/settings/run".

  max-entries:
    type: int
    description: |
      Maximum number of entries before attempting compression.

      Compression is disabled if not defined, or set to <0>.
```

## dts/bindings/settings/zephyr,settings,nvs.yaml
```yaml
# Copyright (C) 2022 Marcin Niestroj
# SPDX-License-Identifier: Apache-2.0

description: |
  Settings using NVS backend.

compatible: "zephyr,settings,nvs"

include: "zephyr,settings-common.yaml"

properties:
  partition:
    type: phandle
    required: true
    description: |
      Flash partition used for NVS storage, e.g. <&storage_partition>.

  sector-size-mult:
    type: int
    required: true
    description: |
      The sector size to use for the NVS settings area as a multiple of flash
      erase block size.

  sector-count:
    type: int
    required: true
    description: |
      Number of sectors used for the NVS settings area.
```

## dts/bindings/settings/zephyr,settings-common.yaml
```yaml
# Copyright (C) 2022 Marcin Niestroj
# SPDX-License-Identifier: Apache-2.0

# Common properties for Zephyr settings compatibles

include: base.yaml

properties:
  priority:
    type: int
    description: |
      Priority of settings backend initialization, used when multiple backends
      are defined.

      Backend with lowest priority number will be initialized first and settings
      loading will be started from that backend.

      Backend with highest priority number will be initialized and settings
      defined in in will be loaded as last. This backend will be used for saving
      settings.

      Use a number between 10 and 99.
```
