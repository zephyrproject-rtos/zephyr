## dts/bindings/serial/altr,jtag-uart.yaml
```yaml
description: Altera JTAG UART

compatible: "altr,jtag-uart"

include: uart-controller.yaml

properties:
  reg:
    required: true

  write-fifo-depth:
    type: int
    default: 64
    description: |
      Buffer size of transmit fifo. This used to implement irq_tx_complete.
      Must be same as Write FIFO: Buffer depth (bytes) in platform designer.
```

## dts/bindings/serial/altr,uart.yaml
```yaml
description: Altera UART

compatible: "altr,uart"

include: uart-controller.yaml

properties:
  reg:
    required: true
    description: Base address of the uart controller.

  current-speed:
    required: true
    description: Default baudrate of the uart controller.

  stop-bits:
    description: |
      Sets the number of stop bits. Defaults to standard of 1 if not specified.
    default: "1"

  data-bits:
    description: |
      Sets the number of data bits. Defaults to standard of 8 if not specified.
    default: 8

  fixed-baudrate:
    type: boolean
    description: |
      Baud rate cannot be changed by software (Divisor register is not writable)
```

## dts/bindings/serial/ambiq,uart.yaml
```yaml
# Copyright (c) 2025, Ambiq Micro Inc. <www.ambiq.com>
# SPDX-License-Identifier: Apache-2.0

description: Ambiq UART controller

compatible: "ambiq,uart"

include: [uart-controller.yaml, pinctrl-device.yaml]

properties:
  reg:
    required: true

  interrupts:
    required: true

  pinctrl-0:
    required: true

  pinctrl-names:
    required: true

  clk-src:
    type: int
    default: 0
    description: |
      Set the UART clock source, apollo510 only
      0x0 - HFRC
      0x1 - SYSPLL
```

## dts/bindings/serial/arm,cmsdk-uart.yaml
```yaml
description: ARM CMSDK UART

compatible: "arm,cmsdk-uart"

include: [uart-controller.yaml, pinctrl-device.yaml]

properties:
  reg:
    required: true

  interrupts:
    required: true
```

## dts/bindings/serial/arm,pl011.yaml
```yaml
description: ARM PL011 UART

compatible: "arm,pl011"

include: [uart-controller.yaml, pinctrl-device.yaml, reset-device.yaml]

properties:
  reg:
    required: true

  framing-error-reporting:
    default: "LAST_READ"

  fifo-disable:
    type: boolean
    description: Disable the UART FIFO
```

## dts/bindings/serial/arm,sbsa-uart.yaml
```yaml
description: ARM SBSA UART

compatible: "arm,sbsa-uart"

include: uart-controller.yaml

properties:
  reg:
    required: true

  interrupts:
```

## dts/bindings/serial/at,at32-usart.yaml
```yaml
# Copyright (c) 2021, ATL Electronics
# SPDX-License-Identifier: Apache-2.0

description: AT32 USART

compatible: "at,at32-usart"

include: [uart-controller.yaml, reset-device.yaml, pinctrl-device.yaml]

properties:
  reg:
    required: true

  interrupts:
    required: true

  resets:
    required: true

  clocks:
    required: true
```

## dts/bindings/serial/atmel,sam-uart.yaml
```yaml
description: SAM family UART

compatible: "atmel,sam-uart"

include:
  - name: uart-controller.yaml
  - name: pinctrl-device.yaml

properties:
  reg:
    required: true

  interrupts:
    required: true

  clocks:
    required: true
```

## dts/bindings/serial/atmel,sam0-uart.yaml
```yaml
description: Atmel SAM0 SERCOM UART driver

compatible: "atmel,sam0-uart"

include: uart-controller.yaml

properties:
    reg:
      required: true

    interrupts:
      required: true

    clocks:
      required: true

    clock-names:
      required: true

    rxpo:
      type: int
      required: true
      description: Receive Data Pinout

    txpo:
      type: int
      required: true
      description: Transmit Data Pinout

    collision-detection:
      type: boolean
      description: Enable collision detection for half-duplex mode.

    pinctrl-0:
      type: phandles
      description: |
        PORT pin configuration for RXD & TRD signals.  We expect that
        the phandles will reference pinctrl nodes.  These nodes will
        have a nodelabel that matches the Atmel SoC HAL defines and
        be of the form p<port><pin><periph>_<inst>_<signal>.

        For example the SERCOM0 on SAMR21 would be
           pinctrl-0 = <&pa5d_sercom0_pad1 &pa4d_sercom0_pad0>;

      required: true

    dmas:
      description: |
        Optional TX & RX dma specifiers.  Each specifier will have a phandle
        reference to the dmac controller, the channel number, and peripheral
        trigger source.

        For example dmas for TX, RX on SERCOM3
           dmas = <&dmac 0 0xb>, <&dmac 0 0xa>;

    dma-names:
      description: |
        Required if the dmas property exists.  This should be "tx" and "rx"
        to match the dmas property.

        For example
           dma-names = "tx", "rx";
```

## dts/bindings/serial/atmel,sam3x-uart.yaml
```yaml
---
title: SAM3X UART
id: atmel,sam3x-uart
version: 0.1

description: >
    This binding gives a base representation of the SAM3X UART

inherits:
  - !include uart.yaml

properties:
  - compatible:
      type: string
      category: required
      description: compatible strings
      constraint: "atmel,sam3x-uart"

  - reg:
      type: array
      description: mmio register space
      generation: define
      category: required

  - interrupts:
      type: array
      category: required
      description: required interrupts
      generation: define
...
```

## dts/bindings/serial/atmosic,atm-uart.yaml
```yaml
# Copyright (c) 2023 Atmosic
#
# SPDX-License-Identifier: Apache-2.0

description: Atmosic UART

compatible: "atmosic,atm-uart"

include: uart-controller.yaml

properties:
    reg:
      required: true

    interrupts:
      required: true

    instance:
      type: int
      required: true
      description: UART Hardware Instance

    rx-pin:
      type: int
      required: false
      description: RX pin to use

    tx-pin:
      type: int
      required: true
      description: TX pin to use

    cts-pin:
      type: int
      required: false
      description: CTS pin to use

    rts-pin:
      type: int
      required: false
      description: RTS pin to use
```

## dts/bindings/serial/bflb,bl-uart.yaml
```yaml
# Copyright (c) 2021-2024 ATL Electronics
#
# SPDX-License-Identifier: Apache-2.0

description: Bouffalo Lab UART

compatible: "bflb,bl-uart"

include:
  - name: uart-controller.yaml
  - name: pinctrl-device.yaml

properties:
  reg:
    required: true
```

## dts/bindings/serial/bflb,uart.yaml
```yaml
# Copyright (c) 2021-2025 ATL Electronics
#
# SPDX-License-Identifier: Apache-2.0

description: Bouffalo Lab UART

compatible: "bflb,uart"

include:
  - name: uart-controller.yaml
  - name: pinctrl-device.yaml

properties:
  reg:
    required: true

  peripheral-id:
    type: int
    description: peripheral ID
    required: true
```

## dts/bindings/serial/brcm,bcm2711-aux-uart.yaml
```yaml
description: BCM2711 UART

compatible: "brcm,bcm2711-aux-uart"

include: [uart-controller.yaml]

properties:
  reg:
    required: true

  interrupts:
    required: true

  clock-frequency:
    required: true
```

## dts/bindings/serial/brcm,bcm2835-aux-uart.yaml
```yaml
description: BCM2835 AUX mini UART

compatible: "brcm,bcm2835-aux-uart"

include: brcm,bcm2711-aux-uart.yaml
```

## dts/bindings/serial/cdns,uart.yaml
```yaml
# *************************************************************************
# Copyright 2022 Meta Platforms, Inc. and its affiliates.
# SPDX-License-Identifier: Apache-2.0
# *************************************************************************

description: This binding gives a base representation of the CADENCE UART IP6528

compatible: "cdns,uart"

include: [uart-controller.yaml, pinctrl-device.yaml]

properties:
  reg:
    required: true
```

## dts/bindings/serial/cypress,psoc6-uart.yaml
```yaml
# Copyright (c) 2018, Cypress
# SPDX-License-Identifier: Apache-2.0

description: Cypress UART

compatible: "cypress,psoc6-uart"

include: uart-controller.yaml

properties:
    reg:
      required: true

    interrupts:
      required: true
```

## dts/bindings/serial/digilent,digi_16550.yaml
```yaml
description: Digilent 16550 UART

compatible: "digi_16550"

include: uart-controller.yaml

properties:
    reg:
      required: true

    reg-shift:
      type: int
      required: false
      description: quantity to shift the register offsets by
```

## dts/bindings/serial/efinix,sapphire-uart0.yaml
```yaml
description: Efinix Sapphire UART

compatible: "efinix,sapphire-uart0"

include: uart-controller.yaml

properties:
  reg:
    required: true
```

## dts/bindings/serial/elan,em32-uart.yaml
```yaml
# Copyright (c) 2026 Elan Microelectronics Corp..
# SPDX-License-Identifier: Apache-2.0

description: ELAN EM32 UART controller

compatible: "elan,em32-uart"

include:
  - name: uart-controller.yaml
  - name: pinctrl-device.yaml
  - name: reset-device.yaml
  - name: uart-controller-pin-inversion.yaml

properties:
  reg:
    required: true

  clocks:
    type: phandle-array
    required: true
    description: |
      Input clock for the UART. The clock specifier includes one cell:
      - gate_id: Clock gate identifier for the peripheral.

  current-speed:
    required: true
    description: Default baud rate in bps.

  pinctrl-0:
    required: true

  pinctrl-names:
    required: true
```

## dts/bindings/serial/ene,kb106x-uart.yaml
```yaml
# Copyright (c) 2025 ENE Technology Inc.
# SPDX-License-Identifier: Apache-2.0

description: ENE KB106X UART

compatible: "ene,kb106x-uart"

include: [uart-controller.yaml, pinctrl-device.yaml]

properties:
  reg:
    required: true

  interrupts:
    required: true

  current-speed:
    required: true

  pinctrl-0:
    required: true

  pinctrl-names:
    required: true
```

## dts/bindings/serial/ene,kb1200-uart.yaml
```yaml
# Copyright (c) 2023 ENE Technology Inc.
# SPDX-License-Identifier: Apache-2.0

description: ENE KB1200 UART

compatible: "ene,kb1200-uart"

include: [uart-controller.yaml, pinctrl-device.yaml]

properties:
  reg:
    required: true

  interrupts:
    required: true

  current-speed:
    required: true

  pinctrl-0:
    required: true

  pinctrl-names:
    required: true
```

## dts/bindings/serial/espressif,esp32-lpuart.yaml
```yaml
description: ESP32 Low Power UART

compatible: "espressif,esp32-lpuart"

include: uart-controller.yaml

properties:
  reg:
    required: true

  tx-pin:
    type: int
    description: |
      LP UART TX pin. The LP UART pins are fixed in silicon and routed
      through the LP IO mux. Defaults are set per SoC in the device tree.

  rx-pin:
    type: int
    description: |
      LP UART RX pin. The LP UART pins are fixed in silicon and routed
      through the LP IO mux. Defaults are set per SoC in the device tree.

  rts-pin:
    type: int
    description: |
      LP UART RTS pin. Only configured when hw-flow-control is enabled.

  cts-pin:
    type: int
    description: |
      LP UART CTS pin. Only configured when hw-flow-control is enabled.

  current-speed:
    type: int

  loopback:
    type: boolean
    description: |
      Enable the LP UART hardware internal loopback, tying TX to RX inside
      the peripheral. Intended for self-test on hardware without external
      wiring.
```

## dts/bindings/serial/espressif,esp32-uart.yaml
```yaml
description: ESP32 UART

compatible: "espressif,esp32-uart"

include: [uart-controller.yaml, uart-controller-pin-inversion.yaml, pinctrl-device.yaml]

properties:
  reg:
    required: true

  pinctrl-0:
    required: true

  pinctrl-names:
    required: true

  stop-bits:
    description: |
      Sets the number of stop bits. Defaults to standard of 1 if not specified.
    default: "1"

  data-bits:
    description: |
      Sets the number of data bits. Defaults to standard of 8 if not specified.
    default: 8

  hw-rs485-hd-mode:
    type: boolean
    description: |
      Enable the hardware RS485 half duplex mode.
      Overrides hw-flow-control if both are set.
      Using this mode, the pin assigned to DTR
      is asserted during transmission.

  uhci-slip-tx:
    type: boolean
    description: |
      Enable SLIP encoding on TX when using UART with DMA (async API).
      When enabled, the UHCI hardware automatically encodes transmitted data
      using SLIP framing (0xC0 -> 0xDB 0xDC, 0xDB -> 0xDB 0xDD).
      Disabled by default to prevent unintended data corruption.

  uhci-slip-rx:
    type: boolean
    description: |
      Enable SLIP decoding on RX when using UART with DMA (async API).
      When enabled, the UHCI hardware automatically decodes received data
      using SLIP framing (0xDB 0xDC -> 0xC0, 0xDB 0xDD -> 0xDB).
      Disabled by default to prevent unintended data corruption.
```

## dts/bindings/serial/espressif,esp32-usb-serial.yaml
```yaml
description: ESP32 UART

compatible: "espressif,esp32-usb-serial"

include: uart-controller.yaml

properties:
  reg:
    required: true

  interrupts:
    required: false
```
