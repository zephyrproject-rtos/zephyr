## dts/bindings/serial/renesas,rz-scif-uart.yaml
```yaml
# Copyright (c) 2024 Renesas Electronics Corporation
# SPDX-License-Identifier: Apache-2.0

description: Renesas RZ SCIF UART controller

compatible: "renesas,rz-scif-uart"

include: [uart-controller.yaml, pinctrl-device.yaml]

properties:
  current-speed:
    description: |
      Initial baud rate setting for UART. Defaults to standard baudrate of 115200 if not specified.
    default: 115200

  stop-bits:
    description: |
      Sets the number of stop bits. Defaults to standard of 1 if not specified.
    default: "1"

  data-bits:
    description: |
      Sets the number of data bits. Defaults to standard of 8 if not specified.
    default: 8

  channel:
    type: int
    required: true
```

## dts/bindings/serial/renesas,rza2m-scif-uart.yaml
```yaml
description: Renesas RZ/A2M UART

compatible: "renesas,rza2m-scif-uart"

include: [uart-controller.yaml, pinctrl-device.yaml]

properties:
  reg:
    required: true

  interrupts:
    required: true

  clocks:
    description: |
      Clock source for calculating BRR value

  channel:
    type: int
    required: true
```

## dts/bindings/serial/renesas,rzt2m-uart.yaml
```yaml
# Copyright (c) 2023 Antmicro <www.antmicro.com>
# SPDX-License-Identifier: Apache-2.0

description: Renesas RZ/T2M UART

compatible: "renesas,rzt2m-uart"

include:
  - name: uart-controller.yaml
  - name: pinctrl-device.yaml

properties:
  reg:
    required: true

  current-speed:
    required: true
    description: |
      Initial baud rate setting for UART. Only a fixed set of baud
      rates is currently supported.
    enum:
      - 9600
      - 115200

  stop-bits:
    description: |
      Sets the number of stop bits. Defaults to standard of 1 if not specified.
    default: "1"

  data-bits:
    description: |
      Sets the number of data bits. Defaults to standard of 8 if not specified.
    default: 8

  interrupts:
    required: true
```

## dts/bindings/serial/renesas,smartbond-uart.yaml
```yaml
description: Renesas SmartBond(tm) UART

compatible: "renesas,smartbond-uart"

include: [uart-controller.yaml, pinctrl-device.yaml]

properties:
  reg:
    required: true

  interrupts:
    required: true

  periph-clock-config:
    type: int
    description: Peripheral clock register configuration (COM domain)
    required: true

  current-speed:
    description: |
      Initial baud rate setting for UART. Only a fixed set of baud
      rates are selectable on these devices.
    enum:
      - 4800
      - 9600
      - 14400
      - 19200
      - 28800
      - 38400
      - 57600
      - 115200
      - 230400
      - 500000
      - 921600
      - 1000000
      - 2000000

  hw-flow-control-supported:
    type: boolean
    description: Set to indicate RTS/CTS flow control is supported.

  rx-wake-gpios:
    type: phandle-array
    description: GPIO configured as wake source

  rx-wake-timeout:
    type: int
    description: |
      Time to prevent UART entering sleep mode after receiving data (ms)

  dtr-gpios:
    type: phandle-array
    description: |
      DTR pin specification. DTR pin when active tells that the driver that there
      is active client on the other side of serial line.
      The device driver does not use DTR for hardware flow control.
      When device is connected to computer serial converter usually asserts DTR
      line when serial port is opened and ready for communication.
      This line can be used in Smartbond(tm) driver to detect remote client presence.
      If client is not present the device can disable UART, allowing for
      power system management to enter more efficient power levels.
```

## dts/bindings/serial/riscv,qemu-uart.yaml
```yaml
---
title: RISCV QEMU UART
id: riscv,qemu-uart
version: 0.1

description: >
    This binding gives a base representation of the RISCV QEMU UART

inherits:
    !include uart.yaml

properties:
    compatible:
      constraint: "riscv,qemu-uart"

    reg:
      type: array
      description: mmio register space
      generation: define
      category: required

    interrupts:
      type: array
      category: required
      description: required interrupts
      generation: define
...
```

## dts/bindings/serial/rpmsg-uart.yaml
```yaml
# Copyright (c) 2025 Ayush Singh, BeagleBoard.org
# SPDX-License-Identifier: Apache-2.0

description: RMPSG UART device

compatible: "rpmsg-uart"

include: [base.yaml]
```

## dts/bindings/serial/segger,rtt-uart.yaml
```yaml
# Copyright (c) 2020, CSIRO.
# SPDX-License-Identifier: Apache-2.0

description: Segger RTT UART

compatible: "segger,rtt-uart"

include: uart-controller.yaml

properties:
    tx-buffer-size:
      type: int
      default: 1024
      description: |
        Size of the RTT up buffer for transmission
        Not used for RTT channel 0 as channel 0 is initialized at compile time,
        see SEGGER_RTT_BUFFER_SIZE_UP.
      required: false

    rx-buffer-size:
      type: int
      default: 16
      description: |
        Size of the RTT down buffer for reception
        Not used for RTT channel 0 as channel 0 is initialized at compile time,
        see SEGGER_RTT_BUFFER_SIZE_DOWN.
      required: false
```

## dts/bindings/serial/sensry,sy1xx-uart.yaml
```yaml
# Copyright (c) 2024 sensry.io
# SPDX-License-Identifier: Apache-2.0

description: Sensry SY1xx UART

compatible: "sensry,sy1xx-uart"

include: uart-controller.yaml

properties:
  reg:
    required: true
    description: Base address of the uart controller.

  current-speed:
    required: true
    description: Default baudrate of the uart controller.

  instance:
    type: int
    required: true
```

## dts/bindings/serial/shakti,uart.yaml
```yaml
# Copyright (c) 2026 RISE Lab, IIT Madras
# SPDX-License-Identifier: Apache-2.0

description: Shakti UART

compatible: "shakti,uart"

include: [uart-controller.yaml]

properties:
  reg:
    required: true

  clock-frequency:
    type: int
    required: true

  current-speed:
    required: true
```

## dts/bindings/serial/shakti,uart0.yaml
```yaml
#
# Copyright (c) 2018, SiFive Inc.
#
# SPDX-License-Identifier: Apache-2.0

description: >
    This binding gives a base representation of the shakti UART

compatible: "shakti,uart0"

include: [uart-controller.yaml]

properties:
    reg:
      required: true

    interrupts:
      required: false
```

## dts/bindings/serial/sifive,uart0.yaml
```yaml
# Copyright (c) 2018, SiFive Inc.
# SPDX-License-Identifier: Apache-2.0

description: SiFive UART

compatible: "sifive,uart0"

include: [uart-controller.yaml, pinctrl-device.yaml]

properties:
    reg:
      required: true

    interrupts:
      required: true
```

## dts/bindings/serial/sifli,sf32lb-usart.yaml
```yaml
# Copyright (c) 2025 Core Devices LLC
# SPDX-License-Identifier: Apache-2.0

description: SiFli SF32LB USART

compatible: "sifli,sf32lb-usart"

include: [uart-controller.yaml, pinctrl-device.yaml]

properties:
  reg:
    required: true

  interrupts:
    required: true

  pinctrl-0:
    required: true

  pinctrl-names:
    required: true
```

## dts/bindings/serial/silabs,efm32-uart.yaml
```yaml
---
title: EFM32 UART
id: silabs,efm32-uart
version: 0.1

description: >
    This binding gives a base representation of the EFM32 UART

inherits:
    !include uart.yaml

properties:
    compatible:
      constraint: "silabs,efm32-uart"

    reg:
      type: array
      description: mmio register space
      generation: define
      category: required

    interrupts:
      type: array
      category: required
      description: required interrupts
      generation: define
...
```

## dts/bindings/serial/silabs,efm32-usart.yaml
```yaml
---
title: EFM32 USART
id: silabs,efm32-usart
version: 0.1

description: >
    This binding gives a base representation of the EFM32 USART

inherits:
    !include uart.yaml

properties:
    compatible:
      type: string
      category: required
      description: compatible strings
      constraint: "silabs,efm32-usart"

    reg:
      type: array
      description: mmio register space
      generation: define
      category: required

    interrupts:
      type: array
      category: required
      description: required interrupts
      generation: define
...
```

## dts/bindings/serial/silabs,eusart-uart.yaml
```yaml
description: Silabs EUSART UART

compatible: "silabs,eusart-uart"

include: [uart-controller.yaml, pinctrl-device.yaml]

properties:
  reg:
    required: true

  interrupts:
    required: true

  current-speed:
    description: |
      Initial baud rate setting for UART. Defaults to standard baudrate of 115200 if not specified.
    default: 115200

  stop-bits:
    description: |
      Sets the number of stop bits. Defaults to standard of 1 if not specified.
    default: "1"

  data-bits:
    description: |
      Sets the number of data bits. Defaults to standard of 8 if not specified.
    default: 8
```

## dts/bindings/serial/silabs,gecko-leuart.yaml
```yaml
description: Gecko LEUART

compatible: "silabs,gecko-leuart"

include: [uart-controller.yaml, pinctrl-device.yaml]

properties:
  reg:
    required: true

  interrupts:
    required: true

  peripheral-id:
    type: int
    description: peripheral ID

  # Note: Not all SoC series support setting individual pin location. If this
  # is a case all location-* properties need to have identical value.

  location-rx:
    type: array
    description: RX pin configuration defined as <location port pin>

  location-tx:
    type: array
    description: TX pin configuration defined as <location port pin>
```

## dts/bindings/serial/silabs,gecko-uart.yaml
```yaml
description: Gecko UART

compatible: "silabs,gecko-uart"

include: uart-controller.yaml

properties:
  reg:
    required: true

  interrupts:
    required: true

  current-speed:
    description: |
      Initial baud rate setting for UART. Defaults to standard baudrate of 115200 if not specified.
    default: 115200

  stop-bits:
    description: |
      Sets the number of stop bits. Defaults to standard of 1 if not specified.
    default: "1"

  data-bits:
    description: |
      Sets the number of data bits. Defaults to standard of 8 if not specified.
    default: 8

  peripheral-id:
    type: int
    required: true
    description: peripheral ID

  # Note: Not all SoC series support setting individual pin location. If this
  # is a case all location-* properties need to have identical value.

  location-rx:
    type: array
    required: true
    description: RX pin configuration defined as <location port pin>

  location-tx:
    type: array
    required: true
    description: TX pin configuration defined as <location port pin>
```

## dts/bindings/serial/silabs,gecko-usart-uart.yaml
```yaml
---
title: GECKO USART
version: 0.1

description: >
    This binding gives a base representation of the Gecko USART UART driver

inherits:
    !include uart.yaml

properties:
    compatible:
      constraint: "silabs,gecko-usart-uart"

    reg:
      type: array
      description: mmio register space
      generation: define
      category: required

    interrupts:
      type: compound
      category: required
      description: required interrupts
      generation: define

    location:
     type: int
     category: required
     description: PIN location
     generation: define
...
```

## dts/bindings/serial/silabs,gecko-usart.yaml
```yaml
description: Gecko USART

compatible: "silabs,gecko-usart"

include: [uart-controller.yaml, pinctrl-device.yaml]

properties:
  reg:
    required: true

  interrupts:
    required: true

  current-speed:
    description: |
      Initial baud rate setting for UART. Defaults to standard baudrate of 115200 if not specified.
    default: 115200

  stop-bits:
    description: |
      Sets the number of stop bits. Defaults to standard of 1 if not specified.
    default: "1"

  data-bits:
    description: |
      Sets the number of data bits. Defaults to standard of 8 if not specified.
    default: 8

  peripheral-id:
    type: int
    description: peripheral ID

  # Note: Not all SoC series support setting individual pin location. If this
  # is a case all location-* properties need to have identical value.

  location-rx:
    type: array
    description: RX pin configuration defined as <location port pin>

  location-tx:
    type: array
    description: TX pin configuration defined as <location port pin>

  location-rts:
    type: array
    description: RTS pin configuration defined as <location port pin>

  location-cts:
    type: array
    description: CTS pin configuration defined as <location port pin>
```

## dts/bindings/serial/silabs,si32-usart.yaml
```yaml
# Copyright (c) 2024 GARDENA GmbH
#
# SPDX-License-Identifier: Apache-2.0

description: Si32 USART

compatible: "silabs,si32-usart"

include: [uart-controller.yaml, pinctrl-device.yaml]

properties:
  reg:
    required: true

  interrupts:
    required: true

  clocks:
    required: true
```

## dts/bindings/serial/silabs,vcom-uart.yaml
```yaml
description: Silabs VCOM UART

compatible: "silabs,vcom-uart"

include: base.yaml

properties:
  en-gpios:
    type: phandle-array
    required: true
    description: Pin used to enable VCOM adapter.
  controller:
    type: phandle
    required: true
    description: UART controller connected to the VCOM adapter.
```

## dts/bindings/serial/snps,hostlink-uart.yaml
```yaml
# Copyright (c) 2023, Synopsys Inc. All rights reserved.
# SPDX-License-Identifier: Apache-2.0

description: ARC HOSTLINK UART

compatible: "snps,hostlink-uart"

include: uart-controller.yaml
```

## dts/bindings/serial/snps,nsim-uart.yaml
```yaml
# Copyright (c) 2019, Linaro Limited
# SPDX-License-Identifier: Apache-2.0

description: Synopsys ARC nSIM UART

compatible: "snps,nsim-uart"

include: uart-controller.yaml

properties:
  reg:
    required: true
```

## dts/bindings/serial/st,stm32-lpuart.yaml
```yaml
description: STM32 LPUART

compatible: "st,stm32-lpuart"

include: st,stm32-uart-base.yaml
```
