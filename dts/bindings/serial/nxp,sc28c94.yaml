## dts/bindings/serial/nxp,sc28c94.yaml
```yaml
# Copyright (c) 2020 Analog Life LLC
# SPDX-License-Identifier: Apache-2.0

description: SC28C94 SPI to 4x UART transceiver

compatible: "nxp,sc28c94"

include: [base.yaml]

properties:
    label:
      required: true

    enable-gpios:
      type: phandles
      required: true

on-bus: spi

bus: nxp,sc28c94

# Example
#
# The up to 4 supported UART devices are child devices of the
# parent quart. The node id (serial0) of the UART devices may
# be modified and must be referenced by the application, the
# path to the UART devices must match the naming scheme. One
# uart0, one uart1 etc.
#
# / {
#     aliases {
#         vcom1 = <&serial0>;
#         vcom2 = <&serial1>;
#         vcom3 = <&serial2>;
#         vcom4 = <&serial3>;
#     };
# };
#
# &spi0 {
#     quart {
#         compatible = "nxp,sc28c94";
#
#         serial0: uart0 {
#             compatible = "nxp,sc28c94-uart";
#             label "serial0";
#             current-speed = 115200;
#             hw-flow-control;
#         };
#
#         serial1: uart1 {
#             compatible = "nxp,sc28c94-uart";
#             label "serial1";
#             current-speed = 115200;
#             hw-flow-control;
#         };
#
#         serial2: uart2 {
#             compatible = "nxp,sc28c94-uart";
#             label "serial2";
#             current-speed = 115200;
#             hw-flow-control;
#         };
#
#         serial3: uart3 {
#             compatible = "nxp,sc28c94-uart";
#             label "serial3";
#             current-speed = 9600;
#             hw-flow-control;
#         };
#     };
# };
```

## dts/bindings/serial/openisa,rv32m1-lpuart.yaml
```yaml
description: OpenISA LPUART

compatible: "openisa,rv32m1-lpuart"

include: [uart-controller.yaml, pinctrl-device.yaml]

properties:
    reg:
      required: true

    interrupts:
      required: true
```

## dts/bindings/serial/opensbi,console-uart.yaml
```yaml
description: OpenSBI Console UART

compatible: "opensbi,console-uart"

include: [base.yaml]
```

## dts/bindings/serial/quicklogic,usbserialport_s3b.yaml
```yaml
# Copyright (c) 2022 Antmicro <www.antmicro.com>
# SPDX-License-Identifier: Apache-2.0

description: QuickLogic USBserialport_S3B serial interface

compatible: "quicklogic,usbserialport-s3b"

include: uart-controller.yaml

properties:
  reg:
    required: true
```

## dts/bindings/serial/raspberrypi,pico-uart-pio.yaml
```yaml
description: Raspberry Pi Pico PIO UART

compatible: "raspberrypi,pico-uart-pio"

include: [uart-controller.yaml, "raspberrypi,pico-pio-device.yaml"]
```

## dts/bindings/serial/raspberrypi,pico-uart.yaml
```yaml
description: Raspberry Pi Pico UART

compatible: "raspberrypi,pico-uart"

include: "arm,pl011.yaml"
```

## dts/bindings/serial/raspberrypi,rp2-uart.yaml
```yaml
description: Raspberry Pi UART

compatible: "raspberrypi,rp2-uart"

include: uart-controller.yaml

properties:
    reg:
      required: true

    interrupts:
      required: true

    tx-pin:
      type: int
      required: true
      description: TX pin as a GPIO number

    rx-pin:
      type: int
      required: true
      description: RX pin as a GPIO number
```

## dts/bindings/serial/realtek,ameba-loguart.yaml
```yaml
# Copyright (c) 2024 Realtek Semiconductor Corp.
# SPDX-License-Identifier: Apache-2.0

description: Ameba LOGUART
compatible: "realtek,ameba-loguart"

include: [uart-controller.yaml, base.yaml, pinctrl-device.yaml]

bus: uart

properties:
  reg:
    required: true

  interrupts:
    required: true
```

## dts/bindings/serial/realtek,ameba-uart.yaml
```yaml
# Copyright (c) 2024 Realtek Semiconductor Corp.
# SPDX-License-Identifier: Apache-2.0

description: Ameba UART
compatible: "realtek,ameba-uart"

include: [uart-controller.yaml, pinctrl-device.yaml]

bus: uart

properties:
  reg:
    required: true

  clocks:
    required: true

  interrupts:
    required: true

  pinctrl-0:
    required: true

  pinctrl-names:
    required: true
```

## dts/bindings/serial/realtek,bee-uart.yaml
```yaml
# Copyright (c) 2026, Realtek Semiconductor Corporation
# SPDX-License-Identifier: Apache-2.0

description: |
  Bee UART.

compatible: "realtek,bee-uart"

include: [uart-controller.yaml, base.yaml, pinctrl-device.yaml]

bus: uart

properties:
  reg:
    required: true

  clocks:
    required: true

  interrupts:
    required: true

  pinctrl-0:
    required: true

  pinctrl-names:
    required: true

  rx-threshold:
    type: int
    description: |
      The Rx threshold level to trigger rx interrupt, range from 1 to 29.

  flow-ctrl:
    type: boolean
    description: |
      Enable CTS and RTS or not.
```

## dts/bindings/serial/realtek,rts5912-uart.yaml
```yaml
# SPDX-License-Identifier: Apache-2.0
#
# Copyright (c) 2024 Realtek Semiconductor Corporation, SIBG-SD7
#

description: Realtek RTS5912 UART

compatible: "realtek,rts5912-uart"

include: [uart-controller.yaml, pinctrl-device.yaml]

properties:
  reg:
    required: true

  port:
    type: int
    required: true

  pinctrl-0:
    required: true

  pinctrl-names:
    required: true

  rx-gpios:
    description: |
      Select the wake up pin for uart rx,
      please check include/zephyr/dt-bindings/gpio/realtek-gpio.h
      For example:
      rx-gpios = <RTS5912_GPIO113 GPIO_ACTIVE_HIGH>;
    type: phandle-array

  uart-dev:
    type: phandle
    description: |
      Get the device of the UART device
```

## dts/bindings/serial/refsoc-uart.yaml
```yaml
#
# Copyright (c) 2018, Linaro Limited
#
# SPDX-License-Identifier: Apache-2.0
#
---
title: REFSOC UART
version: 0.1

description: >
    This binding gives a base representation of the Reference SoC UART

inherits:
    !include uart.yaml

properties:
    compatible:
      constraint: "refsoc-uart"

    reg:
      type: array
      description: mmio register space
      generation: define
      category: required

    interrupts:
      type: array
      category: required
      description: required interrupts
      generation: define
...
```

## dts/bindings/serial/renesas,ra-sci-uart.yaml
```yaml
# Copyright (c) 2024 Renesas Electronics Corporation
# SPDX-License-Identifier: Apache-2.0

description: Renesas RA SCI UART controller

compatible: "renesas,ra-sci-uart"

include: [uart-controller.yaml, pinctrl-device.yaml]

properties:
  channel:
    type: int
    required: true
```

## dts/bindings/serial/renesas,ra-uart-sau.yaml
```yaml
# Copyright (c) 2026 Renesas Electronics Corporation
# SPDX-License-Identifier: Apache-2.0

description: Renesas RA SAU UART

compatible: "renesas,ra-uart-sau"

include: [uart-controller.yaml, pinctrl-device.yaml]

properties:
  pinctrl-0:
    required: true

  pinctrl-names:
    required: true

  reg:
    required: true
    description: |
      SAU UART channel index.

  msb-first:
    type: boolean
    description: |
      Transfer MSB first.

  tx-signal-inversion:
    type: boolean
    description: |
      Inverse the level of transmitted signal.

  sau-channels:
    required: true
    type: phandle-array
    description: |
      SAU channel phandles [TX, RX].
      Must contain exactly 2 phandles: first for TX, second RX.
      These shouldn't be changed to other sau channels.
      Both must use the same clock-source (both "CKm0" or "CKm1").

  stop-bits:
    default: "1"
    description: |
      Sets the number of stop bits. Defaults to standard of 1 if not specified.

  data-bits:
    default: 8
    description: |
      Sets the number of data bits. Defaults to standard of 8 if not specified.

  current-speed:
    default: 115200
    description: |
      Initial baud rate setting for UART. Defaults to standard baudrate of 115200 if not specified.
```

## dts/bindings/serial/renesas,ra-uart-sci.yaml
```yaml
# Copyright (c) 2023 TOKITA Hiroshi <tokita.hiroshi@fujitsu.com>
# SPDX-License-Identifier: Apache-2.0

description: Renesas RA Series SCI based UART controller

compatible: "renesas,ra-uart-sci"

include: [uart-controller.yaml]
```

## dts/bindings/serial/renesas,ra2-sci-uart.yaml
```yaml
# Copyright (c) 2023-2024 MUNIC SA
# SPDX-License-Identifier: Apache-2.0

description: RA2 family SCI based UART

compatible: renesas,ra2-sci-uart

include:
  - name: renesas,ra-lpm-module.yaml
  - name: uart-controller.yaml
  - name: pinctrl-device.yaml

properties:
  reg:
    required: true

  interrupts:
    required: true

  pinctrl-0:
    required: true

  pinctrl-names:
    required: true

  dma:
    type: phandle
    description: |
      Specifies the DMA node. The presence of this property means that the
      driver will be configured for the async API and will not work with the
      interrupt driven API.

  wakeup-gpios:
    type: phandle-array
    description: |
      Specifies wakeup gpio pin (should be the same as RX).
```

## dts/bindings/serial/renesas,ra8-uart-sci-b.yaml
```yaml
# Copyright (c) 2024 Renesas Electronics Corporation
# SPDX-License-Identifier: Apache-2.0

description: Renesas RA SCI_B UART controller

compatible: "renesas,ra8-uart-sci-b"

include: [pinctrl-device.yaml, uart-controller.yaml]

properties:
  channel:
    type: int
    required: true
```

## dts/bindings/serial/renesas,ra8-uart-sci.yaml
```yaml
# Copyright (c) 2024 TOKITA Hiroshi
# SPDX-License-Identifier: Apache-2.0

description: Renesas RA8 Series SCI based UART controller

compatible: "renesas,ra8-uart-sci"

include: [pinctrl-device.yaml, uart-controller.yaml]

properties:
  channel:
    type: int
    required: true

  tx-dtc:
    type: boolean
    description: Enable dtc support for transmit

  rx-dtc:
    type: boolean
    description: Enable dtc support for receive
```

## dts/bindings/serial/renesas,rcar-hscif.yaml
```yaml
# Copyright (c) 2024, EPAM Systems
# SPDX-License-Identifier: Apache-2.0

description: Renesas R-Car HSCIF controller

compatible: "renesas,rcar-hscif"

include: [uart-controller.yaml, pinctrl-device.yaml]

properties:
  reg:
    required: true

  clocks:
    required: true

  current-speed:
    required: true
```

## dts/bindings/serial/renesas,rcar-scif.yaml
```yaml
# Copyright (c) 2021, IoT.bzh
# SPDX-License-Identifier: Apache-2.0
#
description: Renesas R-Car UART controller

compatible: "renesas,rcar-scif"

include: uart-controller.yaml

properties:
    reg:
      required: true

    clocks:
      required: true
```

## dts/bindings/serial/renesas,rh850-rlin3-uart.yaml
```yaml
# Copyright (c) 2026 Renesas Electronics Corporation
# SPDX-License-Identifier: Apache-2.0

description: Renesas RH850 RLIN3 UART controller

compatible: "renesas,rh850-rlin3-uart"

include: [uart-controller.yaml, pinctrl-device.yaml]

properties:
  channel:
    type: int
    required: true
```

## dts/bindings/serial/renesas,rx-uart-sci-qemu.yaml
```yaml
# Copyright (c) 2024 Renesas Electronics Corporation
# SPDX-License-Identifier: Apache-2.0

description: Renesas RX SCI QEMU controller

compatible: "renesas,rx-uart-sci-qemu"

include: [pinctrl-device.yaml, uart-controller.yaml]
```

## dts/bindings/serial/renesas,rx-uart-sci.yaml
```yaml
# Copyright (c) 2024 Renesas Electronics Corporation
# SPDX-License-Identifier: Apache-2.0

description: Renesas RX SCI UART controller

compatible: "renesas,rx-uart-sci"

include: [pinctrl-device.yaml, uart-controller.yaml]

properties:
  fifo-ctrl:
    type: int
```

## dts/bindings/serial/renesas,rz-sci-b-uart.yaml
```yaml
# Copyright (c) 2025 Renesas Electronics Corporation
# SPDX-License-Identifier: Apache-2.0

description: Renesas RZ SCI-B UART controller

compatible: "renesas,rz-sci-b-uart"

include: [uart-controller.yaml, pinctrl-device.yaml]
```

## dts/bindings/serial/renesas,rz-sci-uart.yaml
```yaml
# Copyright (c) 2025 Renesas Electronics Corporation
# SPDX-License-Identifier: Apache-2.0

description: Renesas RZ SCI UART controller

compatible: "renesas,rz-sci-uart"

include: [uart-controller.yaml, pinctrl-device.yaml]
```
