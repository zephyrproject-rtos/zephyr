## dts/bindings/serial/brcm,bcm283x-aux-uart.yaml
```yaml
description: Broadcom BCM283x Auxiliary UART

compatible: "brcm,bcm283x-aux-uart"

include: ns16550.yaml
```

## dts/bindings/serial/google,goldfish-tty.yaml
```yaml
# SPDX-License-Identifier: Apache-2.0

description: Google Goldfish TTY

compatible: "google,goldfish-tty"

include: uart-controller.yaml

properties:
  reg:
    required: true

  big-endian:
    type: boolean
    description: |
      MMIO registers use big-endian byte order. If absent, registers use the
      little-endian Goldfish byte order.
```

## dts/bindings/serial/hisilicon,hi3861-uart.yaml
```yaml
# SPDX-FileCopyrightText: Copyright The Zephyr Project Contributors
# SPDX-License-Identifier: Apache-2.0

description: |
  HiSilicon Hi3861 UART controller with 64-entry transmit and receive FIFOs.
  UART0 does not support hardware RTS/CTS; UART1 and UART2 do.

compatible: "hisilicon,hi3861-uart"

include: [uart-controller.yaml, pinctrl-device.yaml]

properties:
  reg:
    required: true

  interrupts:
    required: true

  clock-frequency:
    required: true
    description: Frequency of the UART input clock in Hz.

  current-speed:
    required: true

  hw-flow-control-supported:
    type: boolean
    description: |
      RTS/CTS capability, available on UART1 and UART2.
      The hw-flow-control property enables it at boot.
```

## dts/bindings/serial/hpmicro,hpm-uart.yaml
```yaml
# Copyright (c) 2022 HPMicro
# Copyright (c) 2026 Cody Gu <gujiaqi@iscas.ac.cn>
# SPDX-License-Identifier: Apache-2.0

description: HPMicro UART

compatible: "hpmicro,hpm-uart"

include: [uart-controller.yaml, pinctrl-device.yaml]

properties:
  reg:
    required: true

  interrupts:
    required: true

  clocks:
    required: true
    description: |
      Clock specifier with the HPM clock resource, source selector and
      divider, respectively.

  clock-names:
    required: true
```

## dts/bindings/serial/infineon,asclin-uart.yaml
```yaml
# SPDX-FileCopyrightText: Copyright (c) 2024 Infineon Technologies AG,
# SPDX-FileCopyrightText: or an affiliate of Infineon Technologies AG. All rights reserved.
# SPDX-FileCopyrightText: Copyright (c) 2026 Linumiz
#
# SPDX-License-Identifier: Apache-2.0

description: Infineon ASCLIN Uart

compatible: "infineon,asclin-uart"

include: [uart-controller.yaml, pinctrl-device.yaml]

properties:
  reg:
    required: true

  clock-frequency:
    type: int
    required: true
    description: |
      Frequency in Hz of the ASCLIN baud-rate logic input clock (fASCLINF),
      used to compute the baud-rate divider.

  oversampling:
    type: int
    default: 16
    description: |
      Number of samples per bit. Valid range is 4-16.
      Higher values provide better noise immunity but limit maximum baud rate.

  samplepoint:
    type: int
    default: 8
    description: |
      Sample point position within the oversampling period.
      Should be between 1 and oversampling-1. Typically set to oversampling/2.

  median-filter:
    type: boolean
    description: |
      Enable median filter for improved noise immunity.
      When enabled, uses 3-sample majority voting at the sample point.

  prescaler:
    type: int
    default: 1
    description: |
      Clock prescaler value. Valid range is 1-4096.
      Used to divide the input clock for baud rate generation.
```

## dts/bindings/serial/infineon,scb-uart.yaml
```yaml
# SPDX-FileCopyrightText: Copyright (c) 2026 Infineon Technologies AG
# SPDX-FileCopyrightText: Copyright (c) 2026 Linumiz
# SPDX-License-Identifier: Apache-2.0

description: |
  Infineon SCB UART

  Serial communication block (SCB) in UART mode.

    uart7: &scb7 {
        compatible = "infineon,scb-uart";
        current-speed = <115200>;
        clocks = <&peri0_group1_8bit_1>;
        pinctrl-0 = <&p9_0_scb7_uart_rx &p9_1_scb7_uart_tx>;
        pinctrl-names = "default";
    };

compatible: "infineon,scb-uart"

include:
  - name: uart-controller.yaml
  - name: pinctrl-device.yaml

properties:
  reg:
    required: true

  interrupts:
    required: true

  clocks:
    required: true
    description: Peripheral clock divider that clocks the SCB

  clk-dst:
    type: int
    required: true
    description: Peripheral clock destination ID of the SCB instance

  current-speed:
    required: true

  pinctrl-0:
    required: true

  pinctrl-names:
    required: true
```

## dts/bindings/serial/mediatek,mt8188-uart.yaml
```yaml
# Copyright (c) 2026 MediaTek Inc.
# SPDX-License-Identifier: Apache-2.0

description: MediaTek MT8188 UART

compatible: "mediatek,mt8188-uart"

include: [uart-controller.yaml, pinctrl-device.yaml]

properties:
  reg:
    required: true

  clocks:
    required: true

  clock-frequency:
    required: true
    description: Frequency of the UART source clock, in Hz.

  current-speed:
    default: 115200

  parity:
    default: "none"

  stop-bits:
    default: "1"

  data-bits:
    default: 8

  pinctrl-0:
    required: true

  pinctrl-names:
    required: true
```

## dts/bindings/serial/microchip,xec-uart.yaml
```yaml
description: Microchip XEC UART

compatible: "microchip,xec-uart"

include:
  - name: uart-controller.yaml
  - name: pinctrl-device.yaml
  - name: microchip,dmec-ecia-girq.yaml

properties:
  reg:
    required: true

  interrupts:
    required: true

  ldn:
    type: int
    required: true
    description: logical device number

  host_io:
    type: int
    description: |
      eSPI host I/O base address the UART is exposed at. When omitted the
      driver falls back to its default host I/O address (0x3F0).

  pcr-scr:
    type: int
    required: true
    description: |
      UART Power Clock Reset(PCR) peripheral index and bit position

  pinctrl-0:
    required: true

  pinctrl-names:
    required: true

  wakerx-gpios:
    type: phandle-array
    description: GPIO configured as UART RX wake source
```

## dts/bindings/serial/nordic,nrf-uart-common.yaml
```yaml
include: [uart-controller.yaml, pinctrl-device.yaml, nordic-clockpin.yaml]

properties:
  reg:
    required: true

  interrupts:
    required: true

  pinctrl-0:
    required: true

  pinctrl-names:
    required: true

  disable-rx:
    type: boolean
    description: |
      Disable UART reception capabilities (only required to disable reception
      if CONFIG_PINCTRL is enabled).

  current-speed:
    type: int
    required: true
    description: |
      Initial baud rate setting for UART.

  current-speed-is-enum:
    type: boolean
    description: |
      Baudrate setting is treated as an enum with following values:
      - 1200
      - 2400
      - 4800
      - 9600
      - 14400
      - 19200
      - 28800
      - 31250
      - 38400
      - 56000
      - 57600
      - 76800
      - 115200
      - 230400
      - 250000
      - 460800
      - 921600
      - 1000000
      - 2000000
      - 4000000
      - 8000000
```

## dts/bindings/serial/ns16550.yaml
```yaml
description: ns16550 UART

compatible: "ns16550"

include: [uart-controller.yaml, pcie-device.yaml, pinctrl-device.yaml, reset-device.yaml]

properties:
  reg-shift:
    type: int
    required: true
    description: quantity to shift the register offsets by

  pcp:
    type: int
    description: custom clock (PRV_CLOCK_PARAMS, if supported)

  dlf:
    type: int
    description: divisor latch fraction (DLF, if supported)

  dlf-auto:
    type: boolean
    description: |
      Automatically compute the fractional divisor (DLF) alongside the
      integer baud rate divisor (DLL/DLH), instead of pairing a static 'dlf'
      value with a plain integer divisor.

      This reduces baud rate error compared to an integer-only divisor,
      particularly when clock-frequency is relatively low (e.g., tens of MHz)
      relative to the target baud rate. Only applicable to DW_apb_uart-compatible
      implementations where the DLF register has a 1/64 resolution; do not set
      this for other 'dlf'-capable hardware with a different fractional scale.

      When set, this takes precedence over a static 'dlf' property: the 'dlf'
      property is ignored, and the fractional divisor is recomputed dynamically
      on every baud rate change.

  io-mapped:
    type: boolean
    description: specify registers are IO mapped or memory mapped

  loopback:
    type: boolean
    description: |
      Connects TX to RX internally creating a loop back connection. Useful
      for testing.
```

## dts/bindings/serial/nuvoton,npcm-uart.yaml
```yaml
# Copyright (c) 2024 Nuvoton Technology Corporation.
# SPDX-License-Identifier: Apache-2.0

description: Nuvoton, NPCM-UART node

compatible: "nuvoton,npcm-uart"

include: [uart-controller.yaml, pinctrl-device.yaml]

properties:
  reg:
    required: true
  clocks:
    required: true
  pinctrl-0:
    required: true
  pinctrl-names:
    required: true
  rx-fifo-threshold:
    type: int
    default: 0
    enum: [0, 1, 2, 3]
    description: |
      RX FIFO interrupt threshold encoding for UFCTRL.RXFTH.

      - 0: interrupt when RX FIFO level >= 1 byte
      - 1: interrupt when RX FIFO level >= 4 bytes
      - 2: interrupt when RX FIFO level >= 8 bytes
      - 3: interrupt when RX FIFO level >= 14 bytes
```

## dts/bindings/serial/nuvoton,npcx-uart-npcmn.yaml
```yaml
# Copyright (c) 2025 Nuvoton Technology Corporation.
# SPDX-License-Identifier: Apache-2.0

description: |
  Nuvoton npcx serial uart for npcmn variant

compatible: "nuvoton,npcx-uart-npcmn"

include: nuvoton,npcx-uart.yaml
```

## dts/bindings/serial/nxp,lpc-usart.yaml
```yaml
# Copyright (c) 2017, 2026 NXP
# SPDX-License-Identifier: Apache-2.0

description: LPC USART

compatible: "nxp,lpc-usart"

include: [uart-controller.yaml, "nxp,lpc-flexcomm.yaml", wuc-device.yaml]
```

## dts/bindings/serial/puya,py32-uart.yaml
```yaml
# SPDX-FileCopyrightText: Copyright The Zephyr Project Contributors
# SPDX-License-Identifier: Apache-2.0

description: Puya PY32 UART with polling and interrupt-driven 8N1 operation

compatible: "puya,py32-uart"

include:
  - name: uart-controller.yaml
    property-blocklist:
      - hw-flow-control
      - clock-frequency
  - pinctrl-device.yaml
  - reset-device.yaml

properties:
  reg:
    required: true
  clocks:
    required: true
  resets:
    required: true
  interrupts:
    required: true
  pinctrl-0:
    required: true
  pinctrl-names:
    required: true
  current-speed:
    default: 115200
  parity:
    const: "none"
  data-bits:
    default: 8
    const: 8
  stop-bits:
    default: "1"
    const: "1"
```

## dts/bindings/serial/renesas,ra6b1-uart.yaml
```yaml
# SPDX-FileCopyrightText: 2026 Renesas Electronics Corporation
# SPDX-License-Identifier: Apache-2.0

description: Renesas RA6B1 UART

compatible: "renesas,ra6b1-uart"

include: [uart-controller.yaml, pinctrl-device.yaml]

properties:
  reg:
    required: true

  interrupts:
    required: true

  interrupt-names:
    required: true

  channel:
    type: int
    enum: [0, 1, 2, 3]
    required: true

  current-speed:
    description: |
      Initial baud rate setting for UART. Only a fixed set of baud
      rates are selectable on these devices.
    enum:
      - 4800
      - 9600
      - 14400
      - 19200
      - 28800
      - 38400
      - 57600
      - 115200
      - 230400
      - 500000
      - 921600
      - 1000000
      - 2000000

  stop-bits:
    description: |
      Sets the number of stop bits. Defaults to standard of 1 if not specified.
    default: "1"

  data-bits:
    description: |
      Sets the number of data bits. Defaults to standard of 8 if not specified.
    default: 8
```

## dts/bindings/serial/renesas,rx-uart-sci-b.yaml
```yaml
# Copyright (c) 2025 Renesas Electronics Corporation
# SPDX-License-Identifier: Apache-2.0

description: Renesas RX SCI_B UART controller

compatible: "renesas,rx-uart-sci-b"

include: [pinctrl-device.yaml, uart-controller.yaml]
```

## dts/bindings/serial/snps,dw-apb-uart.yaml
```yaml
# Copyright (c) 2026 Muhammad Waleed Badar
# SPDX-License-Identifier: Apache-2.0

description: DesignWare 8250 UART Controller

compatible: "snps,dw-apb-uart"

include: [ns16550.yaml]
```

## dts/bindings/serial/ti,cc27xx-uart.yaml
```yaml
# Copyright (c) 2025 Texas Instruments Incorporated
# Copyright (c) 2024 BayLibre, SAS
#
# SPDX-License-Identifier: Apache-2.0

description: TI SimpleLink CC27XX UART node

compatible: "ti,cc27xx-uart"

include: [uart-controller.yaml, pinctrl-device.yaml, base.yaml]

properties:
  reg:
    required: true

  interrupts:
    required: true

  pinctrl-0:
    required: true

  pinctrl-names:
    required: true

  dmas:
    description: |
      Optional TX & RX DMA specifiers. Each specifier will have a phandle
      reference to the DMA controller, the channel number, and the peripheral
      trigger source.

      Example for channels 2/3 with uart0txtrg/uart0rxtrg trigger sources:
        dmas = <&dma 2 6>, <&dma 3 7>;

  dma-names:
    description: |
      Required if the dmas property exists. This should be "tx" and "rx"
      to match the dmas property.

      Example:
        dma-names = "tx", "rx";
```

## dts/bindings/serial/ti,cc35xx-uart.yaml
```yaml
description: TI CC35XX UART

compatible: "ti,cc35xx-uart"

include: [uart-controller.yaml, pinctrl-device.yaml]

properties:
  reg:
    required: true

  pinctrl-0:
    required: true

  pinctrl-names:
    required: true

  dmas:
    description: |
      Optional TX & RX dma specifiers used by async UART.
      The dmas are referenced in the UART node using the following syntax:

      dmas = <&dma 0 CC35XX_DMA_SET_CONFIG(CC35xx_DMA_PERIPH_UARTLIN_0)>,
             <&dma 1 CC35XX_DMA_SET_CONFIG(CC35xx_DMA_PERIPH_UARTLIN_0)>;
      where the first entry is for the TX, and the second for RX.

      The parameters in the dma entry are: dma device phandle, dma channel, dma_peripheral

  dma-names:
    description: |
      Required if the dmas property exists. Should be set to "tx" and "rx"
      to match the dmas property.

      For example
         dma-names = "tx", "rx";
```

## dts/bindings/serial/ti,lpf3-uart.yaml
```yaml
# Copyright (c) 2026 Texas Instruments Incorporated
# Copyright (c) 2024 BayLibre, SAS
#
# SPDX-License-Identifier: Apache-2.0

description: TI SimpleLink LPF3 UART node (CC23x0, CC27xx)

compatible: "ti,lpf3-uart"

include: [uart-controller.yaml, pinctrl-device.yaml, base.yaml]

properties:
  reg:
    required: true

  interrupts:
    required: true

  pinctrl-0:
    required: true

  pinctrl-names:
    required: true

  stop-bits:
    description: |
      Sets the number of stop bits. Defaults to standard of 1 if not specified.
    default: "1"

  data-bits:
    description: |
      Sets the number of data bits. Defaults to standard of 8 if not specified.
    default: 8

  ti,clkctl-id:
    type: int
    required: true
    description: |
      CLKCTL peripheral clock gate ID for this UART instance.
      Use CLKCTL_UART0 (0x4) for uart0, CLKCTL_UART1 (0x8) for uart1.

  dmas:
    description: |
      Optional TX & RX DMA specifiers. Each specifier will have a phandle
      reference to the DMA controller, the channel number, and the peripheral
      trigger source.

      Example for channels 2/3 with uart0txtrg/uart0rxtrg trigger sources:
        dmas = <&dma 2 6>, <&dma 3 7>;

  dma-names:
    description: |
      Required if the dmas property exists. This should be "tx" and "rx"
      to match the dmas property.

      Example:
        dma-names = "tx", "rx";
```
