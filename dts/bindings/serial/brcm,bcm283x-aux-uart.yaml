## dts/bindings/serial/ti,mspm0-uart.yaml
```yaml
description: TI MSPM0 UART

compatible: "ti,mspm0-uart"

include: [uart-controller.yaml, pinctrl-device.yaml, base.yaml]

properties:
  reg:
    required: true

  interrupts:
    required: true

  pinctrl-0:
    required: true

  pinctrl-names:
    required: true

  clk-div:
    type: int
    default: 1
    enum:
      - 1
      - 2
      - 3
      - 4
      - 5
      - 6
      - 7
      - 8
    description: |
      Clock divider selection value.

  rx-fifo-threshold:
    type: int
    default: 2
    enum: [0, 1, 2, 3, 4]
    description: |
     0 - MSPM0_UART_RX_FIFO_LEVEL_ONE_ENTRY
     1 - MSPM0_UART_RX_FIFO_LEVEL_1_4_FULL
     2 - MSPM0_UART_RX_FIFO_LEVEL_1_2_FULL
     3 - MSPM0_UART_RX_FIFO_LEVEL_3_4_FULL
     4 - MSPM0_UART_RX_FIFO_LEVEL_FULL

  tx-fifo-threshold:
    type: int
    default: 4
    enum: [0, 1, 2, 3, 4]
    description: |
      0 - MSPM0_UART_TX_FIFO_LEVEL_ONE_ENTRY
      1 - MSPM0_UART_TX_FIFO_LEVEL_1_4_EMPTY
      2 - MSPM0_UART_TX_FIFO_LEVEL_1_2_EMPTY
      3 - MSPM0_UART_TX_FIFO_LEVEL_3_4_EMPTY
      4 - MSPM0_UART_TX_FIFO_LEVEL_EMPTY

  is-unicomm-uart:
    type: boolean
    description: |
      Enables UNICOMMUART support.
```

## dts/bindings/serial/zephyr,bt-spp-uart.yaml
```yaml
# Copyright (c) 2026 Xiaomi Corporation
# SPDX-License-Identifier: Apache-2.0

description: UART over Bluetooth Classic SPP (RFCOMM) server

compatible: "zephyr,bt-spp-uart"

properties:
  channel:
    type: int
    default: 10
    description: |
      RFCOMM server channel number (1-30), registered locally and advertised
      via SDP. 0 means auto-allocate a dynamic channel.

  tx-fifo-size:
    type: int
    default: 1024
    description: |
      Size of the virtual UART TX FIFO (ring buffer) in bytes.
      The RX path has no byte FIFO: received RFCOMM frames are held as-is
      and their per-frame credits provide native flow control.
```

## dts/bindings/serial/zephyr,cdc-acm-uart.yaml
```yaml
# Copyright (c) 2021 Nordic Semiconductor ASA
# SPDX-License-Identifier: Apache-2.0

description: USB CDC ACM UART

compatible: "zephyr,cdc-acm-uart"

include: uart-controller.yaml

on-bus: usb

properties:
  tx-fifo-size:
    type: int
    default: 1024
    description: |
      Size of the virtual CDC ACM UART TX FIFO

  rx-fifo-size:
    type: int
    default: 1024
    description: |
      Size of the virtual CDC ACM UART RX FIFO

  memory-region:
    type: phandle
    description: |
      Non-cacheable memory region to keep the TX FIFO in, so that data not
      yet received by the host is sent after a reset. Images sharing the
      region may use different tx-fifo-size values.

  label:
    description: |
      The string defined by the label property is also used for the USB
      interface string descriptor.
```

## dts/bindings/serial/zephyr,rfc2217-server.yaml
```yaml
# SPDX-FileCopyrightText: Copyright The Zephyr Project Contributors
# SPDX-License-Identifier: Apache-2.0

title: RFC 2217 server

description: |
  A UART served over TCP with the Telnet COM port control option (RFC 2217),
  started at boot. Clients such as pyserial's rfc2217:// set the line and
  exchange data with the UART.

  Example:

    rfc2217-server {
            compatible = "zephyr,rfc2217-server";
            uart = <&uart1>;
            port = <2217>;
    };

compatible: "zephyr,rfc2217-server"

include: base.yaml

properties:
  uart:
    type: phandle
    required: true
    description: UART the clients get. Its driver must support the interrupt-driven API.

  port:
    type: int
    default: 2217
    description: TCP port the server listens on.
```

## dts/bindings/serial/zephyr,uart-emul-bridge.yaml
```yaml
# SPDX-FileCopyrightText: 2026 Muhammad Waleed Badar
# SPDX-License-Identifier: Apache-2.0

description: |
  Emulated UART bridge

  Bridges a UART with the wire side of a zephyr,uart-emul device: data
  received on the UART is queued on the receive side of the emulated UART,
  and data the emulated UART transmits is sent on the UART. A terminal on
  the UART then drives the console or shell running on the emulated UART.

  The direction property restricts the bridge to one way. The emulated UART
  reports its transmit data to a single consumer, so the backward direction
  cannot be combined with another consumer of that data, such as a display
  terminal attached to the same emulated UART; use the forward direction
  there.

compatible: "zephyr,uart-emul-bridge"

include: base.yaml

properties:
  uart:
    type: phandle
    required: true
    description: |
      UART at the wire side of the bridge.

  emul:
    type: phandle
    required: true
    description: |
      The zephyr,uart-emul device at the other side.

  direction:
    type: string
    default: "both"
    enum:
      - "both"
      - "forward"
      - "backward"
    description: |
      Direction of the data flow: both ways, forward from the UART to the
      emulated UART, or backward from the emulated UART to the UART.

examples:
  - |
    / {
            uart_console: uart_console {
                    compatible = "zephyr,uart-emul";
            };

            uart_kbd {
                    compatible = "zephyr,uart-emul-bridge";
                    uart = <&uart0>;
                    emul = <&uart_console>;
                    direction = "forward";
            };
    };
```
