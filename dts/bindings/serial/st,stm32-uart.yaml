## dts/bindings/serial/st,stm32-uart.yaml
```yaml
description: STM32 UART

compatible: "st,stm32-uart"

include: st,stm32-uart-base.yaml
```

## dts/bindings/serial/st,stm32-usart.yaml
```yaml
description: STM32 USART

compatible: "st,stm32-usart"

include: st,stm32-uart-base.yaml
```

## dts/bindings/serial/tcc,tccvcp-uart.yaml
```yaml
description: Telechips UART

compatible: "tcc,tccvcp-uart"

include: uart-controller.yaml

properties:
  reg:
    required: true
```

## dts/bindings/serial/telink,b91-uart.yaml
```yaml
# Copyright (c) 2021, Telink Semiconductor
# SPDX-License-Identifier: Apache-2.0

description: Telink B91 UART

compatible: "telink,b91-uart"

include: uart-controller.yaml

properties:
  reg:
    required: true

  interrupts:
    required: true

  pinctrl-0:
    type: phandles
    required: true
```

## dts/bindings/serial/telink,b9x-uart.yaml
```yaml
# Copyright (c) 2021-2024, Telink Semiconductor
# SPDX-License-Identifier: Apache-2.0

description: Telink B9x UART

compatible: "telink,b9x-uart"

include: [uart-controller.yaml, pinctrl-device.yaml]

properties:
  reg:
    required: true

  interrupts:
    required: true

  pinctrl-0:
    required: true
```

## dts/bindings/serial/telink,tlx-uart.yaml
```yaml
# Copyright (c) 2024, Telink Semiconductor
# SPDX-License-Identifier: Apache-2.0

description: Telink TLx UART

compatible: "telink,tlx-uart"

include: [uart-controller.yaml, pinctrl-device.yaml]

properties:
  reg:
    required: true

  interrupts:
    required: true

  pinctrl-0:
    required: true
```

## dts/bindings/serial/telink,w91-uart.yaml
```yaml
# Copyright (c) 2024, Telink Semiconductor
# SPDX-License-Identifier: Apache-2.0

description: Telink W91 UART

compatible: "telink,w91-uart"

include: [uart-controller.yaml, pinctrl-device.yaml]

properties:
  pinctrl-0:
    type: phandles
    required: true

  instance-id:
    type: int
    required: true
```

## dts/bindings/serial/ti,cc13xx-cc26xx-uart.yaml
```yaml
# Copyright (c) 2019 Brett Witherspoon
# SPDX-License-Identifier: Apache-2.0

description: TI SimpleLink CC13xx / CC26xx UART node

compatible: "ti,cc13xx-cc26xx-uart"

include: [uart-controller.yaml, pinctrl-device.yaml, base.yaml]

properties:
  reg:
    required: true

  interrupts:
    required: true

  current-speed:
    required: true

  stop-bits:
    description: |
      Sets the number of stop bits. Defaults to standard of 1 if not specified.
    default: "1"

  data-bits:
    description: |
      Sets the number of data bits. Defaults to standard of 8 if not specified.
    default: 8
```

## dts/bindings/serial/ti,cc23x0-uart.yaml
```yaml
# Copyright (c) 2024 Texas Instruments Incorporated
# Copyright (c) 2024 BayLibre, SAS
#
# SPDX-License-Identifier: Apache-2.0

description: TI SimpleLink CC23X0 UART node

compatible: "ti,cc23x0-uart"

include: [uart-controller.yaml, pinctrl-device.yaml, base.yaml]

properties:
  reg:
    required: true

  interrupts:
    required: true

  pinctrl-0:
    required: true

  pinctrl-names:
    required: true

  stop-bits:
    description: |
      Sets the number of stop bits. Defaults to standard of 1 if not specified.
    default: "1"

  data-bits:
    description: |
      Sets the number of data bits. Defaults to standard of 8 if not specified.
    default: 8

  dmas:
    description: |
      Optional TX & RX DMA specifiers. Each specifier will have a phandle
      reference to the DMA controller, the channel number, and the peripheral
      trigger source.

      Example for channels 2/3 with uart0txtrg/uart0rxtrg trigger sources:
        dmas = <&dma 2 6>, <&dma 3 7>;

  dma-names:
    description: |
      Required if the dmas property exists. This should be "tx" and "rx"
      to match the dmas property.

      Example:
        dma-names = "tx", "rx";
```

## dts/bindings/serial/ti,cc32xx-uart.yaml
```yaml
description: TI CC32XX UART

compatible: "ti,cc32xx-uart"

include: [uart-controller.yaml, pinctrl-device.yaml]

properties:
  reg:
    required: true

  interrupts:
    required: true

  pinctrl-0:
    required: true

  pinctrl-names:
    required: true
```

## dts/bindings/serial/ti,msp432p4xx-uart.yaml
```yaml
description: TI MSP432P4XX UART

compatible: "ti,msp432p4xx-uart"

include: uart-controller.yaml

properties:
    reg:
      required: true

    interrupts:
      required: true
```

## dts/bindings/serial/ti,stellaris-uart.yaml
```yaml
description: TI Stellaris UART

compatible: "ti,stellaris-uart"

include: uart-controller.yaml

properties:
  reg:
    required: true

  interrupts:
    required: true
```

## dts/bindings/serial/ti,tiva-c-uart.yaml
```yaml
# SPDX-License-Identifier: Apache-2.0
#
# Copyright (c) 2026 Linumiz
# Author: Sri Surya <srisurya@linumiz.com>

description: TI Tiva C Series UART

compatible: "ti,tiva-c-uart"

include: [uart-controller.yaml, pinctrl-device.yaml]

properties:
  reg:
    required: true

  clocks:
    required: true
    description: |
      Phandle to the system clock providing the UART baud-rate reference.

  peripheral-id:
    type: int
    required: true
    description: |
      UART peripheral index (0-7). Used to enable the clock via
      SysCtlPeripheralEnable(SYSCTL_PERIPH_UARTn).

  pinctrl-0:
    required: true

  pinctrl-names:
    required: true
```

## dts/bindings/serial/ti,tms570-uart.yaml
```yaml
# Copyright (c) 2025, ispace, inc.
# SPDX-License-Identifier: Apache-2.0

description: TI TMS570 UART

compatible: "ti,tms570-uart"

include: [uart-controller.yaml, pinctrl-device.yaml, base.yaml]

properties:
  reg:
    required: true
```

## dts/bindings/serial/uart-controller-pin-inversion.yaml
```yaml
# Copyright (c) 2024 Croxel, Inc.
# SPDX-License-Identifier: Apache-2.0

description: Pin Inversion fields for UART controllers

properties:
  tx-invert:
    type: boolean
    description: |
      Invert the binary logic of tx pin. When enabled, physical logic levels are inverted and
      we use 1=Low, 0=High instead of 1=High, 0=Low.
  rx-invert:
    type: boolean
    description: |
      Invert the binary logic of rx pin. When enabled, physical logic levels are inverted and
      we use 1=Low, 0=High instead of 1=High, 0=Low.
```

## dts/bindings/serial/uart-controller.yaml
```yaml
# Common fields for UART controllers

include: base.yaml

bus: uart

properties:
  clock-frequency:
    type: int
    description: Clock frequency information for UART operation
  current-speed:
    type: int
    description: Initial baud rate setting for UART
  hw-flow-control:
    type: boolean
    description: Set to enable RTS/CTS flow control at boot time
  parity:
    type: string
    description: |
      Configures the parity of the adapter. Enumeration id 0 for none, 1 for odd
      and 2 for even parity, 3 for mark parity and 4 for space parity.
      Default to none if not specified.
    enum:
      - "none"
      - "odd"
      - "even"
      - "mark"
      - "space"
    default: "none"
  stop-bits:
    type: string
    description: |
      Sets the number of stop bits.
    enum:
      - "0_5"
      - "1"
      - "1_5"
      - "2"
  data-bits:
    type: int
    description: |
      Sets the number of data bits.
    enum:
      - 5
      - 6
      - 7
      - 8
      - 9
  framing-error-reporting:
    type: string
    description: |
      Describes how the UART hardware reports framing errors relative
      to byte reads via uart_fifo_read() and uart_err_check().

      This property is used by protocols that rely on framing error
      detection (e.g. DMX512 break detection) to adapt their error
      handling strategy to the underlying hardware. This is especially
      important for protocols that need to read the byte immediately
      following a framing error.

      "FIFO_HEAD" - Error flags reflect the byte at the FIFO head
        BEFORE it is read. Reading pops the byte and updates the
        flags for the new head. Callers can check errors before
        reading to determine if the next byte is clean.
        Multiple error bytes in the FIFO are reported individually.
        Examples: NS16550, STM32 USART (with FIFO enabled).

      "LAST_READ" - Error flags reflect the byte most recently read
        from the data register (AFTER the read). Callers must read
        first, then check. Requires explicit clearing of the error
        status register between reads. Multiple error bytes in the
        FIFO are reported individually as each byte is read.
        Examples: ARM PL011 (RP2040, RP2350).

      "STICKY_MULTIPLE" - A global error flag is set on the first
        framing error and cleared by uart_err_check(). The flag
        does NOT re-assert for error bytes already in the FIFO.
        Multiple error bytes may be buffered, but only the first
        is reported; subsequent error bytes are indistinguishable
        from clean bytes.
        Examples: NXP LPUART (i.MX RT, Kinetis), Atmel SAM0 (SAMD21).

      "STICKY_SINGLE" - Same sticky-and-clear semantics as
        "STICKY_MULTIPLE", but the hardware buffers only one byte
        at a time (e.g. via single-byte DMA transfers). The
        distinction from "STICKY_MULTIPLE" is that there are no
        "hidden" error bytes behind the first one; each byte
        triggers a separate ISR invocation.
        Examples: Nordic nRF UARTE (nRF52, nRF53, nRF91).

      "ISR_SAVED" - Framing errors are captured in the UART ISR and
        stored in driver state. Cleared when the application calls
        uart_err_check(). Behaves like "STICKY_MULTIPLE" from the
        caller's perspective (one report per ISR invocation,
        regardless of how many error bytes triggered the ISR).
        Examples: Espressif ESP32 UART (all variants).
    enum:
      - "FIFO_HEAD"
      - "LAST_READ"
      - "STICKY_MULTIPLE"
      - "STICKY_SINGLE"
      - "ISR_SAVED"
```

## dts/bindings/serial/uart-device.yaml
```yaml
# Copyright (c) 2018, Foundries.io
# SPDX-License-Identifier: Apache-2.0

# Common fields for UART devices

include: base.yaml

on-bus: uart
```

## dts/bindings/serial/uart-rs485-controller.yaml
```yaml
# Common fields for uart-rs485 controllers

include: uart-controller.yaml

properties:
  rs485-enabled:
    type: boolean
    description: Enable rs485 mode
  rs485-de-gpios:
    type: phandle-array
    description: Output for contactor and relay 1
  rs485-full-duplex-mode:
    type: boolean
    description: Enable rs485 in full duplex mode
  rs485-de-active-low:
    type: boolean
    description: Driver enable active low polarity
  rs485-re-active-high:
    type: boolean
    description: Receiver enable active high polarity
  rs485-assertion-time-de-us:
    type: int
    default: 0
    description: Driver enable assertion time in nanoseconds
  rs485-deassertion-time-de-us:
    type: int
    default: 0
    description: Driver enable deassertion time in nanoseconds
  rs485-assertion-time-re-us:
    type: int
    default: 0
    description: Receiver enable assertion time in nanoseconds
  rs485-deassertion-time-re-us:
    type: int
    default: 0
    description: Receiver enable deassertion time in nanoseconds
```

## dts/bindings/serial/uart.yaml
```yaml
# Common fields for UART controllers

inherits:
    !include base.yaml

child:
    bus: uart

properties:
    clock-frequency:
      type: int
      category: optional
      description: Clock frequency information for UART operation
    current-speed:
      type: int
      category: optional
      description: Initial baud rate setting for UART
    label:
      category: required
```

## dts/bindings/serial/ucb,htif-uart.yaml
```yaml
# SPDX-License-Identifier: Apache-2.0
description: HTIF UART for Spike/FESVR
compatible: "ucb,htif"

include: base.yaml

properties:
  label:
    type: string
    required: true
    description: Human-readable string describing the device
```

## dts/bindings/serial/unisoc,uwp-uart.yaml
```yaml
# Copyright (c) 2019, Manivannan Sadhasivam
# SPDX-License-Identifier: Apache-2.0

description: UNISOC UWP Uart

compatible: "unisoc,uwp-uart"

include: uart-controller.yaml

properties:
    reg:
      required: true

    interrupts:
      required: true
```

## dts/bindings/serial/usbh,quectel-driver.yaml
```yaml
# Copyright (c) 2025 Quectel Wireless Solutions Co
# SPDX-License-Identifier: Apache-2.0

description: USBH QUECTEL DRIVER

compatible: "usbh,quectel-driver"

include: uart-controller.yaml
```

## dts/bindings/serial/virtio,console.yaml
```yaml
# Copyright (c) 2025 Antmicro <www.antmicro.com>
# SPDX-License-Identifier: Apache-2.0

description: VIRTIO Console device

compatible: "virtio,console"

include: [base.yaml]
```

## dts/bindings/serial/wch,ch5xx-uart.yaml
```yaml
# SPDX-FileCopyrightText: 2026 SMILE (smile.eu)
# SPDX-License-Identifier: Apache-2.0

description: WCH CH5xx UART

compatible: "wch,ch5xx-uart"

include: [uart-controller.yaml, pinctrl-device.yaml]

properties:
  reg:
    required: true

  data-bits:
    default: 8

  stop-bits:
    default: "1"

  prescaler-divisor:
    type: int
    default: 1
    description: |
      Prescaler divisor for baud rate generation between 1 and 127.
      This value is used to calculate the baud rate register value as follows:
      baud_rate_register =
                    2 * clock-frequency / prescaler-divisor / 16 / baud_rate
```

## dts/bindings/serial/wch,sdi-console.yaml
```yaml
# Copyright (c) 2026 Michael Hope <michaelh@juju.nz>
# SPDX-License-Identifier: Apache-2.0

description: WCH SDI console

compatible: "wch,sdi-console"

include: base.yaml
```
