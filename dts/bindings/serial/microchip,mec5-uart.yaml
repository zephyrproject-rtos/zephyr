## dts/bindings/serial/nxp,kinetis-lpuart.yaml
```yaml
description: Kinetis LPUART

compatible: "nxp,kinetis-lpuart"

include: [uart-controller.yaml, uart-controller-pin-inversion.yaml, pinctrl-device.yaml]

properties:
  reg:
    required: true

  nxp,loopback:
    type: boolean
    description: |
      Enable loopback mode on LPUART peripheral. When present, RX pin is
      disconnected, and transmitter output is internally connected to
      the receiver input.

  single-wire:
    type: boolean
    description: |
      Enable the single wire half-duplex communication.
      Using this mode, TX and RX lines are internally connected and
      only TX pin is used afterwards and should be configured.
      RX/TX conflicts must be handled on user side.

  nxp,rs485-mode:
    type: boolean
    description: |
      Set to enable RTS signal, which can be used to enable the driver
      of an external RS-485 transceiver. Note hw-flow-control should be
      set to false.

  nxp,rs485-de-active-low:
    type: boolean
    description: RTS polarity at RS485 mode.
```

## dts/bindings/serial/nxp,kinetis-uart.yaml
```yaml
description: Kinetis UART

compatible: "nxp,kinetis-uart"

include: [uart-controller.yaml, pinctrl-device.yaml]

properties:
    reg:
      required: true

    interrupts:
      required: true

    clocks:
      required: true

    pinctrl-0:
      type: phandles
      required: true
```

## dts/bindings/serial/nxp,lpc11u6x-uart.yaml
```yaml
description: LPC11U6X UART

compatible: "nxp,lpc11u6x-uart"

include: [uart-controller.yaml, pinctrl-device.yaml]

properties:
    reg:
      required: true

    interrupts:
      required: true

    clocks:
      required: true

    pinctrl-0:
      required: true

    pinctrl-names:
      required: true
```

## dts/bindings/serial/nxp,lpc84x-uart.yaml
```yaml
# Copyright (c) 2026, Aerlync Labs Inc.
# SPDX-License-Identifier: Apache-2.0

description: NXP LPC84x UART

compatible: "nxp,lpc84x-uart"

include:
  - name: uart-controller.yaml
  - name: pinctrl-device.yaml

properties:
  reg:
    required: true

  interrupts:
    required: true

  clocks:
    required: true

  clock-source:
    type: string
    enum: ["fro", "mainclk", "frg0", "frg1", "frodiv"]
    default: "fro"
    description: |
      UART clock source.
        - "fro": FRO oscillator
        - "mainclk": Main clock
        - "frg0": Fractional rate generator 0
        - "frg1": Fractional rate generator 1
        - "frodiv": FRO divided clock
```

## dts/bindings/serial/nxp,lpuart.yaml
```yaml
description: NXP LPUART

compatible: "nxp,lpuart"

include: [uart-controller.yaml, uart-controller-pin-inversion.yaml, pinctrl-device.yaml]

properties:
  reg:
    required: true

  nxp,loopback:
    type: boolean
    description: |
      Enable loopback mode on LPUART peripheral. When present, RX pin is
      disconnected, and transmitter output is internally connected to
      the receiver input.

  single-wire:
    type: boolean
    description: |
      Enable the single wire half-duplex communication.
      Using this mode, TX and RX lines are internally connected and
      only TX pin is used afterwards and should be configured.
      RX/TX conflicts must be handled on user side.

  nxp,rs485-mode:
    type: boolean
    description: |
      Set to enable RTS signal, which can be used to enable the driver
      of an external RS-485 transceiver. Note hw-flow-control should be
      set to false.

  nxp,rs485-de-active-low:
    type: boolean
    description: RTS polarity at RS485 mode.

  nxp,disable-rx-dma-scatter:
    type: boolean
    description: |
      Disable RX DMA destination scatter mode for this LPUART instance.

      This can be used on platforms where the DMA backend misbehaves when
      UART async RX combines cyclic mode with destination scatter enabled.

  nxp,defer-rx-dma-reload:
    type: boolean
    description: |
      Defer RX DMA reload until the completion callback for this LPUART
      instance.

      This can be used on platforms where reloading the next RX buffer
      while the channel is busy is unreliable.
```

## dts/bindings/serial/nxp,s32-linflexd.yaml
```yaml
# Copyright 2022, 2025 NXP
# SPDX-License-Identifier: Apache-2.0

description: NXP S32 LINFlexD

compatible: "nxp,s32-linflexd"

include: [uart-controller.yaml, pinctrl-device.yaml]

properties:
  reg:
    required: true

  interrupts:
    required: true

  pinctrl-0:
    required: true

  pinctrl-names:
    required: true

  clocks:
    required: true

  current-speed:
    description: |
      Initial baud rate setting for UART. Defaults to standard baudrate of 115200 if not specified.
    default: 115200

  stop-bits:
    description: |
      Sets the number of stop bits. Defaults to standard of 1 if not specified.
    default: "1"

  data-bits:
    description: |
      Sets the number of data bits. Defaults to standard of 8 if not specified.
    default: 8
```

## dts/bindings/serial/nxp,sc28c94-uart.yaml
```yaml
# Copyright (c) 2022 Trackunit A/S
# SPDX-License-Identifier: Apache-2.0

description: NXP SC28C94 UART interface which is part of SC28C94

compatible: "nxp,sc28c94-uart"

include: [base.yaml, uart-controller.yaml]

on-bus: nxp,sc28c94

bus: uart
```
