## dts/bindings/serial/microchip,mec5-uart.yaml
```yaml
# Copyright (c) 2024 Microchip Technology Inc.
# SPDX-License-Identifier: Apache-2.0

description: Microchip MEC5 UART

compatible: "microchip,mec5-uart"

include: [uart-controller.yaml, pinctrl-device.yaml]

properties:
  reg:
    required: true

  interrupts:
    required: true

  pinctrl-0:
    required: true

  pinctrl-names:
    required: true

  fifo-mode-disable:
    type: boolean
    description: |
      Disable 16550 FIFO mode. Both 16-byte TX and RX FIFOs will be
      disabled. UART will revert to a one byte holding register for
      TX and RX.

  rx-fifo-trig:
    type: string
    default: "8"
    description: |
      RX FIFO byte count trigger limit. When the number of received bytes
      reaches this level the UART will signal an interrupt if enabled.
    enum:
      - "1"
      - "4"
      - "8"
      - "14"

  use-extclk:
    type: boolean
    description: |
      Optional source of an external UART clock. If present the
      driver will use this pin as the UART input clock source.
      The pin should have a 1.8432 MHz clock waveform for normal
      UART BAUD rates or 48 MHz for high speed BAUD rates.
      Refer to data sheet for the pin(s) available as external UART
      clock input. The pin should be added to the default PINCTRL list.
      Example using external 1.8432MHz clock on MEC5 external UART clock pin.

        clock-frequency = <1843200>;
        pinctrl-0 = < &uart1_tx_gpio170 &uart1_tx_gpio171 &uart_clk_gpio025>;
        pinctrl-names = "default";
```

## dts/bindings/serial/microchip,pic32cxsg-uart.yaml
```yaml
description: Microchip PIC32CXSG SERCOM UART driver

compatible: "microchip,pic32cxsg-uart"

include:
  - name: uart-controller.yaml
  - name: pinctrl-device.yaml

properties:
  reg:
    required: true

  interrupts:
    required: true

  clocks:
    required: true

  clock-names:
    required: true

  rxpo:
    type: int
    required: true
    description: |
      Receive Data Pinout. An enumeration with the following values:

      +-------+---------------+
      | Value | RX Pin        |
      +-------+---------------+
      |     0 | SERCOM_PAD[0] |
      +-------+---------------+
      |     1 | SERCOM_PAD[1] |
      +-------+---------------+
      |     2 | SERCOM_PAD[2] |
      +-------+---------------+
      |     3 | SERCOM_PAD[3] |
      +-------+---------------+


  txpo:
    type: int
    required: true
    description: |
      Transmit Data Pinout. An enumeration with values that depend on the
      hardware being used. This controls both the transmit pins and if
      hardware flow control is used.

      PIC32CXSGD20:

      +-------+---------------+
      | Value | TX Pin        |
      +-------+---------------+
      |     0 | SERCOM_PAD[0] |
      +-------+---------------+
      |     1 | SERCOM_PAD[2] |
      +-------+---------------+

      PIC32CXSGD21/DA21/R21:

      +-------+---------------+---------------+---------------+
      | Value | TX Pin        | RTS           | CTS           |
      +-------+---------------+---------------+---------------+
      |     0 | SERCOM_PAD[0] |           N/A |           N/A |
      +-------+---------------+---------------+---------------+
      |     1 | SERCOM_PAD[2] |           N/A |           N/A |
      +-------+---------------+---------------+---------------+
      |     2 | SERCOM_PAD[0] | SERCOM_PAD[2] | SERCOM_PAD[3] |
      +-------+---------------+---------------+---------------+
      |     3 | Reserved                                      |
      +-------+-----------------------------------------------+

      PIC32CXSGL2x/C2x:

      +-------+----------------+---------------+--------------+
      | Value | TX Pin        | RTS           | CTS           |
      +-------+---------------+---------------+---------------+
      |     0 | SERCOM_PAD[0] |           N/A |           N/A |
      +-------+---------------+---------------+---------------+
      |     1 | SERCOM_PAD[2] |           N/A |           N/A |
      +-------+---------------+---------------+---------------+
      |     2 | SERCOM_PAD[0] | SERCOM_PAD[2] | SERCOM_PAD[3] |
      +-------+---------------+---------------+---------------+
      |     3 | SERCOM_PAD[0] | SERCOM_PAD[2] |           N/A |
      +-------+---------------+---------------+---------------+

      PIC32CXSGD5/E5:

      +-------+---------------+---------------+---------------+
      | Value | TX Pin        | RTS           | CTS           |
      +-------+---------------+---------------+---------------+
      |     0 | SERCOM_PAD[0] |           N/A |           N/A |
      +-------+---------------+---------------+---------------+
      |     1 | Reserved                                      |
      +-------+---------------+---------------+---------------+
      |     2 | SERCOM_PAD[0] | SERCOM_PAD[2] | SERCOM_PAD[3] |
      +-------+---------------+---------------+---------------+
      |     3 | SERCOM_PAD[0] | SERCOM_PAD[2] |           N/A |
      +-------+---------------+---------------+---------------+


  collision-detection:
    type: boolean
    description: Enable collision detection for half-duplex mode.

  dmas:
    description: |
      Optional TX & RX dma specifiers.  Each specifier will have a phandle
      reference to the dmac controller, the channel number, and peripheral
      trigger source.

      For example dmas for TX, RX on SERCOM3
         dmas = <&dmac 0 0xb>, <&dmac 0 0xa>;

  dma-names:
    description: |
      Required if the dmas property exists.  This should be "tx" and "rx"
      to match the dmas property.

      For example
         dma-names = "tx", "rx";
```

## dts/bindings/serial/microchip,pic32cxsg-usart.yaml
```yaml
description: Microchip PIC32CXSG family USART

compatible: "microchip,pic32cxsg-usart"

include:
  - name: uart-controller.yaml
  - name: pinctrl-device.yaml

properties:
  reg:
    required: true

  interrupts:
    required: true

  clocks:
    required: true
```

## dts/bindings/serial/microchip,sercom-g1-uart.yaml
```yaml
# Copyright (c) 2025 Microchip Technology Inc.
# SPDX-License-Identifier: Apache-2.0

title: Microchip SERCOM UART controller

description: |
  Microchip SERCOM UART driver.

  Group g1 SERCOM UART driver supports following hardware peripherals:
    - module name="SERCOM" id="U2201" version="3.1.1","5.0.0"

compatible: "microchip,sercom-g1-uart"

include:
  - name: uart-controller.yaml
  - name: pinctrl-device.yaml

properties:
  reg:
    required: true

  interrupts:
    required: true

  clocks:
    required: true

  clock-names:
    required: true

  rxpo:
    type: int
    required: true
    description: |
      Define the receive data (RxD) pin configuration.
      An enumeration with the following values:

      +-------+---------------+
      | Value | RX Pin        |
      +-------+---------------+
      |     0 | SERCOM_PAD[0] |
      +-------+---------------+
      |     1 | SERCOM_PAD[1] |
      +-------+---------------+
      |     2 | SERCOM_PAD[2] |
      +-------+---------------+
      |     3 | SERCOM_PAD[3] |
      +-------+---------------+

  txpo:
    type: int
    required: true
    description: |
      Transmit Data Pinout. An enumeration with values that depend on the
      hardware being used. This controls both the transmit pins and if
      hardware flow control is used.

      SAMD5/E5:

      +-------+---------------+---------------+---------------+
      | Value | TX Pin        | RTS           | CTS           |
      +-------+---------------+---------------+---------------+
      |     0 | SERCOM_PAD[0] |           N/A |           N/A |
      +-------+---------------+---------------+---------------+
      |     1 | Reserved                                      |
      +-------+---------------+---------------+---------------+
      |     2 | SERCOM_PAD[0] | SERCOM_PAD[2] | SERCOM_PAD[3] |
      +-------+---------------+---------------+---------------+
      |     3 | SERCOM_PAD[0] | SERCOM_PAD[2] |           N/A |
      +-------+---------------+---------------+---------------+

  clock-external:
    type: boolean
    description: |
      select external clock for uart (external clock if true).

  collision-detection:
    type: boolean
    description: |
      Enable collision detection for half-duplex mode.

  run-in-standby-en:
    type: int
    enum:
      - 0
      - 1
    default: 1
    description: |
      This property defines the functionality in standby sleep mode.

      0: Generic clock is disabled when ongoing transfer is finished. The device
         will not wake up on Transfer Complete interrupt unless the appropriate
         ONDEMAND bits are set in the clocking chain.
      1: Wake on Receive Complete interrupt. Generic clock is enabled in all sleep modes.
         Any interrupt can wake up the device.

  dmas:
    description: |
      Optional TX & RX dma specifiers.

      Each specifier will have a phandle reference to the dmac controller,
      the channel number, and peripheral trigger source.

      For example dmas for TX, RX on SERCOM3
         dmas = <&dmac 0 0xb>, <&dmac 0 0xa>;

  dma-names:
    description: |
      Required if the dmas property exists.  This should be "tx" and "rx"
      to match the dmas property.

      For example
         dma-names = "tx", "rx";
```

## dts/bindings/serial/microchip,uart-g1.yaml
```yaml
# Copyright (C) 2026 Microchip Technology Inc.
#
# SPDX-License-Identifier: Apache-2.0
#

title: Microchip UART g1 controller

description: |
  Microchip Universal Asynchronous Receiver Transmitter (UART) driver.

  Group g1 UART driver supports following hardware peripherals:
    - module name="UART" id="6418" version="R"

compatible: "microchip,uart-g1"

include:
  - name: uart-controller.yaml
  - name: pinctrl-device.yaml

properties:
  reg:
    type: array
    required: true
    description: |
      Specifies the base address and size of the UART controller memory-mapped registers.

  interrupts:
    type: array
    required: true
    description: |
      Specifies the interrupt numbers associated with the UART controller.

  clocks:
    type: phandle-array
    required: true
    description: |
      Specifies the clock reference for this UART instance.
```

## dts/bindings/serial/microsemi,coreuart.yaml
```yaml
# Copyright (c) 2018 Linaro Limited
# SPDX-License-Identifier: Apache-2.0

description: SiFive UART

compatible: "microsemi,coreuart"

include: uart-controller.yaml

properties:
  reg:
    required: true
```

## dts/bindings/serial/neorv32,uart.yaml
```yaml
description: NEORV32 UART

compatible: "neorv32,uart"

include: uart-controller.yaml

properties:
  reg:
    required: true

  interrupts:
    required: true

  interrupt-names:
    required: true

  current-speed:
    required: true

  syscon:
    type: phandle
    required: true
    description: |
      phandle to syscon (NEORV32 SYSINFO) node.
```

## dts/bindings/serial/nordic,nrf-uart.yaml
```yaml
description: |
  Nordic nRF family UART.

  This is the binding for the peripheral without EasyDMA support.
  See the "nordic,nrf-uarte" binding for UARTE, i.e. UART with
  EasyDMA.

compatible: "nordic,nrf-uart"

include: nordic,nrf-uart-common.yaml
```

## dts/bindings/serial/nordic,nrf-uarte.yaml
```yaml
description: Nordic nRF family UARTE (UART with EasyDMA)

compatible: "nordic,nrf-uarte"

include: ["nordic,nrf-uart-common.yaml", "memory-region.yaml"]

properties:
  endtx-stoptx-supported:
    type: boolean
    description: |
      UARTE has ENDTX_STOPTX HW short.

  frame-timeout-supported:
    type: boolean
    description: |
      UARTE has RX frame timeout HW feature.

  default-gpio-port:
    type: phandle
    description: |
      UARTE default GPIO port.

  cross-domain-pins-supported:
    type: boolean
    description: |
      UARTE allows usage of cross domain pins with constant latency mode required.

  timer:
    type: phandle
    description: |
      Timer instance used to count received bytes. Due to issues with frame timeout
      feature it is required to reliably receive data in cases where flow control
      is not used and new byte can appear on the line when frame timeout expires
      but before it is handled.
```

## dts/bindings/serial/nuclei,hummingbird-uart.yaml
```yaml
# Copyright (c) 2021, ATL Electronics
# SPDX-License-Identifier: Apache-2.0

description: Nuclei HummingBird UART

compatible: "nuclei,hummingbird-uart"

include: uart-controller.yaml
```

## dts/bindings/serial/nuvoton,npcx-uart-npckn.yaml
```yaml
# Copyright (c) 2025 Nuvoton Technology Corporation.
# SPDX-License-Identifier: Apache-2.0

description: |
  Nuvoton npcx serial uart for npckn variant

compatible: "nuvoton,npcx-uart-npckn"

include: nuvoton,npcx-uart.yaml
```

## dts/bindings/serial/nuvoton,npcx-uart.yaml
```yaml
# Copyright (c) 2020 Nuvoton Technology Corporation.
# SPDX-License-Identifier: Apache-2.0

description: Nuvoton, NPCX-UART node

compatible: "nuvoton,npcx-uart"

include: [uart-controller.yaml, pinctrl-device.yaml]

properties:
    reg:
        required: true
    clocks:
        required: true
    pinctrl-0:
        required: true
    pinctrl-names:
        required: true
    uart-rx:
        type: phandle
        required: true
        description: |
            Mapping table between Wake-Up Input (WUI) and uart rx START signal.

            For example the WUI mapping on NPCX7 UART1 would be
               uart-rx = <&wui_cr_sin1>;
```

## dts/bindings/serial/nuvoton,numaker-uart.yaml
```yaml
# (c) Nuvoton Technology Corp. All rights reserved.
# SPDX-License-Identifier: Apache-2.0

description: Nuvoton, Numaker-UART

compatible: "nuvoton,numaker-uart"

include: [uart-controller.yaml, reset-device.yaml, pinctrl-device.yaml]

properties:
  reg:
    required: true

  interrupts:
    required: true

  resets:
    required: true

  clocks:
    required: true

  pinctrl-0:
    required: true

  pinctrl-names:
    required: true
```

## dts/bindings/serial/nuvoton,numicro-uart.yaml
```yaml
description: NUVOTON NUMICRO FAMILY UART

compatible: "nuvoton,numicro-uart"

include: [uart-controller.yaml, reset-device.yaml, pinctrl-device.yaml]

properties:
  reg:
    required: true

  resets:
    required: true

  clocks:
    required: true

  stop-bits:
    default: "1"

  data-bits:
    default: 8

  pinctrl-0:
    required: true
```

## dts/bindings/serial/nxp,flexcomm-uart.yaml
```yaml
# Copyright 2026
# SPDX-License-Identifier: Apache-2.0

description: NXP Flexcomm UART

compatible: "nxp,flexcomm-uart"

include: [uart-controller.yaml, "nxp,lpc-flexcomm.yaml"]
```

## dts/bindings/serial/nxp,imx-iuart.yaml
```yaml
description: |
    This binding gives a base representation of the NXP iMX IUART

compatible: "nxp,imx-iuart"

include: [uart-controller.yaml, pinctrl-device.yaml]

properties:
  reg:
    required: true

  clocks:
    required: true

  pinctrl-0:
    required: true

  pinctrl-names:
    required: true
```

## dts/bindings/serial/nxp,imx-uart.yaml
```yaml
# Copyright 2017, 2024 NXP
# SPDX-License-Identifier: Apache-2.0

description: iMX UART

compatible: "nxp,imx-uart"

include: [uart-controller.yaml, pinctrl-device.yaml, "nxp,rdc-policy.yaml"]

properties:
  reg:
    required: true

  interrupts:
    required: true

  modem-mode:
    type: int
    required: true
    description: Set the UART Port to modem mode 0 (dce) 64 (dte)

  pinctrl-0:
    required: true

  pinctrl-names:
    required: true
```

## dts/bindings/serial/nxp,kinetis-lpsci.yaml
```yaml
description: Kinetis LPSCI UART

compatible: "nxp,kinetis-lpsci"

include: [uart-controller.yaml, pinctrl-device.yaml]

properties:
  reg:
    required: true

  interrupts:
    required: true

  pinctrl-0:
    type: phandles
    required: true
```
