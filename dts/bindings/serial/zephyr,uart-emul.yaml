## dts/bindings/serial/zephyr,uart-emul.yaml
```yaml
# Copyright (c) 2023, Fabian Blatz
# SPDX-License-Identifier: Apache-2.0

description: UART Emulator

compatible: "zephyr,uart-emul"

include: uart-controller.yaml

properties:
  tx-fifo-size:
    type: int
    default: 256
    description: |
      Size of the virtual UART TX FIFO

  rx-fifo-size:
    type: int
    default: 256
    description: |
      Size of the virtual UART RX FIFO

  loopback:
    type: boolean
    description: |
      Connects TX to RX internally creating a loop back connection. Useful
      for testing.

  latch-buffer-size:
    type: int
    default: 1
    description: |
      Size of the virtual UART latch buffer.

  supported-modes:
    type: string-array
    enum:
      - "polling"
      - "interrupt-driven"
      - "async"
    default: ["polling", "interrupt-driven", "async"]
    description: |
      Modes of the UART API the emulator supports, the interrupt-driven and asynchronous ones when
      their Kconfig options are enabled. Leaving one out emulates a UART driver that does not
      implement it: its operations are missing, as with such a driver. Polling, which every UART
      driver implements, is always supported, so "polling" alone emulates a UART with polling
      only.
```

## dts/bindings/sfp/sff,cmis.yaml
```yaml
# Copyright The Zephyr Project Contributors
# SPDX-License-Identifier: Apache-2.0

description: |
  Cage for a CMIS managed pluggable transceiver (QSFP-DD, OSFP, SFP-DD,
  DSFP).

  As with sff,sfp, the node describes the cage on the board, not the module
  in it. CMIS modules answer at the fixed I2C address 0x50 on the bus given
  by i2c-bus and use a paged memory model: a 128-byte Lower Memory that is
  always accessible and 128-byte upper pages selected through the
  page-select register. The driver reads Lower Memory and Page 00h.

  The GPIO properties use the QSFP-DD signal names. The driver uses
  modprsl-gpios to detect the module; the other lines are described for the
  board and are not driven yet.

  Example:

    qsfp0: qsfp-cage {
      compatible = "sff,cmis";
      i2c-bus = <&i2c2>;
      modprsl-gpios = <&gpio1 0 GPIO_ACTIVE_LOW>;
      intl-gpios = <&gpio1 1 GPIO_ACTIVE_LOW>;
      resetl-gpios = <&gpio1 2 GPIO_ACTIVE_LOW>;
      lpmode-gpios = <&gpio1 3 GPIO_ACTIVE_HIGH>;
    };

compatible: "sff,cmis"

include: base.yaml

properties:
  i2c-bus:
    type: phandle
    required: true
    description: I2C controller the cage's management interface is wired to.

  modprsl-gpios:
    type: phandle-array
    description: |
      ModPrsL module presence input. A module pulls ModPrsL low, so this is
      normally GPIO_ACTIVE_LOW and reads 1 while a module is inserted.
      Without this property a module is assumed to be present.

  intl-gpios:
    type: phandle-array
    description: IntL interrupt input from the module.

  resetl-gpios:
    type: phandle-array
    description: ResetL module reset output.

  lpmode-gpios:
    type: phandle-array
    description: LPMode low-power mode output.

  modsell-gpios:
    type: phandle-array
    description: ModSelL module select output, for cages sharing one I2C bus.
```

## dts/bindings/sfp/sff,sff8472.yaml
```yaml
# Copyright The Zephyr Project Contributors
# SPDX-License-Identifier: Apache-2.0

description: |
  SFF-8472 managed pluggable transceiver (SFP, SFP+, SFP28).

  The serial ID page (A0h) is read at the node's I2C address, which is 0x50 for
  a standard module. The digital diagnostic monitoring page (A2h) is read at the
  address given by the diagnostics-address property, 0x51 by default.

compatible: "sff,sff8472"

include: i2c-device.yaml

properties:
  diagnostics-address:
    type: int
    default: 0x51
    description: |
      I2C address of the SFF-8472 digital diagnostic monitoring page (A2h).
```

## dts/bindings/sfp/sff,sfp.yaml
```yaml
# Copyright The Zephyr Project Contributors
# SPDX-License-Identifier: Apache-2.0

description: |
  SFP, SFP+ or SFP28 cage for an SFF-8472 managed pluggable transceiver.

  The node describes the cage on the board, not the module in it: a module
  can be absent or exchanged at run time. The module's management memory is
  reached on the I2C bus given by i2c-bus, at the addresses SFF-8472 fixes:
  0x50 for the serial ID page (A0h) and 0x51 for the diagnostics page (A2h).

  The properties follow the Linux sff,sfp binding, so a board description
  can be shared between the two. The driver uses mod-def0-gpios to detect
  the module; the remaining control and status lines are described for the
  board and are not driven yet.

  Example:

    sfp0: sfp-cage {
      compatible = "sff,sfp";
      i2c-bus = <&i2c1>;
      mod-def0-gpios = <&gpio0 4 GPIO_ACTIVE_LOW>;
      los-gpios = <&gpio0 5 GPIO_ACTIVE_HIGH>;
      tx-fault-gpios = <&gpio0 6 GPIO_ACTIVE_HIGH>;
      tx-disable-gpios = <&gpio0 7 GPIO_ACTIVE_HIGH>;
    };

compatible: "sff,sfp"

include: base.yaml

properties:
  i2c-bus:
    type: phandle
    required: true
    description: I2C controller the cage's management interface is wired to.

  mod-def0-gpios:
    type: phandle-array
    description: |
      MOD_DEF0 module presence input. A module grounds MOD_DEF0, so this is
      normally GPIO_ACTIVE_LOW and reads 1 while a module is inserted.
      Without this property a module is assumed to be present.

  los-gpios:
    type: phandle-array
    description: Receiver loss of signal (Rx_LOS) input.

  tx-fault-gpios:
    type: phandle-array
    description: Transmitter fault (Tx_Fault) input.

  tx-disable-gpios:
    type: phandle-array
    description: Transmitter disable (Tx_Disable) output.

  rate-select0-gpios:
    type: phandle-array
    description: Receiver rate select (RS0) output.

  rate-select1-gpios:
    type: phandle-array
    description: Transmitter rate select (RS1) output.

  maximum-power-milliwatt:
    type: int
    default: 1000
    description: Maximum power the cage can supply to a module, in milliwatts.
```

## dts/bindings/sfp/zephyr,cmis-module-emul.yaml
```yaml
# Copyright The Zephyr Project Contributors
# SPDX-License-Identifier: Apache-2.0

description: |
  Emulated CMIS pluggable module for tests and samples.

  Place the node on a zephyr,i2c-emul-controller at reg 0x50 and point an
  sff,cmis cage at the same bus.

compatible: "zephyr,cmis-module-emul"

include: i2c-device.yaml
```

## dts/bindings/sfp/zephyr,sfp-module-emul.yaml
```yaml
# Copyright The Zephyr Project Contributors
# SPDX-License-Identifier: Apache-2.0

description: |
  Emulated SFF-8472 pluggable module for tests and samples.

  Place the node on a zephyr,i2c-emul-controller at reg 0x50, where it
  answers for the serial ID page (A0h); the emulator also answers at 0x51
  for the diagnostics page (A2h). Point an sff,sfp cage at the same bus.

compatible: "zephyr,sfp-module-emul"

include: i2c-device.yaml
```

## dts/bindings/smbus/ite,it51xxx-smbus.yaml
```yaml
# Copyright (c) 2026 ITE Corporation. All Rights Reserved.
# SPDX-License-Identifier: Apache-2.0

description: ITE it51xxx SMBus controller

compatible: "ite,it51xxx-smbus"

include: [smbus-controller.yaml, pinctrl-device.yaml]

properties:
  reg:
    required: true

  interrupts:
    required: true

  pinctrl-0:
    required: true

  pinctrl-names:
    required: true

  port-num:
    type: int
    required: true
    enum:
      - 0
      - 1
      - 2
      - 3
      - 4
      - 5
      - 6
      - 7
      - 8
    description: Ordinal identifying the port
      0 = SMB_CHANNEL_A,
      1 = SMB_CHANNEL_B,
      2 = SMB_CHANNEL_C,
      3 = SMB_CHANNEL_D,
      4 = SMB_CHANNEL_E,
      5 = SMB_CHANNEL_F,
      6 = SMB_CHANNEL_G,
      7 = SMB_CHANNEL_H,
      8 = SMB_CHANNEL_I,

  fifo-enable:
    type: boolean
    description: |
      The SMBus controller supports two 32-bytes FIFOs,
      FIFO1 supports SMBus port 0. FIFO2 only supports one port among
      1~8. The default is SMBus port 1.
```

## dts/bindings/smbus/zephyr,smbus-i2c.yaml
```yaml
# SPDX-FileCopyrightText: Copyright (c) 2026 Linumiz
#
# SPDX-License-Identifier: Apache-2.0

description: |
  Generic SMBus controller on top of an I2C controller.

  SMBus protocols are built from I2C transfers on the referenced I2C
  controller, with Packet Error Checking done in software. The bus speed is
  set by the I2C controller node. Block read and block process call are not
  supported.

  Example:

    smbus0: smbus0 {
      compatible = "zephyr,smbus-i2c";
      i2c = <&i2c0>;
      #address-cells = <1>;
      #size-cells = <0>;
    };

compatible: "zephyr,smbus-i2c"

include: smbus-controller.yaml

properties:
  i2c:
    type: phandle
    required: true
    description: I2C controller used to run the SMBus transfers
```

## dts/bindings/sound/cirrus,cs47l63.yaml
```yaml
# Copyright (c) 2023 Nordic Semiconductor ASA
# SPDX-License-Identifier: Apache-2.0

description: Cirrus Logic CS47L63 Low-Power Audio DSP

compatible: "cirrus,cs47l63"

include: spi-device.yaml

properties:
  reg:
    required: true

  irq-gpios:
    type: phandle-array
    description:
      Interrupt request (IRQ) output.

  reset-gpios:
    type: phandle-array
    description:
      Digital reset input.

  cirrus,asp:
    type: int
    enum: [1, 2]
    default: 1
    description: |
      Audio serial port the host's I2S is wired to. ASP1 on the
      nRF5340 Audio DK.

  cirrus,gpio-defaults:
    type: array
    description: |
      GPIOn_CTRL1 values, one per codec GPIO starting at GPIO1, written
      as given each time the driver brings the part out of reset. An entry with a reserved
      bit set, conventionally 0xffffffff, or a GPIO past the end of the
      list, is left at its reset value. At most 12 entries. The four
      pads of a serial port the driver uses (GPIO1-4 for ASP1, GPIO5-8
      for ASP2) are driven by the driver and must be 0xffffffff here.

      For example, 0x410001fa as the tenth entry drives GPIO10 as a CMOS
      output of the output signal path status (GPn_FN = 0x1fa).

  gpio1-gpios:
    type: phandle-array
    description:
      GPIO1 input with bus-keeper

  gpio2-gpios:
    type: phandle-array
    description:
      GPIO2 input with bus-keeper

  gpio3-gpios:
    type: phandle-array
    description:
      GPIO3 input with bus-keeper

  gpio4-gpios:
    type: phandle-array
    description:
      GPIO4 input with bus-keeper

  gpio5-gpios:
    type: phandle-array
    description:
      GPIO5 input with bus-keeper

  gpio6-gpios:
    type: phandle-array
    description:
      GPIO6 input with bus-keeper

  gpio7-gpios:
    type: phandle-array
    description:
      GPIO7 input with bus-keeper

  gpio8-gpios:
    type: phandle-array
    description:
      GPIO8 input with bus-keeper

  gpio9-gpios:
    type: phandle-array
    description:
      GPIO9 input with bus-keeper

  gpio10-gpios:
    type: phandle-array
    description:
      GPIO10 input with bus-keeper

  gpio11-gpios:
    type: phandle-array
    description:
      GPIO11 input with bus-keeper

  gpio12-gpios:
    type: phandle-array
    description:
      GPIO12 input with bus-keeper

child-binding:
  description: |
    Second audio serial port of the same CS47L63, exposed as its own
    audio_codec device. Clocks, output volume and mute, and the input
    paths stay with the parent.
  properties:
    cirrus,asp:
      type: int
      required: true
      enum: [1, 2]
      description: Serial port this device drives; must differ from the parent's.
```

## dts/bindings/spi/adi,axi-spi-engine.yaml
```yaml
# Copyright (c) 2026 Analog Devices, Inc.
# SPDX-License-Identifier: Apache-2.0

description: Analog Devices AXI SPI Engine controller

compatible: "adi,axi-spi-engine"

include: spi-controller.yaml

properties:
  reg:
    required: true
  adi,ref-clock-hz:
    type: int
    required: true
    description: Reference clock frequency in Hz (SPI Engine core clock)
  adi,data-width:
    type: int
    default: 8
    description: |
      Default SPI word size in bits (8, 16, 24, or 32) used when a transfer's
      spi_config leaves the word size unset.
  adi,num-cs:
    type: int
    default: 1
    enum: [1, 2, 3, 4, 5, 6, 7, 8]
    description: |
      Number of chip select lines. Capped at 8 because the CS assert pattern
      is the 8-bit arg2 field of the ASSERT instruction.
```

## dts/bindings/spi/efinix,sapphire-spi.yaml
```yaml
# Copyright (c) 2026 Arkadiusz Grzelka
# SPDX-FileCopyrightText: Copyright The Zephyr Project Contributors
# SPDX-License-Identifier: Apache-2.0

description: |
  Efinix Sapphire SoC SPI controller (SpinalHDL SpiXdrMasterCtrl).

  Chip selects are the controller's own SS lines, selected by the
  child node's reg. cs-gpios may be used instead.

compatible: "efinix,sapphire-spi"

include: spi-controller.yaml

properties:
  reg:
    required: true

  clock-frequency:
    required: true
    description: Controller input clock in Hz (the SoC system clock).

  num-cs:
    type: int
    default: 1
    enum: [1, 2, 3, 4, 5, 6, 7, 8]
    description: Number of SS lines the SoC was generated with.
```

## dts/bindings/spi/infineon,scb-spi.yaml
```yaml
# SPDX-FileCopyrightText: Copyright (c) 2026 Linumiz
#
# SPDX-License-Identifier: Apache-2.0

description: |
  Infineon serial communication block (SCB) in SPI mode

  The SCB runs SPI from its functional clock CLK_SCB, which is the output of
  the peripheral clock divider referenced by "clocks". The SPI clock is
  CLK_SCB divided by an oversampling factor of 4 to 16, so the driver programs
  the divider at run time from the requested bus frequency. The divider must be
  an integer divider (8-bit or 16-bit) without a fixed "clock-div" value, and it
  must not be shared with another peripheral.

  Example:

    &scb0 {
      compatible = "infineon,scb-spi";
      clocks = <&peri0_group1_16bit_3>;
      pinctrl-0 = <&p11_3_scb0_spi_mosi &p11_0_scb0_spi_miso &p11_2_scb0_spi_clk>;
      pinctrl-names = "default";
      cs-gpios = <&gpio_prt11 1 GPIO_ACTIVE_LOW>;
      #address-cells = <1>;
      #size-cells = <0>;
    };

compatible: "infineon,scb-spi"

include: [spi-controller.yaml, pinctrl-device.yaml, "infineon,scb.yaml"]

properties:
  reg:
    required: true

  interrupts:
    required: true

  clocks:
    required: true

  pinctrl-0:
    required: true

  pinctrl-names:
    required: true

  infineon,ss-gpios:
    type: phandle-array
    description: |
      GPIO connected to the slave select pin in peripheral mode. The SCB
      raises no interrupt when the controller deselects it between frames,
      so the driver watches the slave select pin through the GPIO port
      interrupt to end a peripheral transfer that the controller stops
      before the buffers are full. The GPIO edge detector works while the
      pin is routed to the SCB. Without this property a peripheral
      transfer ends only when the buffers are full.
```
