## dts/bindings/spi/infineon,spi.yaml
```yaml
# SPDX-FileCopyrightText: Copyright (c) 2026 Infineon Technologies AG,
# SPDX-FileCopyrightText: or an affiliate of Infineon Technologies AG. All rights reserved.
#
# SPDX-License-Identifier: Apache-2.0

description: Infineon CAT1 SPI

compatible: "infineon,spi"

include: [spi-controller.yaml, pinctrl-device.yaml, "infineon,scb.yaml"]

properties:
  reg:
    required: true

  interrupts:
    required: true

  pinctrl-0:
    required: true

  sck-gpios:
    type: phandle-array
    description: |
      GPIO to which the SPI controller SCK signal is routed. The pin stays assigned to the SCB
      through pinctrl; this GPIO is only used to read the SCK level back. It is only needed
      together with cs-gpios: after the SCB is (re)configured or re-enabled its SCK output
      takes a while to settle at the CPOL idle level, so on every transfer the driver waits
      for it before asserting a GPIO chip select. The SCK pinctrl node must have input-enable
      so that its level can be read. Use GPIO_ACTIVE_HIGH; the physical pin level is compared
      with CPOL.
```

## dts/bindings/spi/nordic,nrf-spi-common.yaml
```yaml
# Copyright (c) 2018 Nordic Semiconductor ASA
# SPDX-License-Identifier: Apache-2.0

# Common fields for Nordic nRF family SPI peripherals

include: [spi-controller.yaml, pinctrl-device.yaml, nordic-clockpin.yaml]

properties:
  reg:
    required: true

  interrupts:
    required: true

  pinctrl-0:
    required: true

  pinctrl-names:
    required: true

  max-frequency:
    type: int
    required: true
    description: |
      Maximum data rate the SPI peripheral can be driven at, in Hz. This
      property must be set at SoC level DTS files.

  overrun-character:
    default: 0xff
    description: |
      Configurable, defaults to 0xff (line high), the most common value used
      in SPI transfers.

  easydma-maxcnt-bits:
    type: int
    required: true
    description: |
      Maximum number of bits available in the EasyDMA MAXCNT register. This
      property must be set at SoC level DTS files.

  wake-gpios:
    type: phandle-array
    description: |
      Optional bi-directional line that allows the SPI controller to indicate
      to the SPI peripheral (by setting the line high) that a transfer is to
      occur, so that
      the latter can prepare (and indicate its readiness) for handling that
      transfer when it is actually needed, and stay in any desired low-power
      state otherwise.
      The protocol is as follows:
      - initially, the SPI peripheral configures its WAKE line pin as an input
        and the SPI controller keeps the line in the low state
      - when a transfer is to be performed, the SPI controller configures its
        WAKE line pin as an input with pull-up; this changes the line state to
        high but allows the SPI peripheral to override that state
      - when the SPI peripheral detects the high state of the WAKE line, it
        prepares
        for the transfer and when everything is ready, it drives the WAKE
        line low by configuring its pin as an output
      - the generated high-to-low transition on the WAKE line is a signal
        to the SPI controller that it can proceed with the transfer
      - the SPI peripheral releases the line by configuring its pin back to be
        an input and the SPI controller again keeps the line in the low state
      Please note that the line must be configured and properly handled on
      both sides for the mechanism to work correctly.
```

## dts/bindings/spi/nordic,nrf-spim.yaml
```yaml
# Copyright (c) 2019 Nordic Semiconductor ASA
# SPDX-License-Identifier: Apache-2.0

description: Nordic nRF family SPIM (SPI controller with EasyDMA)

compatible: "nordic,nrf-spim"

include: ["nordic,nrf-spi-common.yaml", "memory-region.yaml"]

properties:
  dmm-buffer-size:
    type: int
    description: |
      Maximum transfer chunk size in bytes for this controller when the
      Nordic DMM buffer path is enabled. Must be between 1 and 65535.
      If absent, CONFIG_SPI_NRFX_DMM_BUFFER_SIZE supplies the limit.
      The EasyDMA MAXCNT limit also applies.

      This limit also applies to DMA-accessible buffers, which do not need
      a bounce allocation. For inaccessible buffers, full-duplex transfers
      can allocate twice the chunk size from the controller's DMA region.
      Allow space for those allocations and other users of the region.
      This property has no effect on the non-DMM RAM buffer path.

  rx-delay-supported:
    type: boolean
    description: |
      Indicates if the SPIM instance has the capability of delaying SDI
      sampling. This property needs to be defined at SoC level DTS files.

  rx-delay:
    type: int
    enum:
      - 0
      - 1
      - 2
      - 3
      - 4
      - 5
      - 6
      - 7
    description: |
      Number of 64 MHz clock cycles (15.625 ns) delay from the sampling edge
      of SCK (leading or trailing, depending on the CPHA setting used) until
      the input serial data on SDI is actually sampled. This property does
      not have any effect if the rx-delay-supported property is not set.
```

## dts/bindings/spi/nxp,kinetis-l-spi.yaml
```yaml
# Copyright (c) 2026 Gabriel Ivo <gabriel.bozi@usp.br>
#
# SPDX-License-Identifier: Apache-2.0

description: Custom NXP Kinetis L series SPI Driver for kl25z
compatible: "nxp,kinetis-l-spi"

include: [spi-controller.yaml, pinctrl-device.yaml]

properties:
  clocks:
    type: phandle-array
    description: SPI peripheral clock
```

## dts/bindings/spi/nxp,lpc84x-spi.yaml
```yaml
# Copyright (c) 2026, Aerlync Labs Inc.
# SPDX-License-Identifier: Apache-2.0

description: NXP LPC84x SPI

compatible: "nxp,lpc84x-spi"

include: [spi-controller.yaml, pinctrl-device.yaml, "nxp,lpc-spi.yaml"]

properties:
  reg:
    required: true

  interrupts:
    required: true

  clocks:
    required: true

  clock-source:
    type: string
    enum: ["fro", "mainclk", "frg0", "frg1", "frodiv"]
    default: "fro"
    description: SPI clock source.
```

## dts/bindings/spi/nxp,sc18is606-spi.yaml
```yaml
#
# SPDX-FileCopyrightText: Copyright tinyvision.ai
#
# SPDX-License-Identifier: Apache-2.0
#
description: |
  SPI controller behind an NXP SC18IS606 I2C to SPI bridge.

  Deprecated in favor of nxp,sc18is60x-spi. Kept so existing
  overlays continue to build.

compatible: "nxp,sc18is606-spi"
include: spi-controller.yaml
on-bus: nxp,sc18is60x

properties:
  frequency:
    type: int
    deprecated: true
    default: 1875
    enum:
      - 1875
      - 455
      - 115
      - 58
    description: |
      Ignored. Clock rate is the frequency field of the spi_config passed
      to spi_transceive(), normally spi-max-frequency on the SPI child.

  spi-mode:
    type: int
    deprecated: true
    default: 0
    enum:
      - 0
      - 1
      - 2
      - 3
    description: |
      Ignored. CPOL and CPHA come from the operation field of that
      spi_config, normally spi-cpol and spi-cpha on the SPI child.
```

## dts/bindings/spi/nxp,sc18is60x-spi.yaml
```yaml
#
# SPDX-FileCopyrightText: Copyright Alif Semiconductor
#
# SPDX-License-Identifier: Apache-2.0
#
description: |
  SPI controller behind an NXP SC18IS60x I2C to SPI bridge
  (SC18IS602/SC18IS602B or SC18IS606).

compatible: "nxp,sc18is60x-spi"
include: spi-controller.yaml
on-bus: nxp,sc18is60x
```

## dts/bindings/spi/raspberrypi,pico-spi-pio.yaml
```yaml
# Copyright (c) 2023 Stephen Boylan <stephen.boylan@beechwoods.com>
# SPDX-License-Identifier: Apache-2.0

description: Raspberry Pi Pico SPI via PIO

compatible: "raspberrypi,pico-spi-pio"

include: ["spi-controller.yaml", "raspberrypi,pico-pio-device.yaml", "reset-device.yaml"]

properties:
  clk-gpios:
    type: phandle-array
    required: true
    description: |
      Output pin for SPI clock

  sdo-gpios:
    type: phandle-array
    description: |
      Output pin for Serial Data Out.

  sdi-gpios:
    type: phandle-array
    description: |
      Input pin for Serial Data In.

  mosi-gpios:
    type: phandle-array
    deprecated: true
    description: |
      Deprecated. Use sdo-gpios instead.

  miso-gpios:
    type: phandle-array
    deprecated: true
    description: |
      Deprecated. Use sdi-gpios instead.

  sio-gpios:
    type: phandle-array
    description: |
      Single I/O gpio info

      GPIO input/output pin for 3-wire mode.

  clocks:
    required: true
```

## dts/bindings/spi/realtek,bee-spi.yaml
```yaml
# Copyright (c) 2026, Realtek Semiconductor Corporation
# SPDX-License-Identifier: Apache-2.0

description: |
   Bee SPI

compatible: "realtek,bee-spi"

include: [spi-controller.yaml, reset-device.yaml, pinctrl-device.yaml]

properties:
  reg:
    required: true

  interrupts:
    required: true

  clocks:
    required: true

  pinctrl-0:
    required: true

  pinctrl-names:
    required: true

  is-peripheral:
    type: boolean
    description: Indicate the spi operates in peripheral mode.

  is-slave:
    type: boolean
    deprecated: true
    description: Deprecated. Use is-peripheral instead.
```

## dts/bindings/spi/renesas,ra-spi-sau.yaml
```yaml
# Copyright (c) 2026 Renesas Electronics Corporation
# SPDX-License-Identifier: Apache-2.0

description: Renesas RA SAU SPI

compatible: "renesas,ra-spi-sau"

include: [spi-controller.yaml, pinctrl-device.yaml]

properties:
  pinctrl-0:
    required: true

  pinctrl-names:
    required: true

  reg:
    required: true
    description: |
      SAU SPI instance index, with the unit number in the upper nibble and the
      channel number in the lower nibble, matching the SPImn instance name in
      the hardware manual. It is the node unit address only; the SAU unit and
      channel used by this instance come from sau-channel.

  sau-channel:
    type: phandle
    required: true
    description: |
      SAU channel used for this Simplified SPI instance. Simplified SPI uses
      exactly one SAU channel for SCK, SI and SO, so a single phandle fully
      identifies the instance. The channel node provides the channel index,
      the SAU unit (through its parent), the interrupt and the clock.
```

## dts/bindings/spi/renesas,ra-spi-sci-b.yaml
```yaml
# Copyright (c) 2025 Renesas Electronics Corporation
# SPDX-License-Identifier: Apache-2.0

title: Renesas RA SCI B SPI

description: Renesas RA SCI B SPI controller

compatible: "renesas,ra-spi-sci-b"

include: [spi-controller.yaml, pinctrl-device.yaml]

properties:
  channel:
    type: int
    required: true

  tx-dtc:
    type: boolean
    description: |
      Use DTC (Data Transfer Controller) for TX transfers.

  rx-dtc:
    type: boolean
    description: |
      Use DTC (Data Transfer Controller) for RX transfers.

  dma-names:
    enum: ["tx", "rx"]
    description: |
      Names of the DMA channels used for TX and RX transfers.
```

## dts/bindings/spi/renesas,ra8-spi-b.yaml
```yaml
# Copyright (c) 2024 Renesas Electronics Corporation
# SPDX-License-Identifier: Apache-2.0

description: Renesas RA8 SPI_B controller

compatible: "renesas,ra8-spi-b"

include: [spi-controller.yaml, pinctrl-device.yaml]

properties:
  channel:
    type: int
    required: true

  reg:
    required: true

  clocks:
    required: true

  tx-dtc:
    type: boolean
    description: |
      Use DTC (Data Transfer Controller) for TX transfers.

  rx-dtc:
    type: boolean
    description: |
      Use DTC (Data Transfer Controller) for RX transfers.

  pinctrl-0:
    required: true

  pinctrl-names:
    required: true

  interrupts:
    required: true

  interrupt-names:
    required: true
    enum: ["rxi", "txi", "tei", "eri"]
    description: |
      Names of the interrupts used by the SPI controller.

  dma-names:
    enum: ["tx", "rx"]
    description: |
      Names of the DMA channels used for TX and RX transfers.
```
