## dts/bindings/wuc/renesas,ra-lpm-wuc.yaml
```yaml
# Copyright (c) 2026 Renesas Electronics Corporation
# SPDX-License-Identifier: Apache-2.0

description: |
  Renesas RA Deep Software Standby Wakeup Controller.
  Manages wakeup sources for Deep Software Standby mode (PM_STATE_SOFT_OFF).

compatible: "renesas,ra-lpm-wuc"

include: [base.yaml, wuc-controller.yaml]

properties:
  "#wakeup-ctrl-cells":
    type: int
    const: 1

wakeup-ctrl-cells:
  - id
```

## dts/bindings/wuc/wuc-controller.yaml
```yaml
# Copyright 2026 NXP
# SPDX-License-Identifier: Apache-2.0

description: |
    Common file for Wakeup Controllers

properties:
  "#wakeup-ctrl-cells":
    type: int
    required: true
    description: |
      Number of cells in wakeup-ctrls property. There must be a cell
      name "id" to use.
```

## dts/bindings/wuc/wuc-device.yaml
```yaml
# Copyright 2026 NXP
# SPDX-License-Identifier: Apache-2.0

description: |
    Common file for wake-up source devices referencing wake up controller(s).

properties:
  wakeup-ctrls:
    type: phandle-array
    description: |
      Phandle and wakeup source identifier of the corresponding wakeup controller.
```
