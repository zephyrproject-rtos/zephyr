## dts/bindings/wifi/nordic,nrf7001-mspi.yaml
```yaml
# Copyright (c) 2026 Embeint Inc
# SPDX-License-Identifier: Apache-2.0

description: nRF7001 Wi-Fi chip with MSPI interface.

compatible: nordic,nrf7001-mspi

include:
  - "nordic,nrf70-mspi.yaml"
  - "wifi-tx-power-2g.yaml"
```

## dts/bindings/wifi/nordic,nrf7001-spi.yaml
```yaml
# Copyright (c) 2024 Nordic Semiconductor ASA
# SPDX-License-Identifier: Apache-2.0

description: nRF7002 Wi-Fi chip with SPI interface.

compatible: nordic,nrf7001-spi

include:
  - "nordic,nrf70-spi.yaml"
  - "wifi-tx-power-2g.yaml"
```

## dts/bindings/wifi/nordic,nrf7002-coex.yaml
```yaml
# Copyright (c) 2024 Nordic Semiconductor ASA
# SPDX-License-Identifier: Apache-2.0

description: nRF7002 Wi-Fi chip with COEX interface.

compatible: nordic,nrf7002-coex

include:
  - "nordic,nrf70-coex.yaml"
```

## dts/bindings/wifi/nordic,nrf7002-qspi.yaml
```yaml
# Copyright (c) 2024 Nordic Semiconductor ASA
# SPDX-License-Identifier: Apache-2.0

description: nRF7002 Wi-Fi chip with QSPI interface.

compatible: nordic,nrf7002-qspi

include:
  - "nordic,nrf70-qspi.yaml"
  - "wifi-tx-power-2g.yaml"
  - "wifi-tx-power-5g.yaml"
```

## dts/bindings/wifi/nordic,nrf71-wifi.yaml
```yaml
# Copyright (c) 2025 Nordic Semiconductor ASA
# SPDX-License-Identifier: Apache-2.0

description: >
  This is a representation of the Wi-Fi parts of the nRF71 Series Wi-Fi and
  Bluetooth chip SoC.

compatible: "nordic,nrf71-wifi"

include:
  - "wifi-tx-power-2g.yaml"
  - "wifi-tx-power-5g.yaml"
```

## dts/bindings/wifi/nordic,nrf7120-wifi.yaml
```yaml
# Copyright (c) 2025 Nordic Semiconductor ASA
# SPDX-License-Identifier: Apache-2.0

description: >
  Wi-Fi domain of nRF7120 Wi-Fi and
  Bluetooth combo SoC.

compatible: "nordic,nrf7120-wifi"

include:
  - "wifi-tx-power-2g.yaml"
  - "wifi-tx-power-5g.yaml"

properties:
  nordic,wifi-xo-freq-offset:
    type: int
    default: 0
    description: |
      Crystal oscillator (XO) frequency offset trim, applied by the Wi-Fi
      firmware for frequency/temperature/voltage-dependent calibration.
      This is a board-level value that depends on the crystal used.
      The typical default is 0. Interpreted by the firmware as a signed
      8-bit value.
```

## dts/bindings/wifi/nordic,wlan.yaml
```yaml
# Copyright (c) 2025 Nordic Semiconductor ASA
# SPDX-License-Identifier: Apache-2.0

description: |
  Nordic Wi-Fi network interface.

  This binding defines a Wi-Fi network interface for Nordic nRF70 series
  Wi-Fi chips. The interface is used to identify and name Wi-Fi network
  interfaces like wlan0.

compatible: "nordic,wlan"
```

## dts/bindings/wifi/realtek,ameba-wifi.yaml
```yaml
# Copyright (c) 2024 Realtek Semiconductor Corp.
# SPDX-License-Identifier: Apache-2.0

description: Realtek Ameba SoC WiFi

compatible: "realtek,ameba-wifi"

include: [base.yaml]

properties:
  reg:
    description: WiFi controller register space
    required: true
```

## dts/bindings/wifi/silabs,rs9116w.yaml
```yaml
# Copyright (c) 2022, T-Mobile USA, Inc.
# SPDX-License-Identifier: Apache-2.0

# A high level description of the device the binding applies to:
description: This is the RS9116W Combonation WiFi and bluetooth controller

compatible: "silabs,rs9116w"

include: "spi-device.yaml"

properties:
  int-gpios:
      type: phandle-array
      required: true

  reset-gpios:
    type: phandle-array
    required: true

  sleep-wake-indication-gpios:
    type: phandle-array
    required: false

  wake-on-wireless-gpios:
    type: phandle-array
    required: false

  sleep-wake-confirmation-gpios:
    type: phandle-array
    required: false

  poc-gpios:
    type: phandle-array
    required: false
```

## dts/bindings/wifi/silabs,siwx91x-nwp-spi.yaml
```yaml
# Copyright (c) 2026 Silicon Laboratories Inc.
# SPDX-License-Identifier: Apache-2.0

title: Silicon Labs SiWx91x NWP over SPI (NCP mode)

description: |
  Silicon Labs SiWx91x Network Wireless Processor in NCP (Network Co-Processor)
  mode, connected to the host via SPI.

  In NCP mode the SiWx91x module runs its own firmware while an external host MCU
  drives it over SPI with GPIO signals for reset and interrupt handshaking. This
  is the counterpart to the SoC-mode "silabs,siwx91x-nwp" binding, where the NWP
  is on the internal AHB bus.

  Example usage in a board overlay:

    &spi1 {
        siwx917: siwx91x-nwp@0 {
            compatible = "silabs,siwx91x-nwp-spi";
            reg = <0>;
            spi-max-frequency = <2000000>;
            reset-gpios = <&gpiog 14 GPIO_ACTIVE_LOW>;
            irq-gpios   = <&gpiog 6  GPIO_ACTIVE_HIGH>;

            siwx91x_wifi: wifi {
                compatible = "silabs,siwx91x-wifi";
            };
        };
    };

compatible: "silabs,siwx91x-nwp-spi"

include: [spi-device.yaml]

child-binding:
  description: |
    Child devices of the SiWx91x NCP node, such as the WiFi interface
    ("silabs,siwx91x-wifi") or a future BLE interface.

properties:
  reset-gpios:
    type: phandle-array
    required: true
    description: |
      GPIO connected to the SiWx91x RESET_N pin. Active-low output driven by the
      host to reset the module. The host must assert this for at least 1 ms and
      allow sufficient time for the module to boot after release.
  
  cs-gpios:
    type: phandle-array
    required: true
    description: |
      GPIO used as the SPI chip-select for the SiWx91x module. This pin is
      managed manually by the driver (not by the SPI controller) to allow
      protocol-level control of framing. Directly connects to the SiWx91x
      CS_N input. Active-low.

  irq-gpios:
    type: phandle-array
    required: true
    description: |
      GPIO connected to the SiWx91x interrupt output pin. Active-high input; the
      module asserts a rising edge to signal the host that data or events are ready
      for reading over SPI.

  sleep-request-gpios:
    type: phandle-array
    description: |
      Optional GPIO for the host-to-module sleep request signal. The host asserts
      this to indicate that it is entering a low-power state.

  wake-indicator-gpios:
    type: phandle-array
    description: |
      Optional GPIO for the module-to-host wake indicator. The module asserts this
      to indicate that it is awake and ready for SPI communication.
```

## dts/bindings/wifi/silabs,siwx91x-wifi.yaml
```yaml
# Copyright (c) 2023 Antmicro
# Copyright (c) 2024 Silicon Laboratories Inc.
# SPDX-License-Identifier: Apache-2.0

description: Silabs SiWx91x SoC WiFi

compatible: "silabs,siwx91x-wifi"

properties:
  wifi-max-tx-pwr-scan:
    type: int
    default: 31
    description: |
      Maximum TX power (in dBm) used during Wi‑Fi scanning. Actual
      output may be capped by regulatory or hardware constraints.
      Note: SiWx91x firmware does **not** support per‑rate power.
  wifi-max-tx-pwr-join:
    type: int
    default: 31
    description: |
      Maximum TX power (in dBm) used when joining a Wi‑Fi network.
      Actual output may be capped by regulatory or hardware constraints.
      Note: SiWx91x firmware does **not** support per‑rate power.
```

## dts/bindings/wifi/silabs,wfx200.yaml
```yaml
# Copyright (c) 2023, grandcentrix GmbH
# SPDX-License-Identifier: Apache-2.0

description: |
    SiLabs WFx200 WiFi controller with SPI and SDIO Interface

compatible: "silabs,wfx200"

include: [spi-device.yaml]

properties:
  int-gpios:
    type: phandle-array
    required: true
  reset-gpios:
    type: phandle-array
    required: true
  wake-gpios:
    type: phandle-array
  hif-sel-gpios:
    type: phandle-array
    description: GPIO used to either select the SPI or SDIO interface.
  pds:
    type: string-array
    required: true
    description: |
      Platform Data Set as specified by SiLabs. SiLabs implemented
      a quite sophisticated format to configure the WiFi modules.
      This includes settings for IO drive strength, antenna selection etc.
      For some predefined PDS see dt-bindings/wifi/silabs_wf200.h
```

## dts/bindings/wifi/st,st67w611m1.yaml
```yaml
# Copyright (c) 2026 STMicroelectronics
# SPDX-License-Identifier: Apache-2.0

description: ST67W611M1 Wi-Fi module

compatible: "st,st67w611m1"

include: spi-device.yaml

properties:
  chip-select-gpios:
    type: phandle-array
    required: true
    description:
      Pin set to 1 by the host to wake up the ST67 and indicate that data is
      ready to be sent.

  ready-gpios:
    type: phandle-array
    required: true
    description:
      Pin set to 1 by the ST67 to inform the host that data is ready to be
      sent or to acknowledge that it is ready to receive data.

  chip-en-gpios:
    type: phandle-array
    required: true
    description: Pin set to 1 by the host to power on the ST67.
```

## dts/bindings/wifi/telink,w91-wifi.yaml
```yaml
# Copyright (c) 2024 Telink Semiconductor (Shanghai) Co., Ltd.
# SPDX-License-Identifier: Apache-2.0

description: Telink W91 SoC WiFi

compatible: "telink,w91-wifi"
```

## dts/bindings/wifi/wifi-interface.yaml
```yaml
# Copyright (c) 2025, Basalte bv
# SPDX-License-Identifier: Apache-2.0

# Common fields for Wi-Fi interfaces

include: ethernet-controller.yaml
```

## dts/bindings/wifi/zephyr,native-sim-wifi.yaml
```yaml
# SPDX-FileCopyrightText: Copyright The Zephyr Project Contributors
#
# SPDX-License-Identifier: Apache-2.0

description: |
  Native sim Wi-Fi driver. Presents a Wi-Fi station interface in Zephyr that is
  backed by a Linux host network interface (AF_PACKET + nl80211, typically a
  mac80211_hwsim radio). The presence of a node with this compatible enables the
  driver; without one the driver is not built.

  The MAC address is taken from the standard "local-mac-address" /
  "zephyr,random-mac-address" properties. Note the driver overrides it at init
  with the host interface's MAC (the station must share the host radio MAC), so
  these properties only act as a fallback when the host MAC cannot be read.

compatible: "zephyr,native-sim-wifi"

include: ethernet-controller.yaml

properties:
  host-interface:
    type: string
    required: true
    description: |
      Name of the Linux host network interface the driver binds to with
      AF_PACKET and nl80211 (e.g. "zwifi"). It must already exist on the host.
```

## dts/bindings/wifi/zephyr,wifi-emul.yaml
```yaml
# SPDX-FileCopyrightText: 2026 Basalte bv
# SPDX-License-Identifier: Apache-2.0

description: |
  Emulated Wi-Fi offload device for integration testing.

  The device exposes a standard Wi-Fi management interface whose behavior
  (scan results, connection results, disconnect events, ...) is controlled
  at runtime through the API in zephyr/drivers/wifi/wifi_emul.h.

  The data plane is optional. By default the device is self-contained:
  transmitted frames are delivered to a callback and frames can be injected
  with wifi_emul_rx_inject(). Alternatively it can bridge to an Ethernet
  device, either through the "ethernet" phandle below or at runtime with
  wifi_emul_set_eth_iface().

compatible: "zephyr,wifi-emul"

include: ethernet-controller.yaml

properties:
  ethernet:
    type: phandle
    description: |
      Ethernet device providing the data plane. When set, frames sent on the
      Wi-Fi interface are forwarded to this device and the frames it receives
      are redirected to the Wi-Fi interface. When absent, the device is
      self-contained unless an Ethernet interface is attached at runtime with
      wifi_emul_set_eth_iface() (e.g. the native_sim TAP interface, which is
      not devicetree-instantiated).

      The MAC address of this interface is independent from the Ethernet
      device and is configured through the standard local-mac-address /
      zephyr,random-mac-address properties, defaulting to a random address.

examples:
  - |
    wlan0: wifi-emul {
        compatible = "zephyr,wifi-emul";
        status = "okay";
    };
```

## dts/bindings/wifi/zephyr,wifi-hwsim.yaml
```yaml
# Copyright (c) 2026 Nordic Semiconductor ASA
# SPDX-License-Identifier: Apache-2.0

description: |
  Zephyr virtual Wi-Fi simulator node.
  Instantiate one node per virtual radio in your board overlay.

compatible: "zephyr,wifi-hwsim"

include: ethernet-controller.yaml

properties:
  radio-index:
    type: int
    required: true
    description: |
      Index into the hwsim medium radio table (0-based).
      Must be unique across all hwsim nodes in the system.
      Maximum value is CONFIG_WIFI_HWSIM_NUM_RADIOS - 1.

  # MAC address configuration (local-mac-address, zephyr,random-mac-address,
  # zephyr,mac-address-prefix, nvmem-cells) is inherited from
  # ethernet-controller.yaml. If no MAC is configured the driver falls back to
  # a random locally-administered address so each radio has a unique address.
```

## dts/bindings/wuc/nxp,sleepcon-wuc.yaml
```yaml
# SPDX-FileCopyrightText: Copyright 2026 NXP
# SPDX-License-Identifier: Apache-2.0

description: |
  NXP SLEEPCON (Sleep Controller) acting as a Wakeup Controller (WUC).

  The SLEEPCON WAKEUPEN registers gate which peripheral interrupts are
  allowed to wake a CPU from low-power modes. A wakeup source is identified
  by its NVIC interrupt number: enabling source N sets bit (N % 32) of
  the WAKEUPEN(N / 32) register. This maps 1:1 onto the "id" cell consumed
  through "wakeup-ctrls" properties, so the id of a source equals the
  interrupt number of the module that owns it (e.g. the RTC alarm interrupt,
  a GPIO port interrupt, an MU interrupt).

compatible: "nxp,sleepcon-wuc"

include: [base.yaml, wuc-controller.yaml]

properties:
  reg:
    required: true

  '#wakeup-ctrl-cells':
    type: int
    const: 1
    description: |
      Number of cells in wakeup-ctrls property.

wakeup-ctrl-cells:
  - id
```

## dts/bindings/wuc/nxp,wuc-wkpu.yaml
```yaml
# Copyright 2026 NXP
# SPDX-License-Identifier: Apache-2.0

description: |
  NXP Wake-up Unit (WKPU) acting as a Wakeup Controller (WUC).

  This binding is used by SoCs that consume the WKPU through the WUC
  subsystem (i.e. via "wakeup-ctrls" properties), and therefore must
  declare the "#wakeup-ctrl-cells" property required by wuc-controller.

  The WKPU exposes up to 64 wakeup sources: sources 0-3 are internal
  peripheral events (SWT/RTC-API, RTC timeout, LPCMP round-robin, RTI)
  and sources 4..63 are external pins. Use the helpers in
  <zephyr/dt-bindings/wuc/wuc_nxp_wkpu.h> to build wakeup-source ids.

compatible: "nxp,wuc-wkpu"

include: [base.yaml, wuc-controller.yaml]

properties:
  reg:
    required: true

  interrupts:
    required: true

  '#wakeup-ctrl-cells':
    type: int
    const: 1
    description: |
      Number of cells in wakeup-ctrls property.

wakeup-ctrl-cells:
  - id
```

## dts/bindings/wuc/nxp,wuc-wuu.yaml
```yaml
# Copyright 2025 NXP
# SPDX-License-Identifier: Apache-2.0

description: |
  NXP Wakeup Unit (WUU) acting as a Wakeup Controller (WUC).

  This binding is used by SoCs that consume the WUU through the WUC
  subsystem (i.e. via "wakeup-ctrls" properties), and therefore must
  declare the "#wakeup-ctrl-cells" property required by wuc-controller.

  SoCs that only need the legacy "nxp,wuu" interrupt-controller view
  should keep using the binding under
  dts/bindings/interrupt-controller/nxp,wuu.yaml.

compatible: "nxp,wuc-wuu"

include: [base.yaml, wuc-controller.yaml]

properties:
  reg:
    required: true

  interrupts:
    required: true

  '#wakeup-ctrl-cells':
    type: int
    const: 1
    description: |
      Number of cells in wakeup-ctrls property.

wakeup-ctrl-cells:
  - id
```

## dts/bindings/wuc/nxp,wuu.yaml
```yaml
# Copyright 2025 NXP
# SPDX-License-Identifier: Apache-2.0

description: NXP Wakeup Unit (WUU)

compatible: "nxp,wuu"

include: [base.yaml, wuc-controller.yaml]

properties:
  reg:
    required: true

  interrupts:
    required: true

  '#wakeup-ctrl-cells':
    type: int
    const: 1
    description: |
      Number of cells in wakeup-ctrls property.

wakeup-ctrl-cells:
  - id
```
