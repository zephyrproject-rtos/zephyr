## dts/bindings/timer/ambiq,timer.yaml
```yaml
# Copyright (c) 2025 Ambiq Micro Inc. <www.ambiq.com>
# SPDX-License-Identifier: Apache-2.0

description: Ambiq TIMER timer

compatible: "ambiq,timer"

include: [base.yaml]

properties:
  reg:
    required: true

  interrupts:
    required: true

  clk-source:
    type: string
    required: true
    enum:
      - "CLK_SELECT_HFRC_DIV4"
      - "CLK_SELECT_HFRC_DIV16"
      - "CLK_SELECT_HFRC_DIV64"
      - "CLK_SELECT_HFRC_DIV256"
      - "CLK_SELECT_HFRC_DIV1024"
      - "CLK_SELECT_HFRC_DIV4K"
      - "CLK_SELECT_LFRC"
      - "CLK_SELECT_LFRC_DIV2"
      - "CLK_SELECT_LFRC_DIV32"
      - "CLK_SELECT_LFRC_DIV1K"
      - "CLK_SELECT_XT"
      - "CLK_SELECT_XT_DIV2"
      - "CLK_SELECT_XT_DIV4"
      - "CLK_SELECT_XT_DIV8"
      - "CLK_SELECT_XT_DIV16"
      - "CLK_SELECT_XT_DIV32"
      - "CLK_SELECT_XT_DIV128"
      - "CLK_SELECT_RTC_100HZ"
    description: |
      Clock source selection: 32 KHz is available in deep sleep.
      - AM_HAL_TIMER_CLOCK_HFRC_DIV4
      - AM_HAL_TIMER_CLOCK_HFRC_DIV16
      - AM_HAL_TIMER_CLOCK_HFRC_DIV64
      - AM_HAL_TIMER_CLOCK_HFRC_DIV256
      - AM_HAL_TIMER_CLOCK_HFRC_DIV1024
      - AM_HAL_TIMER_CLOCK_HFRC_DIV4K
      - AM_HAL_TIMER_CLOCK_LFRC
      - AM_HAL_TIMER_CLOCK_LFRC_DIV2
      - AM_HAL_TIMER_CLOCK_LFRC_DIV32
      - AM_HAL_TIMER_CLOCK_LFRC_DIV1K
      - AM_HAL_TIMER_CLOCK_XT
      - AM_HAL_TIMER_CLOCK_XT_DIV2
      - AM_HAL_TIMER_CLOCK_XT_DIV4
      - AM_HAL_TIMER_CLOCK_XT_DIV8
      - AM_HAL_TIMER_CLOCK_XT_DIV16
      - AM_HAL_TIMER_CLOCK_XT_DIV32
      - AM_HAL_TIMER_CLOCK_XT_DIV128
      - AM_HAL_TIMER_CLOCK_RTC_100HZ
```

## dts/bindings/timer/andestech,atcpit100.yaml
```yaml
#
# Copyright (c) 2022, Andes Technology Corporation.
#
# SPDX-License-Identifier: Apache-2.0
#

description: |
    This is a representation of the Andes Technology atcpit100 PIT node

compatible: "andestech,atcpit100"

include: base.yaml

properties:
    reg:
      required: true

    interrupts:
      required: true

    clock-frequency:
      type: int
      required: true
      description: channel clock source

    prescaler:
      type: int
      default: 1
      required: false
      description: |
        The prescaler value defines the counter frequency
        (clock-frequency/prescaler) in atcpit100 counter driver, the prescaler
        value could be in range [1 .. clock-frequency] and 1 means no prescaler
        for the PIT clock-frequency.

        Defaults to 1 to use the PIT clock-frequency as the counter frequency.

        Setting the prescaler value if the system overhead is close to or
        larger than a counter tick period, reducing the counter frequency to
        avoid imprecise counter value.

        For example, andes_v5_ae350 platform takes about 200 ~ 300 PIT
        clock cycles for counter interface, setting prescaler value to 600 in
        this case.
```

## dts/bindings/timer/andestech,machine-timer.yaml
```yaml
# Copyright (c) 2022 Nordic Semiconductor ASA
# SPDX-License-Identifier: Apache-2.0

description: |
  Andes Machine Timer

  The Andes machine timer provides RISC-V privileged mtime and mtimecmp
  registers.

compatible: "andestech,machine-timer"

include: base.yaml

properties:
  reg:
    required: true

  interrupts-extended:
    required: true
```

## dts/bindings/timer/arm,armv6m-systick.yaml
```yaml
# Copyright (c) 2022 Kumar Gala <galak@kernel.org>
# SPDX-License-Identifier: Apache-2.0

description: ARMv6-M System Tick

compatible: "arm,armv6m-systick"

include: [cortex-m-systick.yaml]
```

## dts/bindings/timer/arm,armv7-timer.yaml
```yaml
description: per-core ARM architected timer

compatible: "arm,armv7-timer"

include: base.yaml

properties:
  interrupts:
    required: true
```

## dts/bindings/timer/arm,armv7m-systick.yaml
```yaml
# Copyright (c) 2022 Kumar Gala <galak@kernel.org>
# SPDX-License-Identifier: Apache-2.0

description: ARMv7-M System Tick

compatible: "arm,armv7m-systick"

include: [cortex-m-systick.yaml]
```

## dts/bindings/timer/arm,armv8-timer.yaml
```yaml
description: per-core ARM architected timer

compatible: "arm,armv8-timer"

include: base.yaml

properties:
  interrupts:
    required: true

  clock-frequency:
    type: int
    description: |
      The clock source frequencey for this timer, in Hz. This value can be used as
      the default setting for SYS_CLOCK_HW_CYCLES_PER_SEC at the SoC level.
```

## dts/bindings/timer/arm,armv8.1m-systick.yaml
```yaml
# Copyright (c) 2022 Kumar Gala <galak@kernel.org>
# SPDX-License-Identifier: Apache-2.0

description: ARMv8.1-M System Tick

compatible: "arm,armv8.1m-systick"

include: [cortex-m-systick.yaml]
```

## dts/bindings/timer/arm,armv8m-systick.yaml
```yaml
# Copyright (c) 2022 Kumar Gala <galak@kernel.org>
# SPDX-License-Identifier: Apache-2.0

description: ARMv8-M System Tick

compatible: "arm,armv8m-systick"

include: [cortex-m-systick.yaml]
```

## dts/bindings/timer/arm,cmsdk-dtimer.yaml
```yaml
description: ARM CMSDK dual timer

compatible: "arm,cmsdk-dtimer"

include: base.yaml

properties:
    reg:
      required: true

    interrupts:
      required: true

    label:
      required: true
```

## dts/bindings/timer/arm,cmsdk-timer.yaml
```yaml
description: ARM CMSDK timer

compatible: "arm,cmsdk-timer"

include: base.yaml

properties:
    reg:
      required: true

    interrupts:
      required: true

    label:
      required: true
```

## dts/bindings/timer/arm,cortex-m-systick.yaml
```yaml
# Copyright (c) 2024 Enphase Energy
# SPDX-License-Identifier: Apache-2.0

description: ARM Cortex-M System Tick

include: base.yaml

properties:
  reg:
    required: true

  external-reference-clock:
    type: boolean
    description: |
      The default clock source for the Cortex-M systick is the processor
      clock. Enabling this option switches to an implementation defined
      external reference clock (if available). If unsure, leave disabled.

      See section "SysTick Control and Status Register" of the
      Armv6-M/Armv7-M/Armv8-M Architecture Reference Manuals for details.
```

## dts/bindings/timer/atmel,sam-tc.yaml
```yaml
# SPDX-License-Identifier: Apache-2.0

description: Atmel SAM Timer Counter (TC) node

compatible: "atmel,sam-tc"

include:
    - name: base.yaml
    - name: pinctrl-device.yaml

properties:
    reg:
      required: true

    interrupts:
      required: true

    label:
      required: true

    peripheral-id:
      type: array
      description: peripheral ID
      required: true

    channel:
      type: int
      required: false
      description: |
        Timer / Counter channel to use, channel 0 is the default.
        Valid range: 0 - 2

    clk:
      type: int
      required: false
      description: |
        Clock source selection as defined by TCCLKS bit-field of TC_CMR
        register. Consult the datasheet for the details.

    nodivclk:
      type: boolean
      required: false
      description: |
        If set to true the `clk` property is ignored. Instead the TC module is
        driven directly via MCLK. Only supported on sam4e, same70, same70b,
        samv71, samv71b SoC series.

    reg-cmr:
      type: int
      required: false
      description: |
        Alternate value of the CMR (Channel Mode Register) register.
        If specified this value will be written to the register during driver
        instance initialization instead of the default. It can be used to
        configure the timer / counter in the custom mode. Together with other
        properties like channel-num, pinctrl-0 this allows e.g. to configure
        the driver to count events generated on the TIOA, TIOB signal connected
        to the external pin.

    reg-rc:
      type: int
      required: false
      description: |
        Register C compare/match value. RC can be used as compare/match unit
        for an specific timer unit. Their use depends on how timer channel
        is configured,see reg-cmr. It can be used as trigger for both input
        capture or counter mode, or even as event source. The RC register
        behavior is SoC dependent. For more information and use cases,
        check SoC datasheet and application notes.
```

## dts/bindings/timer/atmel,sam0-tc32.yaml
```yaml
# Copyright (c) 2019 Derek Hageman <hageman@inthat.cloud>
# SPDX-License-Identifier: Apache-2.0

description: Atmel SAM0 basic timer counter (TC) operating in 32-bit wide mode

compatible: "atmel,sam0-tc32"

include:
    - name: base.yaml
    - name: pinctrl-device.yaml

properties:
  reg:
    required: true

  interrupts:
    required: true

  clocks:
    required: true

  clock-names:
    required: true

  label:
    required: true

  prescaler:
    type: int
    required: false
    description: Timer prescaler
    enum:
      - 1
      - 2
      - 4
      - 8
      - 16
      - 64
      - 256
      - 1024
```

## dts/bindings/timer/brcm,bcm2835-system-timer.yaml
```yaml
# Copyright (c) 2026 Jonathan Elliot Peace <jep@alphabetiq.com>
# SPDX-License-Identifier: Apache-2.0

description: |
  Broadcom BCM2835 free-running 1 MHz system timer. Provides a 64-bit
  free-running counter and four 32-bit compare channels; a compare match
  raises an interrupt. Channels 0 and 2 are used by the VideoCore firmware.

compatible: "brcm,bcm2835-system-timer"

include: [base.yaml]

properties:
  reg:
    required: true
  interrupts:
    required: true
```

## dts/bindings/timer/efinix,sapphire-timer0.yaml
```yaml
description: Efinix Sapphire timer

compatible: "efinix,sapphire-timer0"

include: base.yaml

properties:
  reg:
    required: true

  interrupts:
    required: true
```

## dts/bindings/timer/espressif,esp32-systimer.yaml
```yaml
# Copyright (c) 2021 Espressif Systems (Shanghai) Co., Ltd.
# SPDX-License-Identifier: Apache-2.0

description: ESP32 System Timer

compatible: "espressif,esp32-systimer"

include: base.yaml

properties:
  reg:
    required: true

  interrupts:
    required: true
```

## dts/bindings/timer/gaisler,gptimer.yaml
```yaml
description: GRLIB GPTIMER

compatible: "gaisler,gptimer"

include: base.yaml

properties:
    reg:
      required: true

    interrupts:
      required: true
```

## dts/bindings/timer/gd,gd32-timer.yaml
```yaml
# Copyright (c) 2021 Teslabs Engineering S.L.
# SPDX-License-Identifier: Apache-2.0

description: GigaDevice GD32 timer

compatible: "gd,gd32-timer"

include: [reset-device.yaml, base.yaml]

properties:
  reg:
    required: true

  clocks:
    required: true

  resets:
    required: true

  channels:
    type: int
    required: true
    description: Number of timer channels.

  prescaler:
    type: int
    default: 0
    description: Timer prescaler. Defaults to 0 (SoC default).

  is-32bit:
    type: boolean
    description: Indicates if timer has a 32-bit counter.

  is-advanced:
    type: boolean
    description: |
      Indicates if timer has advanced features. Such features include break
      inputs, dead-time insertion, etc.
```

## dts/bindings/timer/infineon,cat1-lp-timer-pdl.yaml
```yaml
# Copyright (c) 2025 Infineon Technologies AG,
# or an affiliate of Infineon Technologies AG.
#
# SPDX-License-Identifier: Apache-2.0

description: Infineon CAT1 low power timer

compatible: "infineon,cat1-lp-timer-pdl"

include: [base.yaml, "infineon,system-interrupts.yaml"]

properties:
  reg:
    required: true

  clock-frequency:
    type: int
    default: 32768
    description: |
      Clock frequency (Hz) for tick increment operations
```

## dts/bindings/timer/infineon,cat1-lp-timer.yaml
```yaml
# Copyright (c) 2025 Cypress Semiconductor Corporation (an Infineon company) or
# an affiliate of Cypress Semiconductor Corporation
#
# SPDX-License-Identifier: Apache-2.0

description: Infineon Cat1 low power timer

compatible: "infineon,cat1-lp-timer"

include: [base.yaml, "infineon,system-interrupts.yaml"]

properties:
  reg:
    required: true
```

## dts/bindings/timer/infineon,lp-timer.yaml
```yaml
# Copyright (c) 2025 Cypress Semiconductor Corporation (an Infineon company) or
# an affiliate of Cypress Semiconductor Corporation
#
# SPDX-License-Identifier: Apache-2.0

description: Infineon low power timer

compatible: "infineon,lp-timer"

include: [base.yaml, "infineon,system-interrupts.yaml"]

properties:
  reg:
    required: true

  clock-frequency:
    type: int
    default: 32768
    description: |
      Clock frequency (Hz) for tick increment operations
```

## dts/bindings/timer/infineon,tc3x-stm.yaml
```yaml
# Copyright (c) 2024 Infineon Technologies AG
# SPDX-License-Identifier: Apache-2.0

description: TC3x System Timer Module (STM)

compatible: "infineon,tc3x-stm"

include: base.yaml

properties:
  reg:
    required: true

  interrupts:
    required: true

  clocks:
    required: true

  freeze:
    type: boolean
    description: Stops the timer when the chip enters Debug mode.
```

## dts/bindings/timer/intel,adsp-timer.yaml
```yaml
# Copyright (c) 2022 Intel Corp.
# SPDX-License-Identifier: Apache-2.0

description: Intel ADSP Timer

compatible: "intel,adsp-timer"

include: base.yaml

properties:
  syscon:
    type: phandle
    required: true
    description: |
      phandle to syscon node.
```

## dts/bindings/timer/intel,hpet.yaml
```yaml
# Copyright (c) 2019 Intel Corp.
# SPDX-License-Identifier: Apache-2.0

description: HPET (High-Precision Event Timer)

compatible: "intel,hpet"

include: base.yaml

properties:
  reg:
    required: true

  interrupts:
    required: true

  no-legacy-irq:
    type: boolean
    description: Do not set legacy IRQ bit
```
