## dts/bindings/timer/ti,am654-dmtimer.yaml
```yaml
# Copyright (C) 2023 BeagleBoard.org Foundation
# Copyright (C) 2023 S Prashanth
#
# SPDX-License-Identifier: Apache-2.0

description: TI dual-mode Timer

compatible: "ti,am654-dmtimer"

include: base.yaml

properties:
  reg-shift:
    type: int
    required: true
    description: quantity to shift the register offsets by

  reg:
    required: true

  interrupts:
    required: true
```

## dts/bindings/timer/ti,am654-timer.yaml
```yaml
# Copyright (C) 2023 BeagleBoard.org Foundation
# Copyright (C) 2023 S Prashanth
# SPDX-License-Identifier: Apache-2.0

description: TI Dual-Mode Timer

compatible: "ti,am654-timer"

include: base.yaml

properties:
  reg:
    required: true

  interrupts:
    required: true

  clksel:
    type: phandle-array
    description: |
      Optional syscon configuration for timer clock source selection.
      Format: <&syscon_phandle offset value>
      - syscon_phandle: reference to syscon device
      - offset: register offset within syscon for clock selection
      - value: value to write for desired clock source
```

## dts/bindings/timer/ti,cc13xx-cc26xx-timer.yaml
```yaml
# Copyright (c) 2023 Zephyr Project
# SPDX-License-Identifier: Apache-2.0

description: TI SimpleLink CC13xx/CC26xx Timer Node

compatible: "ti,cc13xx-cc26xx-timer"

include: base.yaml

properties:
  reg:
    required: true

  interrupts:
    required: true
```

## dts/bindings/timer/ti,cc23x0-timer.yaml
```yaml
# Copyright (c) 2024 Baylibre SAS
# SPDX-License-Identifier: Apache-2.0

description: TI SimpleLink CC23x0 Timer Node

compatible: "ti,cc23x0-systim-timer"

include: base.yaml

properties:
  reg:
    required: true

  interrupts:
    required: true
```

## dts/bindings/timer/ti,mspm0-timer-sysclock.yaml
```yaml
# Copyright 2025 Linumiz GmbH
# SPDX-License-Identifier: Apache-2.0

description: TI MSPM0 Timer used as sysclock

compatible: "ti,mspm0-timer-sysclock"

include: base.yaml
```

## dts/bindings/timer/ti,mspm0-timer.yaml
```yaml
# Copyright 2025 Linumiz GmbH
# SPDX-License-Identifier: Apache-2.0

description: TI MSPM0 Timer

compatible: "ti,mspm0-timer"

include: base.yaml

properties:
  reg:
    required: true

  interrupts:
    required: true

  clk-prescaler:
    type: int
    required: true
    description: |
      TIMCLK clock source prescaler value.
      Valid range [0 ... 255].

  clk-div:
    type: int
    required: true
    default: 1
    enum:
      - 1
      - 2
      - 3
      - 4
      - 5
      - 6
      - 7
      - 8
    description: |
      Clock divider selction value.
```

## dts/bindings/timer/ti,tms570-rti.yaml
```yaml
# Copyright (c) 2025 ispace, inc.
# SPDX-License-Identifier: Apache-2.0

description: Real-time interrupt for TMS570

compatible: "ti,tms570-rti"

include: [base.yaml]

properties:
  clock-frequency:
    type: int
    description: Clock frequency of RTI up counter
  tick-frequency:
    type: int
    description: Frequency of RTI interrupt for system tick
```

## dts/bindings/timer/wch,ch32v-v3-systick.yaml
```yaml
# Copyright (c) 2023-2024 Chen Xingyu <hi@xingrz.me>
# SPDX-License-Identifier: Apache-2.0

description: WCH CH32V V3 SysTick

compatible: "wch,ch32v-v3-systick"

include: base.yaml

properties:
  reg:
    required: true

  interrupts:
    required: true
```

## dts/bindings/timer/wch,qingke-systick.yaml
```yaml
# Copyright (c) 2022 TOKITA Hiroshi <tokita.hiroshi@gmail.com>
# SPDX-License-Identifier: Apache-2.0

description: |
  WCH QingKe core's SysTick timer

compatible: "wch,qingke-systick"

include: base.yaml
```

## dts/bindings/timer/wch,systick.yaml
```yaml
# Copyright (c) 2024 Michael Hope
# SPDX-License-Identifier: Apache-2.0

description: WCH CH32V00x Systick

compatible: "wch,systick"

include: base.yaml

properties:
  reg:
    required: true

  interrupts:
    required: true
```

## dts/bindings/timer/xlnx,scntr.yaml
```yaml
description: Xilinx System Timestamp Counter for Versal

compatible: "xlnx,scntr"

include: base.yaml
```

## dts/bindings/timer/xlnx,tmrctr.yaml
```yaml
# Copyright (c) 2023 Advanced Micro Devices, Inc. (AMD)
# Copyright (c) 2023 Alp Sayin <alpsayin@gmail.com>
# SPDX-License-Identifier: Apache-2.0

description: Xilinx AXI TMRCTR timer counter

compatible: "xlnx,tmrctr"

include: base.yaml

properties:
  reg:
    required: true

  clock-frequency:
    type: int
    required: true
    description: Clock frequency information for Timer operation
```

## dts/bindings/timer/xlnx,ttcps.yaml
```yaml
description: Xilinx PS Triple-Timer Counter

compatible: "xlnx,ttcps"

include: base.yaml

properties:
  reg:
    required: true

  clock-frequency:
    type: int
    required: true
    description: Clock frequency information for Timer operation
```

## dts/bindings/timer/xuantie,systimer.yaml
```yaml
# Copyright (C) 2017-2024 Alibaba Group Holding Limited
# SPDX-License-Identifier: Apache-2.0

description: |
  XuanTie System Timer

  The XuanTie system timer provides RISC-V privileged mtime and mtimecmp
  registers.

compatible: "xuantie,systimer"

include: base.yaml

properties:
  reg:
    required: true

  interrupts:
    required: true
```

## dts/bindings/timestamp/intel,ace-timestamp.yaml
```yaml
description: ACE timestamp controller

compatible: "intel,ace-timestamp"

include: base.yaml

properties:
  reg:
      required: true
```

## dts/bindings/timestamp/intel,adsp-timestamp.yaml
```yaml
description: Intel ADSPtimestamp controller

compatible: "intel,adsp-timestamp"

include: base.yaml

properties:
  reg:
    required: true
```

## dts/bindings/touch/azoteq,iqs5xx.yaml
```yaml
description: IQS5XX Trackpad controller

compatible: "azoteq,iqs5xx"

include: i2c-device.yaml

properties:
    rdy-gpios:
      type: phandle-array
      required: true
      description: |
        The ready signal (RDY) from the IQSxxx.
```

## dts/bindings/uaol/intel,adsp-uaol.yaml
```yaml
# Copyright (c) 2023-2024 Intel Corporation
# SPDX-License-Identifier: Apache-2.0

description: Intel USB Audio Offload Link (UAOL) IP

compatible: "intel,adsp-uaol"

include: base.yaml

properties:
  reg:
    required: true

  shim-offset:
    type: int
    required: true

  ip-offset:
    type: int
    required: true

  link:
    type: int
    required: true
```

## dts/bindings/uaol/intel,uaol-dai.yaml
```yaml
# Copyright (c) 2023-2024 Intel Corporation
# SPDX-License-Identifier: Apache-2.0

description: Intel USB Audio Offload Link (UAOL) DAI node

compatible: "intel,uaol-dai"

include: base.yaml

properties:
  reg:
    required: true

  stream:
    type: int
    required: true
```

## dts/bindings/ufs/amd,versal2-ufs.yaml
```yaml
# Copyright (c) 2025 Advanced Micro Devices, Inc.
# SPDX-License-Identifier: Apache-2.0

description: |
  Amd Versal Gen2 UFS Host Controller.

  Example usage:
      ufs@f10b0000 {
        compatible = "amd,versal2-ufs";
        reg = <0xf10b0000 0x1000>;
        interrupts = <GIC_SPI 234 IRQ_TYPE_LEVEL_HIGH>;
        clocks = <&ufs_core_clk>;
        clock-names = "core_clk";
        freq-table-hz = <0 0>;
        resets = <&scmi_reset 4>, <&scmi_reset 35>;
        reset-names = "ufshc-rst", "ufsphy-rst";
    };

compatible: "amd,versal2-ufs"

include: [ufs-common.yaml, reset-device.yaml]

properties:
  clocks:
    required: true
    description: The list of clocks used by the UFS Host Controller.

  clock-names:
    required: true
    description: core_clk - Clock for the core logic

  reg:
    required: true
    description: |
      - Host Controller Base address
      - IOU(Input-Output Unit) SLCR(System-Level Control Register)
      - EFUSE Cache register
      - UFS CRP(Clock reset Power) register

  resets:
    description: Reset control for both UFS Host Controller and PHY.

  reset-names:
    description: |
      - "ufshc-rst" - Reset signal for the UFS Host Controller
      - "ufsphy-rst" - Reset signal for the UFS PHY
```

## dts/bindings/ufs/ufs-common.yaml
```yaml
# Copyright (c) 2025 Advanced Micro Devices, Inc.
# SPDX-License-Identifier: Apache-2.0

# Common properties for Universal Flash Storage (UFS) Host Controllers

include: [base.yaml]

properties:
  freq-table-hz:
    type: array
    description: |
      Array of <min max> operating frequencies in Hz stored in the same order
      as the clocks property. If this property is not defined or a value in the
      array is "0" then it is assumed that the frequency is set by the parent
      clock or a fixed rate clock source.

  interrupts:
    required: true
    description: Interrupts used by the UFS Host Controller.

  lanes-per-direction:
    type: int
    enum: [1, 2]
    description: |
      Number of lanes available per direction. Note that it is assumed that
      same number of lanes are used in both transmit and receive.
```

## dts/bindings/ufs/zephyr,ufs-disk.yaml
```yaml
# Copyright (c) 2025 Advanced Micro Devices, Inc.
# SPDX-License-Identifier: Apache-2.0

description: |
  This Zephyr UFS disk node binding indicates that a UFS disk device is attached
  to a specific UFS LUN in the host controller. It enables the disk to be used
  with the disk driver API and any relevant subsystems, such as Filesystems.

compatible: "zephyr,ufs-disk"

include: base.yaml

properties:
  lun:
    type: int
    default: 0
    description: |
      Specifies the UFS LUN for disk operations. The default is LUN 0 if not
      explicitly defined. The range for LUN values is 0 to 31.

  disk-name:
    type: string
    required: true
    description: The name of the disk, used by the Disk subsystem for registering the UFS disk.
```

## dts/bindings/usb-c/fcs,fusb302b-vbus.yml
```yaml
# Copyright 2023 Jonas Otto
# SPDX-License-Identifier: Apache-2.0

description: USB-C VBUS measurement using FUSB302B

compatible: "fcs,fusb302b-vbus"

include: base.yaml

properties:
  fusb302b:
    type: phandle
    required: true
```

## dts/bindings/usb-c/fcs,fusb302b.yml
```yaml
# Copyright 2023 Jonas Otto
# SPDX-License-Identifier: Apache-2.0

description: FUSB302B Programmable USB Type-C Controller with PD

compatible: "fcs,fusb302b"

include: i2c-device.yaml
```

## dts/bindings/usb-c/ite,it8xxx2-usbpd.yaml
```yaml
# Copyright (c) 2022 Google LLC
# SPDX-License-Identifier: Apache-2.0

description: ITE it8xxx2 USB-C Power Delivery port

compatible: "ite,it8xxx2-usbpd"

include: [base.yaml]
```
