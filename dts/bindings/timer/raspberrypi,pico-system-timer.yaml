## dts/bindings/usb/microchip,usb-g1.yaml
```yaml
# Copyright (c) 2026 Microchip Technology Inc.
# SPDX-License-Identifier: Apache-2.0

title: Microchip USB G1 driver

description: |
  Microchip USB G1 driver bindings.

  Group g1 USB driver supports following hardware peripherals:
    - module name="USB" id="U2222" version="1.2.0"

compatible: "microchip,usb-g1"

include:
  - name: usb-ep.yaml
  - name: pinctrl-device.yaml

properties:
  reg:
    required: true

  interrupts:
    required: true

  maximum-speed:
    required: true

  clocks:
    required: true

  clock-names:
    required: true

  nvm-calib:
    type: phandle
    required: true
    description: |
      Phandle to the NVM software calibration area.

      This property provides the base address for the NVM software calibration
      region. The USB driver reads a calibration word from this memory area
      and extracts individual calibration fields based on the definitions
      provided in the calib-mapping property.

  calib-mapping:
    type: array
    required: true
    description: |
      Configuration for NVM to USB_PADCAL field extraction.

      An array of <dst_bit nvm_bit mask default> tuples defining how to
      extract and write calibration values. The 'default' value is applied
      if the NVM entry is unprogrammed (equals the mask).

      Each entry consists of four cells:

        <dst_bit nvm_bit mask default>

      where:

        dst_bit
          Bit offset of the calibration field in the USB_PADCAL register.

        nvm_bit
          Bit offset of the calibration value in the NVM calibration word.

        mask
          Bit mask defining the width of the calibration field.

        default
          Default value used when the extracted OTP value equals the mask,
          indicating an invalid or unprogrammed calibration entry.

      Multiple entries may be provided to configure all required USB pad
      calibration fields.

  calib-mapping-names:
    type: string-array
    description: |
      Descriptive names for calibration entries.

      Optional string array corresponding to calib-mapping entries,
      intended solely for debugging and documentation.

examples:
  - |
    /* clocks: "mclk" (APB) enabled via mclkperiph, "gclk" (48 MHz) enabled
     * and sourced via gclkperiph. Both are configured separately.
     */

    usb0: usb@41000000 {
            compatible = "microchip,usb-g1";
            reg = <0x41000000 0x1000>;
            interrupts = <80 0>, <81 0>, <82 0>, <83 0>;
            interrupt-names = "usb", "sof", "trcpt0", "trcpt1";
            num-bidir-endpoints = <8>;
            maximum-speed = "full-speed";
            clocks = <&mclkperiph CLOCK_MCHP_MCLKPERIPH_ID_APBB_USB>,
                     <&gclkperiph CLOCK_MCHP_GCLKPERIPH_ID_USB>;
            clock-names = "mclk", "gclk";
            nvm-calib = <&nvm_sw_calib_area>;
            calib-mapping = <0x06 0x20 0x1f 0x05>,
                            <0x0 0x25 0x1f 0x29>,
                            <0x12 0x2a 0x07 0x03>;
            calib-mapping-names = "TRANSN", "TRANSP", "TRIM";
            pinctrl-0 = <&usb_udc_default>;
            pinctrl-names = "default";
            status = "okay";
    };
```

## dts/bindings/usb/microchip,usb-g2.yaml
```yaml
# SPDX-FileCopyrightText: Copyright (c) 2026 Microchip Technology Inc.
# SPDX-License-Identifier: Apache-2.0

title: Microchip USB G2 driver

description: |
  Microchip USB G2 driver bindings.

  Group g2 USB driver supports following hardware peripherals:
    - module name="USBHS" id="03787" version="2a0"

compatible: "microchip,usb-g2"

include:
  - name: mentor,musb.yaml
  - name: pinctrl-device.yaml

properties:
  reg:
    required: true
    description: |
      USBHS wrapper and MUSB core register regions.

  reg-names:
    required: true
    description: |
      Must be "wrapper", "core".

  clocks:
    required: true
    description: |
      Clock configuration for the USB controller.

  clock-names:
    description: |
      Names of the clock inputs.
```

## dts/bindings/usb/microsoft,xbox360-controller-device.yaml
```yaml
# Copyright (c) 2026 Adrien RICCIARDI
# SPDX-License-Identifier: Apache-2.0

description: Microsoft Xbox 360 controller

compatible: "microsoft,xbox360-controller-device"

include: base.yaml
```

## dts/bindings/usb/nordic,nrf-usbhs-phy-type1.yaml
```yaml
# Copyright (c) 2026 Nordic Semiconductor ASA
# SPDX-License-Identifier: Apache-2.0

description: Nordic USBHS Type 1 PHY configuration

compatible: "nordic,nrf-usbhs-phy-type1"

include: base.yaml

properties:
  compdistune:
    type: string
    default: "0"
    enum:
      - "-7.86%"
      - "-5.33%"
      - "-2.86%"
      - "0"
      - "+2.67%"
      - "+6.25%"
      - "+9.78%"
      - "+13.93%"
    description: |
      Disconnect Threshold Adjustment.
      Adjusts the voltage level for the threshold used to detect a disconnect
      event at the host.

  sqrxtune:
    type: string
    default: "0"
    enum:
      - "+17.09%"
      - "+11.15%"
      - "+5.84%"
      - "0"
      - "-5.25%"
      - "-11.01%"
      - "-16.49%"
      - "-22.24%"
    description: |
      Squelch Threshold Adjustment.
      Adjusts the voltage level for the threshold used to detect valid
      high-speed data.

  vdatreftune:
    type: string
    default: "0"
    enum:
      - "+10.26%"
      - "0"
      - "-10.38%"
      - "-20.65%"
    description: |
      Data Detect Voltage Adjustment.
      Adjusts the threshold voltage level used to detect data during Battery
      Charging 1.2 port detection.

  txhsxvtune:
    type: string
    default: "0"
    enum:
      - "-8.96 mV"
      - "+9.21 mV"
      - "0"
    description: |
      Transmitter High-Speed Crossover Adjustment.
      Adjusts the voltage at which the DP0 and DM0 signals cross while
      transmitting in HS mode.

  txfslstune:
    type: string
    default: "0"
    enum:
      - "+6.41%"
      - "+3.09%"
      - "0"
      - "-5.64%"
      - "-10.65%"
    description: |
      FS/LS Source Impedance Adjustment.
      Adjusts the low- and full-speed single-ended source impedance while
      driving high.

  txvreftune:
    type: string
    default: "0"
    enum:
      - "-6.07%"
      - "-4.02%"
      - "-2.04%"
      - "0"
      - "+1.79%"
      - "+3.83%"
      - "+5.80%"
      - "+7.85%"
      - "+9.59%"
      - "+11.63%"
      - "+13.60%"
      - "+15.64%"
      - "+17.41%"
      - "+19.45%"
      - "+21.42%"
      - "+23.46%"
    description: |
      HS DC Voltage Level Adjustment.
      Adjusts the high-speed DC level voltage.

  txrisetune:
    type: string
    default: "0"
    enum:
      - "+2.56%"
      - "0"
      - "-2.81%"
      - "-3.85%"
    description: |
      HS Transmitter Rise/Fall Time Adjustment.
      Adjusts the rise/fall times of the high-speed waveform.

  txrestune:
    type: string
    default: "0"
    enum:
      - "+2.93 ohm"
      - "0"
      - "-2.55 ohm"
      - "-4.82 ohm"
    description: |
      USB Source Impedance Adjustment.
      Adjusts the driver source impedance to compensate for added series
      resistance on the USB.

  txpreempamptune:
    type: string
    default: "1x"
    enum:
      - "disabled"
      - "1x"
      - "2x"
      - "3x"
    description: |
      HS Transmitter Pre-Emphasis Current Control.
      Controls the amount of current sourced to DP0 and DM0 after a J-to-K or
      K-to-J transition. The HS Transmitter pre-emphasis current is defined in
      terms of unit amounts. One unit amount is approximately 600 uA and is
      defined as 1x pre-emphasis current.

  txpreemppulsetune:
    type: string
    default: "1x"
    enum:
      - "2x"
      - "1x"
    description: |
      HS Transmitter Pre-Emphasis Duration Control.
      Controls the duration for which the HS pre-emphasis current is sourced
      onto DP0 or DM0. The HS Transmitter pre-emphasis duration is defined in
      terms of unit amounts. One unit of pre-emphasis duration is approximately
      580 ps and is defined as 1x pre-emphasis duration.
```

## dts/bindings/usb/nordic,nrf-usbhs-phy-type2.yaml
```yaml
# Copyright (c) 2026 Nordic Semiconductor ASA
# SPDX-License-Identifier: Apache-2.0

description: Nordic USBHS Type 2 PHY configuration

compatible: "nordic,nrf-usbhs-phy-type2"

include: base.yaml

properties:
  compdistune:
    type: string
    default: "0"
    enum:
      - "-4.65%"
      - "-3.29%"
      - "-1.44%"
      - "0"
      - "+1.85%"
      - "+3.40%"
      - "+5.48%"
      - "+7.15%"
    description: |
      Disconnect Threshold Adjustment.
      Adjusts the voltage level for the threshold used to detect a disconnect
      event at the host.

  sqrxtune:
    type: string
    default: "0"
    enum:
      - "+16.75%"
      - "+11.06%"
      - "+5.66%"
      - "0"
      - "-5.42%"
      - "-11.03%"
      - "-16.35%"
      - "-21.90%"
    description: |
      Squelch Threshold Adjustment.
      Adjusts the voltage level for the threshold used to detect valid
      high-speed data.

  vdatreftune:
    type: string
    default: "0"
    enum:
      - "+11.36%"
      - "0"
      - "-11.33%"
      - "-22.74%"
    description: |
      Data Detect Voltage Adjustment.
      Adjusts the threshold voltage level (Vdat_ref) used to detect data during
      Battery Charging 1.2 port detection.

  txhsxvtune:
    type: string
    default: "0"
    enum:
      - "-13 mV"
      - "+13 mV"
      - "0"
    description: |
      Transmitter High-Speed Crossover Adjustment.
      Adjusts the voltage at which the DP0 and DM0 signals cross while
      transmitting in HS mode.

  txfslstune:
    type: string
    default: "0"
    enum:
      - "+15%"
      - "+7%"
      - "0"
      - "-6%"
      - "-12%"
    description: |
      FS/LS Source Impedance Adjustment.
      Adjusts the low- and full-speed single-ended source impedance while
      driving high.

  txvreftune:
    type: string
    default: "0"
    enum:
      - "-9%"
      - "-6%"
      - "-3%"
      - "0"
      - "+3%"
      - "+6%"
      - "+9%"
      - "+12%"
      - "+15%"
      - "+18%"
      - "+22%"
      - "+25%"
      - "+28%"
      - "+31%"
      - "+34%"
      - "+37%"
    description: |
      HS DC Voltage Level Adjustment.
      Adjusts the high-speed DC level voltage.

  txrisetune:
    type: string
    default: "0"
    enum:
      - "+10%"
      - "0"
      - "-12%"
      - "-25%"
    description: |
      HS Transmitter Rise/Fall Time Adjustment.
      Adjusts the rise/fall times of the high-speed waveform.

  txrestune:
    type: string
    default: "0"
    enum:
      - "+6.5 ohm"
      - "+3 ohm"
      - "0"
      - "-2 ohm"
    description: |
      USB Source Impedance Adjustment.
      Adjusts the driver source impedance to compensate for added series
      resistance on the USB.

  txpreempamptune:
    type: string
    default: "disabled"
    enum:
      - "disabled"
      - "2x"
      - "1x"
      - "3x"
    description: |
      HS Transmitter Pre-Emphasis Current Control.
      Controls the amount of current sourced to DP0 and DM0 after a J-to-K or
      K-to-J transition. The HS Transmitter pre-emphasis current is defined in
      terms of unit amounts. One unit amount is approximately 4 mA and is
      defined as 1x pre-emphasis current.

  txpreemppulsetune:
    type: string
    default: "2x"
    enum:
      - "2x"
      - "1x"
    description: |
      HS Transmitter Pre-Emphasis Duration Control.
      Controls the duration for which the HS pre-emphasis current is sourced
      onto DP0 or DM0. The HS Transmitter pre-emphasis duration is defined in
      terms of unit amounts. One unit of pre-emphasis duration is approximately
      580 ps and is defined as 1x pre-emphasis duration.
```

## dts/bindings/usb/nordic,nrf-usbhs.yaml
```yaml
description: |
  Nordic USB High-Speed controller (DWC2 compatible) used on targets with NRFS.

compatible: "nordic,nrf-usbhs"

include: ["snps,dwc2.yaml"]

properties:
  reg:
    required: true

  phy:
    required: true
    type: phandle
    description: |
      USB PHY configuration
```

## dts/bindings/usb/realtek,bee-udc.yaml
```yaml
# Copyright (c) 2026, Realtek Semiconductor Corporation
# SPDX-License-Identifier: Apache-2.0

description: |
  Realtek Bee USB device controller (Synopsys DesignWare OTG USB 2.0 core).

compatible: "realtek,bee-udc"

include: ["snps,dwc2.yaml"]
```

## dts/bindings/usb/st,stm32n6-hsotg.yaml
```yaml
# SPDX-FileCopyrightText: Copyright The Zephyr Project Contributors
# SPDX-License-Identifier: Apache-2.0

description: |
  STM32N6 OTG_HS DWC2 compatible controller, driven by the native DWC2 host
  driver. The embedded high-speed PHY is selected by the "phys" phandle, which
  points at an "st,stm32n6-usbphyc" node.

compatible: "st,stm32n6-hsotg"

include: "snps,dwc2.yaml"

properties:
  clocks:
    required: true

  phys:
    required: true

  vbus-gpios:
    type: phandle-array
    description: |
      GPIO enabling the external VBUS power switch in host mode. It is driven
      active while the controller is enabled.
```

## dts/bindings/usb/zephyr,ccid.yaml
```yaml
# SPDX-FileCopyrightText: Copyright (c) 2026 TeraTron GmbH
# SPDX-License-Identifier: Apache-2.0

description: USB CCID single-slot APDU-level interface

compatible: "zephyr,ccid"

include: base.yaml

on-bus: usb

properties:
  instance-id:
    type: int
    required: true
    description: |
      Logical instance ID used by the CCID backend API and the USB class
      registration name ccid_<instance-id>. Must be unique among all enabled
      zephyr,ccid nodes. IDs may be sparse and do not determine the number of
      instances or allocated resources. This is not the USB interface number
      or the CCID slot number.

  label:
    description: |
      ASCII7 string used for the USB interface string descriptor. Defaults to
      "CCID" if omitted. The name does not select a card application or backend.
```

## dts/bindings/usb/zephyr,usbh-billboard.yaml
```yaml
# Copyright (c) 2026 Renesas Electronics Corporation
# SPDX-License-Identifier: Apache-2.0

description: Bindings for Billboard Host driver

compatible: "zephyr,usbh-billboard"

include: base.yaml

properties:
  "#address-cells":
    required: true
    const: 1

  "#size-cells":
    required: true
    const: 0
```

## dts/bindings/usb/zephyr,usbh-dfu-device.yaml
```yaml
# Copyright (c) 2026 Renesas Electronics Corporation
# SPDX-License-Identifier: Apache-2.0

description: Bindings for DFU Host driver device

compatible: "zephyr,usbh-dfu-device"

include: base.yaml

properties:
  reg:
    required: true
    description: USB device vendor + device IDs (0xFFFFFFFF acts as wildcard)
  match-class:
    type: boolean
    description: Whether to use the VID-DID combination or just match this to
      any DFU device.
```
