## dts/bindings/timer/raspberrypi,pico-system-timer.yaml
```yaml
# Copyright (c) 2026 Muhammad Waleed Badar
# SPDX-License-Identifier: Apache-2.0

description: |
  A TIMER block of the Raspberry Pi Pico used as the system timer.

  The block counts microseconds and both cores see the same one, so it suits
  an SMP kernel, which a per-core SysTick does not. Give the compatible to
  the timer, or on the RP2350 to one of its two, and disable the SysTick.

  The first interrupt of the node, alarm 0, is the one used.

compatible: "raspberrypi,pico-system-timer"

include: [base.yaml, reset-device.yaml]

properties:
  reg:
    required: true

  interrupts:
    required: true

  resets:
    required: true

  clock-frequency:
    type: int
    default: 1000000
    description: |
      Rate of the count in Hz. The clock driver runs the tick generators of
      the TIMER blocks at 1 MHz.

examples:
  - |
    /* RP2350: TIMER1 keeps the time, TIMER0 is left to the counter driver */
    &systick {
        status = "disabled";
    };

    &timer1 {
        compatible = "raspberrypi,pico-system-timer";
        status = "okay";
    };
  - |
    /* RP2040, which has one TIMER */
    &systick {
        status = "disabled";
    };

    &timer {
        compatible = "raspberrypi,pico-system-timer";
        status = "okay";
    };
```

## dts/bindings/timer/renesas,rh850-ostm.yaml
```yaml
# SPDX-FileCopyrightText: Copyright (c) 2026 Linumiz
#
# SPDX-License-Identifier: Apache-2.0

description: Renesas RH850 OS timer (OSTM)

compatible: "renesas,rh850-ostm"

include: base.yaml

properties:
  reg:
    required: true

  interrupts:
    required: true

  clock-frequency:
    type: int
    required: true
    description: |
      Frequency in Hz of the OSTM count clock (CLKC_HSB_OSTM).
```

## dts/bindings/timer/riscv,machine-timer.yaml
```yaml
# Copyright (c) 2025 MASSDRIVER EI (massdriver.space)
# SPDX-License-Identifier: Apache-2.0

title: RISC-V Machine Timer.

description: |
  The standard RISC-V machine timer. Takes 2 registers mtime and mtimecmp, or only mtimecmp if the
  target provides a 64-bit TIME CSR instead of a register.

compatible: "riscv,machine-timer"

include: base.yaml

properties:
  reg:
    required: true

  reg-names:
    required: true

  interrupts-extended:
    required: true

  32bit-mmio-mtimecmp:
    type: boolean
    description: |
      Some RISC-V implementations do not support atomic 64-bit MMIO stores to mtimecmp.
      This enables using the 32-bit write sequence (high=max, low=val, high=val) on 64-bit targets.
```

## dts/bindings/timer/ti,mspm0-system-timer.yaml
```yaml
# SPDX-FileCopyrightText: Copyright 2026 Linumiz
#
# SPDX-License-Identifier: Apache-2.0

description: TI MSPM0 Timer used as system timer

compatible: "ti,mspm0-system-timer"

include: base.yaml
```

## dts/bindings/timer/zephyr,native-sim-timer.yaml
```yaml
# SPDX-FileCopyrightText: Copyright The Zephyr Project Contributors
# SPDX-License-Identifier: Apache-2.0

description: |
  native_sim host timer.

  The timer is a CPU or architecture feature rather than a memory mapped
  peripheral, so the node carries neither reg nor interrupts. It exists so that
  the timer can be named by /chosen/zephyr,system-timer and so that its
  frequency can be described alongside the hardware.

compatible: "zephyr,native-sim-timer"

include: base.yaml

properties:
  clock-frequency:
    type: int
    description: |
      The clock source frequency for this timer, in Hz. This value can be used as
      the default setting for SYS_CLOCK_HW_CYCLES_PER_SEC at the SoC level.
```

## dts/bindings/usb/elan,em32-usbd.yaml
```yaml
# SPDX-FileCopyrightText: 2026 ELAN Microelectronics Corp.
# SPDX-License-Identifier: Apache-2.0

description: ELAN EM32 USB 2.0 full-speed device controller

compatible: "elan,em32-usbd"

include: usb-ep.yaml

properties:
  reg:
    required: true
    description: USB device controller register range

  clocks:
    required: true

  clock-names:
    required: true
    enum:
      - "aip"
      - "udc"
      - "atrim"

  interrupts:
    required: true

  interrupt-names:
    required: true
    enum:
      - "setup"
      - "suspend"
      - "resume"
      - "reset"
      - "ep-in"
      - "ep-out"
```

## dts/bindings/usb/generic-ohci.yaml
```yaml
# SPDX-FileCopyrightText: Copyright The Zephyr Project Contributors
# SPDX-License-Identifier: Apache-2.0

description: |
  Generic OHCI USB host controller

  Example of a memory mapped controller with a bus clock, a reset line and a
  USB PHY:

    usbh_ohci: usb@5800c000 {
      compatible = "generic-ohci";
      reg = <0x5800c000 0x1000>;
      clocks = <&rcc STM32_CLOCK(AHB6, 24)>;
      resets = <&rctl STM32_RESET(AHB6, 24)>;
      interrupts = <GIC_SPI 75 IRQ_TYPE_LEVEL IRQ_DEFAULT_PRIORITY>;
      phys = <&usbphyc_port0>;
      maximum-speed = "full-speed";
    };

compatible: "generic-ohci"

include: [usb-controller.yaml, pcie-device.yaml, reset-device.yaml]

properties:
  clocks:
    description: Bus clock of the controller.

  resets:
    description: Reset line of the controller.

  phys:
    type: phandle-array
    description: USB PHY port the controller is connected to.
```

## dts/bindings/usb/infineon,usbfs.yaml
```yaml
# SPDX-FileCopyrightText: Copyright (c) 2026 Infineon Technologies AG,
# SPDX-FileCopyrightText: or an affiliate of Infineon Technologies AG. All rights reserved.
#
# SPDX-License-Identifier: Apache-2.0

description: |
  Infineon MXUSBFS full-speed USB device controller

  The controller drives the dedicated USBDP/USBDM pads and integrates the
  series termination and the D+ pull-up, so no pinctrl or external components
  are required.

  The block must be clocked at 48 MHz

compatible: "infineon,usbfs"

include: usb-ep.yaml

properties:
  reg:
    required: true

  interrupts:
    required: true
    description: |
      Low, medium and high priority interrupt lines, in that order. The driver
      routes bus reset and endpoint 0 to the low line and data endpoint
      completion to the medium line, and leaves the high line unused. The
      medium line should have the higher priority, since it re-arms a bulk
      endpoint before the host's next token.

  interrupt-names:
    required: true

  clk-dst:
    type: int
    required: true
    description: |
      Maps to the en_clk_dst_t value the PDL uses to assign a peripheral clock
      divider for the USB bus reset clock (PCLK_USB_CLOCK_DEV_BRS)

  brs-div-type:
    type: int
    default: 1
    enum: [0, 1, 2, 3]
    description: |
      Peripheral divider type used for the bus reset clock, as cy_en_divider_types_t:
      0 = 8 bit, 1 = 16 bit, 2 = 16.5 bit fractional, 3 = 24.5 bit fractional.
      The default is a 16 bit divider, which is what the Infineon reference
      configuration uses.

  brs-div-num:
    type: int
    default: 7
    description: |
      Index of the peripheral divider used for the bus reset clock. On CAT1A the
      legacy HAL allocates dividers from the bottom upwards, so the default is
      the topmost 16 bit divider to avoid colliding with it. Boards that use
      that divider for something else must override this

  dmas:
    description: |
      One DataWire channel per data endpoint, used when
      CONFIG_UDC_INFINEON_USBFS_DMA is enabled to copy packets between the
      endpoint buffer and RAM. The entries describe data endpoints 1 upwards
      in order, so the first entry serves endpoint 1.

      The channel numbers are not free. A dedicated trigger line pairs
      usb.dma_req[i] with cpuss.dw0_tr_in[8 + i] and cpuss.dw0_tr_out[8 + i]
      with usb.dma_burstend[i], so data endpoint N can only be served by DW0
      channel 7 + N. The driver checks this at build time.

      The SoC lists all eight channels, because the controller has eight data
      endpoints. A board that needs some of those channels for other
      peripherals should shorten the list to the number of endpoints its USB
      configuration actually uses, for example three entries for CDC ACM:

        &usbfs0 {
                dmas = <&dma0 8>, <&dma0 9>, <&dma0 10>;
        };
```

## dts/bindings/usb/ite,it51xxx-uhc.yaml
```yaml
# Copyright (c) 2026 ITE Corporation. All Rights Reserved.
# SPDX-License-Identifier: Apache-2.0

description: ITE IT51XXX usb host controller

compatible: "ite,it51xxx-uhc"

include: [usb-controller.yaml, pinctrl-device.yaml, "ite,general-config.yaml"]

properties:
  phy-handle:
    type: phandle

  reg:
    required: true

  interrupts:
    required: true

  pinctrl-0:
    required: true

  pinctrl-names:
    required: true
```

## dts/bindings/usb/mentor,musb-common.yaml
```yaml
# SPDX-FileCopyrightText: Copyright The Zephyr Project Contributors
# SPDX-FileCopyrightText: Copyright (c) 2026 Arkadiusz Grzelka
#
# SPDX-License-Identifier: Apache-2.0

include: usb-ep.yaml

properties:
  reg:
    required: true

  interrupts:
    required: true

  maximum-speed:
    type: string
    description: |
      Highest speed the controller advertises. "full-speed" leaves
      POWER.HSEN clear; "high-speed" sets it. Omitted means full speed:
      which speed a port may run at is a property of the connector and
      its routing, not of the controller, so a board that has not said
      so gets the slower of the two rather than the faster.
```

## dts/bindings/usb/mentor,musb.yaml
```yaml
# Copyright (c) 2026 Microchip Technology Inc.
# SPDX-License-Identifier: Apache-2.0

description: Mentor Graphics MUSB device controller

compatible: "mentor,musb"

include: usb-ep.yaml

properties:
  reg:
    required: true
    description: |
      MUSB core register region. If the core is behind a vendor wrapper, use
      the named regions "wrapper" and "core".

  interrupts:
    required: true

  num-in-endpoints:
    required: true

  num-out-endpoints:
    required: true
```

## dts/bindings/usb/microchip,pic32cz-usbhs.yaml
```yaml
# SPDX-FileCopyrightText: Copyright The Zephyr Project Contributors
# SPDX-FileCopyrightText: Copyright (c) 2026 Arkadiusz Grzelka
#
# SPDX-License-Identifier: Apache-2.0

title: Microchip PIC32CZ USBHS controller

description: |
  USB controller for the PIC32CZ CA family's USBHS peripheral
  (module name="USBHS" id="03787", usb_otg_2_0_ctlr_v2).

  The peripheral is a Mentor Graphics Inventra MUSB core behind a
  Microchip wrapper: the wrapper registers occupy the low offsets, the
  MUSB core starts at offset 0x1000, and a PHY control block sits at
  0x1500.

  The signals are on dedicated pads, not on GPIO, so there is no pinctrl
  property. Each instance needs a 270 ohm 1% resistor from its USBRBIASn
  pad to AGND; without it the PHY will not meet the USB electrical spec.

  The role is selected at build time: the device controller driver forces
  a B-plug identity and the host controller driver an A-plug identity in
  software. Neither consults the USBID pad.

compatible: "microchip,pic32cz-usbhs"

include: mentor,musb-common.yaml

properties:
  clocks:
    required: true

  clock-names:
    required: true

  drd-gpios:
    type: phandle-array
    description: |
      Select line of the analog switch that connects the Type-C CC
      pull-down resistors to the CC pins, where the board puts the
      resistors behind such a switch. The active level selects the device
      side (Rd) and the inactive level the host side (Rp), so the flags in
      the phandle carry the polarity and the drivers encode none of their
      own. The device driver drives it active, the host driver inactive.

      Omit it on a board whose CC resistors connect to CC directly.

  vbus-enable-gpios:
    type: phandle-array
    description: |
      Enable input of the VBUS power switch on the connector, where the
      board can source 5 V onto it. Driven to its inactive level during
      init: a device that sources VBUS into a host puts two supplies
      against each other. The host driver asserts it while the controller
      is enabled. The flags in the phandle carry the polarity.

      Omit it on a board that cannot source VBUS on this port.

examples:
  - |
    usbhs1: usb@4f012000 {
            compatible = "microchip,pic32cz-usbhs";
            reg = <0x4f012000 0x2000>;
            interrupts = <214 0>;
            clocks = <&mclkperiph CLOCK_MCHP_MCLKPERIPH_ID_HUSB1>;
            clock-names = "mclk";
            num-bidir-endpoints = <8>;
            maximum-speed = "full-speed";
            status = "okay";
    };
```

## dts/bindings/usb/microchip,udphs-g1-udc.yaml
```yaml
# Copyright (c) 2026 Microchip Technology Inc.
# SPDX-License-Identifier: Apache-2.0

description: |
  Microchip USB Device High Speed Port (UDPHS) G1.

  SAM UDPHS is based on the following hardware peripheral:
    - module name="UDPHS" id="6227" version="160"

examples:
  - |
    Example devicetree configuration:

      &pinctrl {
        pinctrl_usba_vbus_det: usba_vbus_det {
          pinmux = <PIN_PD11__GPIO>;
          bias-disable;
        };
      };

      zephyr_udc0: &udphsa {
        vbus-gpios = <&piod 11 GPIO_ACTIVE_HIGH>;
        pinctrl-names = "default";
        pinctrl-0 = <&pinctrl_usba_vbus_det>;
        status = "okay";
      };

compatible: "microchip,udphs-g1-udc"

include:
  - name: usb-ep.yaml
  - name: pinctrl-device.yaml

properties:
  reg:
    required: true

  interrupts:
    required: true

  clocks:
    required: true
```
