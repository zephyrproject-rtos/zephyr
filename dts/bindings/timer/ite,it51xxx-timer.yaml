## dts/bindings/timer/ite,it51xxx-timer.yaml
```yaml
# Copyright (c) 2025 ITE Corporation. All Rights Reserved.
# SPDX-License-Identifier: Apache-2.0

description: ITE it51xxx external timer

compatible: "ite,it51xxx-timer"

include: base.yaml

properties:
  reg:
    required: true

  interrupts:
    required: true
```

## dts/bindings/timer/ite,it8xxx2-timer.yaml
```yaml
# Copyright (c) 2020 ITE Corporation. All Rights Reserved.
# SPDX-License-Identifier: Apache-2.0

description: ITE Ext-timer

compatible: "ite,it8xxx2-timer"

include: base.yaml

properties:
  reg:
    required: true

  interrupts:
    required: true
```

## dts/bindings/timer/litex,timer0.yaml
```yaml
# Copyright (c) 2018 - 2019 Antmicro <www.antmicro.com>
# SPDX-License-Identifier: Apache-2.0

description: LiteX timer

compatible: "litex,timer0"

include: base.yaml

properties:
    reg:
      required: true

    interrupts:
      required: true
```

## dts/bindings/timer/lowrisc,machine-timer.yaml
```yaml
# Copyright (c) 2023 Rivos Inc.
# SPDX-License-Identifier: Apache-2.0

description: |
  OpenTitan Machine Timer

  The OpenTitan machine timer provides RISC-V privileged mtime and mtimecmp
  registers.

compatible: "lowrisc,machine-timer"

include: base.yaml

properties:
  reg:
    required: true

  interrupts:
    required: true
```

## dts/bindings/timer/mediatek,ostimer64.yaml
```yaml
# Copyright 2024 The ChromiumOS Authors
# SPDX-License-Identifier: Apache-2.0

include: base.yaml

# This clock hardware is almost fully described by its register block,
# but needs a binding for the frequency property below (which is
# architecturally fixed at 13 MHz on all known devices)

description: MediaTek Audio DSP Core Clock
compatible: "mediatek,ostimer64"
properties:
  freq-hz:
    type: int
    default: 13000000
```

## dts/bindings/timer/microchip,dspic33-timer.yaml
```yaml
# Copyright (c) 2025 Microchip Technology Inc.
# SPDX-License-Identifier: Apache-2.0

description: Microchip DSPIC33 timer

compatible: "microchip,dspic33-timer"

include: base.yaml

properties:
  reg:
    required: true

  clock-frequency:
    type: int
    required: true

  prescalar:
    type: int
    required: true

  interrupts:
    required: true

  label:
    type: string
```

## dts/bindings/timer/microchip,mec5-ktimer.yaml
```yaml
# Copyright (c) 2019 Microchip Technology Inc.
# SPDX-License-Identifier: Apache-2.0

description: |
  Microchip MEC5 kernel timer implemented by combining
  the 32kHz 32-bit RTOS timer with 32-bit basic timer 5.

compatible: "microchip,mec5-ktimer"

include: base.yaml

properties:
  reg:
    required: true

  interrupts:
    required: true

  clock-frequency:
    type: int
    required: true
    const: 32768
    description: RTOS timer runs at fixed 32 KHz.

  max-value:
    type: int
    required: true
    const: 0xffffffff
    description: RTOS timer counter maximum value.
```

## dts/bindings/timer/microchip,pic32cxsg-tc32.yaml
```yaml
# Copyright (c) 2024 Microchip
# SPDX-License-Identifier: Apache-2.0

description: Microchip PIC32CXSG basic timer counter (TC) operating in 32-bit wide mode

compatible: "microchip,pic32cxsg-tc32"

include:
  - name: base.yaml
  - name: pinctrl-device.yaml

properties:
  reg:
    required: true

  interrupts:
    required: true

  clocks:
    required: true

  clock-names:
    required: true

  prescaler:
    type: int
    description: Timer prescaler
    enum:
      - 1
      - 2
      - 4
      - 8
      - 16
      - 64
      - 256
      - 1024
```

## dts/bindings/timer/microchip,sam-pit64b.yaml
```yaml
# Copyright (C) 2025 Microchip Technology Inc. and its subsidiaries
#
# SPDX-License-Identifier: Apache-2.0
#

description: |
  Microchip SAM 64-bit Periodic Interval Timer (PIT64B).

compatible: "microchip,sam-pit64b"

include: base.yaml

properties:
  reg:
    required: true

  clocks:
    required: true

  clock-frequency:
    type: int
    description: Clock frequency in Hz
```

## dts/bindings/timer/microchip,xec-basic-timer.yaml
```yaml
# Copyright (c) 2025 Microchip Technology Inc.
# SPDX-License-Identifier: Apache-2.0

description: Microchip XEC basic timer properties

compatible: "microchip,xec-basic-timer"

include: ["base.yaml", "microchip,dmec-ecia-girq.yaml"]

properties:
  reg:
    required: true

  interrupts:
    required: true

  clock-frequency:
    type: int
    required: true
    const: 48000000
    description: Basic timer input clock is 48 MHz.

  max-value:
    type: int
    required: true
    description: |
      Counter maximum value. The SoC contains multiple instances
      of the basic timer. Some are 16-bit, others 32-bit.

  prescaler:
    type: int
    required: true
    description: |
      Basic timer implements a 16-bit clock prescale value.
      Count frequency is clock-frequency divided by (prescaler + 1).
```

## dts/bindings/timer/microchip,xec-rtos-timer.yaml
```yaml
# Copyright (c) 2019 Microchip Technology Inc.
# SPDX-License-Identifier: Apache-2.0

description: Microchip XEC RTOS timer

compatible: "microchip,xec-rtos-timer"

include: ["base.yaml", "microchip,dmec-ecia-girq.yaml"]

properties:
  reg:
    required: true

  interrupts:
    required: true

  busy-wait-timer:
    type: phandle
    description: |
      If custom busy wait Kconfig is enabled then this points to the 32-bit
      basic timer node used to implement the 1 MHz busy wait timer.

  clock-frequency:
    type: int
    required: true
    const: 32768
    description: RTOS timer runs at fixed 32 KHz.
```

## dts/bindings/timer/neorv32-machine-timer.yaml
```yaml
# Copyright (c) 2022 Nordic Semiconductor ASA
# SPDX-License-Identifier: Apache-2.0

description: |
  NEORV32 Machine Timer

  The NEORV32 machine timer provides RISC-V privileged mtime and mtimecmp
  registers.

compatible: "neorv32-machine-timer"

include: base.yaml

properties:
    reg:
      required: true

    interrupts:
      required: true
```

## dts/bindings/timer/niosv-machine-timer.yaml
```yaml
# Copyright (C) 2023, Intel Corporation
# SPDX-License-Identifier: Apache-2.0

description: |
  NIOSV Machine Timer

  The NIOSV machine timer provides RISC-V privileged mtime and mtimecmp
  registers.

compatible: "niosv-machine-timer"

include: base.yaml

properties:
  reg:
    required: true

  interrupts:
    required: true
```

## dts/bindings/timer/nordic,nrf-grtc.yaml
```yaml
#
# Copyright (c) 2024 Nordic Semiconductor ASA
#
# SPDX-License-Identifier: Apache-2.0
#

description: |
  Nordic GRTC (Global RTC)

      Example of using clock outputs:
        &grtc {
          pinctrl-0 = <&grtc_default>;
          pinctrl-1 = <&grtc_sleep>;
          pinctrl-names = "default", "sleep";
          clkout-fast-frequency = <8000000>;
          clkout-32k;
          /* In case of nRF54H20 devices: */
          nordic,clockpin-enable = <NRF_FUN_GRTC_CLKOUT_FAST>;
        };

compatible: "nordic,nrf-grtc"

include:
  - "base.yaml"
  - "nordic,split-channels.yaml"
  - "pinctrl-device.yaml"
  - "nordic-clockpin.yaml"

properties:
  reg:
    required: true

  clkout-fast-frequency:
    type: int
    description: Fast output clock frequency.

  clkout-32k:
    type: boolean
    description: 32768 Hz output clock frequency enable.

  interrupts:
    required: true

  cc-num:
    description: Number of capture/compare channels
    type: int
    required: true
```

## dts/bindings/timer/nordic,nrf-timer.yaml
```yaml
# Copyright (c) 2018 Nordic Semiconductor ASA
# SPDX-License-Identifier: Apache-2.0

description: Nordic nRF timer node

compatible: "nordic,nrf-timer"

include: base.yaml

properties:
  reg:
    required: true

  cc-num:
    type: int
    required: true
    description: Number of capture/compare (CC) registers available

  max-bit-width:
    type: int
    required: true
    description: Maximum bit width supported

  interrupts:
    required: true

  max-frequency:
    type: int
    default: 16000000
    description: |
        Maximum timer frequency in Hz.

        The default value is 16MHz which was the maximum frequency for all nRF TIMER peripherals
        up to the nRF54 series, and still remains the most typical maximum frequency for nRF54
        TIMERs.

  prescaler:
    type: int
    required: true
    description: Prescaler value determines frequency (max-frequency/2^prescaler)

  zli:
    type: boolean
    description: Enable event handler in the ZLI (Zero latency interrupt) context
```

## dts/bindings/timer/nuclei,systimer.yaml
```yaml
# Copyright (c) 2021 TOKITA Hiroshi <tokita.hiroshi@gmail.com>
# SPDX-License-Identifier: Apache-2.0

description: |
  Nuclei System Timer

  The Nuclei system timer provides RISC-V privileged mtime and mtimecmp
  registers.

compatible: "nuclei,systimer"

include: base.yaml

properties:
  reg:
    required: true

  interrupts:
    required: true

  clk-divider:
    type: int
    description: |
      clk-divider specifies the division ratio to the CPU frequency that
      clock used by the system timer.
      This property supports the case that the system timer and CPU use
      different clock sources.
      This configuration is used sometimes for such as low power consumption.

      For example, the CPU clock frequency is 108MHz, and the system timer
      uses 27MHz, which is the CPU clock divided by 4.
      In this case, the CPU clock frequency is defined in the CPU node
      as follows

         clock-frequency = <108000000>;

      This property takes exponent of the power of 2.
      The relationship with the frequency division ratio is as
      following equation.

         division_ratio = 2^n
         n = log_2(division_ratio)

      Setting clk-divider to 2 specifies the system timer uses the clock
      that CPU clock frequency divided by (2^2=)4, or 27MHz.

      Devision ratio constants can be found in the
      dt-bindings/timer/nuclei-systimer.h header file.
```

## dts/bindings/timer/nuvoton,nct-itim-systick.yaml
```yaml
# Copyright (c) 2025 Nuvoton Technology Corporation.
# SPDX-License-Identifier: Apache-2.0

description: Nuvoton, NCT series SYSTICK that use internal timer(ITIM) node

compatible: "nuvoton,nct-itim-systick"

include: base.yaml

properties:
  reg:
    required: true

  interrupts:
    required: true
```

## dts/bindings/timer/nuvoton,npcm-itim-systick.yaml
```yaml
# Copyright (c) 2024 Nuvoton Technology Corporation.
# SPDX-License-Identifier: Apache-2.0

description: Nuvoton, NPCM series SYSTICK that use internal timer(ITIM) node

compatible: "nuvoton,npcm-itim-systick"

include: base.yaml

properties:
  reg:
    required: true

  interrupts:
    required: true
```

## dts/bindings/timer/nuvoton,npcx-itim-timer.yaml
```yaml
# Copyright (c) 2021 Nuvoton Technology Corporation.
# SPDX-License-Identifier: Apache-2.0

description: Nuvoton NPCX Internal Timer (ITIM)

compatible: "nuvoton,npcx-itim-timer"

include: base.yaml

properties:
  reg:
    required: true

  interrupts:
    required: true

  clock-frequency:
    required: true
    type: int
    description: |
      The frequency in Hz for this timer's clock source.
      This value is used to set SYS_CLOCK_HW_CYCLES_PER_SEC.
```

## dts/bindings/timer/nxp,ftm.yaml
```yaml
# Copyright (c) 2017, 2025 NXP
# SPDX-License-Identifier: Apache-2.0

description: NXP FlexTimer Module (FTM)

compatible: "nxp,ftm"

include: base.yaml

properties:
  reg:
    required: true

  interrupts:
    required: true

  prescaler:
    type: int
    required: true
    enum:
      - 1
      - 2
      - 4
      - 8
      - 16
      - 32
      - 64
      - 128
    description: Input clock prescaler

  clock-source:
    type: string
    required: true
    enum:
      - "system"
      - "fixed"
      - "external"
    description: |
      Select one of three possible clock sources for the FTM counter:
        * system: it's the bus interface clock driving the FTM module. Usually
          provides higher timer resolution than the other two clock sources.
        * fixed: it's a fixed clock defined by chip integration.
        * external: it's a clock that can be accessed externally to the chip and
          passes through a sychronizer clocked by the FTM bus interface clock.

      This clock source selection is independent of the bus interface clock
      driving the FTM module. Refer to the chip specific documentation for
      further information.
```

## dts/bindings/timer/nxp,gpt-hw-timer.yaml
```yaml
# Copyright (c) 2022 Kumar Gala <galak@kernel.org>
# SPDX-License-Identifier: Apache-2.0

description: NXP MCUX General-Purpose HW Timer (GPT)

compatible: "nxp,gpt-hw-timer"

include: base.yaml

properties:
    reg:
      required: true

    interrupts:
      required: true
```

## dts/bindings/timer/nxp,imx-gpt.yaml
```yaml
# Copyright (c) 2018 Nordic Semiconductor ASA
# SPDX-License-Identifier: Apache-2.0

description: NXP MCUX General-Purpose Timer (GPT)

compatible: "nxp,imx-gpt"

include: base.yaml

properties:
  reg:
    required: true

  interrupts:
    required: true

  gptfreq:
    type: int
    required: true
    description: gpt frequences
```

## dts/bindings/timer/nxp,kinetis-pit.yaml
```yaml
# Copyright (c) 2019 NXP Semiconductor
# SPDX-License-Identifier: Apache-2.0

title: NXP MCUX Periodic Interrupt Timer

description: |
    This is a representation of the NXP MCUX Periodic Interrupt Timer (PIT)

compatible: "nxp,kinetis-pit"

include: base.yaml

properties:
    reg:
      required: true

    interrupts:
      required: true

    label:
      required: true
```
