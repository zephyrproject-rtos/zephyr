## dts/bindings/timer/telink,machine-timer.yaml
```yaml
# Copyright (c) 2022 Nordic Semiconductor ASA
# SPDX-License-Identifier: Apache-2.0

description: |
  Telink Machine Timer

  The Telink machine timer provides RISC-V privileged mtime and mtimecmp
  registers.

compatible: "telink,machine-timer"

include: base.yaml

properties:
  reg:
    required: true

  interrupts:
    required: true
```

## dts/bindings/timer/thead,c906-clint-timer.yaml
```yaml
# Copyright (c) 2023-2024 Chen Xingyu <hi@xingrz.me>
# SPDX-License-Identifier: Apache-2.0

description: T-Head C906 CLINT Timer

compatible: "thead,c906-clint-timer"

include: base.yaml

properties:
  reg:
    required: true

  interrupts-extended:
    required: true
```

## dts/bindings/timer/thead,machine-timer.yaml
```yaml
# Copyright (c) 2023-2024 Chen Xingyu <hi@xingrz.me>
# SPDX-License-Identifier: Apache-2.0

description: T-Head Machine Timer

compatible: "thead,machine-timer"

include: base.yaml

properties:
  reg:
    required: true

  interrupts-extended:
    required: true
```

## dts/bindings/timer/ti,am26-rtitimer.yaml
```yaml
# Copyright (C) 2025 Texas Instruments Incorporated
# SPDX-License-Identifier: Apache-2.0

description: TI RTI Timer

  To use one of the RTI blocks as a system timer,
  provide an alias 'systick-timer' that points to the RTI node of choice in devicetree.

  NOTE - The driver uses Counter Block 0 by default
  for the chosen RTI instance to generate interrupts.

compatible: "ti,am26-rtitimer"

include: base.yaml

properties:
  reg:
    required: true

  interrupts:
    required: true
```
