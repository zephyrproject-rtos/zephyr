## dts/bindings/timer/renesas,rza2m-ostm-timer.yaml
```yaml
# Copyright (c) 2025 Renesas Electronics Corporation
# SPDX-License-Identifier: Apache-2.0

description: Renesas RZA2M OSTM timer

compatible: "renesas,rza2m-ostm-timer"

include: base.yaml
```

## dts/bindings/timer/renesas,rza2m-ostm.yaml
```yaml
description: Renesas RZ/A2M OS timer

compatible: "renesas,rza2m-ostm"

include: base.yaml

properties:
  reg:
    required: true

  clocks:
    required: true

  interrupts:
    required: true
```

## dts/bindings/timer/renesas,smartbond-timer.yaml
```yaml
# Copyright (c) 2022 Renesas Electronics Corporation and/or its affiliates
# SPDX-License-Identifier: Apache-2.0

description: Smartbond timers

compatible: "renesas,smartbond-timer"

include: base.yaml

properties:
  reg:
    required: true

  clock-src:
    type: phandle
    description: |
        Timer uses divn_clk or lp_clk

  prescaler:
    type: int
    required: true
    description: |
      Clock prescaler at the input of the timer
      Could be in range [0 .. 31] (CLK/(prescaler+1) )

  countermode:
    type: int
    default: 0 # SMARTBOND_TIM_COUNTERMODE_UP - reset state
    description: |
      Sets timer counter mode.

      Use constants defined in dt-bindings/timer/smartbond-timer.h.

      * SMARTBOND_TIM_COUNTERMODE_UP             - used as upcounter.
      * SMARTBOND_TIM_COUNTERMODE_DOWN           - used as downcounter.
      * SMARTBOND_TIM_COUNTERMODE_CENTER_DOWN    - counts up and down alternatively.
                                                   Output compare interrupt flags of output channels
                                                   are set only when the counter is counting down.
      * SMARTBOND_TIM_COUNTERMODE_CENTER_UP      - counts up and down alternatively.
                                                   Output compare interrupt flags of output channels
                                                   are set only when the counter is counting up.
      * SMARTBOND_TIM_COUNTERMODE_CENTER_UP_DOWN - counts up and down alternatively.
                                                   Output compare interrupt flags of output channels
                                                   are set only when the counter is counting
                                                   up or down.

      If absent, then SMARTBOND_TIM_COUNTERMODE_UP is used (reset state).
```

## dts/bindings/timer/riscv,aclint-mtimer.yaml
```yaml
# Copyright (c) 2024 Tenstorrent Inc
# SPDX-License-Identifier: Apache-2.0

description: RISC-V Advanced Core Local Interruptor

compatible: "riscv,aclint-mtimer"

include: base.yaml

properties:
  reg:
    required: true
```

## dts/bindings/timer/sifive,clint0.yaml
```yaml
# Copyright (c) 2022 Nordic Semiconductor ASA
# SPDX-License-Identifier: Apache-2.0

description: SiFive RISC-V Core-Local Interruptor.

compatible: "sifive,clint0"

include: base.yaml

properties:
  reg:
    required: true

  use-32bit:
    type: boolean
    description: |
      Access registers using 32-bit instructions on a 64-bit CPU.

  mtime-use-csr:
    type: boolean
    description: |
      Use CSR time register to access the mtime value.
```

## dts/bindings/timer/sifli,sf32lb-atim.yaml
```yaml
# Copyright (c) 2025, Qingsong Gou <gouqs@hotmail.com>
# SPDX-License-Identifier: Apache-2.0

description: Sifli SF32LB ATIM

compatible: "sifli,sf32lb-atim"

include: base.yaml

properties:
  reg:
    required: true

  interrupts:
    required: true

  clocks:
    required: true

  sifli,prescaler:
    type: int
    default: 0
    required: true
    description: |
      Counter prescaler from 0 to 65535. default reset value is 'not divided'
      The clock frequency to the counter is the input frequency divided by (prescaler + 1).
      For example, if the input clock is 48 MHz and the desired counter clock is 1 MHz,
      set this property to 47.
```

## dts/bindings/timer/sifli,sf32lb-gptim.yaml
```yaml
# Copyright (c) 2025, Qingsong Gou <gouqs@hotmail.com>
# SPDX-License-Identifier: Apache-2.0

description: Sifli SF32LB General Purpose Timer (GPT)

compatible: "sifli,sf32lb-gptim"

include: base.yaml

properties:
  reg:
    required: true

  interrupts:
    required: true

  sifli,prescaler:
    type: int
    default: 0
    required: true
    description: |
      Counter prescaler from 0 to 65535. The clock frequency to the counter
      is the input frequency divided by (prescaler + 1). For example, if the
      input clock is 48 MHz and the desired counter clock is 1 MHz, set this
      property to 47.
```

## dts/bindings/timer/sifli,sf32lb-lptim.yaml
```yaml
# Copyright (c) 2025, Qingsong Gou <gouqs@hotmail.com>
# SPDX-License-Identifier: Apache-2.0

description: Sifli SF32LB LPTIM (Low Power Timer)

compatible: "sifli,sf32lb-lptim"

include: base.yaml

properties:
  reg:
    required: true

  interrupts:
    required: true

  clocks:
    required: true

  sifli,prescaler:
    type: int
    default: 0
    required: true
    enum: [0, 1, 2, 3, 4, 5, 6, 7]
    description: |
      Counter prescaler for the low power timer. The clock frequency to the counter
      is the input frequency divided by 2^(prescaler + 1). Valid values are 0-7,
      providing division factors from 1 to 128.
```

## dts/bindings/timer/silabs,gecko-burtc.yaml
```yaml
# Copyright (c) 2023 Antmicro <www.antmicro.com>
# SPDX-License-Identifier: Apache-2.0

title: Silicon Labs Series 2 BURTC (Backup Real Time Counter)

description: |
  Backup RTC timer for Silicon Labs Series 2 SoCs.

compatible: "silabs,gecko-burtc"

include: base.yaml

properties:
  reg:
    required: true

  interrupts:
    required: true
```

## dts/bindings/timer/silabs,gecko-timer.yaml
```yaml
# Copyright (c) 2021, Sun Amar
# SPDX-License-Identifier: Apache-2.0

description: Silabs Gecko timer

compatible: "silabs,gecko-timer"

include: base.yaml

properties:
  reg:
    required: true
```

## dts/bindings/timer/silabs,series2-letimer.yaml
```yaml
# Copyright (c) 2025 Silicon Laboratories Inc.
# SPDX-License-Identifier: Apache-2.0

title: Silicon Labs LETIMER (Low Energy Timer)

description: |
  Low Energy Timer peripheral on Silicon Labs Series 2 SoCs.

compatible: "silabs,series2-letimer"

include: [base.yaml]

properties:
  reg:
    required: true

  clocks:
    required: true

  run-in-debug:
    type: boolean
    description: |
      Enable to keep timer running in debug mode.

  clock-div:
    type: int
    default: 1
    description: Clock divider for timer
    enum:
      - 1
      - 2
      - 4
      - 8
      - 16
      - 32
      - 64
      - 128
      - 256
```

## dts/bindings/timer/silabs,series2-timer.yaml
```yaml
# Copyright (c) 2025 Silicon Laboratories Inc.
# SPDX-License-Identifier: Apache-2.0

title: Silicon Labs TIMER

description: |
  TIMER peripheral on Silicon Labs Series 2 SoCs.

compatible: "silabs,series2-timer"

include: [base.yaml]

properties:
  reg:
    required: true

  clocks:
    required: true

  run-in-debug:
    type: boolean
    description: |
      Enable to keep timer running in debug mode.

  clock-div:
    type: int
    default: 1
    description: Clock divider for timer
    enum:
      - 1
      - 2
      - 4
      - 8
      - 16
      - 32
      - 64
      - 128
      - 256
      - 512
      - 1024

  channels:
    type: int
    required: true
    description: Number of compare/capture channels available

  counter-size:
    type: int
    required: true
    description: Width of the counter in bits
    enum:
      - 16
      - 32
```

## dts/bindings/timer/snps,arc-timer.yaml
```yaml
# Copyright (c) 2022 Nordic Semiconductor ASA
# SPDX-License-Identifier: Apache-2.0

description: |
  Synopsys ARC Local Timer with Interrupt Capabilities

compatible: "snps,arc-timer"

include: base.yaml

properties:
  interrupts:
    required: true
```

## dts/bindings/timer/st,stm32-lptim.yaml
```yaml
# Copyright (c) 2020, STMicroelectronics
# SPDX-License-Identifier: Apache-2.0

description: |
  STM32 low-power timer (LPTIM).

compatible: "st,stm32-lptim"

include:
  - name: st,stm32-timers.yaml
    property-blocklist:
      - st,prescaler
      - st,countermode
      - st,mastermode
      - st,slavemode
      - st,trigger-selection

properties:
  st,prescaler:
    type: int
    default: 1
    description: |
        Clock divider at the input of the lptimer clock, default reset value is 'not divided'.

        Prescaler allows to achieve higher LPTIM timeout (up to 256s when lptim clocked by LSE)
        and consequently higher core sleep durations, but impacts the tick precision.
        To be used with caution.
        CONFIG_SYS_CLOCK_TICKS_PER_SEC could be used to tune tick duration and gain precision,
        at kernel timing granularity cost.

        For example, when LPTIM is clocked by the LSE (32768Hz) and st,prescaler = <32>:
        LPTIM global timeout is 64 seconds with an increment of 0.97 ms.
        Using CONFIG_SYS_CLOCK_TICKS_PER_SEC = 4096, tick = 0.24 ms, LPTIM precision is 4 ticks.
        Using CONFIG_SYS_CLOCK_TICKS_PER_SEC = 1024, tick = 0.97 ms, LPTIM precision is 1 ticks.
    enum:
      - 1
      - 2
      - 4
      - 8
      - 16
      - 32
      - 64
      - 128

  st,timeout:
    type: int
    description: |
        Gives the LPTIM an exact counting value (s) for timeout expiration.
        Value must be consistent with st,prescaler pre-defined setting otherwise
        driver fails to initialize for the related device.
    min: 1
    max: 256

examples:
  - |
    /*
     * Usage of LPTIM as system timer:
     * (1) enable and configure selected LPTIM instance
     */
    &lptim1 {
      status = "okay";
    }

    /* (2) select instance as system timer */
    / {
      chosen {
        zephyr,system-timer = &lptim1;
      };
    };
```

## dts/bindings/timer/st,stm32-timers.yaml
```yaml
# Copyright (c) 2020, STMicroelectronics
# SPDX-License-Identifier: Apache-2.0

description: STM32 timers

compatible: "st,stm32-timers"

include: [base.yaml, reset-device.yaml]

properties:
  reg:
    required: true

  clocks:
    required: true

  resets:
    required: true

  st,prescaler:
    type: int
    required: true
    description: |
      Clock prescaler at the input of the timer
      Could be in range [0 .. 0xFFFF] for STM32 General Purpose Timers (CLK/(prescaler+1) )

  st,countermode:
    type: int
    default: 0 # STM32_TIM_COUNTERMODE_UP - reset state
    description: |
      Sets timer counter mode.

      Use constants defined in dt-bindings/timer/stm32-timer.h.

      * STM32_TIM_COUNTERMODE_UP             - used as upcounter.
      * STM32_TIM_COUNTERMODE_DOWN           - used as downcounter.
      * STM32_TIM_COUNTERMODE_CENTER_DOWN    - counts up and down alternatively.
                                               Output compare interrupt flags of output channels
                                               are set only when the counter is counting down.
      * STM32_TIM_COUNTERMODE_CENTER_UP      - counts up and down alternatively.
                                               Output compare interrupt flags of output channels
                                               are set only when the counter is counting up.
      * STM32_TIM_COUNTERMODE_CENTER_UP_DOWN - counts up and down alternatively.
                                               Output compare interrupt flags of output channels
                                               are set only when the counter is counting up or
                                               down.

      If absent, then STM32_TIM_COUNTERMODE_UP is used (reset state).

  st,deadtime:
    type: int
    default: 0
    description: |
      Sets the dead-time configuration on the associated timer which will add
      a delay between the rising edge of the reference signal and the rising
      edge of both the OCx and OCxN signals. This is commonly used and required
      with bridge circuits to prevent shoot-through currents.

      This feature is supported only by certain timer instances. Refer
      to your product's Reference Manual for more information about this
      feature's availability. (In particular, certain series such as
      STM32L0/STM32L1 have no instance supporting this feature).

      Valid range [0 ... 255].

  st,mastermode:
    type: string
    default: RESET
    enum:
      - RESET
      - ENABLE
      - UPDATE
      - CC1IF
      - OC1REF
      - OC2REF
      - OC3REF
      - OC4REF
    description: |
      Selects master mode (trigger output TRGO source selection)
      of the timer instance. Only available for timer instances
      with master function - property is ignored otherwise.

      For details, refer to your device's Reference Manual.

      * RESET   - The UG bit from the TIMx_EGR register is used
                  as TRGO.
      * ENABLE  - The Counter enable signal, CNT_EN, is used as TRGO.
      * UPDATE  - The update event is used as TRGO.
      * CC1IF   - The CC1IF set event is used as TRGO.
      * OC1REF - OC1REF signal is used as TRGO.
      * OC2REF - OC2REF signal is used as TRGO.
      * OC3REF - OC3REF signal is used as TRGO.
      * OC4REF - OC4REF signal is used as TRGO.
```

## dts/bindings/timer/st,stm32u5-lptim.yaml
```yaml
# Copyright (c) 2026 STMicroelectronics
# SPDX-License-Identifier: Apache-2.0

title: STM32U5 LPTIM

description: |
  Low-Power Timer (LPTIM) with support for multiple channels and input capture mode.
  First found in STM32U5 series, later used in STM32WBA, STM32H5, etc...

compatible: "st,stm32u5-lptim"

include: st,stm32-lptim.yaml
```

## dts/bindings/timer/st,stm32wb0-radio-timer.yaml
```yaml
# Copyright (c) 2025, STMicroelectronics
# SPDX-License-Identifier: Apache-2.0

description: STM32WB0 Bluetooth LE Radio Timer

compatible: "st,stm32wb0-radio-timer"

properties:
  compensated-timer-freq:
    type: int
    required: true
    const: 409600
    description: |
      Timer frequency resulting from LSI or LSE frequency with interpolated value from HSE with
      a periodic temperature compensation algorithm.
      It is independent of hardware oscillator variations due to temperature.
      The timer resolution is equivalent to 625/256 μs (approximately 2.4414 μs).
      The value is expressed in hertz (Hz).

  max-hs-startup-time:
    type: int
    required: true
    description: |
      High speed crystal startup time. This is used by hardware to anticipate wake-up event
      so that high speed crystal is ready at the desired time. This parameter depends on the board
      and the crystal used. It is expressed in the unit of 625/256 μs (approximately 2.4414 μs).
      For example, if the property is set to 320, it means approximately 781 μs are needed.
```

## dts/bindings/timer/starfive,jh7100-clint.yaml
```yaml
# Copyright (c) 2022 Nordic Semiconductor ASA
# SPDX-License-Identifier: Apache-2.0

description: Starfive JH7100 RISC-V Core-Local Interruptor.

compatible: "starfive,jh7100-clint"

include: sifive,clint0.yaml
```

## dts/bindings/timer/stm32-timer-device.yaml
```yaml
# SPDX-License-Identifier: Apache-2.0

# Common fields for stm32-timers devices

include: base.yaml

parent-bus: stm32-timers

properties:
    reg:
      required: false

    label:
      required: true
```

## dts/bindings/timer/sy1xx,sys-timer.yaml
```yaml
# Copyright (c) 2024 sensry.io
# SPDX-License-Identifier: Apache-2.0

description: Sensry ganymed timer peripheral

compatible: "sensry,sy1xx-sys-timer"

include: base.yaml

properties:
  reg:
    required: true

  interrupts:
    required: true

  ticks-us:
    type: int
    required: true
```

## dts/bindings/timer/tcc,ttcvcp.yaml
```yaml
description: Telechips VCP TTC timer

compatible: "tcc,ttcvcp"

include: base.yaml

properties:
  reg:
    required: true

  clock-frequency:
    type: int
    required: true
    description: Clock frequency information for Timer operation
```
