## dts/bindings/timer/nxp,lptmr.yaml
```yaml
# Copyright (c) 2017, NXP
# SPDX-License-Identifier: Apache-2.0

description: NXP Low Power Timer (LPTMR)

compatible: "nxp,lptmr"

include: base.yaml

properties:
  reg:
    required: true

  interrupts:
    required: true

  prescaler:
    type: int
    required: false
    default: 1

    enum:
      - 1
      - 2
      - 4
      - 8
      - 16
      - 32
      - 64
      - 128
    description: LPTMR clock prescaler

  clocks:
    required: true

  clock-names:
    required: true
```

## dts/bindings/timer/nxp,os-timer.yaml
```yaml
# Copyright (c) 2022 Kumar Gala <galak@kernel.org>
# SPDX-License-Identifier: Apache-2.0

description: NXP OS Timer on i.MX-RT5xx/6xx

compatible: "nxp,os-timer"

include: base.yaml

properties:
  reg:
    required: true

  interrupts:
    required: true

  deep-sleep-counter:
    type: phandle
    deprecated: true
    description: |
      Deprecated. The OS Timer now uses the generic system-timer low-power
      companion framework (CONFIG_SYSTEM_TIMER_LPM_COMPANION_*). Select the
      low-power companion counter through the
      /chosen/zephyr,system-timer-companion property instead.

      Instance of a counter peripheral. The OS Timer maybe powered off in
      certain deep power down modes. The OS Timer driver will use this
      counter to wakeup and also to keep track of system time.

  handoff-power-states:
    type: phandles
    description: |
      List of power states in which the OS Timer is powered off or reset and can
      no longer keep time. When the system is about to enter one of these states,
      the driver hands timekeeping over to the low-power companion selected by
      /chosen/zephyr,system-timer-companion for the duration of that state. Each
      phandle points to a "zephyr,power-state" node. If omitted, the OS Timer is
      assumed to keep time in all low-power states and no handoff is performed.

  resets:
    type: phandle-array
    description: reset line
```

## dts/bindings/timer/nxp,rtc-jdp-timer.yaml
```yaml
# Copyright 2026 NXP
# SPDX-License-Identifier: Apache-2.0

description: |
  NXP RTC JDP (RTC_JDP) used as a Zephyr system timer timebase.

compatible: "nxp,rtc-jdp-timer"

include: base.yaml

properties:
  reg:
    required: true

  interrupts:
    required: true

  clock-frequency:
    type: int
    required: true
    description: |
      Frequency, in Hz, of the selected RTC clock source before prescaling.

  clock-source:
    type: int
    required: true
    enum:
      - 0
      - 1
      - 2
      - 3
    description: |
      Select the RTC clock source (chip-specific mux). No binding-wide default
      is provided because the hardware reset default differs by SoC. The SoC
      dtsi must set this to the correct value for each instance.

  prescaler:
    type: int
    default: 1
    enum:
      - 1
      - 32
      - 512
      - 16384
    description: |
      Divider for the RTC clock source. Supported divide values are 1, 32, 512,
      or 16384.
```

## dts/bindings/timer/nxp,s32-sys-timer.yaml
```yaml
# Copyright 2022 NXP
# SPDX-License-Identifier: Apache-2.0

description: NXP S32 System Timer Module (STM)

compatible: "nxp,s32-sys-timer"

include: base.yaml

properties:
  reg:
    required: true

  interrupts:
    required: true

  clock-frequency:
    type: int
    required: true
    description: Module clock frequency in Hz.

  prescaler:
    type: int
    required: true
    description: |
      Selects the module clock divide value for the prescaler, between 1 and 256.
      Timer frequency equals to clock-frequency divided by the prescaler value.

  freeze:
    type: boolean
    description: Stops the timer when the chip enters Debug mode.
```

## dts/bindings/timer/nxp,stm-hw-timer.yaml
```yaml
# Copyright 2026 NXP
# SPDX-License-Identifier: Apache-2.0

description: |
  NXP System Timer Module (STM) used as a Zephyr system timer timebase.

compatible: "nxp,stm-hw-timer"

include: base.yaml

properties:
  reg:
    required: true

  interrupts:
    required: true

  clocks:
    required: true

  clock-frequency:
    type: int
    required: true
    description: |
      Effective STM counter clock frequency in Hz (after prescaling).

  prescaler:
    type: int
    required: true
    description: |
      STM prescaler divide value (0-255). The STM effective counter frequency is
      expected to be consistent with `clock-frequency`.
```

## dts/bindings/timer/nxp,utick.yaml
```yaml
# Copyright 2025 NXP
# SPDX-License-Identifier: Apache-2.0

description: NXP Micro-Tick Timer

compatible: "nxp,utick"

include: base.yaml

properties:
  reg:
    required: true

  interrupts:
    required: true

  clk-source:
    type: int
    enum: [0, 1, 2, 3]
    description: Utick function clock source

  clk-divider:
    type: int
    description: Utick function clock divider
```

## dts/bindings/timer/openisa,rv32m1-lptmr.yaml
```yaml
description: OpenISA RV32M1 LPTMR peripheral

compatible: "openisa,rv32m1-lptmr"

include: base.yaml

properties:
    reg:
      required: true

    interrupts:
      required: true

    label:
      required: true
```

## dts/bindings/timer/qcom,hvm-timer.yaml
```yaml
# SPDX-License-Identifier: Apache-2.0
# Copyright (c) Qualcomm Technologies, Inc. and/or its subsidiaries.

description: |
  Qualcomm Hexagon HVM virtual timer.

  This timer is provided by the H2 hypervisor via the vmtimerop interface.
  The guest programs timeouts through trap1 hypercalls and receives
  timer expiry as a virtual interrupt.

compatible: "qcom,hvm-timer"

include: base.yaml

properties:
  reg:
    required: true
    description: Base address and size of the timer register block.

  interrupts:
    required: true
    description: Virtual interrupt number delivered on timer expiry.
```

## dts/bindings/timer/realtek,bee-basic-timer.yaml
```yaml
# Copyright (c) 2026, Realtek Semiconductor Corporation
# SPDX-License-Identifier: Apache-2.0

description: Realtek Bee Basic Timer

compatible: "realtek,bee-basic-timer"

include: [base.yaml]
```

## dts/bindings/timer/realtek,bee-enhanced-timer.yaml
```yaml
# Copyright (c) 2026, Realtek Semiconductor Corporation
# SPDX-License-Identifier: Apache-2.0

description: Realtek Bee Enhanced Timer

compatible: "realtek,bee-enhanced-timer"

include: [base.yaml]
```

## dts/bindings/timer/realtek,bee-timer.yaml
```yaml
# Copyright (c) 2026, Realtek Semiconductor Corporation
# SPDX-License-Identifier: Apache-2.0

description: |
  Realtek Bee Timer.

compatible: "realtek,bee-timer"

include: [base.yaml]

properties:
  reg:
    required: true

  interrupts:
    required: true

  clocks:
    required: true

  prescaler:
    type: int
    default: 1
    description: |
      Clock division factor.
      For RTL87X2G series: 1/2/4/8/16/32/40/64.
      For RTL8752H series: 1/2/4/8/40/125.
    enum: [1, 2, 4, 8, 16, 32, 40, 64, 125]
```

## dts/bindings/timer/realtek,rts5912-rtmr.yaml
```yaml
# SPDX-License-Identifier: Apache-2.0
#
# Copyright (c) 2024 Realtek Semiconductor Corporation, SIBG-SD7
#

description: RTOS Timer on Realtek RTS5912 EC

compatible: "realtek,rts5912-rtmr"

include: base.yaml

properties:
  reg:
    required: true

  interrupts:
    required: true
```

## dts/bindings/timer/realtek,rts5912-slwtimer.yaml
```yaml
# SPDX-License-Identifier: Apache-2.0
#
# Copyright (c) 2024 Realtek Semiconductor Corporation, SIBG-SD7
#

description: Realtek RTS5912 32-bit slow timer

compatible: "realtek,rts5912-slwtimer"

include: rtc.yaml

properties:
  reg:
    required: true

  interrupts:
    required: true

  max-value:
    type: int
    required: true
    description: Maximum counter value the instance can handle

  clock-frequency:
    required: true

  prescaler:
    type: int
    required: true
    description: Timer frequency equals clock-frequency divided by the prescaler value
```

## dts/bindings/timer/renesas,ra-ulpt-timer.yaml
```yaml
# Copyright (c) 2025 Renesas Electronics Corporation
# SPDX-License-Identifier: Apache-2.0

description: Renesas RA ULPT TIMER

compatible: "renesas,ra-ulpt-timer"

include: base.yaml
```

## dts/bindings/timer/renesas,ra8-ulpt-timer.yaml
```yaml
# Copyright (c) 2024 Renesas Electronics Corporation
# SPDX-License-Identifier: Apache-2.0

description: Renesas RA8 ULPT TIMER

compatible: "renesas,ra8-ulpt-timer"

include: base.yaml

properties:
  reg:
    required: true

  channel:
    type: int
    required: true

  interrupts:
    required: true
```

## dts/bindings/timer/renesas,rcar-cmt.yaml
```yaml
description: Renesas R-Car CMT timer

compatible: "renesas,rcar-cmt"

include: base.yaml

properties:
    reg:
      required: true

    clock-frequency:
      type: int
      required: true
      description: Clock frequency information for Timer operation

    clocks:
      required: true

    interrupts:
      required: true
```

## dts/bindings/timer/renesas,rh850-ostm-timer.yaml
```yaml
# Copyright (c) 2026 Renesas Electronics Corporation
# SPDX-License-Identifier: Apache-2.0

description: Renesas RH850 OSTM System Timer

compatible: "renesas,rh850-ostm-timer"

include: base.yaml
```

## dts/bindings/timer/renesas,rx-timer-cmt-start-control.yaml
```yaml
# Copyright (c) 2021 KT-Elektronik, Klaucke und Partner GmbH
# Copyright (c) 2024 Renesas Electronics Corporation
# SPDX-License-Identifier: Apache-2.0

description: Renesas RX timer node

compatible: "renesas,rx-timer-cmt-start-control"

include: base.yaml

properties:
  reg:
    required: true

  clocks:
    required: true

  clock-frequency:
    type: int
    required: true
    description: |
      Clock frequency information for Timer operation
      This value need to be set at PCLKB/8
```

## dts/bindings/timer/renesas,rx-timer-cmt.yaml
```yaml
# Copyright (c) 2021 KT-Elektronik, Klaucke und Partner GmbH
# Copyright (c) 2024 Renesas Electronics Corporation
# SPDX-License-Identifier: Apache-2.0

description: Renesas RX timer node

compatible: "renesas,rx-timer-cmt"

include: base.yaml

properties:
  reg:
    required: true
```

## dts/bindings/timer/renesas,rz-cmtw.yaml
```yaml
# Copyright (c) 2025 Renesas Electronics Corporation
# SPDX-License-Identifier: Apache-2.0

description: Renesas RZ CMTW Timer

compatible: "renesas,rz-cmtw"

include: base.yaml

properties:
  prescaler:
    type: int
    required: true
    enum:
      - 1
      - 2
      - 4
      - 8
      - 16
      - 32
      - 64
      - 128
      - 256
      - 512
    description: Input clock prescaler. For RZ/T2M, RZ/N2L, only 8, 32, 128, 512 are supported.

  reg:
    required: true

  channel:
    type: int
    required: true

  interrupts:
    required: true
```

## dts/bindings/timer/renesas,rz-gpt.yaml
```yaml
# Copyright (c) 2024-2025 Renesas Electronics Corporation
# SPDX-License-Identifier: Apache-2.0

description: Renesas RZ GPT

compatible: "renesas,rz-gpt"

include: [base.yaml]

properties:
  prescaler:
    type: int
    required: true
    enum:
      - 1
      - 2
      - 4
      - 8
      - 16
      - 32
      - 64
      - 128
      - 256
      - 512
      - 1024
    description: |
      Input clock prescaler:
      - For RZ/G3S, RZ/G2, and RZ/V2L, only prescalers 1, 4, 16, 64, 256, and 1024 are supported.
      - For RZ/V2H, RZ/V2N, RZ/T2, and RZ/N2, prescalers 128 and 512 are prohibited.

  channel:
    type: int
    required: true

  interrupts:
    required: true

  interrupt-names:
    required: true
```

## dts/bindings/timer/renesas,rz-gtm-os-timer.yaml
```yaml
# Copyright (c) 2024 Renesas Electronics Corporation
# SPDX-License-Identifier: Apache-2.0

description: Renesas RZ OS timer

compatible: "renesas,rz-gtm-os-timer"

include: base.yaml
```

## dts/bindings/timer/renesas,rz-gtm.yaml
```yaml
# Copyright (c) 2024 Renesas Electronics Corporation
# SPDX-License-Identifier: Apache-2.0

description: Renesas RZ GTM Timer

compatible: "renesas,rz-gtm"

include: base.yaml

properties:
  reg:
    required: true

  channel:
    type: int
    required: true

  interrupts:
    required: true
```

## dts/bindings/timer/renesas,rz-mtu.yaml
```yaml
# Copyright (c) 2025 Renesas Electronics Corporation
# SPDX-License-Identifier: Apache-2.0

description: Renesas RZ MTU controller

compatible: "renesas,rz-mtu"

include: [base.yaml, pinctrl-device.yaml]

properties:
  channel:
    type: int
    description: channel MTU

  prescaler:
    type: int
    required: true
    enum:
      - 1
      - 2
      - 4
      - 8
      - 16
      - 32
      - 64
      - 256
      - 1024
    description: Input clock prescaler.
```

## dts/bindings/timer/renesas,rza2m-gpt.yaml
```yaml
# Copyright (c) 2025 Renesas Electronics Corporation
# SPDX-License-Identifier: Apache-2.0

description: Renesas RZA2M GPT

compatible: "renesas,rza2m-gpt"

include: [base.yaml]

properties:
  prescaler:
    type: int
    required: true
    enum:
      - 1
      - 4
      - 16
      - 64
      - 256
      - 1024
    description: Input clock prescaler.

  channel:
    type: int
    required: true

  interrupts:
    required: true

  interrupt-names:
    required: true
```
