## dts/bindings/dma/dma-controller.yaml
```yaml
# Copyright (c) 2019, Song Qiang <songqiang1304521@gmail.com>
# SPDX-License-Identifier: Apache-2.0

# Common fields for DMA controllers

include: base.yaml

bus: dma

properties:
  "#dma-cells":
    type: int
    required: true
    description: Number of items to expect in a DMA specifier

  dma-channel-mask:
    type: int
    description: |
      Bitmask of available DMA channels in ascending order that are
      not reserved by firmware and are available to the
      kernel. i.e. first channel corresponds to LSB.

  dma-channels:
    type: int
    description: Number of DMA channels supported by the controller

  dma-requests:
    type: int
    description: Number of DMA request signals supported by the controller.

  dma-buf-addr-alignment:
    type: int
    description: Memory address alignment requirement for DMA buffers used by the controller.

  dma-buf-size-alignment:
    type: int
    description: Memory size alignment requirement for DMA buffers used by the controller.

  dma-copy-alignment:
    type: int
    description: Minimal chunk of data possible to be copied by the controller.
```

## dts/bindings/dma/dma.yaml
```yaml
# Copyright (c) 2019, Linaro Limited
# Copyright (c) 2019, Song Qiang <songqiang1304521@gmail.com>
# SPDX-License-Identifier: Apache-2.0

# Common fields for DMA users

properties:
    dmas:
      required: true
      type: phandle-array
      description: DMA instances information

    dma-names:
      required: false
      type: string-array
      description: name of each dma instance
```

## dts/bindings/dma/dmamux-controller.yaml
```yaml
# Copyright (c) 2019, STMicroelectronics
# SPDX-License-Identifier: Apache-2.0

# Common fields for DMAMUX controllers

include: base.yaml

bus: dmamux

properties:
    label:
      required: true

    "#dma-cells":
      type: int
      required: true
      description: Number of items to expect in a DMA specifier (see dma V2)

    dma-channels:
      type: int
      required: true
      description: Number of DMAMUX output request channels supported by the controller

    dma-generators:
      type: int
      required: false
      description: Number of DMAMUX Request generator supported by the controller

    dma-requests:
      type: int
      required: true
      description: |
        Number of DMAMUX Peripheral Request Line inputs supported by the controller
        This is not directly the value to program in the DMAREQ_ID of the DMAMUX_CxCR
```

## dts/bindings/dma/espressif,esp32-gdma.yaml
```yaml
# Copyright (c) 2022 Espressif Systems (Shanghai) Co., Ltd.
# SPDX-License-Identifier: Apache-2.0

description: |
  ESP32 GDMA (General Direct Memory Access)

  General Direct Memory Access (GDMA) is a feature that allows
  peripheral-to-memory, memory-to-peripheral, and memory-to-memory
  data transfer at a high speed.

  The GDMA controller in ESP32-C3 has six independent channels,
  three transmit channels and three receive channels.

  Every channel can be connected to different peripherals.

  ESP32C3's Peripherals with GDMA:
  * SPI2
  * UHCI0 (UART0/UART1)
  * I2S
  * AES (Not Supported yet)
  * SHA (Not Supported yet)
  * ADC

  The GDMA controller in ESP32-S3 has ten independent channels,
  five transmit channels and five receive channels. Only six are
  supported, meaning three transmit and three receive channels.

  ESP32S3's Peripherals with GDMA:
  * SPI2
  * SPI3
  * UHCI0
  * I2S0
  * I2S1
  * LCD/CAM
  * AES (Not Supported yet)
  * SHA (Not Supported yet)
  * ADC
  * RMT (Not Supported yet)

compatible: "espressif,esp32-gdma"

include: dma-controller.yaml

properties:
  "#dma-cells":
    const: 1

dma-cells:
  - channel
```

## dts/bindings/dma/gd,gd32-dma-base.yaml
```yaml
# Copyright (c) 2022, TOKITA Hiroshi <tokita.hiroshi@gmail.com>
# SPDX-License-Identifier: Apache-2.0

include: dma-controller.yaml

properties:
  reg:
    required: true

  interrupts:
    required: true

  dma-channels:
    required: true

  clocks:
    required: true

  gd,mem2mem:
    type: boolean
    description: The DMA controller supporting memory to memory transfer
```

## dts/bindings/dma/gd,gd32-dma-v1.yaml
```yaml
# Copyright (c) 2022, TOKITA Hiroshi <tokita.hiroshi@gmail.com>
# SPDX-License-Identifier: Apache-2.0

description: |
  GD32 DMA controller with FIFO

  channel: Select channel for data transmitting

  slot: Select peripheral to connect DMA

  config: A 32bit mask specifying the DMA channel configuration
    - bit 6-7:   Direction  (see dma.h)
                 - 0x0: MEMORY to MEMORY
                 - 0x1: MEMORY to PERIPH
                 - 0x2: PERIPH to MEMORY
                 - 0x3: reserved for PERIPH to PERIPH

    - bit 9:     Peripheral address increase
                 - 0x0: no address increment between transfers
                 - 0x1: increment address between transfers

    - bit 10:    Memory address increase
                 - 0x0: no address increase between transfers
                 - 0x1: increase address between transfers

    - bit 11-12: Peripheral data width
                 - 0x0: 8 bits
                 - 0x1: 16 bits
                 - 0x2: 32 bits
                 - 0x3: reserved

    - bit 13-14: Memory data width
                 - 0x0: 8 bits
                 - 0x1: 16 bits
                 - 0x2: 32 bits
                 - 0x3: reserved

    - bit 15:    Peripheral Increment Offset Size
                 - 0x0: offset size is linked to the peripheral bus width
                 - 0x1: offset size is fixed to 4 (32-bit alignment)

    - bit 16-17: Priority
                 - 0x0: low
                 - 0x1: medium
                 - 0x2: high
                 - 0x3: very high

  fifo-threshold: A 32bit bitfield value specifying FIFO threshold
    - bit 0-1:   Depth of DMA's FIFO used by burst-transfer.
                 - 0x0: 1 word
                 - 0x1: 2 word
                 - 0x2: 3 word
                 - 0x3: 4 word


  Example of devicetree configuration

  &spi0 {
        status = "okay";
        pinctrl-0 = <&spi0_default>;
        pinctrl-names = "default";
        cs-gpios = <&gpioa 4 GPIO_ACTIVE_LOW>;

        dmas = <&dma1 0 3 0 0>, <&dma1 5 3 GD32_DMA_PRIORITY_HIGH 0>
        dma-names = "rx", "tx";
  };

  "spi0" uses dma1 for transmitting and receiving in the example.
  Each is named "rx" and "tx".
  The first cell assigns channel 0 to receive and channel 5 to transmit.
  The second cell is slot. Both channels select 3.
  What the slot number '3' means depends on the DMA controller and channel.
  See the Hardware manual.
  The config that places on the third can take various configs.
  But the setting used depends on each driver implementation.
  Set the priority for the transmitting channel as HIGH, LOW(the default) for receive channel.
  The fifo-threshold cell that places the fourth is configuring FIFO threshold.
  The behavior of burst transfer determines by data-width in the config cell,
  burst-length in the dma_config struct, and fifo-threshold.
  A single burst transfer transfers [(4 * fifo-threshold)] bytes using with DMA's FIFO.
  Where (data-width * burst-length) must be multiple numbers of burst transfer size.
  For example, In the case of data-width is 'byte' and burst-length is 8.
  If the fifo-threshold is a 2-word case, it runs one burst transfer to transfer 8 bytes.
  Or the fifo-threshold is a 4-word case, runs two times burst transfer to transferring 8 bytes each
  time.

compatible: "gd,gd32-dma-v1"

include: ["reset-device.yaml", "gd,gd32-dma-base.yaml"]

properties:
  "#dma-cells":
    const: 4

dma-cells:
  - channel
  - slot
  - config
  - fifo-threshold
```

## dts/bindings/dma/gd,gd32-dma.yaml
```yaml
# Copyright (c) 2022, TOKITA Hiroshi <tokita.hiroshi@gmail.com>
# SPDX-License-Identifier: Apache-2.0

description: |
  GD32 DMA controller

  channel: Select channel for data transmitting

  config: A 32bit mask specifying the DMA channel configuration
    - bit 6-7:   Direction  (see dma.h)
                 - 0x0: MEMORY to MEMORY
                 - 0x1: MEMORY to PERIPH
                 - 0x2: PERIPH to MEMORY
                 - 0x3: reserved for PERIPH to PERIPH

    - bit 9:     Peripheral address increase
                 - 0x0: no address increment between transfers
                 - 0x1: increment address between transfers

    - bit 10:    Memory address increase
                 - 0x0: no address increase between transfers
                 - 0x1: increase address between transfers

    - bit 11-12: Peripheral data width
                 - 0x0: 8 bits
                 - 0x1: 16 bits
                 - 0x2: 32 bits
                 - 0x3: reserved

    - bit 13-14: Memory data width
                 - 0x0: 8 bits
                 - 0x1: 16 bits
                 - 0x2: 32 bits
                 - 0x3: reserved

    - bit 15:    Peripheral Increment Offset Size
                 - 0x0: offset size is linked to the peripheral bus width
                 - 0x1: offset size is fixed to 4 (32-bit alignment)

    - bit 16-17: Priority
                 - 0x0: low
                 - 0x1: medium
                 - 0x2: high
                 - 0x3: very high

  Example of devicetree configuration

  &spi0 {
        status = "okay";
        pinctrl-0 = <&spi0_default>;
        pinctrl-names = "default";
        cs-gpios = <&gpioa 4 GPIO_ACTIVE_LOW>;

        dmas = <&dma0 3 0>, <&dma0 5 GD32_DMA_PRIORITY_HIGH>;
        dma-names = "rx", "tx";
  };

  "spi0" uses dma0 for transmitting and receiving in the example.
  Each is named "rx" and "tx".
  The channel cell assigns channel 3 to receive and channel 5 to transmit.
  The config cell can take various configs.
  But the setting used depends on each driver implementation.
  Set the priority for the transmitting channel as HIGH, LOW(the default) for receive channel.

compatible: "gd,gd32-dma"

include: ["gd,gd32-dma-base.yaml"]

properties:
  "#dma-cells":
    const: 2

dma-cells:
  - channel
  - config
```

## dts/bindings/dma/infineon,cat1-dma.yaml
```yaml
# Copyright (c) 2025 Infineon Technologies AG,
# or an affiliate of Infineon Technologies AG.
#
# SPDX-License-Identifier: Apache-2.0

title: Infineon CAT1 DMA

description: |
  DMA for Infineon CAT1 devices

compatible: "infineon,cat1-dma"

include: [dma-controller.yaml, "infineon,system-interrupts.yaml"]

properties:
  reg:
    required: true

  interrupts:
    description: Required for non-cat1c devices

  system-interrupts:
    description: Required for cat1c devices

  "#dma-cells":
    const: 1

  enable-chaining:
    type: boolean
    description: |
      This property can be used to enable descriptor chaining

dma-cells:
  - channel
```

## dts/bindings/dma/infineon,mdma.yaml
```yaml
# SPDX-FileCopyrightText: <text>Copyright (c) 2026 Infineon Technologies AG,
# or an affiliate of Infineon Technologies AG. All rights reserved.</text>
#
# SPDX-License-Identifier: Apache-2.0

title: Infineon M-DMA

description: |
  M-DMA (MXSAXIDMAC) controller for Infineon devices.

compatible: "infineon,mdma"

include: dma-controller.yaml

properties:
  reg:
    required: true

  interrupts:
    required: true

  "#dma-cells":
    const: 1

dma-cells:
  - channel
```

## dts/bindings/dma/infineon,xmc4xxx-dma.yaml
```yaml
# Copyright 2022 Andriy Gelman
# SPDX-License-Identifier: Apache-2.0

description: |
  XMC4xxx DMA Controller

compatible: "infineon,xmc4xxx-dma"

include: dma-controller.yaml

properties:
  reg:
    required: true

  interrupts:
    required: true

  dma-channels:
    type: int
    description: Number of DMA channels supported by the controller

  "#dma-cells":
    const: 3

dma-cells:
  - channel
  - priority
  - config
```

## dts/bindings/dma/intel,ace-gpdma.yaml
```yaml
# Copyright (c) 2022 Intel Corporation. All rights reserved.
# SPDX-License-Identifier: Apache-2.0

description: Intel ACE Designware based General Purpose DMA Controller node

compatible: "intel,ace-gpdma"

include: snps,designware-dma.yaml

properties:
    shim:
      type: array
      required: true
```

## dts/bindings/dma/intel,adsp-gpdma.yaml
```yaml
# Copyright (c) 2022 Intel Corporation. All rights reserved.
# SPDX-License-Identifier: Apache-2.0

description: Intel ADSP Designware based General Purpose DMA Controller node

compatible: "intel,adsp-gpdma"

include: snps,designware-dma.yaml

properties:
  shim:
    type: array
    required: true

  dma-buf-size-alignment:
    required: true

  dma-copy-alignment:
    required: true
```

## dts/bindings/dma/intel,adsp-hda-dmic-cap.yaml
```yaml
# Copyright (c) 2022 Intel Corporation
#
# SPDX-License-Identifier: Apache-2.0

description: Intel HDA DMIC Capabilities controller

compatible: "intel,adsp-hda-dmic-cap"

include: base.yaml

properties:
  reg:
    required: true
```

## dts/bindings/dma/intel,adsp-hda-host-in.yaml
```yaml
# Copyright (c) 2022 Intel Corporation. All rights reserved.
# SPDX-License-Identifier: Apache-2.0

description: Intel ADSP HDA Host In controller

compatible: "intel,adsp-hda-host-in"

include: intel,adsp-hda.yaml
```

## dts/bindings/dma/intel,adsp-hda-host-out.yaml
```yaml
# Copyright (c) 2022 Intel Corporation. All rights reserved.
# SPDX-License-Identifier: Apache-2.0

description: Intel ADSP HDA Host Out controller

compatible: "intel,adsp-hda-host-out"

include: intel,adsp-hda.yaml
```

## dts/bindings/dma/intel,adsp-hda-link-in.yaml
```yaml
# Copyright (c) 2022 Intel Corporation. All rights reserved.
# SPDX-License-Identifier: Apache-2.0

description: Intel ADSP HDA Link In controller

compatible: "intel,adsp-hda-link-in"

include: intel,adsp-hda.yaml
```

## dts/bindings/dma/intel,adsp-hda-link-out.yaml
```yaml
# Copyright (c) 2022 Intel Corporation. All rights reserved.
# SPDX-License-Identifier: Apache-2.0

description: Intel ADSP HDA Link Out controller

compatible: "intel,adsp-hda-link-out"

include: intel,adsp-hda.yaml
```

## dts/bindings/dma/intel,adsp-hda-ssp-cap.yaml
```yaml
# Copyright (c) 2022 Intel Corporation
#
# SPDX-License-Identifier: Apache-2.0

description: Intel HDA SSP Capabilities controller

compatible: "intel,adsp-hda-ssp-cap"

include: base.yaml

properties:
  reg:
    required: true
    description: |
        Intel HD Audio Multiple Links Capability Structure
        for I2S / PCM Link.
```

## dts/bindings/dma/intel,adsp-hda.yaml
```yaml
# Copyright (c) 2022 Intel Corporation. All rights reserved.
# SPDX-License-Identifier: Apache-2.0

# Common fields for Intel ADSP HDA DMA controllers

include: dma-controller.yaml

properties:
  reg:
    required: true

  dma-channels:
    required: true

  "#dma-cells":
    const: 1

  "dma-buf-addr-alignment":
    required: true

  "dma-buf-size-alignment":
    required: true

  "dma-copy-alignment":
    required: true

dma-cells:
  - channel
```

## dts/bindings/dma/intel,cavs-hda-host-in.yaml
```yaml
# Copyright (c) 2022 Intel Corporation. All rights reserved.
# SPDX-License-Identifier: Apache-2.0

description: Intel cAVS HDA Host In controller

compatible: "intel,cavs-hda-host-in"

include: intel,cavs-hda.yaml
```

## dts/bindings/dma/intel,cavs-hda-host-out.yaml
```yaml
# Copyright (c) 2022 Intel Corporation. All rights reserved.
# SPDX-License-Identifier: Apache-2.0

description: Intel cAVS HDA Host Out controller

compatible: "intel,cavs-hda-host-out"

include: intel,cavs-hda.yaml
```

## dts/bindings/dma/intel,cavs-hda-link-in.yaml
```yaml
# Copyright (c) 2022 Intel Corporation. All rights reserved.
# SPDX-License-Identifier: Apache-2.0

description: Intel cAVS HDA Link In controller

compatible: "intel,cavs-hda-link-in"

include: intel,cavs-hda.yaml
```

## dts/bindings/dma/intel,cavs-hda-link-out.yaml
```yaml
# Copyright (c) 2022 Intel Corporation. All rights reserved.
# SPDX-License-Identifier: Apache-2.0

description: Intel cAVS HDA Link Out controller

compatible: "intel,cavs-hda-link-out"

include: intel,cavs-hda.yaml
```
