## dts/bindings/dma/intel,cavs-hda.yaml
```yaml
# Copyright (c) 2022 Intel Corporation. All rights reserved.
# SPDX-License-Identifier: Apache-2.0

# Common fields for HDA DMA controllers

include: dma-controller.yaml

properties:
    reg:
      required: true

    dma-channels:
      required: true

    "#dma-cells":
      const: 1
```

## dts/bindings/dma/intel,lpss.yaml
```yaml
# Copyright (c) 2019 Intel Corporation. All rights reserved.
# SPDX-License-Identifier: Apache-2.0

description: LPSS DMA Controller

compatible: "intel,lpss"

include: dma-controller.yaml

properties:
  "#dma-cells":
    const: 1

dma-cells:
  - channel
```
