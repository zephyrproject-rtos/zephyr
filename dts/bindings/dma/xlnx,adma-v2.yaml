## dts/bindings/dma/xlnx,adma-v2.yaml
```yaml
#
#  Copyright (c) 2025 Advanced Micro Devices.
#
#  SPDX-License-Identifier: Apache-2.0

description: XILINX ADMA

compatible: "amd,versal2-dma-1.0"

include: xlnx,adma.yaml
```

## dts/bindings/dma/xlnx,zynqmp-dma-1.0.yaml
```yaml
#
#  Copyright (c) 2025 Advanced Micro Devices.
#
#  SPDX-License-Identifier: Apache-2.0

description: XILINX ADMA

compatible: "xlnx,zynqmp-dma-1.0"

include: dma-controller.yaml

properties:
  reg:
    required: true

  "#dma-cells":
    const: 1

  interrupts:
    required: true

  clocks:
    required: true

  clock-names:
    required: true

  xlnx,bus-width:
    type: int
    enum: [64, 128]
```

## dts/bindings/dma/zephyr,dma-emul.yaml
```yaml
# Copyright 2023 Meta
# SPDX-License-Identifier: Apache-2.0

description: Emulated DMA Controller

include: dma-controller.yaml

compatible: zephyr,dma-emul

properties:
  stack-size:
    type: int
    required: true
    description: >
      Stack size (in bytes) for the instance-specific work_q thread.

  priority:
    type: int
    description: >
      Priority for the instance-specific work_q thread.
```

## dts/bindings/dsa/microchip,ksz8794.yaml
```yaml
# Copyright (c) 2020 DENX Software Engineering GmbH
# SPDX-License-Identifier: Apache-2.0

description: |
    KSZ8794 ethernet switch with SPI interface

compatible: "microchip,ksz8794"

include: [microchip_dsa.yaml]
properties:
    workaround:
        type: int
        required: false
        description: |
          Define the applied workaround for the switch used for
          short connections. Use bitmask to select the workaround or more
          0x01: Short Cable Problems with the KSZ8795 Family
          0x02: 1) CAT-5E/6 Short Cable with a Link Issue for the KSZ8795 Family
          0x04: 2) CAT-5E/6 Short Cable with a Link Issue for the KSZ8795 Family
    mii-lowspeed-drivestrength:
        type: int
        required: false
        description: |
          Define the Low-Speed Interface Drive Strength for MII and RMMI
          Supported values 2,4,8,12,16,20,24,28mA
          see Register 163 (0xA3): Global Control 20 for more details
        enum:
          - 2
          - 4
          - 8
          - 12
          - 16
          - 20
          - 24
          - 28
```

## dts/bindings/dsa/microchip,ksz8863-i2c.yaml
```yaml
# Copyright (c) 2022 EEIC - Eaton European Innovation Center
# SPDX-License-Identifier: Apache-2.0

description: |
    KSZ8863 ethernet switch

compatible: "microchip,ksz8863"

include: [microchip_dsa-i2c.yaml]
```

## dts/bindings/dsa/microchip,ksz8863.yaml
```yaml
# Copyright 2026 DZG Metering GmbH
# SPDX-License-Identifier: Apache-2.0

description: Microchip KSZ8863 Ethernet switch

compatible: "microchip,ksz8863"

include:
  - name: spi-device.yaml
  - name: dsa.yaml

properties:
  reset-gpios:
    type: phandle-array
    description: Active-low reset GPIO for the switch.
```

## dts/bindings/dsa/microchip_dsa-i2c.yaml
```yaml
# Copyright (c) 2022 EEIC - Eaton European Innovation Center
# SPDX-License-Identifier: Apache-2.0

description: |
    DSA Device

include: [i2c-device.yaml]
properties:
    dsa-master-port:
       type: phandle
       required: false
       description: Phandle to master port.
    dsa-slave-ports:
       type: int
       required: false
       description: Number of slave ports on the switch

    reset-gpios:
        type: phandle-array
        required: false
        description: |
          The pin is asserted for 10ms during boot to reset the KSZ8794.

child-binding:
    description: Properties of slave port
    properties:
        label:
            type: string
            required: true
        local-mac-address:
            type: uint8-array
            required: false
            description: |
              Specifies the MAC address that was assigned to the port
```

## dts/bindings/dsa/microchip_dsa.yaml
```yaml
# Copyright (c) 2020 DENX Software Engineering GmbH
# SPDX-License-Identifier: Apache-2.0

description: |
    DSA Device

include: [spi-device.yaml]
properties:
  dsa-master-port:
    type: phandle
    description: Phandle to master port.
  dsa-slave-ports:
    type: int
    description: Number of slave ports on the switch
  reset-gpios:
    type: phandle-array
    description: |
      The pin is asserted for 10ms during boot to reset the KSZ8794.

child-binding:
  description: Properties of slave port
  properties:
    local-mac-address:
      type: uint8-array
      description: |
        Specifies the MAC address that was assigned to the port
```

## dts/bindings/dsa/nxp,imx-netc-dsa.yaml
```yaml
# Copyright 2024 NXP
# SPDX-License-Identifier: Apache-2.0

description: NXP i.MX NETC ethernet switch

compatible: "nxp,imx-netc-dsa"

properties:
  dsa-master-port:
    type: phandle
    description: Phandle to master port.

child-binding:
  description: Properties of slave port
  include: [pinctrl-device.yaml]
  properties:
    local-mac-address:
      type: uint8-array
      description: Specifies the MAC address that was assigned to the network device

    reg:
      type: array
      description: Specifies the switch port index.

    phy-handle:
      type: phandle
      description: |
        Specifies a reference to a node representing a PHY device.

    phy-connection-type:
      type: string
      description: |
        Specifies the interface connection type between ethernet MAC and PHY.
      enum:
        - "mii"
        - "rmii"
        - "gmii"
        - "rgmii"
        - "internal"
```

## dts/bindings/dsa/nxp,netc-switch.yaml
```yaml
# Copyright 2025 NXP
# SPDX-License-Identifier: Apache-2.0

description: NXP NETC ethernet switch

compatible: "nxp,netc-switch"

include: [dsa.yaml]
```

## dts/bindings/dsp/nxp,powerquad.yaml
```yaml
# SPDX-FileCopyrightText: Copyright 2026 NXP
# SPDX-License-Identifier: Apache-2.0

description: NXP PowerQuad DSP coprocessor

compatible: "nxp,powerquad"

include: [base.yaml]

properties:
  reg:
    required: true

  clocks:
    required: true
```

## dts/bindings/ec_host_cmd_backend/zephyr,ec-host-cmd-periph-espi.yaml
```yaml
# SPDX-License-Identifier: Apache-2.0

description: Host Command Backend using the eSPI bus

compatible: "zephyr,ec-host-cmd-backend-espi"

include: base.yaml

properties:
  bus:
    required: true
    type: phandle
    description:
      Phandle to the eSPI bus which will be used for communication with AP
      by the host commands subsystem
```

## dts/bindings/ec_host_cmd_backend/zephyr,sim-ec-host-cmd-periph.yaml
```yaml
# SPDX-License-Identifier: Apache-2.0

description: Simulated Host Command Peripheral

compatible: "zephyr,sim-ec-host-cmd-backend"

include: base.yaml
```

## dts/bindings/ec_host_cmd_perhip/zephyr,ec-host-cmd-periph-espi.yaml
```yaml
# SPDX-License-Identifier: Apache-2.0

description: Host Command Peripheral using the eSPI bus

compatible: "zephyr,ec-host-cmd-periph-espi"

include: base.yaml

properties:
  bus:
    required: true
    type: phandle
    description:
      Phandle to the eSPI bus which will be used for communication with AP
      by the host commands subsystem
```

## dts/bindings/ec_host_cmd_perhip/zephyr,sim-ec-host-cmd-periph.yaml
```yaml
# SPDX-License-Identifier: Apache-2.0

description: Simulated Host Command Peripheral

compatible: "zephyr,sim-ec-host-cmd-periph"

include: base.yaml

properties:
    label:
      required: true
```

## dts/bindings/edac/intel,ibecc.yaml
```yaml
# Copyright (c) 2021, Intel Corporation
# SPDX-License-Identifier: Apache-2.0

description: EDAC In-Band Error Correcting Code (IBECC)

compatible: "intel,ibecc"

include: base.yaml
```

## dts/bindings/edac/intel,io96b.yaml
```yaml
# Copyright (c) 2021, Intel Corporation
# SPDX-License-Identifier: Apache-2.0

description: IO96B ECC

compatible: "intel,io96b"

include: base.yaml

properties:
  reg:
    required: true

  max-ecc-buff-entries:
    type: int
    default: 16
    description: |
      Maximum number ecc error entires in IO96B ECC buffer. If more
      than maximum buffer entries an overflow flag will be set.

  producer-counter-cap:
    type: int
    default: 0x80000000
    description: |
      The producer counter will reset to 0 upon reaching to this value.
```

## dts/bindings/edac/intel,socpga-ecc.yaml
```yaml
# Copyright (c) 2023, Intel Corporation
# SPDX-License-Identifier: Apache-2.0

description: |
          Intel SoC FPGA ECC (Error checking and correction) block is integrated
          around a memory wrapper to provide protection and detection of single bit
          and double bit errors.

compatible: "intel,socfpga-ecc"

include: base.yaml

properties:
  reg:
    description: mmio register space
    required: true

  dual-port:
    type: boolean
    description: RAM port type dual/single port
```

## dts/bindings/edac/intel,socpga-hps-ecc.yaml
```yaml
# Copyright (c) 2023, Intel Corporation
# SPDX-License-Identifier: Apache-2.0

description: EDAC for Intel SoC FPGA HPS ECC manager

compatible: "intel,socfpga-hps-ecc"

include: base.yaml

properties:
  interrupts:
    required: true
```

## dts/bindings/edac/nxp,edac.yaml
```yaml
# Copyright 2025 NXP
# SPDX-License-Identifier: Apache-2.0

description: NXP Error Detection And Correction module container

compatible: "nxp,edac"

properties:
  erm:
    type: phandle
    required: true
    description: Reference to the ERM device

  eim:
    type: phandle
    description: Reference to the EIM device

include: base.yaml
```

## dts/bindings/edac/nxp,eim-channel.yaml
```yaml
# Copyright 2025 NXP
# SPDX-License-Identifier: Apache-2.0

description: NXP Error Injection Channel Descriptor

compatible: "nxp,eim-channel"

include: base.yaml

properties:
  channel-id:
    type: int

  size:
    type: int

  start-address:
    type: int

  inject-enable:
    type: int

  ecc-enable:
    type: int
```

## dts/bindings/edac/nxp,eim.yaml
```yaml
# Copyright 2025 NXP
# SPDX-License-Identifier: Apache-2.0

description: NXP Error Injection Module

compatible: "nxp,eim"

include: [reset-device.yaml, base.yaml]

child-binding:
  properties:
    channel-id:
      required: true
      type: int

    erm-channel-id:
      type: int
      description: erm channel id for current eim channel.

    size:
      required: true
      type: int
      description: size of the memory channel.

    start-address:
      required: true
      type: int
      description: start address of the memory channel.

    ecc-enable:
      type: int
      description: ecc enable magic number for the memory channel.
```

## dts/bindings/edac/nxp,erm.yaml
```yaml
# Copyright 2025 NXP
# SPDX-License-Identifier: Apache-2.0

description: NXP Error Reporting Module

compatible: "nxp,erm"

include: [reset-device.yaml, base.yaml]

properties:
  interrupts:
    required: true

  channels:
    type: array
    required: true
```

## dts/bindings/edac/nxp,mecc.yaml
```yaml
# Copyright 2026 NXP
# SPDX-License-Identifier: Apache-2.0

description: NXP MECC (Memory ECC Controller) EDAC binding

compatible: "nxp,mecc"

include: base.yaml

properties:
  reg:
    required: true

  interrupts:
    required: true

  memory-start-address:
    type: int
    required: true
    description: Start address of OCRAM memory region to enable ECC

  memory-end-address:
    type: int
    required: true
    description: End address of OCRAM memory region to enable ECC
```

## dts/bindings/edac/xlnx,zynqmp-ddrc-2.40a.yaml
```yaml
# Copyright (c) 2025 Calian Ltd
# SPDX-License-Identifier: Apache-2.0

description: Xilinx ZynqMP DDR memory controller

compatible: "xlnx,zynqmp-ddrc-2.40a"

include: base.yaml
```
