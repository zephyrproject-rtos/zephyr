## dts/bindings/dma/st,stm32-dma-v2.yaml
```yaml
# Copyright (c) 2019, Song Qiang <songqiang1304521@gmail.com>
# SPDX-License-Identifier: Apache-2.0

description: |
  STM32 DMA controller (V2)

  It is present on stm32 devices like stm32L4 or stm32WB.
  This DMA controller includes several channels with different requests.
  DMA clients connected to the STM32 DMA controller must use the format
  described in the dma.txt file, using a four-cell specifier for each
  capable of supporting 5 or 6 or 7 or 8 independent DMA channels.
  DMA clients connected to the STM32 DMA controller must use the format
  described in the dma.txt file, using a 3-cell specifier for each
  channel: a phandle to the DMA controller plus the following four integer cells:
    1. channel: the dma stream from 1 to <dma-requests>
    2. slot: DMA periph request ID, which is written in the DMAREQ_ID of the DMAMUX_CxCR
    this value is 0 for Memory-to-memory transfers
    or a value between <1> .. <dma-generators> (not supported yet)
    or a value between <dma-generators>+1  ..  <dma-generators>+<dma-requests>
    3. channel-config: A 32bit mask specifying the DMA channel configuration
    A name custom DMA flags for channel configuration is used
    which is device dependent. See stm32_dma.h:
      -bit 5 : DMA  cyclic mode config
                0x0: STM32_DMA_MODE_NORMAL
                0x1: STM32_DMA_MODE_CYCLIC
      -bit 6-7 : Direction (see dma.h)
                0x0: STM32_DMA_MEMORY_TO_MEMORY: MEM to MEM
                0x1: STM32_DMA_MEMORY_TO_PERIPH: MEM to PERIPH
                0x2: STM32_DMA_PERIPH_TO_MEMORY: PERIPH to MEM
                0x3: reserved for PERIPH to PERIPH
      -bit 9 : Peripheral Increment Address
               0x0: STM32_DMA_PERIPH_NO_INC: no address increment between transfers
               0x1: STM32_DMA_PERIPH_INC: increment address between transfers
      -bit 10 : Memory Increment Address
               0x0: STM32_DMA_MEM_NO_INC: no address increment between transfers
               0x1: STM32_DMA_MEM_INC: increment address between transfers
      -bit 11-12 : Peripheral data size
               0x0: STM32_DMA_PERIPH_8BITS: Byte (8 bits)
               0x1: STM32_DMA_PERIPH_16BITS: Half-word (16 bits)
               0x2: STM32_DMA_PERIPH_32BITS: Word (32 bits)
               0x3: reserved
      -bit 13-14 : Memory data size
               0x0: STM32_DMA_MEM_8BITS: Byte (8 bits)
               0x1: STM32_DMA_MEM_16BITS: Half-word (16 bits)
               0x2: STM32_DMA_MEM_32BITS: Word (32 bits)
               0x3: reserved
      -bit 15: Reserved
      -bit 16-17 : Priority level
               0x0: STM32_DMA_PRIORITY_LOW: low
               0x1: STM32_DMA_PRIORITY_MEDIUM: medium
               0x2: STM32_DMA_PRIORITY_HIGH: high
               0x3: STM32_DMA_PRIORITY_VERY_HIGH: very high

  Example of dma usual combination for peripheral transfer
       #define STM32_DMA_PERIPH_TX	(STM32_DMA_MEMORY_TO_PERIPH | STM32_DMA_MEM_INC)
       #define STM32_DMA_PERIPH_RX	(STM32_DMA_PERIPH_TO_MEMORY | STM32_DMA_MEM_INC)

  Example of dma node for stm32wb55x
     dma2: dma-controller@40020400 {
         compatible = "st,stm32-dma-v2";
         ...
         dma-requests = <7>;
         status = "disabled";
        };

  For the client part, example for stm32l476 on DMA1 instance
    Tx using channel 3 with request 1
    Rx using channel 2 with request 1
    spi1 {
     compatible = "st,stm32-spi";
     dmas = <&dma1 3 1 (STM32_DMA_PERIPH_TX | STM32_DMA_PRIORITY_HIGH)>,
            <&dma1 2 1 (STM32_DMA_PERIPH_RX | STM32_DMA_PRIORITY_HIGH)>;
     dma-names = "tx", "rx";
    };

compatible: "st,stm32-dma-v2"

include: st,stm32-dma.yaml

properties:
  "#dma-cells":
    const: 3

# Parameter syntax of stm32 follows the dma client dts syntax
# in the Linux kernel declared in
# https://git.kernel.org/pub/scm/linux/kernel/git/devicetree/devicetree-rebasing.git/plain/Bindings/dma/stm32/st,stm32-dma.yaml

dma-cells:
  - channel
  - slot
  - channel-config
```

## dts/bindings/dma/st,stm32-dma-v2bis.yaml
```yaml
# Copyright (c) 2021, STMicroelectronics
# SPDX-License-Identifier: Apache-2.0

description: |
  STM32 DMA controller (V2bis) for the stm32F0, stm32F1 and stm32L1 soc families

  This DMA controller includes several channels with different requests.
  All the requests ar ORed before entering the DMA, so that only one request
  must be enabled at a time.
  DMA clients connected to the STM32 DMA controller must use the format
  described in the dma.txt file, using a 2-cell specifier for each
  channel: a phandle to the DMA controller plus the following four integer cells:
    1. channel: the dma stream from 1 to <dma-requests>
    2. channel-config: A 32bit mask specifying the DMA channel configuration
    A name custom DMA flags for channel configuration is used
    which is device dependent see stm32_dma.h:
      -bit 5 : DMA  cyclic mode config
                0x0: STM32_DMA_MODE_NORMAL
                0x1: STM32_DMA_MODE_CYCLIC
      -bit 6-7 : Direction (see dma.h)
                0x0: STM32_DMA_MEMORY_TO_MEMORY: MEM to MEM
                0x1: STM32_DMA_MEMORY_TO_PERIPH: MEM to PERIPH
                0x2: STM32_DMA_PERIPH_TO_MEMORY: PERIPH to MEM
                0x3: reserved for PERIPH to PERIPH
      -bit 9 : Peripheral Increment Address
               0x0: STM32_DMA_PERIPH_NO_INC: no address increment between transfers
               0x1: STM32_DMA_PERIPH_INC: increment address between transfers
      -bit 10 : Memory Increment Address
               0x0: STM32_DMA_MEM_NO_INC: no address increment between transfers
               0x1: STM32_DMA_MEM_INC: increment address between transfers
      -bit 11-12 : Peripheral data size
               0x0: STM32_DMA_PERIPH_8BITS: Byte (8 bits)
               0x1: STM32_DMA_PERIPH_16BITS: Half-word (16 bits)
               0x2: STM32_DMA_PERIPH_32BITS: Word (32 bits)
               0x3: reserved
      -bit 13-14 : Memory data size
               0x0: STM32_DMA_MEM_8BITS: Byte (8 bits)
               0x1: STM32_DMA_MEM_16BITS: Half-word (16 bits)
               0x2: STM32_DMA_MEM_32BITS: Word (32 bits)
               0x3: reserved
      -bit 15: Reserved
      -bit 16-17 : Priority level
               0x0: STM32_DMA_PRIORITY_LOW: low
               0x1: STM32_DMA_PRIORITY_MEDIUM: medium
               0x2: STM32_DMA_PRIORITY_HIGH: high
               0x3: STM32_DMA_PRIORITY_VERY_HIGH: very high

  Example of dma usual combination for peripheral transfer
       #define STM32_DMA_PERIPH_TX	(STM32_DMA_MEMORY_TO_PERIPH | STM32_DMA_MEM_INC)
       #define STM32_DMA_PERIPH_RX	(STM32_DMA_PERIPH_TO_MEMORY | STM32_DMA_MEM_INC)

  Example of dma node for stm32f103
     dma1: dma-controller@40020400 {
         compatible = "st,stm32-dma-v2bis";
         ...
         dma-requests = <7>;
         status = "disabled";
        };

  For the client part, example for stm32f103 on DMA1 instance
    Tx using channel 3
    Rx using channel 2
    spi1 {
     compatible = "st,stm32-spi";
     dmas = <&dma1 3 (STM32_DMA_PERIPH_TX | STM32_DMA_PRIORITY_HIGH)>,
            <&dma1 2 (STM32_DMA_PERIPH_RX | STM32_DMA_PRIORITY_HIGH)>;
     dma-names = "tx", "rx";
    };

compatible: "st,stm32-dma-v2bis"

include:
  - name: st,stm32-dma.yaml

properties:
  "#dma-cells":
    const: 2

# Parameter syntax of stm32 follows the dma client dts syntax
# in the Linux kernel declared in
# https://git.kernel.org/pub/scm/linux/kernel/git/devicetree/devicetree-rebasing.git/plain/Bindings/dma/stm32/st,stm32-dma.yaml

dma-cells:
  - channel
  - channel-config
```

## dts/bindings/dma/st,stm32-dma-v3.yaml
```yaml
# Copyright (C) 2025 Savoir-faire Linux, Inc.
# SPDX-License-Identifier: Apache-2.0

description: |
  STM32 DMA controller V3.

  This DMA controller is what is used in the STM32MP2 series SoCs in the form
  of HPDMA, high-performance DMA. It supports 16 independent DMA channels
  and 256 DMA requests from peripherals.
  DMA clients connected to the STM32 HPDMA controller must use a three-cell
  specifier for each channel.

  It is a phandle to the STM32 DMA3 controller plus the following three integer
  cells:
  1. channel: The DMA channel number (0 to 15)
  2. request: The DMA request line number (0 to 255)
  3. channel-config: A 32-bit mask specifying the DMA channel configuration
  which is device dependent (see 'dma_stm32.h'):
  - bit 5: Cyclic Mode
            0x0: STM32_DMA_MODE_NORMAL
            0x1: STM32_DMA_MODE_CYCLIC
  - bits 6-7: Direction
            0x0: STM32_DMA_MEMORY_TO_MEMORY: MEM to MEM
            0x1: STM32_DMA_MEMORY_TO_PERIPH: MEM to PERIPH
            0x2: STM32_DMA_PERIPH_TO_MEMORY: PERIPH to MEM
            0x3: reserved for PERIPH to PERIPH
  - bit 9: Peripheral Address Increment
            0x0: STM32_DMA_PERIPH_NO_INC: no address increment between transfers
            0x1: STM32_DMA_PERIPH_INC: increment address between transfers
  - bit 10: Memory Address Increment
            0x0: STM32_DMA_MEM_NO_INC: no address increment between transfers
            0x1: STM32_DMA_MEM_INC: increment address between transfers
  - bits 11-12: Peripheral Data Size
            0x0: STM32_DMA_PERIPH_8BITS: Byte (8 bits)
            0x1: STM32_DMA_PERIPH_16BITS: Half-word (16 bits)
            0x2: STM32_DMA_PERIPH_32BITS: Word (32 bits)
            0x3: STM32_DMA_PERIPH_64BITS: Double-word (64 bits)
  - bits 13-14: Memory Data Size
            0x0: STM32_DMA_MEM_8BITS: Byte (8 bits)
            0x1: STM32_DMA_MEM_16BITS: Half-word (16 bits)
            0x2: STM32_DMA_MEM_32BITS: Word (32 bits)
            0x3: STM32_DMA_MEM_64BITS: Double-word (64 bits)
  - bit 15: Reserved
  - bits 16-17: Priority Level
            0x0: STM32_DMA_PRIORITY_LOW: Low
            0x1: STM32_DMA_PRIORITY_MEDIUM: Medium
            0x2: STM32_DMA_PRIORITY_HIGH: High
            0x3: STM32_DMA_PRIORITY_VERY_HIGH: Very High

  For the client part, example for stm32mp257f-ev1 on the CM33 using the HPDMA3
  instance:
    rx using channel 0 with request 17 for uart5_rx
    tx using channel 1 with request 18 for uart5_tx
    uart5 {
      dmas = <&hpdma3 0 18 (STM32_DMA_PERIPH_TX | STM32_DMA_PRIORITY_HIGH)>,
             <&hpdma3 1 17 (STM32_DMA_PERIPH_RX | STM32_DMA_PRIORITY_HIGH)>;
      dma-names = "tx", "rx";
    };

compatible: "st,stm32-dma-v3"

include:
  - name: st,stm32-dma.yaml

properties:
  "#dma-cells":
    const: 3

# Parameter syntax of stm32 follows the dma client dts syntax
# in the Linux kernel declared in
# https://git.kernel.org/pub/scm/linux/kernel/git/devicetree/devicetree-rebasing.git/plain/Bindings/dma/stm32/st,stm32-dma3.yaml

dma-cells:
  - channel
  - slot
  - channel-config
```

## dts/bindings/dma/st,stm32-dma.yaml
```yaml
# Copyright (c) 2019, Song Qiang <songqiang1304521@gmail.com>
# SPDX-License-Identifier: Apache-2.0

description: |
  STM32 DMA controller

  The STM32 DMA is a general-purpose direct memory access controller
  capable of supporting 5 or 6 or 7 or 8 independent DMA channels.
  Each stm32 soc with a DMA is of a special version type, which could be
  V1 like stm32F4 or stm32F2 socs, they include FIFO control registers
  or V2 like stm32L4 soc or stm322WB, some also have DMAMUX controller
  or V2bis like stm32F1 or stm32L1, where requests are multiplexed

compatible: "st,stm32-dma"

include: dma-controller.yaml

properties:
  reg:
    required: true

  interrupts:
    required: true

  st,mem2mem:
    type: boolean
    description: If the DMA controller V1 supports memory to memory transfer

  dma-offset:
    type: int
    description: |
      offset in the table of channels when mapping to a DMAMUX
      for 1st dma instance, offset is 0,
      for 2nd dma instance, offset is the nb of dma channels of the 1st dma,
      for 3rd dma instance, offset is the nb of dma channels of the 2nd dma
      plus the nb of dma channels of the 1st dma instance, etc.
```

## dts/bindings/dma/st,stm32-dmamux.yaml
```yaml
# Copyright (c) 2019, STMicroelectronics
# SPDX-License-Identifier: Apache-2.0

description: |
  STM32 DMAMUX controller

  The STM32 DMAMUX is a direct memory access multiplexer
  capable of supporting independent DMA channels.
  DMAMUX clients connected to the STM32 DMA ultiplexer must use a two-cell specifier
  for each dmamux channel: a phandle to the DMA multiplexer plus the following 2 integer cells:
    1. channel: the mux channel from 0 to <dma-channels> - 1
    2. slot: the request line Multiplexer ID
    3. channel-config: A 32bit mask specifying the DMA channel configuration
    which is device dependent:
        -bit 6-7 : Direction  (see dma.h)
               0x0: MEM to MEM
               0x1: MEM to PERIPH
               0x2: PERIPH to MEM
               0x3: reserved for PERIPH to PERIPH
        -bit 9 : Peripheral Increment Address
               0x0: no address increment between transfers
               0x1: increment address between transfers
        -bit 10 : Memory Increment Address
               0x0: no address increment between transfers
               0x1: increment address between transfers
        -bit 11-12 : Peripheral data size
               0x0: Byte (8 bits)
               0x1: Half-word (16 bits)
               0x2: Word (32 bits)
               0x3: reserved
        -bit 13-14 : Memory data size
               0x0: Byte (8 bits)
               0x1: Half-word (16 bits)
               0x2: Word (32 bits)
               0x3: reserved
        -bit 15: Peripheral Increment Offset Size not USED for DMA V2
               0x0: offset size is linked to the peripheral bus width
               0x1: offset size is fixed to 4 (32-bit alignment)
        -bit 16-17 : Priority level
               0x0: low
               0x1: medium
               0x2: high
               0x3: very high
   exemple for stm32wb55x
     dmamux1: dmamux@40020800 {
         compatible = "st,stm32-dmamux";
         ...
         dma-channels = <14>;
         dma-generators = <4>;
         dma-requests= <36>;
         status = "disabled";
         label = "DMAMUX_1";
        };
    for client SPI of stm32wb55x
     spi1: spi@40013000 {
         compatible = "st,stm32-spi";
         dmas = <&dmamux1 11 7 0x20440
                  &dmamux1 1 6 0x20480>;
         dma-names = "tx", "rx";
        };

compatible: "st,stm32-dmamux"

include: dmamux-controller.yaml

properties:
    reg:
      required: true

    interrupts:
      required: true

    "#dma-cells":
      const: 3

# Parameter syntax of stm32 follows the dma client dts syntax
# in the Linux kernel declared in
# https://git.kernel.org/pub/scm/linux/kernel/git/devicetree/devicetree-rebasing.git/plain/Bindings/dma/st,stm32-dmamux.yaml

dma-cells:
  - channel
  - slot
  - channel-config
```
