## dts/bindings/dma/st,stm32u5-dma.yaml
```yaml
# Copyright (c) 2022 STMicroelectronics
# SPDX-License-Identifier: Apache-2.0

title: STM32U5 DMA controller

description: |
  LPDMA/GPDMA/HPDMA direct memory access controllers; first found in STM32U5.

  These DMA controllers contain various channels as well as a request multiplexer
  that allows any of the DMA request lines to trigger an arbitrary channel, in a
  similar fashion to the combined (DMA1/DMA2)+DMAMUX found in some STM32 series.

  The DMA cells are used as follows:
    - channel: DMA channel to use
        (between 0 and (<dma-channels> - 1))
    - slot: ID of request that should trigger the channel
        (between 0 and (<dma-requests> - 1))
    - channel-config: 32-bit configuration bitmask
        (refer to include/zephyr/dt-bindings/dma/stm32_dma.h for details)

compatible: "st,stm32u5-dma"

include:
  - name: st,stm32-dma.yaml
    property-blocklist:
      - st,mem2mem
      - dma-offset

properties:
  "#dma-cells":
    const: 3

  interrupts:
    description: |
      One interrupt cell per channel, in order of channel numbers.

      For example, if channel 0 has IRQn 74 and channel 1 has IRQn 47:
        interrupts = <74 0>, <47 0>;

dma-cells:
  - channel
  - slot
  - channel-config

examples:
  - |
    /* Definition example: STM32U5 SoC DTSI */
    gpdma1: dma@40020000 {
      compatible = "st,stm32u5-dma";
      #dma-cells = <3>;
      reg = <0x40020000 DT_SIZE_K(1)>;
      clocks = <&rcc STM32_CLOCK(AHB1, 0)>;
      interrupts = <29 0>, <30 0>, <31 0>, <32 0>,
                   <33 0>, <34 0>, <35 0>, <36 0>,
                   <80 0>, <81 0>, <82 0>, <83 0>,
                   <84 0>, <85 0>, <86 0>, <87 0>;
      dma-channels = <16>;
      dma-requests = <114>;
    };

  - |
    /*
     * Usage example: SPI1 Rx/Tx via GPDMA on STM32U585
     *
     * Allocates channel 0/1 to Rx/Tx (request ID 6/7).
     * Refer to your product's Reference Manual for
     * the list and mapping of available DMA requests.
     */
    &spi1 {
      dmas = <&gpdma 0 6 (STM32_DMA_PERIPH_RX | STM32_DMA_PRIORITY_MEDIUM)>,
             <&gpdma 1 7 (STM32_DMA_PERIPH_TX | STM32_DMA_PRIORITY_MEDIUM)>;
      dma-names = "rx", "tx";
    };
```

## dts/bindings/dma/ti,am62l-pktdma.yaml
```yaml
# Copyright (c) 2026 Texas Instruments Incorporated
# Author: Siddharth Vadapalli <s-vadapalli@ti.com>
# SPDX-License-Identifier: Apache-2.0

description: TI AM62L PKTDMA (Packet DMA)

compatible: "ti,am62l-pktdma"

include: [dma-controller.yaml, interrupt-nexus.yaml]

properties:
  reg:
    required: true
    description: |
      Global Configuration Registers region
      Realtime Channel Configuration Registers region
      Realtime Ring Configuration Registers region

  reg-names:
    required: true
    description: |
      Register names "gcfg", "chanrt" and "ringrt" corresponding to
      the Global Configuration Registers region, the Realtime Channel
      Configuration Registers region and the Realtime Ring Configuration
      Registers region respectively.

  power-domains:
    required: true

  "#address-cells":
    required: true
    const: 0

  "#dma-cells":
    required: true
    const: 2

  "#interrupt-cells":
    required: true
    const: 1

  interrupt-map:
    required: true
    description: |
      Mapping of PKTDMA Channel IDs to GIC interrupt numbers.
      Each entry has 7 cells:
        1. channel_id
        2. gic_phandle
        3. gic_addr
        4. gic_irq_type (SPI/PPI)
        5. gic_irq_number
        6. gic_irq_flags
        7. gic_irq_priority

# Parameter syntax
dma-cells:
  - channel_id
  - asel
```

## dts/bindings/dma/ti,cc23x0-dma.yaml
```yaml
# Copyright (c) 2024 BayLibre, SAS
# SPDX-License-Identifier: Apache-2.0

description: TI CC23X0 DMA controller

compatible: "ti,cc23x0-dma"

include: dma-controller.yaml

properties:
  reg:
    required: true

  interrupts:
    required: true

  "#dma-cells":
    const: 2
    description: |
      The 1st cell specifies the DMA channel to be used for the data transfer.
      This channel should be unique between all peripherals that are using the
      DMA instance.
      The 2nd cell defines the peripheral trigger which is the source of the transfer.
      See the SoC's reference manual for all the supported request sources.

      Example of devicetree DMA channel configuration for the client part:

      &uart0 {
          dmas = <&dma 0 7>, <&dma 1 6>;
          dma-names = "rx", "tx";
      };

      Above, fragment 0 and 1 represent the different channels used to transfer
      data between peripheral and RAM. The numbers 7/6 are uart0 rx/tx triggers.

dma-cells:
  - channel
  - trigsrc
```

## dts/bindings/dma/tsnlab,tsn-nic-dma.yaml
```yaml
# Copyright (c) 2024 Junho Lee <junho@tsnlab.com>
# SPDX-License-Identifier: Apache-2.0

description: DMA driver for TSN NIC

compatible: "tsnlab,tsn-nic-dma"

include: dma-controller.yaml

# properties:
#   reg:
#     required: true

#   interrupts:
#     required: true

#   "#dma-cells":
#     type: int
#     required: true
#     const: 0
```

## dts/bindings/dma/wch,wch-dma.yaml
```yaml
# Copyright (c) 2024 Paul Wedeck <paulwedeck@gmail.com>
# SPDX-License-Identifier: Apache-2.0

description: |
  WCH DMA controller

  The WCH DMA controller is a general-purpose direct memory access controller
  featuring between 7 and 11 independent channels.
  Every channel is capable of memory-to-memory, memory-to-peripheral, and
  peripheral-to-memory access.

  Mapping of peripheral requests to DMA channels is limited and SoC specific.
  Commonly, each peripheral request maps to just a single DMA channel.
  The controller supports 8, 16, and 32 bit width memory access.

  It is present on WCH CH32V and CH32X series SoCs.

compatible: "wch,wch-dma"

include: dma-controller.yaml

properties:
  reg:
    required: true

  interrupts:
    required: true

  "#dma-cells":
    const: 1

dma-cells:
  - channel
```

## dts/bindings/dma/xilinx,alinx-dma.yaml
```yaml
description: TODO

compatible: "xilinx,alinx-dma"

include: dma-controller.yaml

# properties:
#   reg:
#     required: true

#   interrupts:
#     required: true

#   "#dma-cells":
#     type: int
#     required: true
#     const: 0
```

## dts/bindings/dma/xilinx,axi-dma-base.yaml
```yaml
# Copyright 2024 CISPA Helmholtz Center for Information Security gGmbH
# SPDX-License-Identifier: Apache-2.0

description: Xilinx AXI DMA LogiCORE IP controller

include: dma-controller.yaml

# multiple "compatible" properties match the same driver and options

properties:
  reg:
    type: array
    description: DMA Control registers
    required: true

  interrupts:
    type: array
    description: TX IRQ number followed by RX IRQ number
    required: true

  interrupt-parent:
    type: phandle
    description: Interrupt controller that the DMA is connected to

  clocks:
    type: phandle-array

  clock-frequency:
    type: int

  xlnx,addrwidth:
    type: int
    required: true
    description: DMA address width (64 or 32 bit)
    enum:
      - 32
      - 64

  axistream-connected:
    type: phandle
    description: |
      Handle to connected node, e.g., AXI Ethernet controller.
      The axistream-connected and axistream-control-connected properties can easily cause circular
      dependencies, if they are provided at the second device as well.
      In this case, the python device tree script fails to assign ordinals, causing build failure.
      I suggest you do not provide them at the DMA.

  axistream-control-connected:
    type: phandle
    description: Handle to connected control node, e.g., AXI Ethernet controller

  xlnx,include-dre:
    type: boolean
    description: Data realignment engine activated. This enables unaligned DMA transfers.

  xlnx,num-queues:
    type: int
    description: Number of queues per channel.
```

## dts/bindings/dma/xilinx,axi-dma.yaml
```yaml
# Copyright 2024 CISPA Helmholtz Center for Information Security gGmbH
# SPDX-License-Identifier: Apache-2.0

description: |
  Xilinx AXI DMA LogiCORE IP controller with compatibility string
  generated for use of the DMA outside of the AXI Ethernet subsystem.

include: xilinx,axi-dma-base.yaml

compatible: "xlnx,axi-dma-1.00.a"

# no custom properties, just different compatible
```

## dts/bindings/dma/xilinx,eth-dma.yaml
```yaml
# Copyright 2024 CISPA Helmholtz Center for Information Security gGmbH
# SPDX-License-Identifier: Apache-2.0

description: |
  Xilinx AXI DMA LogiCORE IP controller with compatibility string
  generated in use with the AXI Ethernet subsystem.

include: xilinx,axi-dma-base.yaml

# this is the compatible generated by Vitis for the AXI Ethernet subsystem
compatible: "xlnx,eth-dma"

# no custom properties, just different compatible
```
