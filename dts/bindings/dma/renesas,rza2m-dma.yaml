## dts/bindings/dma/renesas,rza2m-dma.yaml
```yaml
# Copyright (c) 2025 Renesas Electronics Corporation
# SPDX-License-Identifier: Apache-2.0

description: |
  RZA2M DMA controller

  channel: Select channel for data transmitting

  slot: Select peripheral to connect DMA. Use one of the RZA2M_DMA_* macros from
    dt-bindings/dma/renesas_rza2m_dma.h. Each macro packs the DMARS request code
    together with the CHCFG AM, LVL and REQD settings that the hardware fixes for
    that request source, so no raw slot value should ever be written here.

  config: A 32bit mask specifying the DMA channel configuration. Reserved for
    future use, pass 0.

  Example of devicetree configuration

    &spi0 {
      status = "okay";

      dmas = <&dma0 1 RZA2M_DMA_RS_SPTI0 0>, <&dma0 0 RZA2M_DMA_RS_SPRI0 0>;
      dma-names = "tx", "rx";
    }

compatible: "renesas,rza2m-dma"

include: [dma-controller.yaml, pinctrl-device.yaml]

properties:
  reg:
    required: true

  interrupts:
    required: true

  dma-channels:
    required: true

  "#dma-cells":
    const: 3

  dma-buf-addr-alignment:
    required: true

dma-cells:
  - channel
  - slot
  - config
```

## dts/bindings/dma/renesas,smartbond-dma.yaml
```yaml
# Copyright (c) 2023 Renesas Electronics Corporation
# SPDX-License-Identifier: Apache-2.0

include: dma-controller.yaml

description: Renesas Smartbond(tm) DMA

compatible: "renesas,smartbond-dma"

properties:
  reg:
    required: true

  interrupts:
    required: true

  block-count:
    required: true
    type: int
    const: 1
    description: Number of block counts supported

  "#dma-cells":
    const: 2

# - #dma-cells : Must be <2>.
# channel: dma channel to be reserved
# config: peripheral's dma request line. Valid values are defined in dt-bindings/dma/dma_smartbond.h

dma-cells:
  - channel
  - config
```

## dts/bindings/dma/sifli,sf32lb-dmac.yaml
```yaml
# Copyright (c) 2025 Core Devices LLC
# SPDX-License-Identifier: Apache-2.0

description: |
  SF32LB DMA Controller

  DMA consumers must specify 3 cells:
  - channel: DMA channel number
  - request: DMA request (see sf32lbxx-dma.h)
  - config: DMA channel configuration (bitfield, see sf32lb-dma-config.h)

compatible: "sifli,sf32lb-dmac"

include: dma-controller.yaml

properties:
  reg:
    required: true

  interrupts:
    required: true

  clocks:
    required: true

  dma-channels:
    required: true

  dma-requests:
    required: true

  "#dma-cells":
    const: 3

dma-cells:
  - channel
  - request
  - config
```

## dts/bindings/dma/silabs,gpdma.yaml
~~~~yaml
description: |
  Silicon Labs SiWx91x General Purpose DMA (GPDMA) Controller

  The SiWx91x GPDMA controller provides high-performance DMA transfers for
  memory-to-memory, memory-to-peripheral, and peripheral-to-memory operations.
  It supports up to 8 channels.

  Usage in Device Tree Overlays:

  To enable GPDMA for a peripheral (e.g., SPI), add the following to your overlay:

  ```dts
  &spi0 {
      status = "okay";
      cs-gpios = <&gpiob 12 GPIO_ACTIVE_LOW>;
      pinctrl-0 = <&spi0_default>;
      pinctrl-names = "default";

      dmas = <&gpdma0 0 11>, <&gpdma0 1 10>;
      dma-names = "tx", "rx";

      slow@0 {
          compatible = "test-spi-loopback-slow";
          reg = <0>;
          spi-max-frequency = <500000>;
      };
      fast@1 {
          compatible = "test-spi-loopback-fast";
          reg = <1>;
          spi-max-frequency = <10000000>;
      };
  };

  &gpdma0 {
      status = "okay";
  };
  ```

  DMA Configuration:
  - Channel 0: Used for TX (transmit) operations
  - Channel 1: Used for RX (receive) operations
  - Slot 11: Peripheral slot for SPI TX
  - Slot 10: Peripheral slot for SPI RX

  The GPDMA controller automatically handles descriptor management and
  interrupt generation for transfer completion and error conditions.

compatible: "silabs,gpdma"

include: dma-controller.yaml

properties:
  reg:
    required: true

  silabs,channel-reg-base:
    type: int
    description: |
        Base address for channel specific registers.

  silabs,dma-channel-count:
    type: int
    description: |
        Base address for channel specific registers.

  "#dma-cells":
    const: 2

# Parameter syntax
dma-cells:
  - channel
  - slot
~~~~

## dts/bindings/dma/silabs,ldma.yaml
```yaml
# Copyright (c) 2024 Silicon Laboratories Inc.
# SPDX-License-Identifier: Apache-2.0

description: |
  Silabs LDMA controller

  The Silabs LDMA is a general-purpose direct memory access controller
  capable of supporting 8 independent DMA channels. It supports specific
  functions like scatter-gather.

  It is present on silabs radio board devices like EFR32xG21

compatible: "silabs,ldma"

include: dma-controller.yaml

properties:
  reg:
    required: true

  interrupts:
    required: true

  dma_channels:
    type: int
    required: true
```

## dts/bindings/dma/silabs,si32-dma.yaml
```yaml
# Copyright (c) 2024 GARDENA GmbH
#
# SPDX-License-Identifier: Apache-2.0

description: Si32 DMA controller

compatible: "silabs,si32-dma"

include: dma-controller.yaml

properties:
  reg:
    required: true

  interrupts:
    required: true

  dma-channels:
    required: true
    description: >
      Limiting the number of enabled channels saves RAM.

  "#dma-cells":
    const: 3

dma-cells:
  - channel
  - high-prio
  - rpower
```

## dts/bindings/dma/silabs,siwx91x-dma.yaml
```yaml
description: Silabs SiWx91x DMA

compatible: "silabs,siwx91x-dma"

include: dma-controller.yaml

properties:
  reg:
    required: true

  silabs,sram-region:
    type: phandle
    description: |
        SRAM Address for UDMA Descriptor Storage. Some instance require this
        buffer to be placed in a specific area. If the instance doesn't have
        this requirement, this attribute is not required and the memory will
        will be automatically allocated.

  "#dma-cells":
    const: 1

# Parameter syntax
dma-cells:
  - channel
```

## dts/bindings/dma/snps,designware-dma-axi.yaml
```yaml
# Copyright (c) 2023 Intel Corporation. All rights reserved.
# SPDX-License-Identifier: Apache-2.0

description: Synopsys Designware axi DMA Controller

compatible: "snps,designware-dma-axi"

include: [dma-controller.yaml, reset-device.yaml]

properties:
  reg:
    required: true

  dma-channels:
    required: true

  interrupts:
    required: true

  "#dma-cells":
    const: 1

# #dma-cells : Must be <1>.
# The 1st cell specifies the hardware handshaking signal ID
# Example of device-tree dma channel configuration:
#
# &spi0 {
#      /* Configure DMA */
#   dmas = <&dma0 18>, <&dma0 19>;
#   dma-names = "tx", "rx";
# };
#
# In above spi node numbers 18 and 19 represents the
# peripheral handshaking interface ID
dma-cells:
  - slot
```

## dts/bindings/dma/snps,designware-dma.yaml
```yaml
# Copyright (c) 2019 Intel Corporation. All rights reserved.
# SPDX-License-Identifier: Apache-2.0

description: Synopsys Designware DMA Controller

compatible: "snps,designware-dma"

include: dma-controller.yaml

properties:
  reg:
    required: true

  interrupts:
    required: true

  "#dma-cells":
    const: 1

dma-cells:
  - channel
```

## dts/bindings/dma/st,stm32-bdma.yaml
```yaml
# Copyright (c) 2023 Jeroen van Dooren <jeroen.van.dooren@nobleo.nl>
# SPDX-License-Identifier: Apache-2.0

description: |
  STM32 BDMA controller

  The STM32 BDMA is a general-purpose direct memory access controller
  capable of supporting 5 or 6 or 7 or 8 independent BDMA channels.
  Each channel can have up to 8 requests.
  BDMA clients connected to the STM32 BDMA controller must use the format
  described in the dma.txt file, using a four-cell specifier for each
  channel: a phandle to the BDMA controller plus the following four integer cells:
    1. channel: the bdma stream from 0 to <bdma-requests>
    2. slot: bdma request
    3. channel-config: A 32bit mask specifying the BDMA channel configuration
    which is device dependent:
        -bit 6-7 : Direction  (see dma.h)
               0x0: MEM to MEM
               0x1: MEM to PERIPH
               0x2: PERIPH to MEM
               0x3: reserved for PERIPH to PERIPH
        -bit 9 : Peripheral Increment Address
               0x0: no address increment between transfers
               0x1: increment address between transfers
        -bit 10 : Memory Increment Address
               0x0: no address increment between transfers
               0x1: increment address between transfers
        -bit 11-12 : Peripheral data size
               0x0: Byte (8 bits)
               0x1: Half-word (16 bits)
               0x2: Word (32 bits)
               0x3: reserved
        -bit 13-14 : Memory data size
               0x0: Byte (8 bits)
               0x1: Half-word (16 bits)
               0x2: Word (32 bits)
               0x3: reserved
        -bit 15: Peripheral Increment Offset Size
               0x0: offset size is linked to the peripheral bus width
               0x1: offset size is fixed to 4 (32-bit alignment)
        -bit 16-17 : Priority level
               0x0: low
               0x1: medium
               0x2: high
               0x3: very high

    examples for stm32h7
     bdma1: dma-controller@58025400 {
         compatible = "st,stm32-bdma";
         ...
         st,mem2mem;
         dma-requests = <7>;
         status = "disabled";
        };

  For the client part, example for STM32H743 on BDMA1 instance
  using dmamux2

    &adc3 {
       dmas = < &dmamux2 0 17 0x2C80 >;
       dma-names = "dmamux";
    };

compatible: "st,stm32-bdma"

include: dma-controller.yaml

properties:
  reg:
    required: true

  interrupts:
    required: true

  st,mem2mem:
    type: boolean
    description: If the BDMA controller supports memory to memory transfer

  dma-offset:
    type: int
    description: >
      offset in the table of channels when mapping to a DMAMUX
      for 1st dma instance, offset is 0,
      for 2nd dma instance, offset is the nb of dma channels of the 1st dma,
      for 3rd dma instance, offset is the nb of dma channels of the 2nd dma
      plus the nb of dma channels of the 1st dma instance, etc.

  "#dma-cells":
    const: 4

# Parameter syntax of stm32 follows the dma client dts syntax
# in the Linux kernel declared in
# https://git.kernel.org/pub/scm/linux/kernel/git/devicetree/devicetree-rebasing.git/plain/Bindings/dma/stm32/st,stm32-dma.yaml

dma-cells:
  - channel
  - slot
  - channel-config
```

## dts/bindings/dma/st,stm32-dma-v1.yaml
```yaml
# Copyright (c) 2019, Song Qiang <songqiang1304521@gmail.com>
# SPDX-License-Identifier: Apache-2.0

description: |
  STM32 DMA controller (V1)

  It is present on stm32 devices like stm32F4 or stm32F2.
  This DMA controller includes FIFO control registers.
  DMA clients connected to the STM32 DMA controller must use the format
  described in the dma.txt file, using a four-cell specifier for each
  channel: a phandle to the DMA controller plus the following four integer cells:
    1. channel: the dma stream from 0 to <dma-requests>
    2. slot: DMA periph request ID, which is written in the DMAREQ_ID of the DMAMUX_CxCR
    this value is 0 for Memory-to-memory transfers
    or a value between <1> .. <dma-generators> (not supported yet)
    or a value between <dma-generators>+1  ..  <dma-generators>+<dma-requests>
    3. channel-config: A 32bit mask specifying the DMA channel configuration
    which is device dependent. See stm32_dma.h:
        -bit 6-7 : Direction  (see dma.h)
               0x0: STM32_DMA_MEMORY_TO_MEMORY: MEM to MEM
               0x1: STM32_DMA_MEMORY_TO_PERIPH: MEM to PERIPH
               0x2: STM32_DMA_PERIPH_TO_MEMORY: PERIPH to MEM
               0x3: reserved for PERIPH to PERIPH
        -bit 9 : Peripheral Increment Address
               0x0: STM32_DMA_PERIPH_NO_INC: no address increment between transfers
               0x1: STM32_DMA_PERIPH_INC: increment address between transfers
        -bit 10 : Memory Increment Address
               0x0: STM32_DMA_MEM_NO_INC: no address increment between transfers
               0x1: STM32_DMA_MEM_INC: increment address between transfers
        -bit 11-12 : Peripheral data size
               0x0: STM32_DMA_PERIPH_8BITS: Byte (8 bits)
               0x1: STM32_DMA_PERIPH_16BITS: Half-word (16 bits)
               0x2: STM32_DMA_PERIPH_32BITS: Word (32 bits)
               0x3: reserved
        -bit 13-14 : Memory data size
               0x0: STM32_DMA_MEM_8BITS: Byte (8 bits)
               0x1: STM32_DMA_MEM_16BITS: Half-word (16 bits)
               0x2: STM32_DMA_MEM_32BITS: Word (32 bits)
               0x3: reserved
        -bit 15: Peripheral Increment Offset Size
               0x0: STM32_DMA_OFFSET_LINKED_BUS: offset size is linked to the peripheral bus width
               0x1: STM32_DMA_OFFSET_FIXED_4: offset size is fixed to 4 (32-bit alignment)
        -bit 16-17 : Priority level
               0x0: STM32_DMA_PRIORITY_LOW: low
               0x1: STM32_DMA_PRIORITY_MEDIUM: medium
               0x2: hSTM32_DMA_PRIORITY_HIGH: high
               0x3: STM32_DMA_PRIORITY_VERY_HIGH: very high
    4. features: A 32bit bitfield value specifying DMA features
        -bit 0-1: DMA FIFO threshold selection
               0x0: STM32_DMA_FIFO_1_4: 1/4 full FIFO
               0x1: STM32_DMA_FIFO_HALF: 1/2 full FIFO
               0x2: STM32_DMA_FIFO_3_4: 3/4 full FIFO
               0x3: STM32_DMA_FIFO_FULL: full FIFO

  Example of dma usual combination for peripheral transfer
       #define STM32_DMA_PERIPH_TX	(STM32_DMA_MEMORY_TO_PERIPH | STM32_DMA_MEM_INC)
       #define STM32_DMA_PERIPH_RX	(STM32_DMA_PERIPH_TO_MEMORY | STM32_DMA_MEM_INC)

    examples for stm32f411
     dma2: dma-controller@40020400 {
         compatible = "st,stm32-dma-v1";
         ...
         st,mem2mem;
         dma-requests = <7>;
         status = "disabled";
        };

  For the client part, example for stm32f411 on DMA2 instance
    Tx using stream 5 on channel 3 (stream 2 on channel 2 is also possible)
    Rx using stream 2 on channel 3 (stream 0 on channel 3 is also possible)
    spi1 {
     dmas = <&dma2 5 3 STM32_DMA_PERIPH_TX STM32_DMA_FIFO_FULL>,
           <&dma2 2 3 STM32_DMA_PERIPH_RX STM32_DMA_FIFO_FULL>;
     dma-names = "tx", "rx";
     };

compatible: "st,stm32-dma-v1"

include: st,stm32-dma.yaml

properties:
  "#dma-cells":
    const: 4

# Parameter syntax of stm32 follows the dma client dts syntax
# in the Linux kernel declared in
# https://git.kernel.org/pub/scm/linux/kernel/git/devicetree/devicetree-rebasing.git/plain/Bindings/dma/st,stm32-dma.yaml

dma-cells:
  - channel
  - slot
  - channel-config
  - features
```
