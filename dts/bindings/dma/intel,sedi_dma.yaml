## dts/bindings/dma/nxp,lpc-dma.yaml
```yaml
# Copyright (c) 2020, NXP
# SPDX-License-Identifier: Apache-2.0

description: NXP LPC DMA controller

compatible: "nxp,lpc-dma"

include: dma-controller.yaml

properties:
  reg:
    required: true

  interrupts:
    required: true

  dma-channels:
    required: true

  nxp,dma-num-of-otrigs:
    type: int
    description: Number of Inputmux connections a DMA channel can receive from

  nxp,dma-otrig-base-address:
    type: int
    description: Address used when listening to Inputmux DMA signals

  nxp,dma-itrig-base-address:
    type: int
    description: DMA Channel Selection Address used for receiving signals

  "#dma-cells":
    type: int
    required: true
    description: Number of items to expect in a DMA specifier

# - #dma-cells : Must be <1>.
# channel: the dma channel, each channel supports one DMA request line

dma-cells:
  - channel
```

## dts/bindings/dma/nxp,mcux-edma-v3.yaml
```yaml
# Copyright 2023 NXP
# SPDX-License-Identifier: Apache-2.0

description: NXP MCUX EDMA version 3 controller

compatible: "nxp,mcux-edma-v3"

include: nxp,mcux-edma.yaml

properties:
  no-error-irq:
    type: boolean
    description: |
      If the SoCs don't have a separate interrupt id for error IRQ.
```

## dts/bindings/dma/nxp,mcux-edma-v4.yaml
```yaml
# Copyright 2024 NXP
# SPDX-License-Identifier: Apache-2.0

description: NXP MCUX EDMA version 4 controller

compatible: "nxp,mcux-edma-v4"

include: nxp,mcux-edma.yaml

properties:
  no-error-irq:
    type: boolean
    description: |
      If the SoCs don't have a separate interrupt id for error IRQ.
  dma-channels:
    required: true
  channels-shared-irq-mask:
    type: array
    description: |
      Describes channel enabled mask value on every IRQ.
      The channel number is mapped to the bit value of array element value.
      If the interrupt is shared on one channel number, the correspongding
      bit is set to 1.
      Please note each element of the array must be 32-bit. If there are more
      than 32 channels, add one or more 32-bit elements in array. The software
      will determine the mask value of several elements corresponding to the
      same interrupt according to the number of channels.
```

## dts/bindings/dma/nxp,pxp.yaml
```yaml
# Copyright 2023 NXP
# SPDX-License-Identifier: Apache-2.0

description: NXP PXP 2D DMA engine

compatible: "nxp,pxp"

include: dma-controller.yaml

properties:
  reg:
    required: true

  interrupts:
    required: true

  "#dma-cells":
    type: int
    required: true
    const: 0
```

## dts/bindings/dma/nxp,sdma.yaml
```yaml
# Copyright 2024 NXP
# SPDX-License-Identifier: Apache-2.0

description: NXP SDMA

compatible: "nxp,sdma"

include: [dma-controller.yaml, base.yaml]

properties:
  reg:
    required: true
  "#dma-cells":
    const: 2

dma-cells:
  - channel
  - mux
```

## dts/bindings/dma/nxp,smartdma.yaml
```yaml
# Copyright 2023 NXP
# SPDX-License-Identifier: Apache-2.0

description: NXP SmartDMA controller

compatible: "nxp,smartdma"

include: dma-controller.yaml

properties:
  reg:
    required: true

  interrupts:
    required: true

  program-mem:
    type: int
    required: true
    description: |
      Program memory to load SMARTDMA routines into. Must be set to a RAM
      region that the SMARTDMA can access on the chip.

  # SmartDMA does not support channels, so no DMA cells should be provided.
  # the driver or application using SMARTDMA can set the DMA program to run
  # using the `dma_slot` parameter.
  "#dma-cells":
    const: 0
```

## dts/bindings/dma/nxp,sof-host-dma.yaml
```yaml
# Copyright 2023 NXP
# SPDX-License-Identifier: Apache-2.0

description: NXP SOF host DMA node

compatible: "nxp,sof-host-dma"

include: [base.yaml, dma-controller.yaml]

properties:
  dma-channels:
    required: true
```

## dts/bindings/dma/raspberrypi,pico-dma.yaml
```yaml
# Copyright (c) 2023 TOKITA Hiroshi <tokita.hiroshi@fujitsu.com>
# SPDX-License-Identifier: Apache-2.0

description: |
  Raspberry Pi Pico DMA

  channel: Select channel for data transmitting

  slot: Select peripheral data request
    Use the definitions defined in `zephyr/dt-bindings/dma/rpi_pico_dma.h`.

  channel-config: A 32bit mask specifying the DMA channel configuration
    - bit 3: Enable Quiet IRQ
    - bit 1: Enable Byte Swap
    - bit 0: Enable High Priority

compatible: "raspberrypi,pico-dma"

include: [dma-controller.yaml, reset-device.yaml]

properties:
  reg:
    required: true

  interrupts:
    required: true

  dma-channels:
    required: true

  irq0-channels:
    type: uint8-array
    default: [0, 2, 4, 6, 8, 10]
    description: Channels list that uses the irq0

  "#dma-cells":
    const: 3

dma-cells:
  - channel
  - slot
  - channel-config
```

## dts/bindings/dma/realtek,ameba-gdma.yaml
```yaml
# Copyright (c) 2026 Realtek Semiconductor Corp.
# SPDX-License-Identifier: Apache-2.0

description: |
  Realtek's GDMA (General Direct Memory Access) peripheral

  General Direct Memory Access (GDMA) device allows
  peripheral-to-memory, memory-to-peripheral, and memory-to-memory
  data transfer.

  The GDMA controller in ameba has eight independent channels,
  each channel can be connected to different peripherals.

  channel: Select channel for data transmitting
  slot: Handshake interface index, ref to ameba_gdma.h
  config: A 32bit mask specifying the DMA channel configuration
    - bit 0-1:     Direction  (see dma.h)
                 - 0x0: MEMORY to MEMORY
                 - 0x1: MEMORY to PERIPH
                 - 0x2: PERIPH to MEMORY
                 - 0x3: PERIPH to PERIPH(reserved)
    - bit 2-3:     Source address increase
                 - 0x0: increment address between transfers
                 - 0x1: decrement address between transfers
                 - 0x2: no address increment between transfers
                 - 0x3: reserved
    - bit 4-5:     Destination address increase
                 - 0x0: increment address between transfers
                 - 0x1: decrement address between transfers(Not support)
                 - 0x2: no address increment between transfers
                 - 0x3: reserved
    - bit 6-8:     Source data width
                 - 0x1: 1 byte
                 - 0x2: 2 byte
                 - 0x4: 4 byte
    - bit 9-11:    Destination data width
                 - 0x1: 1 byte
                 - 0x2: 2 byte
                 - 0x4: 4 byte
    - bit 12-16:   Source data msize
                 - 0x1: msize 1
                 - 0x4: msize 4
                 - 0x8: msize 8
                 - 0x10: msize 16
    - bit 17-21:   Destination data width
                 - 0x1: msize 1
                 - 0x4: msize 4
                 - 0x8: msize 8
                 - 0x10: msize 16
    - bit 22-24:   Priority
                 - 0 ~ 7 can be configured
  Example of devicetree configuration
  &uart2 {
        dmas = <&dma 2 5 0xa>, <&dma 3 4 0x10021>;
        dma-names = "rx", "tx";
  };
  "uart2" uses dma0 for transmitting and receiving in the example.
  Each is named "rx" and "tx".
  The channel cell assigns channel 2 to receive and channel 3 to transmit.
  The slot cell configs specified handshake for different peripherals.
  The config cell can take various configs.
  But the setting used depends on each driver implementation.
  Set the priority for the transmitting channel as HIGH, LOW(the default) for receive channel.

compatible: "realtek,ameba-gdma"

include: dma-controller.yaml

properties:
  "#dma-cells":
    const: 3

dma-cells:
  - channel
  - slot
  - config
```

## dts/bindings/dma/realtek,bee-dma.yaml
```yaml
# Copyright (c) 2026, Realtek Semiconductor Corporation
# SPDX-License-Identifier: Apache-2.0

description: |
  Bee DMA controller.

  channel: Select channel for data transmitting

  slot: Handshake index.

  config: A 32bit mask specifying the DMA channel configuration
    - bit 0-1:     Direction  (see dma.h)
                 - 0x0: MEMORY to MEMORY
                 - 0x1: MEMORY to PERIPH
                 - 0x2: PERIPH to MEMORY
                 - 0x3: PERIPH to PERIPH(reserved)

    - bit 2-3:     Source address increase
                 - 0x0: increment address between transfers
                 - 0x1: decrement address between transfers
                 - 0x2: no address increment between transfers
                 - 0x3: reserved

    - bit 4-5:     Destination address increase
                 - 0x0: increment address between transfers
                 - 0x1: decrement address between transfers
                 - 0x2: no address increment between transfers
                 - 0x3: reserved

    - bit 6-7:     Source data width
                 - 0x0: 8 bits
                 - 0x1: 16 bits
                 - 0x2: 32 bits
                 - 0x3: reserved

    - bit 8-9:     Destination data width
                 - 0x0: 8 bits
                 - 0x1: 16 bits
                 - 0x2: 32 bits
                 - 0x3: reserved

    - bit 10-12:   Source data msize
                 - 0x0: msize 1
                 - 0x1: msize 4
                 - 0x2: msize 8
                 - 0x3: msize 16
                 - 0x4: msize 32
                 - 0x5: msize 64
                 - 0x6: msize 128
                 - 0x7: msize 256

    - bit 13-15:   Destination data width
                 - 0x0: msize 1
                 - 0x1: msize 4
                 - 0x2: msize 8
                 - 0x3: msize 16
                 - 0x4: msize 32
                 - 0x5: msize 64
                 - 0x6: msize 128
                 - 0x7: msize 256

    - bit 16-20:   Priority
                 - 0 ~ 9 can be configured

  Example of devicetree configuration

  &uart2 {
        status = "okay";
        dmas = <&dma0 2 4 0x10021>, <&dma0 3 5 0xa>;
        dma-names = "tx", "rx";
  };

  "uart2" uses dma0 for transmitting and receiving in the example.
  Each is named "tx" and "rx".
  The channel cell assigns channel 2 to transmit and channel 3 to receive.
  The slot cell configs specified handshake for different peripherals.
  The config cell can take various configs.
  But the setting used depends on each driver implementation.
  Set the priority for the transmitting channel as HIGH, LOW(the default) for receive channel.

compatible: "realtek,bee-dma"

include: dma-controller.yaml

properties:
  reg:
    required: true

  interrupts:
    required: true

  dma-channels:
    required: true

  clocks:
    required: true

  dma-port:
    type: int
    required: true

  "#dma-cells":
    const: 3

dma-cells:
  - channel
  - slot
  - config
```

## dts/bindings/dma/renesas,ra-dma.yaml
```yaml
# Copyright (c) 2025 Renesas Electronics Corporation
# SPDX-License-Identifier: Apache-2.0

description: |
  Renesas RA DMA Controller

  The following example displays the minimum DMA node layout:

    dma0: dma@4000a000 {
        compatible = "renesas,ra-dma";
        reg = <0x4000a000 0x200>, <0x4000a800 0xa0>;
        reg-names = "channel", "common";
        clocks = <&iclk MSTPA 22>;
        dma-channels = <8>;
        #dma-cells = <2>;
        status = "disabled";
    };

  By default, the DMA controller node appears with `status = "disabled"`.
  To enable and use the DMA controller, add an overlay that sets `status = "okay"`
  and provides the required `interrupts` and `interrupt-names` properties.

  Example overlay to enable the DMA controller for specific channels:

    &dma0 {
        status = "okay";
        interrupts = <95 1>, <94 1>;
        interrupt-names = "ch0", "ch1";
    };

  Note:
  - The `interrupts` property specifies only the channels intended for use.
    It is not necessary to declare interrupts for all available DMA channels;
    just include entries for the channels intended for use.
  - The `interrupt-names` property provides human-readable names corresponding
    to each interrupt, typically matching the channel number.

compatible: "renesas,ra-dma"

include: [dma-controller.yaml, base.yaml]

properties:
  reg:
    required: true

  interrupts:
    required: true

  interrupt-names:
    required: true
    description: |
      The `interrupt-names` property is required and must be specified as an array,
      with one entry for each DMA channel in use.
      Each entry must strictly follow the format "chX", where X is the DMA channel number.
      The order of entries must correspond to the channels defined in the `interrupts` property.

      Example:
        interrupt-names = "ch0", "ch1";

      In this example, "ch0" and "ch1" are the interrupt names assigned to DMA Channel 0 and
      DMA Channel 1, each corresponding to its respective entry in the `interrupts` property.

  clocks:
    required: true

  dma-channels:
    required: true

  "#dma-cells":
    const: 2

dma-cells:
  - channel
  - config
```

## dts/bindings/dma/renesas,rz-dma.yaml
```yaml
# Copyright (c) 2024 Renesas Electronics Corporation
# SPDX-License-Identifier: Apache-2.0

description: |
  RZ DMA controller

  channel: Select channel for data transmitting

  config: A 32bit mask specifying the DMA channel configuration

   Example of devicetree configuration

   &ssi0 {
        status = "okay";

        dmas = <&dma0 0 RZ_DMA_PERIPH_TO_MEM>, <&dma0 5 RZ_DMA_MEM_TO_PERIPH>
        dma-names = "rx", "tx";
   };

compatible: "renesas,rz-dma"

include: [dma-controller.yaml, pinctrl-device.yaml]

properties:
  reg:
    required: true

  interrupts:
    required: true

  dma-channels:
    required: true

  "#dma-cells":
    const: 2

dma-cells:
  - channel
  - config
```
