## dts/bindings/dma/intel,sedi_dma.yaml
```yaml
# Copyright (c) 2023 Intel Corporation
#
# SPDX-License-Identifier: Apache-2.0

description: Intel SEDI DMA controller.

compatible: "intel,sedi_dma"

include: dma-controller.yaml

properties:
  reg:
    required: true

  interrupts:
    required: true

  peripheral-id:
    type: int
    description: Peripheral Instance ID
    required: true
```

## dts/bindings/dma/mediatek,afe-memif-dma.yaml
```yaml
# Copyright 2026 MediaTek
# SPDX-License-Identifier: Apache-2.0

description: MediaTek AFE MEMIF DMA controller

compatible: "mediatek,afe-memif-dma"

include: [base.yaml, dma-controller.yaml]

properties:
  reg:
    required: true

  dma-channels:
    required: true
```

## dts/bindings/dma/mediatek,sof-host-dma.yaml
```yaml
# Copyright 2026 MediaTek
# SPDX-License-Identifier: Apache-2.0

description: MediaTek SOF host DMA

compatible: "mediatek,sof-host-dma"

include: [base.yaml, dma-controller.yaml]

properties:
  dma-channels:
    required: true
```

## dts/bindings/dma/microchip,dmac-g1-dma.yaml
```yaml
# Copyright (c) 2025 Microchip Technology Inc.
# SPDX-License-Identifier: Apache-2.0

title: Microchip G1 DMA Controller

description: |
  Microchip G1 DMA driver.

  Group G1 DMA driver supports following hardware peripherals:
    - module name="DMAC" id="U2503" version="1.0.1"

compatible: "microchip,dmac-g1-dma"

include: dma-controller.yaml

properties:
  reg:
    type: array
    required: true
    description: |
      Specifies the base address and size of the DMA controller's
      memory-mapped registers.

  interrupts:
    type: array
    required: true
    description: |
      Defines the list of interrupt numbers associated with the DMA controller.

  clocks:
    type: phandle-array
    required: true
    description: |
      A reference to the clock source used by the DMA controller.

  clock-names:
    type: string-array
    required: true
    description: |
      The name of the clock source referenced in the 'clocks' property.

  dma-channels:
    type: int
    required: true
    description: |
      The number of DMA channels available in the DMA controller.

  dma-alignment:
    type: int
    default: 16
    description: |
      Specifies the required memory alignment for DMA transfers.
      The value should be set to 16 for 128-bit alignment.

  "#dma-cells":
    type: int
    const: 2
    description: |
      Specifies the number of cells used for the DMA specifier.

# #dma-cells : Must be <2>.
# The 1st cell specifies the DMAC channel to be used for the data transfer.
#   This channel should be unique between all peripherals that are using the
#   DMAC instance.
# The 2nd cell defines the peripheral trigger which is the source of the transfer.
#   For details on trigger selection and trigger modes, refer to
#   "Transfer Triggers and Actions".
#   See the SoC's reference manual for all the supported request sources.
#
# Example of devicetree dma channel configuration:
#
# &sercom3 {
#     /* Configure DMA channels for async operation */
#     dmas = <&dmac 10 7>, <&dmac 11 8>;
#     dma-names = "rx", "tx";
# };
#
# In above fragment 10 and 11 represents the different channels used to
# transfer data between peripheral and ram. The numbers 7/8 are, for instance,
# uart_rx/tx peripheral trigger for sercom3.
dma-cells:
  - channel
  - trigsrc
```

## dts/bindings/dma/microchip,dmac-g2-dma.yaml
```yaml
# Copyright (c) 2026 Microchip Technology Inc.
# SPDX-License-Identifier: Apache-2.0

title: Microchip G2 DMA Controller

description: |
  Microchip G2 DMA driver.

  Group G2 DMA driver supports following hardware peripherals:
    - module name="DMAC" id="U2223" version="2.4.0"

compatible: "microchip,dmac-g2-dma"

include: dma-controller.yaml

properties:
  reg:
    required: true

  interrupts:
    required: true

  clocks:
    required: true

  clock-names:
    required: true

  dma-channels:
    required: true

  "#dma-cells":
    type: int
    const: 2
    description: |
      Specifies the number of cells used for the DMA specifier.

# #dma-cells : Must be <2>.
# The 1st cell specifies the DMAC channel to be used for the data transfer.
#   This channel should be unique between all peripherals that are using the
#   DMAC instance.
# The 2nd cell defines the peripheral trigger which is the source of the transfer.
#   For details on trigger selection and trigger modes, refer to
#   "Transfer Triggers and Actions".
#   See the SoC's reference manual for all the supported request sources.
#
# Example of devicetree dma channel configuration:
#
# &sercom3 {
#     /* Configure DMA channels for async operation */
#     dmas = <&dmac 10 7>, <&dmac 11 8>;
#     dma-names = "rx", "tx";
# };
#
# In above fragment 10 and 11 represents the different channels used to
# transfer data between peripheral and ram. The numbers 7/8 are, for instance,
# uart_rx/tx peripheral trigger for sercom3.
dma-cells:
  - channel
  - trigsrc
```

## dts/bindings/dma/microchip,pic32cxsg-dmac.yaml
```yaml
description: Microchip PIC32CXSG DMA controller

compatible: "microchip,pic32cxsg-dmac"

include: dma-controller.yaml

properties:
  reg:
    required: true

  interrupts:
    required: true

  "#dma-cells":
    const: 2

# #dma-cells : Must be <2>.
# The 1st cell specifies the DMAC channel to be used for the data transfer.
#   This channel should be unique between all peripherals that are using the
#   DMAC instance.
# The 2nd cell defines the peripheral trigger which is the source of the transfer.
#   For details on trigger selection and trigger modes, refer to
#   "Transfer Triggers and Actions".
#   See the SoC's reference manual for all the supported request sources.
#
# Example of devicetree dma channel configuration:
#
# &sercom3 {
#     /* Configure DMA channels for async operation */
#     dmas = <&dmac 10 7>, <&dmac 11 8>;
#     dma-names = "rx", "tx";
# };
#
# In above fragment 10 and 11 represents the different channels used to
# transfer data between peripheral and ram. The numbers 7/8 are, for instance,
# uart_rx/tx peripheral trigger for sercom3.
dma-cells:
  - channel
  - trigsrc
```

## dts/bindings/dma/microchip,xdmac-g1-dma.yaml
```yaml
#
# Copyright (c) 2026 Microchip Technology Inc.
#
# SPDX-License-Identifier: Apache-2.0
#

title: Microchip XDMAC G1 DMA Controller

description: |
  Microchip XDMAC G1 DMA controller driver.

  Group G1 DMA driver supports following hardware peripherals:
    - module name="XDMAC" id="11161" version="M"
    - module name="XDMAC" id="11161" version="293"
    - module name="XDMAC" id="11161" version="475"

compatible: "microchip,xdmac-g1-dma"

include: dma-controller.yaml

properties:
  reg:
    type: array
    required: true
    description: |
      Specifies the base address and size of the XDMAC controller memory-mapped
      registers.

  interrupts:
    type: array
    required: true
    description: |
      Specifies the interrupt numbers associated with the XDMAC controller.

  clocks:
    type: phandle-array
    required: true
    description: |
      Specifies the clock reference for this XDMAC instance.

  "#dma-cells":
    type: int
    const: 2

dma-cells:
  - channel
  - perid
```

## dts/bindings/dma/microchip,xec-dmac.yaml
```yaml
description: Microchip XEC DMA controller

compatible: "microchip,xec-dmac"

include: dma-controller.yaml

properties:
  reg:
    required: true

  interrupts:
    required: true

  pcrs:
    type: array
    required: true
    description: PCR register index and bit position

  girqs:
    type: array
    required: true
    description: Encoded interrupt information

  aggregated-girq:
    type: phandle
    description: |
      If DMA driver uses aggregated interrupt mode
      provide the handle to the GIRQ.

  "#dma-cells":
    const: 2

  "pcr-cells":
    type: int
    const: 2

  "girq-cells":
    type: int
    const: 2

# #dma-cells : Must be <2>.
# The 1st cell specifies the DMAC channel to be used for the data transfer.
#   This channel should be unique between all peripherals that are using the
#   DMAC instance.
# The 2nd cell defines the peripheral trigger which is the source of the transfer.
#   For details on trigger selection and trigger modes, refer to
#   "Transfer Triggers and Actions".
#   See the SoC's reference manual for all the supported request sources.
#
# Example of devicetree dma channel configuration:
#
# &sercom3 {
#     /* Configure DMA channels for async operation */
#     dmas = <&dmac 10 7>, <&dmac 11 8>;
#     dma-names = "rx", "tx";
# };
#
# In above fragment 10 and 11 represents the different channels used to
# transfer data between peripheral and ram. The numbers 7/8 are, for instance,
# uart_rx/tx peripheral trigger for sercom3.
dma-cells:
  - channel
  - trigsrc

pcr-cells:
  - regidx
  - bitpos

girq-cells:
  - girqno
  - girqpos
```

## dts/bindings/dma/nordic,nrf-mvdma.yaml
```yaml
# Copyright (c) 2025, Nordic Semiconductor ASA
# SPDX-License-Identifier: Apache-2.0

description: Nordic MVDMA

compatible: "nordic,nrf-mvdma"

include: base.yaml

properties:
  reg:
    required: true

  interrupts:
    required: true
```

## dts/bindings/dma/nuvoton,npcx-gdma.yaml
```yaml
# Copyright (c) 2025 Nuvoton Technology Corporation.
# SPDX-License-Identifier: Apache-2.0

description: Nuvoton, NPCX-GDMA node

compatible: "nuvoton,npcx-gdma"

include: dma-controller.yaml

properties:
  reg:
    required: true
  chan-offset:
    type: int
    required: true
    description: GDMA channel offset
  support-npckn-v1:
    type: boolean
    description: |
      This option enables the GDMA support for NPCKn.
  "#dma-cells":
    type: int
    required: true
    description: |
      Number of items to expect in a DMA specifier.

      A phandle to the GDMA controller plus the following two integer cells:
        1. channel: the dma channel, each channel supports one GDMA request line.
          0: channel 0
          1: channel 1
        2. config: A 32bit mask specifying the GDMA channel configuration
            - bit 0-5:  Reserved. (default: 0x0)
            - bit 6-7:  Direction  (see dma.h)
                        - 0x0: MEM to MEM
                        - 0x1: MEM to PERIPH
                        - 0x2: PERIPH to MEM
                        - 0x3: reserved for PERIPH to PERIPH
            - bit 8-9:  Transfer Width Select. The address width must be aligned
                        with the selected data width.
                        - 0x0: Byte (8 bits)
                        - 0x1: Word (16 bits)
                        - 0x2: Double-Word (32 bits)
                               This value is required if bit 10 is set to 1.
                        - 0x3: Reserved
            - bit 10:   16-byte transfer (address must be 16-byte aligned)
                        - 0x0: Disable 16-byte transfer
                        - 0x1: Enable 16-byte transfer
            - bit 11:   Destination address direction.
                        - 0x0: Destination address incremented successively. (default)
                        - 0x1: Destination address decremented successively.
            - bit 12:   Source address direction.
                        - 0x0: Source address incremented successively. (default)
                        - 0x1: Source address decremented successively.
            - bit 13:   Destination address fixed.
                        - 0x0: Change the Destination address during the GDMA
                               operation. (default)
                        - 0x1: Fixed address is used for each data transfer from
                               the destination.
            - bit 14:   Source address fixed.
                        - 0x0: Change the source address during the GDMA operation. (default)
                        - 0x1: Fixed address is used for each data transfer from
                               the source.

# -#dma-cells :
# channel: the dma channel, each channel supports one DMA request line.
# config : A 32bit mask specifying the DMA channel configuration
dma-cells:
  - channel
  - config
```

## dts/bindings/dma/nxp,4ch-dma.yaml
```yaml
# Copyright 2025 NXP
# SPDX-License-Identifier: Apache-2.0

description: NXP 4 channel DMA controller (DMA + DMAMUX)

compatible: "nxp,4ch-dma"

include: dma-controller.yaml

properties:
  reg:
    required: true
    description: |
      Specifies base address and size of DMA and respective DMAMUX base address
      that routes DMA sources. Provide two regions: index 0 is DMA, index 1 is DMAMUX.

  interrupts:
    required: true
    description: |
      Interrupts for each DMA channel.

  dma-channels:
    required: true
    description: |
      Specifies the number of DMA channels supported by the controller. This value is
      used to validate the channel number provided in the DMA specifier.

  dma-requests:
    required: true
    description: |
      Indicates the maximum value of the DMA request sources (slots) index supported by
      DMAMUX. This value is used to validate the request source index provided in the
      DMA specifier.

  "#dma-cells":
    type: int
    required: true
    const: 2
    description: |
      Number of items to expect in a specifier, including the channel number and
      the DMA request source.

dma-cells:
  - channel
  - source
```

## dts/bindings/dma/nxp,edma.yaml
```yaml
# Copyright 2024 NXP
# SPDX-License-Identifier: Apache-2.0

description: NXP enhanced Direct Memory Access (eDMA) node

compatible: "nxp,edma"

include: [dma-controller.yaml, base.yaml]

properties:
  reg:
    required: true
  valid-channels:
    type: array
    description: |
      Use this property to specify which channel indexes are
      to be considered valid. The difference between this
      property and "dma-channels" is the fact that this
      property allows you to have "gaps" between the channel
      indexes. This is useful in cases where you know you're
      not going to be using all of the possible channels, thus
      leading to a more readable DTS. Of course, this property
      and "dma-channels" are mutually exclusive, meaning you
      can't specify both properties as this will lead to a
      BUILD_ASSERT() failure.
  "#dma-cells":
    const: 2

# IMPORTANT: if your EDMA version doesn't support channel MUX-ing please
# leave the MUX cell as 0. This is not mandatory for the driver as the
# MUX value will be ignored in this case but all entities using EDMA should
# be consistent in this regard.
dma-cells:
  - channel
  - mux
```

## dts/bindings/dma/nxp,gdma.yaml
```yaml
# Copyright (c) 2026 NXP
# SPDX-License-Identifier: Apache-2.0

description: NXP GDMA (General DMA) controller

compatible: "nxp,gdma"

include: dma-controller.yaml

properties:
  reg:
    required: true

  interrupts:
    required: true

  dma-channels:
    required: true
    description: Number of DMA channels supported by the controller

  "#dma-cells":
    type: int
    required: true
    description: |
      Number of items to expect in a DMA specifier.

      A phandle to the GDMA controller plus the following integer cell:
        1. channel: the dma channel number (0 to dma-channels - 1)

# - #dma-cells : Must be <1>.
# channel: the dma channel, each channel supports one DMA request line

dma-cells:
  - channel
```
