## dts/bindings/adc/microchip,mcp356x-base.yaml
```yaml
# Common fields for Microchip MCP3204/MCP3208

include: [adc-controller.yaml, spi-device.yaml]

properties:
    "#io-channel-cells":
      const: 1

    irq-gpios:
      required: true
      type: phandle-array
      description: IRQ pin
        The bIRQ/MDAT pin from the device, which is active low, configurable to
        either driven or high-Z in inactive state.  This has DRDY, POR, CRCCFG,
        and STP interrupts.

    drive-open-drain:
      required: false
      type: boolean
      description: IRQ pin drive mode is open drain.  The default.

    drive-push-pull:
      required: false
      type: boolean
      description: IRQ pin drive mode is push-poll.  Mutually exclusive with drive-open-drain.

    address:
      required: false
      type: int
      default: 1
      description: Device address
        Internal device address.  This is burned into the chip during
        manufacture and allows multiple ADCs to share the same CS line and yet
        be individually addressable.  The default value is 1, which is used in
        the standard part.
        Valid range 0 - 3

    clocks:
      required: false
      type: phandle-array
      description: External MCLK signal

    amclk-div:
      required: false
      type: int
      default: 1
      description: AMCLK prescaler
        This is the divisor from MCLK to AMCLK.  The default is 1.
      enum:
       - 1
       - 2
       - 4
       - 8

    boost:
      required: false
      type: string
      default: "1x"
      description: Bias Current
        The bias current setting, see §5.4.3 and Table 5-5.  Higher bias
        current increases bandwidth and allows higher AMCLK values at the cost
        of increased sampling current (see Figure 2-36).
      enum:
       - "0.5x"
       - "0.66x"
       - "1x"
       - "2x"

io-channel-cells:
    - channel
```

## dts/bindings/adc/microchip,mcp356xr.yaml
```yaml
description: Microchip MCP356xR

compatible: "microchip,mcp356xr"

include: [adc-controller.yaml, spi-device.yaml]

properties:
  "#io-channel-cells":
    const: 1
  address:
    type: int
    enum:
      - 0
      - 1
      - 2
      - 3
      - 4
    required: true
    description: |
      ADC address, must be between 0 and 4. In most cases address is "1".
  analog-clock-prescaler:
    type: int
    enum:
      - 0
      - 1
      - 2
      - 3
    required: true
    description: |
      Prescaler to use to derive the analog (AMCKL) from the master clock (MCLK).
      Valid values are:
      - MCP356XR_ANALOG_CLOCK_NO_DIV
      - MCP356XR_ANALOG_CLOCK_DIV_2
      - MCP356XR_ANALOG_CLOCK_DIV_4
      - MCP356XR_ANALOG_CLOCK_DIV_8
  boost-current-bias:
    type: int
    enum:
      - 0
      - 1
      - 2
      - 3
    required: true
    description: |
      Delta-sigma modulator current biasing configuration.
      Valid values are:
      - MCP356XR_BOOST_CURRENT_BIAS_DIV_2
      - MCP356XR_BOOST_CURRENT_BIAS_MUL_0_66
      - MCP356XR_BOOST_CURRENT_BIAS_MUL_1
      - MCP356XR_BOOST_CURRENT_BIAS_MUL_2
  vref-settle-time-ms:
    type: int
    description: |
      Time in milliseconds to wait for after the selected voltage reference has changed
      in order to stabilize itself. This is necessary if a mix of channels with different
      reference voltages is used.
  irq-gpios:
    type: phandle-array
    description: |
      GPIO connected to the MCP356XR's IRQ pin
  irq-pin-drive-open-drain:
    type: boolean
    description: |
      Drives the MCP356XR's IRQ pin in an open drain fashion
  enable-adc-offset-cancellation:
    type: boolean
    description: |
      Enable ADC induced offset cancellation
  enable-internal-vref-offset-cancellation:
    type: boolean
    description: |
      Enable internal voltage reference induced offset cancellation
  use-internal-clock:
    type: boolean
    description: |
      Use the internal ADC clock instead of providing it via the MCLK pin
  enable-analog-clock-output:
    type: boolean
    description: |
      Output AMCLK on the MCLK pin only effective when use-internal-clock is set
  spi-cs-setup-delay-ns:
    default: 1000
  spi-cs-hold-delay-ns:
    default: 1000

io-channel-cells:
  - input
```

## dts/bindings/adc/microchip,mcp3914.yaml
```yaml
# Copyright 2013 EVOS Energy Pty Ltd
#
#  Licensed under the Apache License, Version 2.0 (the "License");
#  you may not use this file except in compliance with the License.
#  You may obtain a copy of the License at
#
#      http://www.apache.org/licenses/LICENSE-2.0
#
#  Unless required by applicable law or agreed to in writing, software
#  distributed under the License is distributed on an "AS IS" BASIS,
#  WITHOUT WARRANTIES OR CONDITIONS OF ANY KIND, either express or implied.
#  See the License for the specific language governing permissions and
#  limitations under the License.


description: |
  Driver for MCP3914 8 ch ADC on SPI bus.

compatible: "microchip,mcp3914"

include:
  - spi-device.yaml
  - name: adc-controller.yaml
    child-binding:
      property-allowlist:
        - reg
        - zephyr,gain
        - zephyr,reference
        - zephyr,acquisition-time
        - zephyr,resolution

properties:

  "#io-channel-cells":
    const: 1

  mclk-src:
    type: string
    description: |
      Device digital clock source
      - "MCP3914_CLK_SRC_XTAL"
      - "MCP3914_CLK_SRC_EXT" .. POR default
    default:
      "MCP3914_CLK_SRC_EXT"
    enum:
      - "MCP3914_CLK_SRC_XTAL"
      - "MCP3914_CLK_SRC_EXT"

  mclk-freq:
    type: int
    description: |
      Master clock frequency, in MHz. (Unused at the moment)
    required:
      true

  channel-count:
    type: int
    description: Number of channels available on this device
    default: 8

  amclk-prescale:
    type: string
    description: |
      Master clock to analogue master clock divider
      - "MCP3914_AMCLK_PRESCALE_NONE" .. POR default
      - "MCP3914_AMCLK_PRESCALE_DIV2"
      - "MCP3914_AMCLK_PRESCALE_DIV4"
      - "MCP3914_AMCLK_PRESCALE_DIV8"
    default:
      "MCP3914_AMCLK_PRESCALE_NONE"
    enum:
      - "MCP3914_AMCLK_PRESCALE_NONE"
      - "MCP3914_AMCLK_PRESCALE_DIV2"
      - "MCP3914_AMCLK_PRESCALE_DIV4"
      - "MCP3914_AMCLK_PRESCALE_DIV8"

  hware-osr:
    type: string
    description: |
      Oversampling ratio applied to all channels on device
      - "MCP3914_OSR_32"
      - "MCP3914_OSR_64"
      - "MCP3914_OSR_128"
      - "MCP3914_OSR_256" .. POR default
      - "MCP3914_OSR_512"
      - "MCP3914_OSR_1024"
      - "MCP3914_OSR_2048"
      - "MCP3914_OSR_4096"
    default:
      "MCP3914_OSR_256"
    enum:
      - "MCP3914_OSR_32"
      - "MCP3914_OSR_64"
      - "MCP3914_OSR_128"
      - "MCP3914_OSR_256"
      - "MCP3914_OSR_512"
      - "MCP3914_OSR_1024"
      - "MCP3914_OSR_2048"
      - "MCP3914_OSR_4096"

  dready-gpios:
    type: phandle-array
    description: |
      The /DR signal from the device goes low when
      the ADC has valid data to read. Required as
      driver hasn't implement polling as yet.

io-channel-cells:
  - input
```

## dts/bindings/adc/microchip,mec5-adc-sar.yaml
```yaml
# Copyright 2024 Microchip Technology Inc.
# SPDX-License-Identifier: Apache-2.0

description: Microchip MEC5 HAL based ADC SAR controller

compatible: "microchip,mec5-adc-sar"

include: [adc-controller.yaml, pinctrl-device.yaml]

properties:
  reg:
    required: true

  interrupts:
    required: true

  clktime:
    type: int
    description: |
      ADC sampling clock high and low time in units of
      48 MHz clocks <1:255>. The default value of 1 produces
      a 24 MHz ADC sampling clock.

  warm-up-delay:
    type: int
    description: |
      ADC warm up delay expressed as ADC sampling clocks.
      Warm up delay takes effect both Single and Repeat
      enables are clear and firmware sets one or both.
      For single conversion mode the warm up delay is performed
      each time firmware sets the Start Single bit. For repeat
      mode warm up delay is performed when the Start Repeat bit
      is set the first time. If the ADC is in performing a set of
      single or repeat conversions and the other mode's start bit
      is set the warm up delay is not performed. Note: the default
      warm up delay is 514 ADC sample clocks.

  repeat-cycle-start-delay:
    type: int
    description: |
      An additional delay before the set of channels selected for
      repeat conversion is begun. This delay is in units of 40
      microseconds and uses a 16-bit field. Zero is no additional
      delay and 0xffff is 2.6 seconds. Default value is 0 (no delay).

  repeat-cycle-delay:
    type: int
    description: |
      A delay before the second and all subsequent set of repeat mode
      channels is converted. This delay in in units of 40 microseconds
      and uses a 16-bit field. Default value is 0 (no delay).

  pinctrl-0:
    required: true

  pinctrl-names:
    required: true

  sar-config:
    type: int
    description: |
      Optional 32-bit value for overriding the ADC SAR configuration
      register set by the Boot-ROM from OTP. Contact Microchip for
      support in using this override.

  "#io-channel-cells":
    const: 1

io-channel-cells:
  - input
```

## dts/bindings/adc/microchip,pic32cxsg-adc.yaml
```yaml
# Copyright (c) 2024 Microchip
# SPDX-License-Identifier: Apache-2.0

description: Microchip PIC32CXSG family ADC

compatible: "microchip,pic32cxsg-adc"

include:
  - name: adc-controller.yaml
  - name: pinctrl-device.yaml

properties:
  reg:
    required: true

  interrupts:
    required: true

  clocks:
    required: true

  clock-names:
    required: true

  gclk:
    type: int
    required: true
    description: generic clock generator source

  prescaler:
    type: int
    required: true
    description: clock prescaler divisor applied to the generic clock

  "#io-channel-cells":
    const: 1

  calib-offset:
    type: int
    description: |
      bit position offset in NVM SW Calib for start of ADC0 BIASCOMP field.
      This property is expected to be set on PIC32CXSG family of SoCs.
      For ADC0 this should be 0, and for ADC1 this should be 14.
    enum:
      - 0
      - 14

io-channel-cells:
  - input
```

## dts/bindings/adc/microchip,xec-adc-v2.yaml
```yaml
# Copyright (c) 2019, Intel Corporation
# Copyright (c) 2021, Microchip Technology Inc.
# SPDX-License-Identifier: Apache-2.0

description: Microchip XEC ADC

compatible: "microchip,xec-adc-v2"

include: [adc-controller.yaml, pinctrl-device.yaml]

properties:
  reg:
    required: true

  interrupts:
    required: true

  "#io-channel-cells":
    const: 1

  girqs:
    type: array
    required: true
    description: Array of pairs of GIRQ number and bit position

  pcrs:
    type: array
    required: true
    description: ADC PCR register index and bit position

  pinctrl-0:
    required: true

  pinctrl-names:
    required: true

io-channel-cells:
  - input
```

## dts/bindings/adc/microchip,xec-adc.yaml
```yaml
# Copyright (c) 2019, Intel Corporation
# Copyright (c) 2021, Microchip Technology Inc.
# SPDX-License-Identifier: Apache-2.0

description: Microchip XEC ADC

compatible: "microchip,xec-adc"

include:
  - name: adc-controller.yaml
  - name: pinctrl-device.yaml
  - name: microchip,dmec-ecia-girq.yaml

properties:
  reg:
    required: true

  interrupts:
    required: true

  "#io-channel-cells":
    const: 1

  pcr-scr:
    type: int
    required: true
    description: |
      ADC Power Clock Reset(PCR) peripheral index and bit position

  clktime:
    type: int
    required: true
    description: ADC clock high & low time count value <1:255>

  channels:
    type: int
    required: true
    description: Number of ADC channels supported by SoC

  pinctrl-0:
    required: true

  pinctrl-names:
    required: true

io-channel-cells:
  - input
```

## dts/bindings/adc/nordic,nrf-adc.yaml
```yaml
# Copyright (c) 2018, Nordic Semiconductor ASA
# SPDX-License-Identifier: Apache-2.0

description: nRF ADC node

compatible: "nordic,nrf-adc"

interrupt-source: true

include: adc-controller.yaml

properties:
  reg:
    required: true

  "#io-channel-cells":
    const: 1

io-channel-cells:
  - input
```

## dts/bindings/adc/nordic,nrf-comp.yaml
```yaml
# Copyright (c) 2022, Nordic Semiconductor ASA
# SPDX-License-Identifier: Apache-2.0

description: Nordic nRF family COMP (Comparator)

compatible: "nordic,nrf-comp"

interrupt-source: true

include: base.yaml

properties:
  reg:
    required: true

  "#io-channel-cells":
    type: int
    const: 1
    required: true

io-channel-cells:
  - input
```

## dts/bindings/adc/nuvoton,nct-adc.yaml
```yaml
# Copyright (c) 2025 Nuvoton Technology Corporation.
# SPDX-License-Identifier: Apache-2.0

description: Nuvoton, NCT-ADC node

compatible: "nuvoton,nct-adc"

include: [adc-controller.yaml, pinctrl-device.yaml]

properties:
  reg:
    required: true
  clocks:
    required: true
  pinctrl-0:
    required: true
  pinctrl-names:
    required: true
  vref-mv:
    type: int
    required: true
    description: ADC reference voltage (Unit:mV)
  channel-count:
    type: int
    required: true
    description: the number of ADC channels

io-channel-cells:
  - input
```

## dts/bindings/adc/nuvoton,npcm-adc.yaml
```yaml
# Copyright (c) 2024 Nuvoton Technology Corporation.
# SPDX-License-Identifier: Apache-2.0

description: Nuvoton, NPCM-ADC node

compatible: "nuvoton,npcm-adc"

include: [adc-controller.yaml, pinctrl-device.yaml]

properties:
  reg:
    required: true
  clocks:
    required: true
  pinctrl-0:
    required: true
  pinctrl-names:
    required: true
  vref-mv:
    type: int
    required: true
    description: ADC reference voltage (Unit:mV)
  channel-count:
    type: int
    required: true
    description: the number of ADC channels

io-channel-cells:
  - input
```

## dts/bindings/adc/nuvoton,npcx-adc.yaml
```yaml
# Copyright (c) 2020 Nuvoton Technology Corporation.
# SPDX-License-Identifier: Apache-2.0

description: Nuvoton, NPCX-ADC node

compatible: "nuvoton,npcx-adc"

include: [adc-controller.yaml, pinctrl-device.yaml]

properties:
  reg:
    required: true
  clocks:
    required: true
  pinctrl-0:
    required: true
  pinctrl-names:
    required: true
  vref-mv:
    type: int
    required: true
    description: ADC reference voltage (Unit:mV)
  channel-count:
    type: int
    required: true
    description: the number of ADC channels
  threshold-count:
    type: int
    required: true
    description: the number of threshold detectors adc supports
  speed-conf:
    type: array
    required: true
    description: ADC speed configurations
  support-npcxn-v1:
    type: boolean
    description: |
        This option enables the ADC support for NPCXn V1.
  support-npcxn-v2:
    type: boolean
    description: |
        This option enables the ADC support for NPCXn V2.
  support-npcxn-v3:
    type: boolean
    description: |
        This option enables the ADC support for NPCXn V3.
io-channel-cells:
  - input
```

## dts/bindings/adc/nuvoton,numaker-adc.yaml
```yaml
# Copyright (c) 2023 Nuvoton Technology Corporation.
# SPDX-License-Identifier: Apache-2.0

description: Nuvoton, NuMaker ADC controller

compatible: "nuvoton,numaker-adc"

include: [adc-controller.yaml, reset-device.yaml, pinctrl-device.yaml]

properties:
  reg:
    required: true

  interrupts:
    required: true

  resets:
    required: true

  clocks:
    required: true

  channels:
    type: int
    description: Number of channels
    required: true

  "#io-channel-cells":
    const: 1

io-channel-cells:
  - input
```
