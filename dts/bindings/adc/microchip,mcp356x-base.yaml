## dts/bindings/adc/nxp,adc12.yaml
```yaml
# Copyright (c) 2019 Vestas Wind Systems A/S
# SPDX-License-Identifier: Apache-2.0

description: NXP ADC12

compatible: "nxp,adc12"

include: [adc-controller.yaml, pinctrl-device.yaml]

properties:
  reg:
    required: true

  interrupts:
    required: true

  clk-source:
    type: int
    required: true
    description: converter clock source

  clk-divider:
    type: int
    required: true
    description: clock divider for the converter

  alternate-voltage-reference:
    type: boolean
    description: use alternate voltage reference source

  sample-time:
    type: int
    required: true
    description: sample time in clock cycles

  vref-mv:
    type: int
    required: true
    description: Indicates the reference voltage of the ADC in mV.

  "#io-channel-cells":
    const: 1

io-channel-cells:
  - input
```

## dts/bindings/adc/nxp,gau-adc.yaml
```yaml
# Copyright 2022 NXP
# SPDX-License-Identifier: Apache-2.0

description: |
  NXP GAU GPADC.

compatible: "nxp,gau-adc"

include:
  - name: base.yaml
  - name: adc-controller.yaml

properties:
  reg:
    required: true

  interrupts:
    required: true

  nxp,clock-divider:
    type: int
    description: |
      Clock divider from 1 to 32.
      Default is 1 which is reset value.
    default: 1

  nxp,power-mode:
    type: string
    description: |
      Current bias.
      Default is "full-bias" because it is the reset value.
    enum:
      - "full-bias"
      - "half-bias"
    default: "full-bias"

  nxp,input-buffer:
    type: boolean
    description: Enable use of the input buffer

  nxp,calibration-voltage:
    type: string
    enum:
      - "internal"
      - "external"
    default: "internal"
    description: |
      Use external calibration voltage.
      Default is "internal" because it is the reset value.

  "#io-channel-cells":
    const: 1

io-channel-cells:
  - input
```

## dts/bindings/adc/nxp,kinetis-adc16.yaml
```yaml
# Copyright (c) 2017, NXP
# SPDX-License-Identifier: Apache-2.0

description: Kinetis ADC16

compatible: "nxp,kinetis-adc16"

include: ["adc-controller.yaml", "pinctrl-device.yaml"]

properties:
  reg:
    required: true

  channel-mux-b:
    type: boolean
    description: |
      Use alternate set (b instead of a) of ADC channels

  interrupts:
    required: true

  periodic-trigger:
    type: boolean
    description: if periodic trigger enabled

  "#io-channel-cells":
    const: 1

  clk-source:
    type: int
    description: use alternate clock reference source

  long-sample:
    type: int
    enum:
      - 0
      - 1
      - 2
      - 3
      - 4
    description: long sample mode

  continuous-convert:
    type: boolean
    description: If use continuous convert

  high-speed:
    type: boolean
    description: If use high speed

  hw-trigger-src:
    type: int
    description: hardware trigger source (See ADCxTRGSEL field in user manual for more details)

  has-differential-mode:
    type: boolean
    description: |
      Controller instance supports differential channel conversion.
      This expresses the hardware capability of this particular ADC
      instance and should be set in SoC dtsi. Board dts files should
      not modify this.

io-channel-cells:
  - input
```

## dts/bindings/adc/nxp,lpc-lpadc.yaml
```yaml
# Copyright (c) 2020, Toby Firth
# SPDX-License-Identifier: Apache-2.0

description: LPC LPADC

compatible: "nxp,lpc-lpadc"

include: [adc-controller.yaml, pinctrl-device.yaml]

properties:
  reg:
    required: true

  interrupts:
    required: true

  clk-divider:
    type: int
    description: clock divider for the converter

  clk-source:
    type: int
    description: source to attach the ADC clock to

  voltage-ref:
    type: int
    required: true
    description: |
      Voltage reference selection. Corresponds to value of
      register field CFG[REFSEL] (see chip specific manual).
    enum:
      - 0
      - 1
      - 2
      - 3

  calibration-average:
    type: int
    description: conversion average number for auto-calibration
    enum:
      - 1
      - 2
      - 4
      - 8
      - 16
      - 32
      - 64
      - 128

  no-power-level:
    type: boolean
    description: |
      There is no power level selection function.

  power-level:
    type: int
    description: |
      Power level selection. Corresponds to the value of
      register field CFG[PWRSEL] (see chip specific manual).
    enum:
      - 0
      - 1
      - 2
      - 3

  offset-value-a:
    type: int
    required: true
    description: Offset value A to use if CONFIG_LPADC_DO_OFFSET_CALIBRATION is false

  offset-value-b:
    type: int
    required: true
    description: Offset value B to use if CONFIG_LPADC_DO_OFFSET_CALIBRATION is false

  nxp,references:
    type: phandle-array
    description: References to required regulators which must be enabled for LPADC to function

  nxp,opamps:
    type: phandle-array
    description: |
      When the opamp output is used as the ADC input, the opamp output can be adjusted by
      adjusting the opamp gain.

  ideal-sample-range:
    type: array
    description: |
      Ideal ADC sample range for the application. This is used to calculate the opamp gain
      when the opamp output is used as the ADC input.

  "#io-channel-cells":
    const: 1

io-channel-cells:
  - input
```

## dts/bindings/adc/nxp,mcux-12b1msps-sar.yaml
```yaml
# Copyright (c) 2019 Vestas Wind Systems A/S
# SPDX-License-Identifier: Apache-2.0

description: NXP MCUA 12B1MSPS SAR ADC

compatible: "nxp,mcux-12b1msps-sar"

include: [adc-controller.yaml, pinctrl-device.yaml]

properties:
  reg:
    required: true

  interrupts:
    required: true

  clk-divider:
    type: int
    required: true
    description: clock divider for the converter

  sample-period-mode:
    type: int
    required: true
    description: sample period mode

  "#io-channel-cells":
    const: 1

io-channel-cells:
  - input
```

## dts/bindings/adc/nxp,s32-adc-sar.yaml
```yaml
# Copyright 2023 NXP
# SPDX-License-Identifier: Apache-2.0

description: NXP S32 ADC SAR controller

compatible: "nxp,s32-adc-sar"

include: [adc-controller.yaml, pinctrl-device.yaml]

properties:
  reg:
    required: true

  interrupts:
    required: true

  vref-mv:
    type: int
    default: 3300
    description: Indicates the reference voltage of the ADC in mV.

  group-channel:
    type: string
    required: true
    enum:
      - "precision"
      - "standard"
      - "external"
    description: The ADC group channel.

  high-speed:
    type: boolean
    description: Use high speed during conversion, calibration.

  callback-select:
    type: string
    default: "normal-end-conversion"
    enum:
      - "normal-end-conversion"
      - "normal-end-chain"
    description: |
      Select normal end conversion callback to reduce interrupt handling time.
      Select normal end chain callback to reduce the number of interrupt occurrences.

  "#io-channel-cells":
    const: 1

io-channel-cells:
  - input
```

## dts/bindings/adc/nxp,sar-adc.yaml
```yaml
# Copyright 2025 NXP
# SPDX-License-Identifier: Apache-2.0

description: |
  NXP successive-approximation ADC (SAR ADC) controller.

compatible: "nxp,sar-adc"

include: [adc-controller.yaml]

properties:
  reg:
    required: true

  interrupts:
    required: true

  has-external-channels:
    type: boolean
    description: |
      Indicates whether this SAR ADC instance supports the External channel group
      (group2: NCMR2/CEOCFR2/CIMR2/ECDR).
      Some SoCs expose different capabilities per ADC instance.

  overwrite:
    type: boolean
    description: |
      Enable overwrite of conversion results when the result registers are full.

  auto-clock-off:
    type: boolean
    description: |
      Reduces power consumption by turning off the clock of the analog part of
      ADC when it is in Idle state.

  hw-average-support:
    type: boolean
    description: |
      Indicates whether the ADC hardware supports averaging of conversion results.

  conv-clk-freq-div-factor:
    type: int
    enum: [0, 1, 2, 3]
    description: |
      Select ADC conversion clock frequency division factor.
      ADC conversion clock = ADC module clock ÷ (1 << conv-clk-freq-div-factor)
      - 0: ADC module clock frequency
      - 1: ADC module clock frequency divided by 2
      - 2: ADC module clock frequency divided by 4
      - 3: ADC module clock frequency divided by 8
      NOTE: This property is not available on I.MX devices.

  "#io-channel-cells":
    const: 1

io-channel-cells:
  - input
```

## dts/bindings/adc/nxp,vf610-adc.yaml
```yaml
# Copyright (c) 2021, Antonio Tessarolo
# SPDX-License-Identifier: Apache-2.0

description: Vf610 Adc

compatible: "nxp,vf610-adc"

include: [adc-controller.yaml, "nxp,rdc-policy.yaml"]

properties:
  reg:
    required: true

  interrupts:
    required: true

  clk-source:
    type: int
    required: true
    description: |
      Select adc clock source: 0 clock from IPG, 1 clock from IPG divided 2, 2 async clock

  clk-divider:
    type: int
    required: true
    description: |
      Select clock divider: 0 clock divided by 1, 1 clock divided by 2, 2 clock divided by 4,
      3 clock divided by 8

  "#io-channel-cells":
    const: 1

io-channel-cells:
  - input
```

## dts/bindings/adc/raspberrypi,pico-adc.yaml
```yaml
# Copyright (c) 2022 TOKTIA Hrioshi <tokita.hiroshi@fujitsu.com>
# SPDX-License-Identifier: Apache-2.0

description: Raspberry Pi Pico ADC

compatible: "raspberrypi,pico-adc"

include: [adc-controller.yaml, pinctrl-device.yaml, reset-device.yaml]

properties:
  reg:
    required: true

  vref-mv:
    type: int
    default: 3300
    description: |
      Indicate the reference voltage of the ADC in mV.
      Raspberry Pi has one voltage reference.
      And it is usually connected to VDD.
      In such case, set this property to the VDD (in mV) value.

  "#io-channel-cells":
    const: 1

io-channel-cells:
  - input
```

## dts/bindings/adc/realtek,ameba-adc.yaml
```yaml
# Copyright (c) 2026 Realtek Semiconductor Corp.
# SPDX-License-Identifier: Apache-2.0

description: |
  Ameba ADC

  Mapping input pinctrl:
  Channel 0 -> adc_in0_pb19
  Channel 1 -> adc_in1_pb18
  Channel 2 -> adc_in2_pb17
  Channel 3 -> adc_in3_pb16
  Channel 4 -> adc_in4_pb15
  Channel 5 -> adc_in5_pb14
  Channel 6 -> adc_in6_pb13

compatible: "realtek,ameba-adc"

include:
  - adc-controller.yaml
  - pinctrl-device.yaml

properties:
  reg:
    required: true

  clocks:
    required: true

  interrupts:
    required: true

  pinctrl-0:
    required: true

  pinctrl-names:
    required: true

  vref-mv:
    type: int
    default: 3300
    description: |
      Indicates the reference voltage of the ADC in millivolts.
      Default is 3300 mV, which matches the typical VDDA supply voltage
      used on Ameba reference boards.

  channel-count:
    type: int
    required: true
    description: The maximum channels supported.

  "#io-channel-cells":
    const: 1

io-channel-cells:
  - input
```

## dts/bindings/adc/realtek,bee-adc.yaml
```yaml
# Copyright (c) 2026, Realtek Semiconductor Corporation
# SPDX-License-Identifier: Apache-2.0

description: |
  Bee ADC controller.
  Pinctrl must be configured as "SW_MODE" while using ADC.

  The RTL87x2G ADC has 9 channels.
  P2_0 to P2_7 could be configured as ADC sampling pins, corresponding to ADC channel 0 to 7.
  The last ADC channel(channel 8) is internal vbat channel, which does not need a external pin
  to sample.

  The RTL8752H ADC has 8 channels.
  P2_0 to P2_5 and P2_7 could be configured as ADC sampling pins,
  corresponding to ADC channel 0 to 5 and 7.
  The last ADC channel(channel 8) is internal vbat channel, which does not need a external pin
  to sample.
  Notes: ADC channel 6 is not supported on RTL8752H!!!

  Example of devicetree configuration.

  &adc {
    pinctrl-0 = <&adc_default>;
    pinctrl-names = "default";
    #address-cells = <1>;
    #size-cells = <0>;
    status = "okay";

    channel@0 {
        reg = <0>;
        zephyr,gain = "ADC_GAIN_1";
        zephyr,reference = "ADC_REF_INTERNAL";
        zephyr,acquisition-time = <ADC_ACQ_TIME_DEFAULT>;
        zephyr,resolution = <12>;
    };

    channel@8 {
        reg = <8>;
        zephyr,gain = "ADC_GAIN_1";
        zephyr,reference = "ADC_REF_INTERNAL";
        zephyr,acquisition-time = <ADC_ACQ_TIME_DEFAULT>;
        zephyr,resolution = <12>;
    };
  };

  &pinctrl {
    adc_default: adc_default {
        group1 {
            psels = <BEE_PSEL(SW_MODE, P2_0)>;
            output-disable;
            bias-pull-down;
        };
    };
  };

compatible: "realtek,bee-adc"

include: [adc-controller.yaml, pinctrl-device.yaml]

properties:
  reg:
    required: true

  clocks:
    required: true

  channels:
    type: int
    description: Number of ADC channels
    required: true

  interrupts:
    required: true

  "#io-channel-cells":
    const: 1

  pinctrl-0:
    required: true

  pinctrl-names:
    required: true

  is-bypass-mode:
    type: int
    default: 0
    description: |
      This is a channel map (bitmask) to configure bypass/divide mode for each adc channel.
      For example, setting to 0x05 means channel 0 and channel 2 are configured as bypass mode,
      and other channels are configured as divide mode by default.
      - Divide mode (default): the ADC range is 0 to 3.3V.
      - Bypass mode: the ADC range is 0 to 0.9V.

io-channel-cells:
  - input
```

## dts/bindings/adc/realtek,rts5912-adc.yaml
```yaml
description: Realtek rts5912 ADC

compatible: "realtek,rts5912-adc"

include: [adc-controller.yaml, pinctrl-device.yaml]

properties:
  interrupts:
    required: true

  pinctrl-0:
    required: true

  pinctrl-names:
    required: true

  vref-mv:
    type: int
    default: 3300
    description: The reference voltage of the ADC in mV.

io-channel-cells:
  - input
```
