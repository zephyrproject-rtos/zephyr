## dts/bindings/adc/ti,ads7828-base.yaml
```yaml
# Copyright (c) 2026 RAKwireless Technology Limited
# SPDX-License-Identifier: Apache-2.0

# Common fields for the Texas Instruments ADS7828 and ADS7830

include: [adc-controller.yaml, i2c-device.yaml]

properties:
  "#io-channel-cells":
    const: 1

io-channel-cells:
  - input
```

## dts/bindings/adc/ti,ads7828.yaml
```yaml
# Copyright (c) 2026 RAKwireless Technology Limited
# SPDX-License-Identifier: Apache-2.0

description: Texas Instruments ADS7828 12-bit 8-channel I2C ADC

compatible: "ti,ads7828"

include: ti,ads7828-base.yaml
```

## dts/bindings/adc/ti,ads7830.yaml
```yaml
# Copyright (c) 2026 RAKwireless Technology Limited
# SPDX-License-Identifier: Apache-2.0

description: Texas Instruments ADS7830 8-bit 8-channel I2C ADC

compatible: "ti,ads7830"

include: ti,ads7828-base.yaml
```

## dts/bindings/adc/ti,ads7950.yaml
```yaml
# Copyright (c) 2026 James Walmsley <james@fullfat-fs.co.uk>
# SPDX-License-Identifier: Apache-2.0

description: TI ADS7950-Q1 SPI ADC

compatible: "ti,ads7950"

include: ti,ads79xx-base.yaml
```

## dts/bindings/adc/ti,ads7951.yaml
```yaml
description: TI ADS7951-Q1 SPI ADC

compatible: "ti,ads7951"

include: ti,ads79xx-base.yaml
```

## dts/bindings/adc/ti,ads7952.yaml
```yaml
description: TI ADS7952-Q1 SPI ADC

compatible: "ti,ads7952"

include: ti,ads79xx-base.yaml
```

## dts/bindings/adc/ti,ads7953.yaml
```yaml
description: TI ADS7953-Q1 SPI ADC

compatible: "ti,ads7953"

include: ti,ads79xx-base.yaml
```

## dts/bindings/adc/ti,ads7954.yaml
```yaml
description: TI ADS7954-Q1 SPI ADC

compatible: "ti,ads7954"

include: ti,ads79xx-base.yaml
```

## dts/bindings/adc/ti,ads7955.yaml
```yaml
# Copyright (c) 2026 James Walmsley <james@fullfat-fs.co.uk>
# SPDX-License-Identifier: Apache-2.0

description: TI ADS7955-Q1 SPI ADC

compatible: "ti,ads7955"

include: ti,ads79xx-base.yaml
```

## dts/bindings/adc/ti,ads7956.yaml
```yaml
description: TI ADS7956-Q1 SPI ADC

compatible: "ti,ads7956"

include: ti,ads79xx-base.yaml
```

## dts/bindings/adc/ti,ads7957.yaml
```yaml
# Copyright (c) 2026 James Walmsley <james@fullfat-fs.co.uk>
# SPDX-License-Identifier: Apache-2.0

description: TI ADS7957-Q1 SPI ADC

compatible: "ti,ads7957"

include: ti,ads79xx-base.yaml
```

## dts/bindings/adc/ti,ads7958.yaml
```yaml
description: TI ADS7958-Q1 SPI ADC

compatible: "ti,ads7958"

include: ti,ads79xx-base.yaml
```

## dts/bindings/adc/ti,ads7959.yaml
```yaml
# Copyright (c) 2026 James Walmsley <james@fullfat-fs.co.uk>
# SPDX-License-Identifier: Apache-2.0

description: TI ADS7959-Q1 SPI ADC

compatible: "ti,ads7959"

include: ti,ads79xx-base.yaml
```

## dts/bindings/adc/ti,ads7960.yaml
```yaml
# Copyright (c) 2026 James Walmsley <james@fullfat-fs.co.uk>
# SPDX-License-Identifier: Apache-2.0

description: TI ADS7960-Q1 SPI ADC

compatible: "ti,ads7960"

include: ti,ads79xx-base.yaml
```

## dts/bindings/adc/ti,ads7961.yaml
```yaml
description: TI ADS7961-Q1 SPI ADC

compatible: "ti,ads7961"

include: ti,ads79xx-base.yaml
```

## dts/bindings/adc/ti,ads79xx-base.yaml
```yaml
# Copyright (c) 2026 James Walmsley <james@fullfat-fs.co.uk>
# SPDX-License-Identifier: Apache-2.0

description: TI ADS79xx-Q1 SPI ADC (ADS7950..ADS7961 family)

include: [spi-device.yaml, adc-controller.yaml]

properties:
  "#io-channel-cells":
    const: 1
  ti,range:
    type: int
    default: 1
    enum: [1, 2]
    description: |
      Input range selection for manual mode:
      1 = 0..Vref (default device state)
      2 = 0..2*Vref (requires 2*Vref <= VA)

io-channel-cells:
  - input
```

## dts/bindings/adc/ti,am335x-adc.yaml
```yaml
# Copyright (c) 2025 Texas Instruments
#
# SPDX-License-Identifier: Apache-2.0

description: TI AM335X ADC

compatible: "ti,am335x-adc"

include: [adc-controller.yaml]

properties:
  interrupts:
    required: true

  ti,vrefp:
    type: int
    required: true
    description: Reference Voltage (in mV)

  ti,fifo:
    type: int
    required: true
    enum:
      - 0
      - 1
    description: FIFO for storing conversions

  "#io-channel-cells":
    const: 1

io-channel-cells:
  - input

child-binding:
  properties:
    ti,open-delay:
      type: int
      default: 0
      description: Delay before acquisition period

    zephyr,resolution:
      default: 12

    zephyr,oversampling:
      default: 0
```

## dts/bindings/adc/ti,cc13xx-cc26xx-adc.yaml
```yaml
# Copyright (c) 2022 Florin Stancu <niflostancu@gmail.com>
# SPDX-License-Identifier: Apache-2.0

description: TI CC13XX/CC26xx family ADC

compatible: "ti,cc13xx-cc26xx-adc"

include: [adc-controller.yaml]

properties:
  reg:
    required: true

  interrupts:
    required: true

  "#io-channel-cells":
    const: 1

io-channel-cells:
  - input
```

## dts/bindings/adc/ti,cc23x0-adc.yaml
```yaml
# Copyright (c) 2024 BayLibre, SAS
# SPDX-License-Identifier: Apache-2.0

description: TI CC23X0 16-channel ADC

compatible: "ti,cc23x0-adc"

include: [adc-controller.yaml, pinctrl-device.yaml]

properties:
  reg:
    required: true

  interrupts:
    required: true

  pinctrl-0:
    required: true

  pinctrl-names:
    required: true

  "#io-channel-cells":
    const: 1

  dmas:
    description: |
      Optional DMA specifier. The specifier will have a phandle reference to the
      DMA controller, the channel number, and the peripheral trigger source.

      Example for channel 3 with adc0trg trigger source:
        dmas = <&dma 3 5>;

  dma-names:
    description: |
      Required if the dmas property exists. This should be "dma".

      Example:
        dma-names = "dma";

io-channel-cells:
  - input
```

## dts/bindings/adc/ti,cc32xx-adc.yaml
```yaml
# Copyright (c) 2021 Pavlo Hamov <pasha.gamov@gmail.com>
# SPDX-License-Identifier: Apache-2.0

description: cc32xx ADC node

compatible: "ti,cc32xx-adc"

include: adc-controller.yaml

properties:
  reg:
    required: true

  interrupts:
    required: true

  "#io-channel-cells":
    const: 1

io-channel-cells:
  - input
```

## dts/bindings/adc/ti,lmp90077.yaml
```yaml
description: Texas Instruments LMP90077 AFE binding

compatible: "ti,lmp90077"

include: ti,lmp90xxx-base.yaml
```

## dts/bindings/adc/ti,lmp90078.yaml
```yaml
description: Texas Instruments LMP90078 AFE binding

compatible: "ti,lmp90078"

include: ti,lmp90xxx-current.yaml
```

## dts/bindings/adc/ti,lmp90079.yaml
```yaml
description: Texas Instruments LMP90079 AFE binding

compatible: "ti,lmp90079"

include: ti,lmp90xxx-base.yaml
```

## dts/bindings/adc/ti,lmp90097.yaml
```yaml
description: Texas Instruments LMP90097 AFE binding

compatible: "ti,lmp90097"

include: ti,lmp90xxx-base.yaml
```

## dts/bindings/adc/ti,lmp90098.yaml
```yaml
description: Texas Instruments LMP90098 AFE binding

compatible: "ti,lmp90098"

include: ti,lmp90xxx-current.yaml
```
