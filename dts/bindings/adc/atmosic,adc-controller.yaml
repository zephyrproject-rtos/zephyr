## dts/bindings/adc/infineon,autanalog-sar-fir.yaml
```yaml
# SPDX-FileCopyrightText: <text>Copyright (c) 2026 Infineon Technologies AG,
# or an affiliate of Infineon Technologies AG. All rights reserved.</text>
#
# SPDX-License-Identifier: Apache-2.0

title: Infineon AutAnalog SAR ADC FIR Filter

description: |
  FIR filter configuration for the Infineon AutAnalog SAR ADC.

  Up to 2 FIR filters (64-tap each) are available for post-processing of ADC
  conversion results. Each filter can be independently configured with its own
  source channel, coefficient set, and output options.

  FIR filter nodes must be named "fir-0" and/or "fir-1" under the parent
  SAR ADC node, corresponding to FIR filter hardware indices 0 and 1
  respectively.

compatible: "infineon,autanalog-sar-fir"

properties:
  channel-source:
    type: int
    default: 0
    description: |
      Selects the ADC channel to use as the FIR filter input.
      If omitted (defaults to DISABLED), the channel source must be
      configured via the pseudo-channel's zephyr,input-positive property
      or at runtime using the vendor-specific API.
      Use IFX_AUTANALOG_SAR_FIR_CH_* constants from
      <dt-bindings/adc/infineon-autanalog-sar.h>.
        IFX_AUTANALOG_SAR_FIR_CH_DISABLED (0)  - Disabled
        IFX_AUTANALOG_SAR_FIR_CH_GPIO0    (1)  - GPIO channel 0
        IFX_AUTANALOG_SAR_FIR_CH_GPIO1    (2)  - GPIO channel 1
        IFX_AUTANALOG_SAR_FIR_CH_GPIO2    (3)  - GPIO channel 2
        IFX_AUTANALOG_SAR_FIR_CH_GPIO3    (4)  - GPIO channel 3
        IFX_AUTANALOG_SAR_FIR_CH_GPIO4    (5)  - GPIO channel 4
        IFX_AUTANALOG_SAR_FIR_CH_GPIO5    (6)  - GPIO channel 5
        IFX_AUTANALOG_SAR_FIR_CH_GPIO6    (7)  - GPIO channel 6
        IFX_AUTANALOG_SAR_FIR_CH_GPIO7    (8)  - GPIO channel 7
        IFX_AUTANALOG_SAR_FIR_CH_MUX0     (9)  - MUX channel 0
        IFX_AUTANALOG_SAR_FIR_CH_MUX1     (10) - MUX channel 1
        IFX_AUTANALOG_SAR_FIR_CH_MUX2     (11) - MUX channel 2
        IFX_AUTANALOG_SAR_FIR_CH_MUX3     (12) - MUX channel 3
        IFX_AUTANALOG_SAR_FIR_CH_MUX4     (13) - MUX channel 4
        IFX_AUTANALOG_SAR_FIR_CH_MUX5     (14) - MUX channel 5
        IFX_AUTANALOG_SAR_FIR_CH_MUX6     (15) - MUX channel 6
        IFX_AUTANALOG_SAR_FIR_CH_MUX7     (16) - MUX channel 7
        IFX_AUTANALOG_SAR_FIR_CH_MUX8     (17) - MUX channel 8
        IFX_AUTANALOG_SAR_FIR_CH_MUX9     (18) - MUX channel 9
        IFX_AUTANALOG_SAR_FIR_CH_MUX10    (19) - MUX channel 10
        IFX_AUTANALOG_SAR_FIR_CH_MUX11    (20) - MUX channel 11
        IFX_AUTANALOG_SAR_FIR_CH_MUX12    (21) - MUX channel 12
        IFX_AUTANALOG_SAR_FIR_CH_MUX13    (22) - MUX channel 13
        IFX_AUTANALOG_SAR_FIR_CH_MUX14    (23) - MUX channel 14
        IFX_AUTANALOG_SAR_FIR_CH_MUX15    (24) - MUX channel 15

  coefficients:
    type: array
    description: |
      Array of FIR filter coefficients in Q1.15 fixed-point format.
      The number of elements determines the filter tap count (1 to 64).

      Values use two's complement notation with the decimal point fixed to
      the right of the most significant bit. Valid range:
      -32768 (approximately -1.0) to 32767 (approximately +1.0) with a
      resolution of 1/32768.

      Examples:
        0.25  = 0x2000 (8192)
        -0.25 = 0xFFFFE000 (-8192, sign-extended to 32-bit cell)
        0.5   = 0x4000 (16384)

  shift-sel:
    type: int
    default: 0
    description: |
      FIR filter output scaling. Shifts the FIR output right by the
      specified number of bits. Valid range: 0 to 16.

  wait-tap-init:
    type: boolean
    description: |
      If set, the FIR filter waits for (tap-count) updates before
      outputting first valid data. If not set, the FIR generates a
      trigger after each update.

  fir-limit:
    type: int
    default: 0
    enum: [0, 1, 2, 3, 4]
    description: |
      Range detection configuration for the FIR filter output.
      Use IFX_AUTANALOG_SAR_LIMIT_* constants from
      <dt-bindings/adc/infineon-autanalog-sar.h>.
        IFX_AUTANALOG_SAR_LIMIT_DISABLED (0) - Disabled (default)
        IFX_AUTANALOG_SAR_LIMIT_STC0     (1) - Limit config 0
        IFX_AUTANALOG_SAR_LIMIT_STC1     (2) - Limit config 1
        IFX_AUTANALOG_SAR_LIMIT_STC2     (3) - Limit config 2
        IFX_AUTANALOG_SAR_LIMIT_STC3     (4) - Limit config 3

  fifo-sel:
    type: int
    default: 0
    enum: [0, 1, 2, 3, 4, 5, 6, 7, 8]
    description: |
      FIFO selection for routing FIR filter output.
      Use IFX_AUTANALOG_SAR_FIFO_* constants from
      <dt-bindings/adc/infineon-autanalog-sar.h>.
        IFX_AUTANALOG_SAR_FIFO_DISABLED (0) - Disabled (default)
        IFX_AUTANALOG_SAR_FIFO_0        (1) - FIFO 0
        IFX_AUTANALOG_SAR_FIFO_1        (2) - FIFO 1
        IFX_AUTANALOG_SAR_FIFO_2        (3) - FIFO 2
        IFX_AUTANALOG_SAR_FIFO_3        (4) - FIFO 3
        IFX_AUTANALOG_SAR_FIFO_4        (5) - FIFO 4
        IFX_AUTANALOG_SAR_FIFO_5        (6) - FIFO 5
        IFX_AUTANALOG_SAR_FIFO_6        (7) - FIFO 6
        IFX_AUTANALOG_SAR_FIFO_7        (8) - FIFO 7
```

## dts/bindings/adc/infineon,autanalog-sar-seq-hs.yaml
```yaml
# SPDX-FileCopyrightText: <text>Copyright (c) 2026 Infineon Technologies AG,
# or an affiliate of Infineon Technologies AG. All rights reserved.</text>
#
# SPDX-License-Identifier: Apache-2.0

title: Infineon AutAnalog SAR ADC HS Sequencer Table Entry

description: |
  High-Speed (HS) mode sequencer table entry for the Infineon AutAnalog SAR
  ADC.  Up to 32 entries may be defined as child nodes of the ADC node.  Nodes
  must be named "seq-hs-<index>" (e.g. seq-hs-0, seq-hs-1, ...).

  Each entry configures one step in the ADC scan sequence.  The hardware
  executes entries in order, with the next-action field controlling
  transitions between entries.

  When only default (single-entry) operation is desired, these nodes may be
  omitted entirely and the driver will create a single entry with backward-
  compatible defaults.

  Use IFX_AUTANALOG_SAR_SEQ_* constants from
  <dt-bindings/adc/infineon-autanalog-sar.h> for property values.

compatible: "infineon,autanalog-sar-seq-hs"

properties:
  sample-time-en:
    type: boolean
    description: |
      Enable the programmable sample-time delay for this sequencer entry.
      When disabled, the ADC uses its default minimum sampling window.

  acc-en:
    type: boolean
    description: |
      Enable accumulation / averaging for conversions triggered by this
      sequencer entry.

  acc-count:
    type: int
    default: 0
    enum: [0, 1, 2, 3, 4, 5, 6, 7]
    description: |
      Number of samples to accumulate when acc-en is set.
      Use IFX_AUTANALOG_SAR_SEQ_ACC_CNT* constants.
        0 = 2 samples   (IFX_AUTANALOG_SAR_SEQ_ACC_CNT2)
        1 = 4 samples   (IFX_AUTANALOG_SAR_SEQ_ACC_CNT4)
        2 = 8 samples   (IFX_AUTANALOG_SAR_SEQ_ACC_CNT8)
        3 = 16 samples  (IFX_AUTANALOG_SAR_SEQ_ACC_CNT16)
        4 = 32 samples  (IFX_AUTANALOG_SAR_SEQ_ACC_CNT32)
        5 = 64 samples  (IFX_AUTANALOG_SAR_SEQ_ACC_CNT64)
        6 = 128 samples (IFX_AUTANALOG_SAR_SEQ_ACC_CNT128)
        7 = 256 samples (IFX_AUTANALOG_SAR_SEQ_ACC_CNT256)

  cal-req:
    type: int
    default: 0
    enum: [0, 1, 2, 3]
    description: |
      Real-time calibration request for this sequencer entry.
      Use IFX_AUTANALOG_SAR_SEQ_CAL_* constants.
        0 = Disabled  (IFX_AUTANALOG_SAR_SEQ_CAL_DISABLED)
        1 = Both offset and linearity (IFX_AUTANALOG_SAR_SEQ_CAL_BOTH)
        2 = Offset only    (IFX_AUTANALOG_SAR_SEQ_CAL_OFFSET)
        3 = Linearity only (IFX_AUTANALOG_SAR_SEQ_CAL_LINEARITY)

  next-action:
    type: int
    default: 0
    enum: [0, 1, 2]
    description: |
      Action after this sequencer entry completes.
      Use IFX_AUTANALOG_SAR_SEQ_NEXT_* constants.
        0 = Stop, send SAR_EOS and SAR_DONE, go idle
            (IFX_AUTANALOG_SAR_SEQ_NEXT_STOP)
        1 = Send SAR_EOS and return to start (continuous)
            (IFX_AUTANALOG_SAR_SEQ_NEXT_REPEAT)
        2 = Continue to next entry in scan table
            (IFX_AUTANALOG_SAR_SEQ_NEXT_CONTINUE)

  gpio-channels:
    type: int
    default: 0
    description: |
      Bitmask of GPIO channels (0-7) to sample in this sequencer entry.
      Each bit enables the corresponding GPIO channel.  When zero, GPIO
      channel selection is configured at runtime.

  mux-mode:
    type: int
    default: 0
    enum: [0, 1, 2, 3, 4]
    description: |
      MUX channel operating mode for this sequencer entry.
      Use IFX_AUTANALOG_SAR_MUX_* constants.

  mux0-sel:
    type: int
    default: 0
    enum: [0, 1, 2, 3, 4, 5, 6, 7, 8, 9, 10, 11, 12, 13, 14, 15]
    description: |
      MUX0 channel selection (0-15) for this entry.
      Selects which of the 16 internal MUX channels to sample.

  mux1-sel:
    type: int
    default: 0
    enum: [0, 1, 2, 3, 4, 5, 6, 7, 8, 9, 10, 11, 12, 13, 14, 15]
    description: |
      MUX1 channel selection (0-15) for this entry.
      Selects which of the 16 internal MUX channels to sample.

  sample-time:
    type: int
    default: 0
    enum: [0, 1, 2, 3]
    description: |
      Which of the 4 sample-time slots to use for this entry.
      Use IFX_AUTANALOG_SAR_SEQ_SAMPLE_TIME* constants.
```

## dts/bindings/adc/infineon,autanalog-sar-seq-lp.yaml
```yaml
# SPDX-FileCopyrightText: <text>Copyright (c) 2026 Infineon Technologies AG,
# or an affiliate of Infineon Technologies AG. All rights reserved.</text>
#
# SPDX-License-Identifier: Apache-2.0

title: Infineon AutAnalog SAR ADC LP Sequencer Table Entry

description: |
  Low-Power (LP) mode sequencer table entry for the Infineon AutAnalog SAR
  ADC.  Up to 32 entries may be defined as child nodes of the ADC node.  Nodes
  must be named "seq-lp-<index>" (e.g. seq-lp-0, seq-lp-1, ...).

  LP mode only supports MUX channels; each entry selects a single MUX
  channel via mux0-sel.

  When only default (single-entry) operation is desired, these nodes may be
  omitted entirely and the driver will create a single entry with backward-
  compatible defaults.

  Use IFX_AUTANALOG_SAR_SEQ_* constants from
  <dt-bindings/adc/infineon-autanalog-sar.h> for property values.

compatible: "infineon,autanalog-sar-seq-lp"

properties:
  mux0-sel:
    type: int
    default: 0
    enum: [0, 1, 2, 3, 4, 5, 6, 7, 8, 9, 10, 11, 12, 13, 14, 15]
    description: |
      MUX channel selection (0-15) for this LP sequencer entry.
      Selects which of the 16 internal MUX channels to sample.
      Each MUX channel's analog input pin and FIFO routing are
      configured via the corresponding channel@N node.

  sample-time-en:
    type: boolean
    description: |
      Enable the programmable sample-time delay for this sequencer entry.
      When using multiple sequencer entries that switch between MUX
      channels, this should be enabled to allow the analog input to
      settle before conversion.

  sample-time:
    type: int
    default: 0
    enum: [0, 1, 2, 3]
    description: |
      Which of the 4 sample-time slots to use for this entry.

  acc-en:
    type: boolean
    description: |
      Enable accumulation / averaging for conversions triggered by this
      sequencer entry.

  acc-count:
    type: int
    default: 0
    enum: [0, 1, 2, 3, 4, 5, 6, 7]
    description: |
      Number of samples to accumulate when acc-en is set.
      Use IFX_AUTANALOG_SAR_SEQ_ACC_CNT* constants.

  cal-req:
    type: int
    default: 0
    enum: [0, 1, 2, 3]
    description: |
      Real-time calibration request for this sequencer entry.
      Use IFX_AUTANALOG_SAR_SEQ_CAL_* constants.

  next-action:
    type: int
    default: 0
    enum: [0, 1, 2]
    description: |
      Action after this sequencer entry completes.
      Use IFX_AUTANALOG_SAR_SEQ_NEXT_* constants.
```

## dts/bindings/adc/infineon,cat1-adc.yaml
```yaml
# Copyright (c) 2023 Cypress Semiconductor Corporation (an Infineon company) or
# an affiliate of Cypress Semiconductor Corporation
#
# SPDX-License-Identifier: Apache-2.0

description: |
  Infineon Cat1 ADC
  Each ADC group Cat1 is assigned to a Zephyr device. Refer to the Infineon PSOC 6 reference
  manual (Section Port I/O functions) for the group/channel mapping to a specific port-pin on
  the board.  For example on the cy8cproto_062_4343w P10.0 is mapped to adc0,channel0 and
  P10.1 is mapped to adc0,channel1.

compatible: "infineon,cat1-adc"

include: adc-controller.yaml

properties:
  reg:
    required: true

  interrupts:
    required: true

  "#io-channel-cells":
    const: 1

io-channel-cells:
  - input
```

## dts/bindings/adc/infineon,psoc4-sar-adc.yaml
```yaml
# Copyright (c) 2025 Infineon Technologies AG,
# or an affiliate of Infineon Technologies AG.
#
# SPDX-License-Identifier: Apache-2.0

description: |
  Infineon PSOC4 SAR ADC

compatible: "infineon,psoc4-adc"

include:
  - name: adc-controller.yaml
  - name: pinctrl-device.yaml

properties:
  reg:
    required: true
    description: Base address of the PSOC4 SAR ADC registers

  interrupts:
    required: true
    description: Interrupt configuration for the PSOC4 SAR ADC

  "#io-channel-cells":
    const: 1
    description: Number of cells in an io-channel specifier

  vref-src:
    type: string
    default: "internal"
    enum:
      - "internal"
      - "vdda"
      - "vdda_by_2"
      - "external"
    description: |
      Selects which voltage reference to use for the ADC.
      "internal": Internal Bandgap (1.2V)
      "vdda": VDDA
      "vdda_by_2": VDDA / 2
      "external": External Ref pin

  vref-mv:
    type: int
    default: 1200
    description: |
      Reference voltage in millivolts.
      For "internal" source, this is typically 1200.
      For "vdda" or "external", this should match the actual voltage applied.

  clk-dst:
    type: int
    required: true
    description: Peripheral clock destination for the ADC.

io-channel-cells:
  - input
```
