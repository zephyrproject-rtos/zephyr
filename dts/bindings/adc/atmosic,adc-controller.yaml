## dts/bindings/adc/atmosic,adc-controller.yaml
```yaml
# Copyright (c) 2017, NXP
# SPDX-License-Identifier: Apache-2.0

# Common fields for ADC controllers

include: adc-controller.yaml

properties:
    resolution:
      type: int
      required: true

    ch-cell:
      type: int
      required: false

    ch-store:
      type: int
      required: false

    ch-core:
      type: int
      required: false

    ch-temp:
      type: int
      required: false

    ch-p1diff:
      type: int
      required: false

    ch-p0diff:
      type: int
      required: false

    ch-p1single0:
      type: int
      required: false

    ch-p1single1:
      type: int
      required: false

    ch-p0single0:
      type: int
      required: false

    ch-p0single1:
      type: int
      required: false

    ch-batt:
      type: int
      required: false

io-channel-cells:
    - input
```

## dts/bindings/adc/atmosic,atm34-adc.yaml
```yaml
# Copyright (c) 2023-2024 Atmosic
# SPDX-License-Identifier: Apache-2.0

description: Atmosic ADC for ATM34

compatible: "atmosic,atm34-adc"

include: atmosic,adc-controller.yaml

properties:
    interrupts:
      required: true

    clock-freq:
      type: int
      description: |
        ADC clock frequency selector;
      enum:
        - 0 # 8 MHz
        - 1 # 4 MHz (default)
        - 2 # 2 MHz
        - 3 # 1 MHz

    sample-avg:
      type: int
      description: |
        ADC samples (0 <= X <= 7) to be averaged. Default 6;

    osr-select:
      type: int
      description: |
        ADC OSR selector;
      enum:
        - 0 # 128 (default)
        - 1 # 64
```

## dts/bindings/adc/atmosic,atmx2-adc.yaml
```yaml
# Copyright (c) 2021-2023 Atmosic
# SPDX-License-Identifier: Apache-2.0

description: Atmosic ADC for ATMx2

compatible: "atmosic,atmx2-adc"

include: atmosic,adc-controller.yaml

properties:
    interrupts:
      required: true
```

## dts/bindings/adc/atmosic,atmx3-adc.yaml
```yaml
# Copyright (c) 2021-2023 Atmosic
# SPDX-License-Identifier: Apache-2.0

description: Atmosic ADC for ATMx3

compatible: "atmosic,atmx3-adc"

include: atmosic,adc-controller.yaml

properties:
    interrupts:
      required: true
```

## dts/bindings/adc/avia,hx711.yaml
```yaml
# Copyright (c) 2024 Vinicius Miguel
# SPDX-License-Identifier: Apache-2.0

description: AVIA Semiconductor HX711 24 Bit ADC for Weigh Scales

compatible: "avia,hx711"

include: [adc-controller.yaml]

bus: hx711

properties:
  "#io-channel-cells":
    const: 1

  sck-gpios:
    type: phandle-array
    required: true
    description: "GPIO for Clock signal"

  dout-gpios:
    type: phandle-array
    required: true
    description: "GPIO for Data output signal"

  rate-gpios:
    type: phandle-array
    required: true
    description: "GPIO for data rate setting signal"

  gain:
    type: int
    enum:
      - 32
      - 64
      - 128
    default: 32
    description: "Gain setting"

  rate:
    type: int
    enum:
      - 10
      - 80
    default: 10
    description: "Data rate setting in SPS"
```

## dts/bindings/adc/bflb,adc.yaml
```yaml
# Copyright (c) 2025 MASSDRIVER EI (massdriver.space)
#
# SPDX-License-Identifier: Apache-2.0

description: |
  Bouffalolab ADC

compatible: "bflb,adc"

include: [adc-controller.yaml, pinctrl-device.yaml]

properties:
  reg:
    required: true

  interrupts:
    required: true

  "#io-channel-cells":
    const: 1

io-channel-cells:
  - input
```

## dts/bindings/adc/ene,kb106x-adc.yaml
```yaml
# Copyright (c) 2025 ENE Technology Inc.
# SPDX-License-Identifier: Apache-2.0

description: ENE KB106X ADC controller

compatible: "ene,kb106x-adc"

include: [adc-controller.yaml, pinctrl-device.yaml]

properties:
  reg:
    required: true

  "#io-channel-cells":
    const: 1

  pinctrl-0:
    required: true

  pinctrl-names:
    required: true

io-channel-cells:
  - input
```

## dts/bindings/adc/ene,kb1200-adc.yaml
```yaml
# Copyright (c) 2024 ENE Technology Inc.
# SPDX-License-Identifier: Apache-2.0

description: ENE KB1200 ADC controller

compatible: "ene,kb1200-adc"

include: [adc-controller.yaml, pinctrl-device.yaml]

properties:
  reg:
    required: true

  "#io-channel-cells":
    const: 1

  pinctrl-0:
    required: true

  pinctrl-names:
    required: true

io-channel-cells:
  - input
```

## dts/bindings/adc/espressif,esp32-adc.yaml
```yaml
# Copyright (c) 2022 Wolter HV <wolterhv@gmx.de>
#
# SPDX-License-Identifier: Apache-2.0

description: |
  Espressif ESP32 ADC
  Possible available resolutions depends on the used chip.
    - ESP32     < 9,10,11,12 >
    - ESP32-S2  < 12 >
    - ESP32-C3  < 12 >
  For chips with configurable resolution feature (ESP32),
  maximum resolution will be used if not set explicitly.

  Zephyr API is using gain unit to characterize ADC input.
  To achieve compatibility we choose to select those gain,
  which coresponds to the ESP32 ADC attenuation feature.

    ESP32,attenuation ~ zephyr,gain
    -----------------   -----------
    0 dB                ADC_GAIN_1
    2.5 dB              ADC_GAIN_4_5
    6 dB                ADC_GAIN_1_2
    11 dB               ADC_GAIN_1_4

  In case unsupported gain is selected the adc_channel_setup()
  would return ENOTSUP error.

compatible: "espressif,esp32-adc"

include: [adc-controller.yaml]

properties:

  unit:
    type: int
    required: true
    description: ADC unit number.
      Possible values are 1,2,.. depending on chip.

  channel-count:
    type: int
    required: true
    description: The maximum channels supported on each unit.

  "#io-channel-cells":
    const: 1

io-channel-cells:
  - input
```

## dts/bindings/adc/gd,gd32-adc.yaml
```yaml
# Copyright (c) 2022 BrainCo Inc.
# SPDX-License-Identifier: Apache-2.0

description: GigaDevice GD32 ADC

# gd32 adc irq have some special cases as below:
#   1. adc number no larger than 3.
#   2. adc0 and adc1 share the same irq number.
#   3. For gd32f4xx, adc2 share the same irq number with adc0 and adc1.
#
# To cover this cases, adc_gd32 driver use node-label 'adc0', 'adc1' and
# 'adc2' to handle gd32 adc irq config directly.
#
# Sorry for the restriction, But new added gd32 adc node-label must be 'adc0',
# 'adc1' and 'adc2'.

compatible: "gd,gd32-adc"

include: [adc-controller.yaml, reset-device.yaml, pinctrl-device.yaml]

properties:
  reg:
    required: true

  resets:
    required: true

  clocks:
    required: true

  rcu-clock-source:
    type: int
    description: |
      Some GD32 ADC have additional clock source, like IRC14M or IRC28M.
      This property used to select the clock and related prescaler, valid
      values defined at 'dts-bindings/adc/gd32xxx.h' headers.

  channels:
    type: int
    description: Number of external channels
    required: true

  interrupts:
    required: true

  "#io-channel-cells":
    const: 1

  pinctrl-0:
    required: true

  pinctrl-names:
    required: true

io-channel-cells:
  - input
```
