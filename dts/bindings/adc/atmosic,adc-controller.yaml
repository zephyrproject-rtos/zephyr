## dts/bindings/adc/infineon,sar-adc.yaml
```yaml
# Copyright (c) 2025 Infineon Technologies AG,
# or an affiliate of Infineon Technologies AG.
#
# SPDX-License-Identifier: Apache-2.0

description: |
  Infineon SAR ADC

  Successive Approximation Register (SAR) ADC peripheral found in
  Infineon devices. The IP block is version-specific, indicated
  by the infineon,version property which corresponds to
  CY_IP_M0S8PASS4A_SAR_VERSION in the PDL headers.

compatible: "infineon,sar-adc"

include:
  - name: adc-controller.yaml
  - name: pinctrl-device.yaml

properties:
  reg:
    required: true
    description: Base address of the SAR ADC registers

  interrupts:
    required: true
    description: Interrupt configuration for the SAR ADC

  infineon,version:
    type: int
    required: true
    enum: [2, 3]
    description: |
      SAR ADC IP block version. Corresponds to CY_IP_M0S8PASS4A_SAR_VERSION
      in the PDL. Different versions have varying capabilities (e.g., v2/v3
      have limited differential support, v4+ has full differential addressing).

  clocks:
    required: true
    description: Clock divider phandle for the ADC peripheral.

  "#io-channel-cells":
    const: 1
    description: Number of cells in an io-channel specifier

  vref-src:
    type: string
    default: "internal"
    enum:
      - "internal"
      - "vdda"
      - "vdda_by_2"
      - "external"
    description: |
      Selects which voltage reference to use for the ADC.
      "internal": Internal Bandgap (1.2V)
      "vdda": VDDA
      "vdda_by_2": VDDA / 2
      "external": External Ref pin

  vref-mv:
    type: int
    default: 1200
    description: |
      Reference voltage in millivolts.
      For "internal" source, this is typically 1200.
      For "vdda" or "external", this should match the actual voltage applied.

  clk-dst:
    type: int
    required: true
    description: Peripheral clock destination for the ADC.

io-channel-cells:
  - input

child-binding:
  description: |
    ADC channel configuration

  properties:
    gpio-port:
      type: int
      description: |
        GPIO port number for the ADC input pin. Required for SARMUX pins
        to configure GPIO drive mode. If not specified, defaults to port 2
        for SARMUX pins 0-7.

    gpio-pin:
      type: int
      description: |
        GPIO pin number within the port for the ADC input pin. Required for
        SARMUX pins to configure GPIO drive mode. This should match the pin
        number in the pinctrl configuration.

    gpio-port-negative:
      type: int
      description: |
        GPIO port number for the negative ADC input pin (differential mode only).
        If not specified, defaults to port 2 for SARMUX pins.

    gpio-pin-negative:
      type: int
      description: |
        GPIO pin number for the negative ADC input pin (differential mode only).
        This should match the pin number in the pinctrl configuration.
```

## dts/bindings/adc/infineon,sar-v2.yaml
```yaml
# Copyright (c) 2026 Linumiz
#
# SPDX-License-Identifier: Apache-2.0

description: |
  Infineon CAT1 SAR driver(cyt4dn) based on pdl
  sample overlay

  / {
        zephyr,user {
                io-channels = <&adc0 20>;
        };
  };

  &adc0 {
        #address-cells = <1>;
        #size-cells = <0>;

        channel@20 {
                reg = <20>;
                zephyr,gain = "ADC_GAIN_1";
                zephyr,reference = "ADC_REF_VDD_1";
                zephyr,input-positive = <15>; /* internal led ADC[0]_15 */
                zephyr,acquisition-time = <ADC_ACQ_TIME(ADC_ACQ_TIME_MICROSECONDS, 10)>;
                zephyr,resolution = <12>;
        };
  };

compatible: "infineon,sar-v2"

include: [adc-controller.yaml, "infineon,system-interrupts.yaml", pinctrl-device.yaml]

properties:
  reg:
    required: true

  interrupts:
    type: array

  "#io-channel-cells":
    const: 1

  clock-frequency:
    type: int

  total-channels:
    type: int
    required: true
    description: total adc channels available in SoC.

io-channel-cells:
  - input
```

## dts/bindings/adc/infineon,xmc4xxx-adc.yaml
```yaml
# Copyright (c) 2022 Andriy Gelman <andriy.gelman@gmail.com>
# SPDX-License-Identifier: Apache-2.0

description: |
  Infineon XMC4XXX ADC
  Each ADC group XMC4XXX is assigned to a Zephyr device. Refer to Infineon XMC4XXX reference manual
  (Section Port I/O functions) for the group/chanel mapping to a specific port-pin on the board.
  For example on the xmc45_relax_kit P14.0 is mapped to adc0,channel0 and P14.1 is mapped to
  adc0,channel1.

compatible: "infineon,xmc4xxx-adc"

include: adc-controller.yaml

properties:
  reg:
    required: true

  interrupts:
    required: true

  vref-internal-mv:
    type: int
    required: true
    description: |
      This property sets the internal reference voltage (in millivolts).

  "#io-channel-cells":
    const: 1

io-channel-cells:
  - input
```

## dts/bindings/adc/ite,it51xxx-adc.yaml
```yaml
# Copyright (c) 2025 ITE Corporation. All Rights Reserved.
# SPDX-License-Identifier: Apache-2.0

description: ITE it51xxx ADC

compatible: "ite,it51xxx-adc"

include: [adc-controller.yaml, pinctrl-device.yaml]

properties:
  interrupts:
    required: true

  pinctrl-0:
    required: true

  pinctrl-names:
    required: true

  "#io-channel-cells":
    const: 1

  channel-count:
    type: int
    required: true
    description: the number of ADC channels

io-channel-cells:
  - input
```

## dts/bindings/adc/ite,it8xxx2-adc-cmp.yaml
```yaml
# Copyright (c) 2022 Intel Corporation
# SPDX-License-Identifier: Apache-2.0

description: |
    This will perform signal comparision with threshold established.

compatible: "ite,it8xxx2-adc-cmp"

properties:
  adc:
    type: phandle
    required: true
    description: |
      ADC port that will be performing measurement.

  scan-period:
    type: string
    required: false
    default: VCMP_SCAN_PERIOD_1MS
    description: |
      Define interval at which ADC scan will me performed.
    enum:
      - VCMP_SCAN_PERIOD_100US
      - VCMP_SCAN_PERIOD_200US
      - VCMP_SCAN_PERIOD_400US
      - VCMP_SCAN_PERIOD_600US
      - VCMP_SCAN_PERIOD_800US
      - VCMP_SCAN_PERIOD_1MS
      - VCMP_SCAN_PERIOD_1_5MS
      - VCMP_SCAN_PERIOD_2MS
      - VCMP_SCAN_PERIOD_2_5MS
      - VCMP_SCAN_PERIOD_3MS
      - VCMP_SCAN_PERIOD_4MS
      - VCMP_SCAN_PERIOD_5MS

child-binding:
  description: |
    Define each individual voltage comparator with parameters.
  properties:
    adc-channel:
      type: int
      required: true
      description: |
        ADC channel that will perform signal measurement.

    threshold-mv:
      type: int
      required: false
      description: |
        Value in millivolts present on ADC data as threshold assert.

    trigger-mode:
      type: string
      required: false
      description: |
        Determines the condition to be met between ADC data and
        threshold assert value that will trigger comparator event.
      enum:
      - VCMP_TRIGGER_MODE_LESS_OR_EQUAL
      - VCMP_TRIGGER_MODE_GREATER
```

## dts/bindings/adc/ite,it8xxx2-adc.yaml
```yaml
# Copyright (c) 2020 ITE Corporation. All Rights Reserved.
# SPDX-License-Identifier: Apache-2.0

description: ITE it8xxx2 ADC

compatible: "ite,it8xxx2-adc"

include: [adc-controller.yaml, pinctrl-device.yaml]

properties:
    interrupts:
      required: true

    pinctrl-0:
      required: true

    pinctrl-names:
      required: true

io-channel-cells:
    - input
```

## dts/bindings/adc/lltc,ltc2451.yaml
```yaml
# Copyright (c) 2023 Brill Power Ltd. All Rights Reserved.
# SPDX-License-Identifier: Apache-2.0

description: Linear Technology LTC2451 ADC

compatible: "lltc,ltc2451"

include: i2c-device.yaml

properties:
  conversion-speed:
    type: int
    default: 60
    enum:
      - 30
      - 60
    description: |
      Set conversion speed in Hz
      Default value corresponds to the default value of the register
      To specify channel 2 and 4 = 0b001010 = 10
```

## dts/bindings/adc/m5stack,m5pm1-adc.yaml
```yaml
# Copyright (c) 2026 The Zephyr Project Contributors
# SPDX-License-Identifier: Apache-2.0

description: |
  M5Stack M5PM1 ADC.

  The exposed input channels are:
    0: VREF   - internal reference voltage (mV)
    1: VBAT   - battery voltage (mV)
    2: VIN    - VIN / USB input voltage (mV)
    3: 5VOUT  - 5 V boost output voltage (mV)
    4: GPIO1  - external analog input on pin IO1 (mV)
    5: GPIO2  - external analog input on pin IO2 (mV)
    6: TEMP   - on-chip temperature (degrees Celsius, not mV)

compatible: "m5stack,m5pm1-adc"

include: adc-controller.yaml

on-bus: m5pm1

properties:
  "#io-channel-cells":
    const: 1

io-channel-cells:
  - input
```
