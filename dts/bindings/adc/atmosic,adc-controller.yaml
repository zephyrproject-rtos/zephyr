## dts/bindings/adc/infineon,autanalog-sar-adc.yaml
```yaml
# SPDX-FileCopyrightText: <text>Copyright (c) 2026 Infineon Technologies AG,
# or an affiliate of Infineon Technologies AG. All rights reserved.</text>
#
# SPDX-License-Identifier: Apache-2.0

title: PSOC Edge AutAnalog SAR ADC

description: |
  Infineon PSOC Edge 84 AutAnalog SAR ADC

  The AutAnalog (Autonomous Analog) SAR ADC provides high resolution 12-bit analog-to-digital
  conversion capabilities for the PSOC Edge family of microcontrollers.

  The ADC provides 12-bit resolution with a sampling rate of up to 5Msps when configured in
  high performance mode.  The inputs can be configured to sample directly from GPIO analog
  inputs (up to 8 channels) or through an internal mux to select from signals from other
  AutAnalog peripherals (up to 16 MUX channels).

  MUX channels allow sampling from CTB opamp outputs, DAC outputs, temperature sensor,
  and other internal analog signals.  MUX channels are selected using
  IFX_AUTANALOG_SAR_PIN_MUX_* constants from
  <dt-bindings/adc/infineon-autanalog-sar.h>.

  The AutAnalog SAR ADC is part of the AutAnalog subsystem, which must be set up before
  initializing the ADC.  Additionally, the AutAnalog subsystem uses a shared interrupt
  which handles events from all AutAnalog peripherals.

compatible: "infineon,autanalog-sar-adc"

include: adc-controller.yaml

properties:
  reg:
    required: true
    description: Base address of the AutAnalog SAR ADC Registers

  "#io-channel-cells":
    const: 1
    description: Number of cells in an io-channel specifier

  vref-mv:
    type: int
    default: 1800
    description: |
      Internal reference voltage in millivolts.

  offset-cal:
    type: boolean
    description: |
      Enables Self-Calibration for offset correction within the ADC.  If left disabled,
      the factory calibration for offset correction will be used.

  linear-cal:
    type: boolean
    description: |
      Enables Self-Calibration for linearity correction within the ADC. If left disabled,
      the factory calibration for linearity will be used.

  vref-source:
    type: int
    default: 0
    enum:
      - 0
      - 1
      - 2
      - 3
      - 4
      - 5
    description: |
      Selects which voltage reference to use for the ADC.
      Use IFX_AUTANALOG_SAR_VREF_* constants from
      <dt-bindings/adc/infineon-autanalog-sar.h>.
        IFX_AUTANALOG_SAR_VREF_VDDA      (0) - Vdda supply (default)
        IFX_AUTANALOG_SAR_VREF_EXT       (1) - External reference
        IFX_AUTANALOG_SAR_VREF_VBGR      (2) - Band-gap reference
        IFX_AUTANALOG_SAR_VREF_VDDA_BY_2 (3) - Vdda / 2
        IFX_AUTANALOG_SAR_VREF_PRB_OUT0  (4) - PRB Vref0
        IFX_AUTANALOG_SAR_VREF_PRB_OUT1  (5) - PRB Vref1

  pos-buf-pwr:
    type: int
    default: 0
    description: |
      Power mode for the positive MUX input buffer.
      Use IFX_AUTANALOG_SAR_BUF_PWR_* constants from
      <dt-bindings/adc/infineon-autanalog-sar.h>.
        IFX_AUTANALOG_SAR_BUF_PWR_OFF             (0)  - Off (default)
        IFX_AUTANALOG_SAR_BUF_PWR_ULTRA_LOW       (1)  - Ultra low, charge pump off
        IFX_AUTANALOG_SAR_BUF_PWR_ULTRA_LOW_RAIL  (2)  - Ultra low, charge pump on
        IFX_AUTANALOG_SAR_BUF_PWR_LOW_RAIL        (4)  - Low, charge pump on
        IFX_AUTANALOG_SAR_BUF_PWR_MEDIUM_RAIL     (6)  - Medium, charge pump on (recommended)
        IFX_AUTANALOG_SAR_BUF_PWR_HIGH_RAIL       (8)  - High, charge pump on
        IFX_AUTANALOG_SAR_BUF_PWR_ULTRA_HIGH_RAIL (10) - Ultra high, charge pump on
    enum: [0, 1, 2, 4, 6, 8, 10]

  neg-buf-pwr:
    type: int
    default: 0
    description: |
      Power mode for the negative MUX input buffer.
      Use IFX_AUTANALOG_SAR_BUF_PWR_* constants from
      <dt-bindings/adc/infineon-autanalog-sar.h>.
      See pos-buf-pwr for valid values.
    enum: [0, 1, 2, 4, 6, 8, 10]

  acc-mode:
    type: int
    default: 0
    enum:
      - 0
      - 1
    description: |
      Accumulator / averaging mode for the ADC.
      Use IFX_AUTANALOG_SAR_ACC_* constants from
      <dt-bindings/adc/infineon-autanalog-sar.h>.
        IFX_AUTANALOG_SAR_ACC_DISABLED  (0) - Averaging disabled (default)
        IFX_AUTANALOG_SAR_ACC_ACCUNDUMP (1) - Accumulate and dump

  shift-mode:
    type: boolean
    description: |
      Set the resolution of the averaging result when averaging is performed in HW.
      If false (default), the result is shifted back to 12 bits.
      If true, the result is shifted to 16 bits.

  fifo-chan-id:
    type: boolean
    description: |
      Enable channel number identifier for data stored in FIFO.

  lp-mode:
    type: boolean
    description: |
      Enable Low Power (LP) mode for the SAR ADC. In LP mode the ADC is clocked
      from the LPOSC at 4.096 MHz instead of CLK_HF and only MUX channels
      (channel IDs >= 8) can be used. The maximum throughput in LP mode is
      200 ksps. LP mode is available in both Active and Deep Sleep power modes.

      When lp-mode is set the parent AutAnalog MFD basic-mode STT automatically
      enters LP operation for the AC states. LP mode is also activated if any
      other AutAnalog child peripheral (DAC, CTB, PTCOMP, PRB) sets lp-mode.
      In advanced mode (ac-states), use the per-state ac-lp-mode property
      instead.

  lp-diff-en:
    type: boolean
    description: |
      Enable differential mode for the LP channel. When set, the LP sampler
      operates in differential mode measuring the difference between the
      positive and negative MUX inputs. Required for accurate die temperature
      measurement in LP mode.

      Only effective when lp-mode is also set.

  limit-cond-0:
    type: array
    description: |
      Range detection condition 0. Channels that set limit =
      IFX_AUTANALOG_SAR_LIMIT_STC0 use this condition. The array contains
      three integers: <condition low high>.

      condition uses IFX_AUTANALOG_SAR_COND_* constants from
      <dt-bindings/adc/infineon-autanalog-sar.h>:
        IFX_AUTANALOG_SAR_COND_BELOW   (0) - result < low
        IFX_AUTANALOG_SAR_COND_INSIDE  (1) - low <= result < high
        IFX_AUTANALOG_SAR_COND_ABOVE   (2) - result > high
        IFX_AUTANALOG_SAR_COND_OUTSIDE (3) - result < low OR result >= high

      low and high are signed 32-bit threshold values in ADC counts.

  limit-cond-1:
    type: array
    description: |
      Range detection condition 1. See limit-cond-0 for format.

  limit-cond-2:
    type: array
    description: |
      Range detection condition 2. See limit-cond-0 for format.

  limit-cond-3:
    type: array
    description: |
      Range detection condition 3. See limit-cond-0 for format.

  gain-corr:
    type: array
    description: |
      Array of 8 gain correction coefficients, one per coefficient slot
      (COEFF0 through COEFF7). Each value is an unsigned 16-bit fixed-point
      number in the format X.XXXXXXXXXXXXXXX where:
        - 0x0001 = 1/32768 = 0.000030517578125
        - 0x8000 = 1.0 (default / unity gain)
        - 0xFFFF = 2 - 1/32768 = 1.999969482421875

      Channels select which coefficient slot to use via the per-channel
      pos-coeff and neg-coeff properties.

  offset-corr:
    type: array
    description: |
      Array of 8 signed offset correction coefficients, one per coefficient
      slot (COEFF0 through COEFF7). Each value is a signed 16-bit integer
      added to the 12-bit ADC result:
        - Range: -2048 (0xF800) to +2047 (0x07FF)
        - Default: 0 (no offset correction)

      Channels select which coefficient slot to use via the per-channel
      pos-coeff and neg-coeff properties.

child-binding:
  properties:
    mux-buf-bypass:
      type: boolean
      description: |
        Bypass the Hi-Z buffers for MUX channels.

    sign:
      type: boolean
      description: |
        Enable sign extension for this channel's conversion result.

    differential:
      type: boolean
      description: |
        Enable differential mode for this GPIO channel. When set, the negative
        input pin is taken from the neg-pin property. Only applies to GPIO
        channels (channel IDs 0-7).

    neg-pin:
      type: int
      default: 0
      description: |
        Negative GPIO pin for differential mode on GPIO channels. Only used
        when differential is enabled. Values correspond to GPIO pin indices
        (0-7).

    pos-coeff:
      type: int
      default: 0
      enum: [0, 1, 2, 3, 4, 5, 6, 7, 8]
      description: |
        Positive channel correction coefficient selection.
        Use IFX_AUTANALOG_SAR_CH_COEFF_* constants from
        <dt-bindings/adc/infineon-autanalog-sar.h>.
          IFX_AUTANALOG_SAR_CH_COEFF_DISABLED (0) - Disabled (default)
          IFX_AUTANALOG_SAR_CH_COEFF0         (1) - Coefficient config 0
          IFX_AUTANALOG_SAR_CH_COEFF1         (2) - Coefficient config 1
          IFX_AUTANALOG_SAR_CH_COEFF2         (3) - Coefficient config 2
          IFX_AUTANALOG_SAR_CH_COEFF3         (4) - Coefficient config 3
          IFX_AUTANALOG_SAR_CH_COEFF4         (5) - Coefficient config 4
          IFX_AUTANALOG_SAR_CH_COEFF5         (6) - Coefficient config 5
          IFX_AUTANALOG_SAR_CH_COEFF6         (7) - Coefficient config 6
          IFX_AUTANALOG_SAR_CH_COEFF7         (8) - Coefficient config 7

    neg-coeff:
      type: int
      default: 0
      enum: [0, 1, 2, 3, 4, 5, 6, 7, 8]
      description: |
        Negative channel correction coefficient selection.
        Use IFX_AUTANALOG_SAR_CH_COEFF_* constants from
        <dt-bindings/adc/infineon-autanalog-sar.h>.
        See pos-coeff for valid values.

    acc-shift:
      type: boolean
      description: |
        Enable accumulator shift for this channel. When enabled, the
        accumulator result is right-shifted after accumulation.

    limit:
      type: int
      default: 0
      enum: [0, 1, 2, 3, 4]
      description: |
        Limit status / range detection configuration for this channel.
        Use IFX_AUTANALOG_SAR_LIMIT_* constants from
        <dt-bindings/adc/infineon-autanalog-sar.h>.
          IFX_AUTANALOG_SAR_LIMIT_DISABLED (0) - Disabled (default)
          IFX_AUTANALOG_SAR_LIMIT_STC0     (1) - Limit status config 0
          IFX_AUTANALOG_SAR_LIMIT_STC1     (2) - Limit status config 1
          IFX_AUTANALOG_SAR_LIMIT_STC2     (3) - Limit status config 2
          IFX_AUTANALOG_SAR_LIMIT_STC3     (4) - Limit status config 3

    fifo-sel:
      type: int
      default: 0
      enum: [0, 1, 2, 3, 4, 5, 6, 7, 8]
      description: |
        Route this channel's conversion result to a FIFO buffer.
        Use IFX_AUTANALOG_SAR_FIFO_* constants from
        <dt-bindings/adc/infineon-autanalog-sar.h>.
          IFX_AUTANALOG_SAR_FIFO_DISABLED (0) - FIFO disabled (default)
          IFX_AUTANALOG_SAR_FIFO_0        (1) - Route to FIFO buffer 0
          IFX_AUTANALOG_SAR_FIFO_1        (2) - Route to FIFO buffer 1
          IFX_AUTANALOG_SAR_FIFO_2        (3) - Route to FIFO buffer 2
          IFX_AUTANALOG_SAR_FIFO_3        (4) - Route to FIFO buffer 3
          IFX_AUTANALOG_SAR_FIFO_4        (5) - Route to FIFO buffer 4
          IFX_AUTANALOG_SAR_FIFO_5        (6) - Route to FIFO buffer 5
          IFX_AUTANALOG_SAR_FIFO_6        (7) - Route to FIFO buffer 6
          IFX_AUTANALOG_SAR_FIFO_7        (8) - Route to FIFO buffer 7

io-channel-cells:
  - input
```

## dts/bindings/adc/infineon,autanalog-sar-fifo.yaml
```yaml
# SPDX-FileCopyrightText: <text>Copyright (c) 2026 Infineon Technologies AG,
# or an affiliate of Infineon Technologies AG. All rights reserved.</text>
#
# SPDX-License-Identifier: Apache-2.0

title: Infineon AutAnalog SAR ADC FIFO Configuration

description: |
  FIFO configuration for the Infineon AutAnalog SAR ADC.

  The AutAnalog subsystem contains a shared FIFO that can be split into up to
  8 independent buffers. ADC GPIO channels, MUX channels, and FIR filter
  outputs can each be routed to one of these FIFO buffers using the fifo-sel
  property on the respective channel or FIR node.

  A single FIFO node named "fifo" must be placed under the parent SAR ADC
  node. The FIFO has a dedicated interrupt line (autanalog_fifo) separate from
  the main AutAnalog interrupt.

  The number of entries in fifo-levels determines how the FIFO memory is
  partitioned:
    1 entry  -> SPLIT1 (single 512-word buffer)
    2 entries -> SPLIT2 (two 256-word buffers)
    4 entries -> SPLIT4 (four 128-word buffers)
    8 entries -> SPLIT8 (eight 64-word buffers)

  A watermark interrupt is automatically enabled for each buffer whose
  fifo-levels entry is non-zero.

compatible: "infineon,autanalog-sar-fifo"

properties:
  fifo-levels:
    type: array
    required: true
    description: |
      Array of FIFO buffer level thresholds. The length of this array
      determines the FIFO split configuration:
        1 entry  -> single 512-word buffer
        2 entries -> two 256-word buffers
        4 entries -> four 128-word buffers
        8 entries -> eight 64-word buffers

      When the number of words in a buffer reaches its level threshold,
      a FIFO level interrupt is generated. Buffers with a threshold of 0
      do not generate watermark interrupts. Valid threshold range depends
      on the resulting buffer size.
```
