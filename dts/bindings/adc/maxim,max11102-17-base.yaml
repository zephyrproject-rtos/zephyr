## dts/bindings/adc/maxim,max11102-17-base.yaml
```yaml
# Copyright (c) 2023 SILA Embedded Solutions GmbH
# SPDX-License-Identifier: Apache-2.0

include: [adc-controller.yaml, spi-device.yaml]

properties:
  "#io-channel-cells":
    const: 1

io-channel-cells:
  - input
```

## dts/bindings/adc/maxim,max11102.yaml
```yaml
# Copyright (c) 2023 SILA Embedded Solutions GmbH
# SPDX-License-Identifier: Apache-2.0

description: Maxim Integrated 2 channels 12 bit 2 Msps SPI ADC

compatible: "maxim,max11102"

include: maxim,max11102-17-base.yaml

properties:
  chsel-gpios:
    type: phandle-array
    description: "GPIO for channel selection"
```

## dts/bindings/adc/maxim,max11105.yaml
```yaml
# Copyright (c) 2023 SILA Embedded Solutions GmbH
# SPDX-License-Identifier: Apache-2.0

description: Maxim Integrated 1 channel 12 bit 2 Msps SPI ADC

compatible: "maxim,max11105"

include: maxim,max11102-17-base.yaml
```

## dts/bindings/adc/maxim,max11106.yaml
```yaml
# Copyright (c) 2023 SILA Embedded Solutions GmbH
# SPDX-License-Identifier: Apache-2.0

description: Maxim Integrated 2 channels 10 bit 3 Msps SPI ADC

compatible: "maxim,max11106"

include: maxim,max11102-17-base.yaml

properties:
  chsel-gpios:
    type: phandle-array
    description: "GPIO for channel selection"
```

## dts/bindings/adc/maxim,max11110.yaml
```yaml
# Copyright (c) 2023 SILA Embedded Solutions GmbH
# SPDX-License-Identifier: Apache-2.0

description: Maxim Integrated 1 channel 10 bit 2 Msps SPI ADC

compatible: "maxim,max11110"

include: maxim,max11102-17-base.yaml
```

## dts/bindings/adc/maxim,max11111.yaml
```yaml
# Copyright (c) 2023 SILA Embedded Solutions GmbH
# SPDX-License-Identifier: Apache-2.0

description: Maxim Integrated 2 channels 8 bit 3 Msps SPI ADC

compatible: "maxim,max11111"

include: maxim,max11102-17-base.yaml

properties:
  chsel-gpios:
    type: phandle-array
    description: "GPIO for channel selection"
```

## dts/bindings/adc/maxim,max11116.yaml
```yaml
# Copyright (c) 2023 SILA Embedded Solutions GmbH
# SPDX-License-Identifier: Apache-2.0

description: Maxim Integrated 1 channel 8 bit 3 Msps SPI ADC

compatible: "maxim,max11116"

include: maxim,max11102-17-base.yaml
```

## dts/bindings/adc/maxim,max11117.yaml
```yaml
# Copyright (c) 2023 SILA Embedded Solutions GmbH
# SPDX-License-Identifier: Apache-2.0

description: Maxim Integrated 1 channel 10 bit 3 Msps SPI ADC

compatible: "maxim,max11117"

include: maxim,max11102-17-base.yaml
```

## dts/bindings/adc/maxim,max11253.yaml
```yaml
description: Maxim Integrated MAX11253 SPI ADC

compatible: "maxim,max11253"

include: maxim,max1125x-base.yaml
```

## dts/bindings/adc/maxim,max11254.yaml
```yaml
description: Maxim Integrated MAX11254 SPI ADC

compatible: "maxim,max11254"

include: maxim,max1125x-base.yaml
```

## dts/bindings/adc/maxim,max1125x-base.yaml
```yaml
# Common fields for Analog Devices MAX1125x

include: [adc-controller.yaml, spi-device.yaml]

properties:
  "#io-channel-cells":
    const: 1
  gpio0-enable:
    type: boolean
    description: this option for gpio0 enable or disable
  gpio1-enable:
    type: boolean
    description: this option for gpio1 enable or disable
  gpio0-direction:
    type: boolean
    description: this option for gpio0 direction enable for input, disable for output
  gpio1-direction:
    type: boolean
    description: this option for gpio0 direction enable for input, disable for output
  gpo0-enable:
    type: boolean
    description: this option for gpo0 enable or disable
  gpo1-enable:
    type: boolean
    description: this option for gpo1 enable or disable
  drdy-gpios:
    type: phandle-array
    required: true
    description: |
      gpio for data ready, becomes active when a conversion result is ready
  self-calibration:
    type: boolean
    description: start self calibration during channel setup

io-channel-cells:
  - input
```

## dts/bindings/adc/maxim,max2253x.yaml
```yaml
# Copyright (c) 2025 Gabriele Zampieri <opensource@arsenaling.com>
# SPDX-License-Identifier: Apache-2.0

description: Maxim MAX2253x ADC Controller

compatible: "maxim,max2253x"

include: [adc-controller.yaml, spi-device.yaml]

properties:
  int-gpios:
    type: phandle-array
    description: |
      gpio connected to nINT

io-channel-cells:
  - input
```

## dts/bindings/adc/microchip,adc-g1.yaml
```yaml
# Copyright (c) 2025 Microchip Technology Inc.
# SPDX-License-Identifier: Apache-2.0

title: Microchip ADC G1 Driver

description: |
  Binding for the Microchip ADC driver supporting Group G1 peripherals.

  Group G1 ADC driver supports the following hardware peripheral:
    - module name="ADC" id="U2500" version="1.0.0"

compatible: "microchip,adc-g1"

include:
  - name: adc-controller.yaml
  - name: pinctrl-device.yaml

properties:
  reg:
    required: true
    description: |
      Register base address and size for the ADC peripheral.

  interrupts:
    required: true
    description: |
      Interrupt specifier for the ADC peripheral.

  clocks:
    required: true
    description: |
      Clock phandles used to drive the ADC.

  clock-names:
    required: true
    description: |
      Clock name corresponding to the `clocks` entry.

  prescaler:
    type: int
    required: true
    enum: [2, 4, 8, 16, 32, 64, 128, 256]
    description: |
      Clock prescaler value. Must be a power of 2 between 2 and 256 inclusive.

      The ADC clock is derived by dividing the source clock by this prescaler.

  num-channels:
    type: int
    required: true
    description: |
      Number of input channels supported by this ADC instance.

  "#io-channel-cells":
    const: 1
    description: |
      Specifies that each io-channel uses a single cell (input index).

  nvm-calib:
    type: phandle
    required: true
    description: |
      Phandle to the NVM software calibration area containing
      ADC factory calibration values.

  calib-mapping:
    type: array
    required: true
    description: |
      Calibration mapping entries describing how values are extracted
      from the NVM calibration area and programmed into the ADC CALIB
      register.

      Each entry consists of three cells in the form:
      <adc_bit nvm_bit mask>.

  calib-mapping-names:
    type: string-array
    description: |
      Names of ADC calibration fields corresponding one-to-one with
      the entries in calib-mapping.

io-channel-cells:
  - input
```

## dts/bindings/adc/microchip,mcp3204.yaml
```yaml
description: Microchip MCP3204

compatible: "microchip,mcp3204"

include: microchip,mcp320x-base.yaml
```

## dts/bindings/adc/microchip,mcp3208.yaml
```yaml
description: Microchip MCP3208

compatible: "microchip,mcp3208"

include: microchip,mcp320x-base.yaml
```

## dts/bindings/adc/microchip,mcp320x-base.yaml
```yaml
# Common fields for Microchip MCP3204/MCP3208

include: [adc-controller.yaml, spi-device.yaml]

properties:
  "#io-channel-cells":
    const: 1

io-channel-cells:
  - input
```

## dts/bindings/adc/microchip,mcp3221.yaml
```yaml
description: Microchip MCP3221 Low-Power 12-Bit A/D Converter with I2C Interface

compatible: "microchip,mcp3221"

include: [adc-controller.yaml, i2c-device.yaml]

properties:
  "#io-channel-cells":
    const: 1

io-channel-cells:
  - input
```

## dts/bindings/adc/microchip,mcp3425.yaml
```yaml
# Copyright (c) 2023 Alva Technology
# SPDX-License-Identifier: Apache-2.0

description: Microchip MCP3425

compatible: "microchip,mcp3425"

include: [i2c-device.yaml, adc-controller.yaml]

properties:
  "#io-channel-cells":
    const: 1

io-channel-cells:
  - input
```

## dts/bindings/adc/microchip,mcp3426.yaml
```yaml
# Copyright (c) 2025 Axel Utech <utech@sofiha.de>
# SPDX-License-Identifier: Apache-2.0

description: Microchip MCP3426 16-Bit, 2 channel ΔΣ ADC

compatible: "microchip,mcp3426"

include: microchip,mcp342x-base.yaml
```

## dts/bindings/adc/microchip,mcp3427.yaml
```yaml
# Copyright (c) 2025 Axel Utech <utech@sofiha.de>
# SPDX-License-Identifier: Apache-2.0

description: Microchip MCP3427 16-Bit, 2 channel ΔΣ ADC

compatible: "microchip,mcp3427"

include: microchip,mcp342x-base.yaml
```

## dts/bindings/adc/microchip,mcp3428.yaml
```yaml
# Copyright (c) 2025 Axel Utech <utech@sofiha.de>
# SPDX-License-Identifier: Apache-2.0

description: Microchip MCP3428 16-Bit, 4 channel ΔΣ ADC

compatible: "microchip,mcp3428"

include: microchip,mcp342x-base.yaml
```

## dts/bindings/adc/microchip,mcp342x-base.yaml
```yaml
# Copyright (c) 2025 Axel Utech <utech@sofiha.de>
# SPDX-License-Identifier: Apache-2.0

include: [i2c-device.yaml, adc-controller.yaml]

properties:
  "#io-channel-cells":
    const: 1

io-channel-cells:
  - input
```

## dts/bindings/adc/microchip,mcp3561.yaml
```yaml
description: Microchip MCP3561

compatible: "microchip,mcp3561"

include: microchip,mcp356x-base.yaml
```

## dts/bindings/adc/microchip,mcp3562.yaml
```yaml
description: Microchip MCP3562

compatible: "microchip,mcp3562"

include: microchip,mcp356x-base.yaml
```

## dts/bindings/adc/microchip,mcp3564.yaml
```yaml
description: Microchip MCP3564

compatible: "microchip,mcp3564"

include: microchip,mcp356x-base.yaml
```
