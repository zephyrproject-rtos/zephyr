## dts/bindings/adc/microchip,adc-g2.yaml
```yaml
# SPDX-FileCopyrightText: 2026 Microchip Technology Inc.
# SPDX-License-Identifier: Apache-2.0

title: Microchip ADC G2 Driver

description: |
  Global Binding for the Microchip ADC driver supporting Group G2 peripherals.

  Group G2 ADC driver supports the following hardware peripheral:
    - module name="ADC" id="03620" version="1a0"

compatible: "microchip,adc-g2"

include:
  - name: base.yaml

properties:
  reg:
    required: true

  interrupts:
    required: true

  clock-parent:
    type: phandle
    description: Reference to the clock node

  clocks:
    required: true

  clock-names:
    required: true

  ctrl-clock-div:
    type: int
    required: true
    description: |
      This field(CTLCKDIV) divides the GCLK_ADC input clock into ADC control clock(CTL_CLK).

      Range from 0 to 63.

  adc-wkup-clock-count:
    type: int
    required: true
    description: |
      Wake-Up TAD Clock Count.

      This field represent the number of ADC TAD clocks required to warm-up the ADC module before
      it can perform conversion.

  num-cores:
    type: int
    required: true
    description: |
      Number of ADC Cores Supported.

  "#address-cells":
    const: 1

  "#size-cells":
    const: 0

child-binding:
  description: |
    ADC Core instances linked to the global ADC driver instance.

  include:
    - name: adc-controller.yaml
      property-blocklist: [compatible]
    - name: pinctrl-device.yaml

  properties:
    interrupts:
      required: true
      description: |
        Interrupt specifier for the ADC Core.

    core-id:
      type: int
      required: true
      description: |
        Core specifier for ADC peripheral.

    num-channels:
      type: int
      required: true
      description: |
        Number of input channels supported by this ADC instance.

    adc-div-ratio:
      type: int
      required: true
      description: |
        Division Ratio for ADC Sampling Clock.

        This field(ADCDIV) provides the ADC analog functional clock referred to as the ADC clock or
        TAD, (i.e., the period of the ADC clock). It divides CTL_CLK output clock from
        (GCLK_ADC Period * (CTLCKDIV + 1)) with period = TQ to produce the resulting ADC_CLK
        for ADC sampling and converting. It will have the period TAD given by the
        formula: TAD = (GCLK_ADC x Period * (CTLCKDIV + 1)) * (2 * ADCDIV)
        Range from 1 to 127.

    "#io-channel-cells":
      const: 1

  io-channel-cells:
    - input

examples:
  - |
    adc: adc@46820000 {
      compatible = "microchip,adc-g2";
      reg = <0x46820000 0x15c>, <0x0a007000 0x188>;
      reg-names = "adc", "fuses";
      interrupts = <1 2>;
      adc-wkup-clock-count = <8>;
      num-cores = <2>;
      status = "okay";

      adc1: adc@1 {
        reg = <1>;
        #address-cells = <1>;
        #size-cells = <0>;
        core-id = <1>;
        interrupts = <187 0>;
        num-channels = <6>;
        adc-div-ratio = <2>;
        status = "okay";

        channel@1 {
          reg = <1>;
          zephyr,gain = "ADC_GAIN_1";
          zephyr,reference = "ADC_REF_INTERNAL";
          zephyr,acquisition-time = <ADC_ACQ_TIME_DEFAULT>;
          zephyr,resolution = <12>;
          zephyr,input-positive = <MCHP_ADC_AIN0>;
        };

        channel@2 {
          reg = <2>;
          zephyr,gain = "ADC_GAIN_1";
          zephyr,reference = "ADC_REF_INTERNAL";
          zephyr,acquisition-time = <ADC_ACQ_TIME_DEFAULT>;
          zephyr,resolution = <12>;
          zephyr,differential;
          zephyr,input-positive = <MCHP_ADC_AIN0>;
        };
      };
    };
```

## dts/bindings/adc/microchip,mcp3553.yaml
```yaml
# SPDX-FileCopyrightText: Copyright The Zephyr Project Contributors
# SPDX-License-Identifier: Apache-2.0

title: Microchip MCP3553 22-bit delta-sigma ADC

description: |
  Low-power, single-channel 22-bit delta-sigma ADC with a differential input,
  an external reference input and a 3-wire SPI interface (CS, SCK, SDO/RDY).
  A conversion takes 16.67 ms.

compatible: "microchip,mcp3553"

include: microchip,mcp355x-base.yaml

examples:
  - |
    #include <zephyr/dt-bindings/adc/adc.h>

    &spi1 {
        status = "okay";

        adc@0 {
            compatible = "microchip,mcp3553";
            reg = <0>;
            spi-max-frequency = <1000000>;
            #address-cells = <1>;
            #size-cells = <0>;
            #io-channel-cells = <1>;

            channel@0 {
                reg = <0>;
                zephyr,gain = "ADC_GAIN_1";
                zephyr,reference = "ADC_REF_EXTERNAL0";
                zephyr,vref-mv = <5000>;
                zephyr,acquisition-time = <ADC_ACQ_TIME_DEFAULT>;
                zephyr,resolution = <22>;
                zephyr,differential;
            };
        };
    };
```

## dts/bindings/adc/nordic,nrf-saadc.yaml
```yaml
# Copyright (c) 2018, Nordic Semiconductor ASA
# SPDX-License-Identifier: Apache-2.0

description: Nordic Semiconductor nRF family SAADC node

compatible: "nordic,nrf-saadc"

include: ["adc-controller.yaml", "memory-region.yaml"]

properties:
  reg:
    required: true

  interrupts:
    required: true

  "#io-channel-cells":
    const: 1

  nordic,saadc-inputs:
    type: phandle-array
    required: true
    specifier-space: adc-gpio
    description: |
      GPIO pins connected to the external SAADC analog inputs, one entry per
      input, in the form <&gpioN pin NRF_SAADC_AINx>. The AIN number selects
      the input, so the entry order does not have to match it. AIN numbers
      that are not listed are rejected by the driver. Internal inputs (for
      example VDD) are not listed.

      On SoCs where the SAADC selects inputs by AIN number instead of by pin
      (nRF52, nRF53, nRF91), the pin is fixed in silicon and only the AIN
      numbers listed here are usable; the pin cell documents the routing.

io-channel-cells:
  - input
```

## dts/bindings/adc/nxp,aon-lpadc.yaml
```yaml
# SPDX-FileCopyrightText: Copyright 2026 NXP
# SPDX-License-Identifier: Apache-2.0

description: |
  NXP Always-On Low-Power ADC (AON_LPADC).

compatible: "nxp,aon-lpadc"

include: [adc-controller.yaml, pinctrl-device.yaml]

properties:
  reg:
    required: true

  interrupts:
    required: true

  clocks:
    required: true

  voltage-ref:
    type: int
    default: 0
    enum:
      - 0
      - 1
    description: |
      Voltage reference selection (CFG[REFSEL]), applied to the whole converter.
      Which reference each setting selects is SoC specific, see the chip-specific
      LPADC information in the reference manual; on SoCs where both settings
      select the same rail this property has no effect. The default matches the
      register reset value.

  power-level:
    type: int
    default: 0
    enum:
      - 0
      - 1
    description: |
      Converter power configuration (CFG[PWRSEL]). 0 selects power
      Option 1, 1 selects Option 2 (see the chip reference manual). The
      default matches the register reset value.

  "#io-channel-cells":
    const: 1

io-channel-cells:
  - input
```

## dts/bindings/adc/puya,py32-adc.yaml
```yaml
# SPDX-FileCopyrightText: Copyright The Zephyr Project Contributors
# SPDX-License-Identifier: Apache-2.0

description: |
  Puya PY32 ADC. Conversion reference is VDD. External input channels are
  numbered 0 through 9; channels 11 and 12 select the internal temperature
  sensor and voltage reference. Internal channels use the longest acquisition
  time. The ADC uses one common sampling time, chosen as the longest requested
  time among the channels in each sequence.

compatible: "puya,py32-adc"

include: [adc-controller.yaml, pinctrl-device.yaml, reset-device.yaml]

properties:
  reg:
    required: true
  reg-names:
    required: true
  clocks:
    required: true
  resets:
    required: true
  interrupts:
    required: true
  "#io-channel-cells":
    const: 1

io-channel-cells:
  - input
```

## dts/bindings/adc/silabs,series3-adc.yaml
```yaml
# Copyright (c) 2023 Antmicro <www.antmicro.com>
# Copyright (c) 2025 Silicon Laboratories Inc.
# SPDX-License-Identifier: Apache-2.0

title: Silicon Labs Series 3 ADC (Analog-to-Digital Converter)

description: |
  ADC peripheral for Silicon Labs Series 3 SoCs.

compatible: "silabs,series3-adc"

include: [adc-controller.yaml, pinctrl-device.yaml]

properties:
  reg:
    required: true

  interrupts:
    required: true

  "#io-channel-cells":
    const: 1

io-channel-cells:
  - input
```

## dts/bindings/adc/st,stm32f1-adc.yaml
```yaml
# Copyright (c) 2023 STMicroelectronics

# SPDX-License-Identifier: Apache-2.0

title: STM32F1 ADC

description: |
        This compatible stands for all ADC blocks similar to the one on STM32F1,
        like STM32F37x.
        It is similar to the STM32 ADC described in st,stm32-adc.yaml except that
        it removes the st,adc-clock-source and st,adc-prescaler properties, and
        that the clocks are configured in the child nodes.

compatible: "st,stm32f1-adc"

include:
  - name: st,stm32-adc.yaml
    property-blocklist:
      - clocks
      - clock-names
      - st,adc-clock-source
      - st,adc-prescaler

child-binding:
  properties:
    clocks:
      required: true

    clock-names:
      required: true
      enum:
        - "adcx"
        - "adc_pre"
      description: |
        Expected names are the following:
        - "adcx" for the enabling the register clock (mandatory)
        - "adc_pre" for configuring the prescaler (if applicable)
```

## dts/bindings/adc/st,stm32f4-adc.yaml
```yaml
# Copyright (c) 2023 STMicroelectronics

# SPDX-License-Identifier: Apache-2.0

title: STM32F4 ADC

description: |
        This compatible stands for all ADC blocks similar to the one on STM32F4,
        like F2, F7 or L1.
        It is similar to the STM32 ADC described in st,stm32-adc.yaml except that
        the clocks are configured in the child nodes.

compatible: "st,stm32f4-adc"

include:
  - name: st,stm32-adc.yaml
    property-blocklist:
      - clocks
      - clock-names

child-binding:
  properties:
    clocks:
      required: true

    clock-names:
      required: true
      enum:
        - "adcx"
        - "adc_ker"
      description: |
        Expected name is the following:
        - "adcx" for the enabling the register clock (mandatory)
        - "adc_ker" for configuring the kernel clock (if applicable)
```

## dts/bindings/adc/st,stm32n6-adc.yaml
```yaml
# Copyright (c) 2024 STMicroelectronics

# SPDX-License-Identifier: Apache-2.0

title: STM32N6 ADC

description: |
        This compatible stands for all ADC blocks similar to the one on STM32N6,
        like C5 or U3.
        It is similar to the STM32 ADC described in st,stm32-adc.yaml except that
        it removes the st,adc-clock-source and st,adc-prescaler properties.

compatible: "st,stm32n6-adc"

include:
  - name: st,stm32-adc.yaml
    property-blocklist:
      - st,adc-clock-source
      - st,adc-prescaler
```

## dts/bindings/adc/ti,ads122s14.yaml
```yaml
# Copyright (c) 2026 Testo SE & Co. KGaA
# SPDX-License-Identifier: Apache-2.0

description: Texas Instruments ADS122S14 24-bit 8-channel delta-sigma SPI ADC

compatible: "ti,ads122s14"

include: ti,ads1x2s14-base.yaml
```

## dts/bindings/adc/ti,ads1262.yaml
```yaml
# Copyright 2026 Sacra Systems Private Limited
# SPDX-License-Identifier: Apache-2.0

# Device-tree binding for the Texas Instruments ADS1262.

description: |
  Texas Instruments ADS1262 32-bit Precision ADC

  ADS1262 — 32-bit 38.4 kSPS single-channel delta-sigma ADC
    • ADC1: 32-bit, up to 38.4 kSPS, 10-channel MUX, PGA (1..32)
    • No ADC2, no GPIO, no AC excitation, no TDAC
    • SPI interface, DRDY interrupt output

  Example DTS node:

  &spi1 {
      cs-gpios = <&gpioa 4 GPIO_ACTIVE_LOW>;

      ads1262: adc@0 {
          compatible = "ti,ads1262";
          reg = <0>;
          spi-max-frequency = <8000000>;

          drdy-gpios  = <&gpiob 0 GPIO_ACTIVE_LOW>;
          reset-gpios = <&gpiob 1 GPIO_ACTIVE_LOW>;
      };
  };

compatible: "ti,ads1262"

include:
  - name: spi-device.yaml
  - name: adc-controller.yaml
  - name: ti,ads126x-common.yaml

properties:
  chip-id:
    type: int
    default: 0        # ADS126X_CHIP_ADS1262 = 0  (set fixed by this binding)
    description: |
      Identifies the chip variant to the driver.  Fixed to 0 (ADS1262).
      Do not override.
```

## dts/bindings/adc/ti,ads1263.yaml
```yaml
# Copyright 2026 Sacra Systems Private Limited
# SPDX-License-Identifier: Apache-2.0

# Device-tree binding for the Texas Instruments ADS1263.

description: |
  Texas Instruments ADS1263 32-bit + 24-bit Dual ADC
  ADS1263 — 32-bit + 24-bit dual ADC precision converter

  • ADC1: 32-bit, up to 38.4 kSPS, 10-channel MUX, PGA (1..32)
  • ADC2: 24-bit, up to 800 SPS, 8-channel MUX, PGA (1..128)
  • 4x programmable GPIO (GP0..GP3)
  • 2x on-chip TDAC outputs (TDACP/TDACN)
  • AC excitation source (IDAC) with ACEX bit in ADC2CFG
  • SPI interface, DRDY interrupt output

  Key differences vs ADS1262:
  +  ADC2 (24-bit, 800 SPS max, own MUX + gain + reference)
  +  GPIO control registers (GPIOCON, GPIODIR, GPIODAT)
  +  TDACP / TDACN registers (on-chip DAC for excitation)
  +  AC excitation control bit (ADC2CFG.AC_EXCITE)
  +  ADC2 calibration commands (SYOCAL2, SYGCAL2, SFOCAL2)
  -  Same ADC1 core as ADS1262

  Example DTS node:

  &spi1 {
      cs-gpios = <&gpioa 4 GPIO_ACTIVE_LOW>;

      ads1263: adc@0 {
          compatible = "ti,ads1263";
          reg = <0>;
          spi-max-frequency = <8000000>;

          drdy-gpios  = <&gpiob 0 GPIO_ACTIVE_LOW>;
          reset-gpios = <&gpiob 1 GPIO_ACTIVE_LOW>;
      };
  };

compatible: "ti,ads1263"

include:
  - name: spi-device.yaml
  - name: adc-controller.yaml
  - name: ti,ads126x-common.yaml

properties:
  chip-id:
    type: int
    default: 1
    description: |
      Identifies the chip variant to the driver.  Fixed to 1 (ADS1263).
      Do not override.
```
