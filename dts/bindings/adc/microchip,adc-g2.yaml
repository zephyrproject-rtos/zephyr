## dts/bindings/adc/ti,ads1x2s14-base.yaml
```yaml
# Copyright (c) 2026 Testo SE & Co. KGaA
# SPDX-License-Identifier: Apache-2.0

description: |
  Common properties of the Texas Instruments ADS112S14 (16-bit) and
  ADS122S14 (24-bit) delta-sigma ADCs with eight multiplexed inputs.

  The channel acquisition time selects the speed mode and the digital
  filter setting. Use the ADC_ACQ_TIME_TICKS unit with a value built by
  the ADS1X2S14_DATA_RATE() macro. ADC_ACQ_TIME_DEFAULT is speed mode 0
  with OSR 16, the device reset configuration.

  zephyr,current-source-pin selects the analog inputs driven by IDAC1 and
  IDAC2 (0 = AIN0 to 7 = AIN7) while the channel is converted. Channels
  without it convert with both IDACs switched off.

include: [adc-controller.yaml, spi-device.yaml]

properties:
  "#io-channel-cells":
    const: 1

  internal-reference-mv:
    type: int
    enum:
      - 1250
      - 2500
    default: 1250
    description: |
      Voltage of the internal reference in millivolts, used by channels
      with ADC_REF_INTERNAL. ADC_REF_EXTERNAL0 selects the REFP/REFN
      inputs, ADC_REF_VDD_1 the analog supply. 2500 requires an analog
      supply of at least 2.7 V. The default is the device reset value.

  idac1-current-microamp:
    type: int
    enum:
      - 0
      - 1
      - 10
      - 20
      - 30
      - 40
      - 50
      - 60
      - 70
      - 80
      - 90
      - 100
      - 200
      - 300
      - 400
      - 500
      - 600
      - 700
      - 800
      - 900
      - 1000
    default: 0
    description: |
      Output current of excitation current source IDAC1 in microamperes,
      0 disables it. Both IDACs share one unit current (1 uA or 10 uA), so
      idac1-current-microamp and idac2-current-microamp must either both be
      from 0, 1, 10, 20, ..., 100 or both from 0, 10, 100, 200, ..., 1000.
      The default is the device reset value.

  idac2-current-microamp:
    type: int
    enum:
      - 0
      - 1
      - 10
      - 20
      - 30
      - 40
      - 50
      - 60
      - 70
      - 80
      - 90
      - 100
      - 200
      - 300
      - 400
      - 500
      - 600
      - 700
      - 800
      - 900
      - 1000
    default: 0
    description: |
      Output current of excitation current source IDAC2 in microamperes,
      0 disables it. See idac1-current-microamp for the allowed combinations.
      The default is the device reset value.

  global-chop:
    type: boolean
    description: |
      Enable global-chop mode. The device averages two conversions with
      alternating input polarity to cancel its internal offset voltage, which
      doubles the conversion time.

io-channel-cells:
  - input
```

## dts/bindings/adc/ti,ads8684.yaml
```yaml
# Copyright (c) 2026 Ryomei Osaki
# SPDX-License-Identifier: Apache-2.0

description: TI ADS8684 4-channel 16-bit SAR ADC

compatible: "ti,ads8684"

include: ti,ads868x-base.yaml
```

## dts/bindings/adc/ti,ads8688.yaml
```yaml
# Copyright (c) 2026 Ryomei Osaki
# SPDX-License-Identifier: Apache-2.0

description: TI ADS8688 8-channel 16-bit SAR ADC

compatible: "ti,ads8688"

include: ti,ads868x-base.yaml
```

## dts/bindings/adc/ti,ads868x-base.yaml
```yaml
# Copyright (c) 2026 Ryomei Osaki
# SPDX-License-Identifier: Apache-2.0

description: |
  TI ADS8684/ADS8688 16-bit SAR ADC (SPI, 4 or 8 single-ended inputs with a
  per-channel input range).

  The input range of a channel is selected with the standard channel
  properties, relative to the 4.096 V reference (Vref):

    zephyr,gain    zephyr,differential   input range
    ADC_GAIN_2_5   (absent)              0 .. 2.5 x Vref   (0 .. 10.24 V)
    ADC_GAIN_4_5   (absent)              0 .. 1.25 x Vref  (0 .. 5.12 V)
    ADC_GAIN_2_5   true                  -2.5 .. +2.5 x Vref   (+/-10.24 V)
    ADC_GAIN_4_5   true                  -1.25 .. +1.25 x Vref (+/-5.12 V)

  The inputs are single-ended; zephyr,differential selects the bipolar
  variant of a range. Samples of bipolar channels are returned as signed
  16-bit values (the offset binary output of the device is converted to
  two's complement), which is what adc_raw_to_millivolts_dt() expects for
  a differential channel. The +/-0.625 x Vref range would need a gain of
  8/5, which the ADC API does not define, and is not supported.

  zephyr,reference must be ADC_REF_INTERNAL (REFSEL pin low, internal
  4.096 V reference) or ADC_REF_EXTERNAL0 (REFSEL pin high, external
  4.096 V reference on REFIO). zephyr,resolution must be 16.

  Example:

    ads8688@0 {
      compatible = "ti,ads8688";
      reg = <0>;
      spi-max-frequency = <17000000>;
      #io-channel-cells = <1>;
      #address-cells = <1>;
      #size-cells = <0>;

      channel@0 {
        reg = <0>;
        zephyr,gain = "ADC_GAIN_4_5";
        zephyr,reference = "ADC_REF_INTERNAL";
        zephyr,acquisition-time = <ADC_ACQ_TIME_DEFAULT>;
        zephyr,resolution = <16>;
      };
    };

include: [spi-device.yaml, adc-controller.yaml]

properties:
  "#io-channel-cells":
    const: 1

io-channel-cells:
  - input
```

## dts/bindings/adc/ti,cc35xx-adc.yaml
```yaml
# SPDX-License-Identifier: Apache-2.0

description: cc35xx ADC node

compatible: "ti,cc35xx-adc"

include: [pinctrl-device.yaml, adc-controller.yaml]

properties:
  reg:
    required: true

  interrupts:
    required: true

  clkdiv:
    required: true
    type: int
    description: Select ADC clock divider.

  sample-period:
    required: true
    type: int
    description: Sample period in ADC cycles (after clock divider)
  vref-internal-mv:
    required: true
    type: int
    description: This property sets the internal reference voltage (in millivolts)

io-channel-cells:
  - input
```

## dts/bindings/adc/ti,lpf3-adc.yaml
```yaml
# Copyright (c) 2025 Texas Instruments Incorporated
# Copyright (c) 2024 BayLibre, SAS
# SPDX-License-Identifier: Apache-2.0

description: Texas Instruments LPF3 (CC23X0 & CC27XX) 16-channel ADC

compatible: "ti,lpf3-adc"

include: [adc-controller.yaml, pinctrl-device.yaml]

properties:
  reg:
    required: true

  interrupts:
    required: true

  pinctrl-0:
    required: true

  pinctrl-names:
    required: true

  "#io-channel-cells":
    const: 1

  dmas:
    description: |
      Optional DMA specifier. The specifier will have a phandle reference to the
      DMA controller, the channel number, and the peripheral trigger source.

      Example for channel 3 with adc0trg trigger source:
        dmas = <&dma 3 5>;

  dma-names:
    description: |
      Required if the dmas property exists. This should be "dma".

      Example:
        dma-names = "dma";

io-channel-cells:
  - input
```

## dts/bindings/adc/ti,msp432p4xx-adc.yaml
```yaml
# Copyright (c) 2026 Gail Rojas <gailroco@gmail.com>
# SPDX-License-Identifier: Apache-2.0

description: TI MSP432P4xx ADC14 controller

compatible: "ti,msp432p4xx-adc"

include: adc-controller.yaml

properties:
  reg:
    required: true

  interrupts:
    required: true

  "#io-channel-cells":
    const: 1

io-channel-cells:
  - input
```

## dts/bindings/adc/ti,mspm0-adc12.yaml
```yaml
# TI MSPM0 Family

# Copyright (c) 2026, Texas Instruments
# Copyright (c) 2026, Linumiz
# SPDX-License-Identifier: Apache-2.0

description: TI MSPM0 ADC12

compatible: "ti,mspm0-adc12"

include: [adc-controller.yaml, pinctrl-device.yaml]

properties:
  reg:
    required: true

  interrupts:
    required: true

  pinctrl-0:
    required: true

  pinctrl-names:
    required: true

  "#io-channel-cells":
    const: 1

  clocks:
    required: true

  ti,clk-divider:
    type: int
    default: 1
    enum:
      - 1 # clock is not divided
      - 2
      - 4
      - 8
      - 16
      - 24
      - 32
      - 48
    description: |
      Divider applied to the ADC sample clock source; the effective
      sampling period scales with this divider. A value of 1 leaves the
      clock undivided.

  auto-powerdown:
    type: boolean
    description: |
      Enable automatic power-down mode, in which the ADC powers down
      between conversions to reduce power consumption. When omitted, the
      ADC uses manual power-down mode and stays powered between conversions.

  vref:
    type: phandle
    description: |
      Phandle to the voltage reference regulator supplying the ADC
      reference voltage. This may be the on-chip VREF module or an external
      reference. The driver reads the referenced regulator's configured
      output voltage to determine the reference voltage in millivolts.

  max-result-reg:
    type: int
    required: true
    description: |
      Number of conversion result memory registers available on this ADC instance.
      L-series devices typically have 4 registers (MEMRES0:3), while G-series
      devices typically have 12 registers (MEMRES0:11). This determines the
      maximum number of channels that can be converted in a single sequence.

  ti,num-channels:
    type: int
    required: true
    description: |
      Number of analog input channels wired to this ADC instance on the
      silicon (i.e. valid CHANSEL values for MEMCTLx), as opposed to
      max-result-reg which bounds how many of them can be converted in a
      single sequence. Devices are typically 16 or 32 channels depending on
      variant.

io-channel-cells:
  - input
```

## dts/bindings/adc/waveshare,ch32v003-adc.yaml
```yaml
# Copyright 2026, Kim Bøndergaard <kim@fam-boendergaard.dk>
# SPDX-License-Identifier: Apache-2.0

description: Waveshare CH32V003 ADC input controller

compatible: "waveshare,ch32v003-adc"

include: adc-controller.yaml

properties:
  "#io-channel-cells":
    const: 1

io-channel-cells:
  - input
```

## dts/bindings/adc/wch,adc.yaml
```yaml
# Copyright (c) 2025 Michael Hope <michaelh@juju.nz>
# SPDX-License-Identifier: Apache-2.0

description: WCH CH32V00x ADC

compatible: "wch,adc"

include: [adc-controller.yaml, pinctrl-device.yaml]

properties:
  reg:
    required: true

  interrupts:
    required: true

  clocks:
    required: true

  vref-mv:
    type: int
    default: 3300
    description: |
      Reference voltage in mV. This is typically VDD.

  channels:
    type: int
    min: 10
    max: 18
    required: true
    description: |
      Number of ADC channels. 10 on the CH32V003 and CH32V00x, 18 on
      the CH32V20x/30x.

  resolution:
    type: int
    min: 10
    max: 12
    required: true
    description: |
      Resolution of the ADC in bits. 10 on the CH32V003, 12 on the
      CH32V00x and CH32V20x/30x.

  pinctrl-0:
    required: true

  pinctrl-names:
    required: true

  "#io-channel-cells":
    const: 1

io-channel-cells:
  - input
```

## dts/bindings/amp/amp-cluster-group.yaml
```yaml
# SPDX-FileCopyrightText: Copyright The Zephyr Project Contributors
# SPDX-FileCopyrightText: Copyright (c) 2026 Siemens Mobility GmbH
# SPDX-License-Identifier: Apache-2.0
title: Generic cluster group

description: |
  An optional node to put multiple clusters of the same type in, e.g. all
  Cortex-R clusters, if there are also Cortex-M clusters. In such cases the reg
  property of this node needs to match the SoC specific enum that identifies the
  cluster type for the struct core_identification

compatible: "amp-cluster-group"

include: base.yaml
```
