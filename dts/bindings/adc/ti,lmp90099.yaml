## dts/bindings/adc/ti,lmp90099.yaml
```yaml
description: Texas Instruments LMP90099 AFE binding

compatible: "ti,lmp90099"

include: ti,lmp90xxx-base.yaml
```

## dts/bindings/adc/ti,lmp90xxx-base.yaml
```yaml
# Common fields for Texas Instruments LMP90xxx AFEs

include: [adc-controller.yaml, spi-device.yaml]

bus: lmp90xxx

properties:
  drdyb-gpios:
    type: phandle-array
    description: Data Ready Bar

  "#io-channel-cells":
    const: 1

io-channel-cells:
  - input
```

## dts/bindings/adc/ti,lmp90xxx-current.yaml
```yaml
# Common fields for Texas Instruments LMP90xxx AFEs with current sources

include: ti,lmp90xxx-base.yaml

properties:
  rtd-current:
    type: int
    description: RTD current in microampere
```

## dts/bindings/adc/ti,tla2021.yaml
```yaml
# Copyright (c) 2023 Caspar Friedrich <c.s.w.friedrich@gmail.com>
# SPDX-License-Identifier: Apache-2.0

description: Texas Instruments TLA2021 Low-Power ADC

compatible: "ti,tla2021"

include: [i2c-device.yaml, adc-controller.yaml]

properties:
  "#io-channel-cells":
    const: 1

io-channel-cells:
  - input
```

## dts/bindings/adc/ti,tla2022.yaml
```yaml
# Copyright (c) 2024 Securiton AG
# SPDX-License-Identifier: Apache-2.0

description: Texas Instruments TLA2022 Low-Power ADC with PGA

compatible: "ti,tla2022"

include: ti,tla202x-base.yaml
```

## dts/bindings/adc/ti,tla2024.yaml
```yaml
# Copyright (c) 2024 Securiton AG
# SPDX-License-Identifier: Apache-2.0

description: Texas Instruments TLA2024 Low-Power 4 CH ADC with PGA

compatible: "ti,tla2024"

include: ti,tla202x-base.yaml
```

## dts/bindings/adc/ti,tla202x-base.yaml
```yaml
# Copyright (c) 2023 Caspar Friedrich <c.s.w.friedrich@gmail.com>
# SPDX-License-Identifier: Apache-2.0

include: [i2c-device.yaml, adc-controller.yaml]

properties:
  "#io-channel-cells":
    const: 1

io-channel-cells:
  - input
```

## dts/bindings/adc/ti,tla2528-adc.yaml
```yaml
# Copyright (c) 2026 Leica Geosystems AG
# SPDX-License-Identifier: Apache-2.0

description: ADC binding for the Texas Instruments 8 channel 12 bit I2C ADC with GPIOs

compatible: "ti,tla2528-adc"

include: [adc-controller.yaml, base.yaml]

on-bus: tla2528

properties:
  "#io-channel-cells":
    const: 1

io-channel-cells:
  - input
```

## dts/bindings/adc/wisblock-adc.yaml
```yaml
# Copyright (c) 2026 RAKwireless Technology Limited
# SPDX-License-Identifier: Apache-2.0

description: |
  ADC channels exposed on the WisBlock IO connector.

  The WisBlock specification defines AIN0, AIN1, and IO1 through IO7 as
  possible ADC-capable connector signals. Individual Core boards may expose
  only a subset of these signals to the SoC ADC. This binding provides a
  nexus mapping from the common WISBLOCK_ADC_* indices defined in
  <zephyr/dt-bindings/adc/wisblock-adc.h> to the board's actual ADC channels.

  Example usage in a WisBlock Core board file:

    wisblock_adc: wisblock-adc {
      compatible = "wisblock-adc";
      io-channel-map =
        <WISBLOCK_ADC_AIN0 &adc 3>,
        <WISBLOCK_ADC_AIN1 &adc 7>,
        <WISBLOCK_ADC_IO4  &adc 2>,
        <WISBLOCK_ADC_IO7  &adc 4>;
      #io-channel-cells = <1>;
    };

compatible: "wisblock-adc"

include: base.yaml

properties:
  io-channel-map:
    type: compound
    required: true
    description: |
      Nexus mapping from WisBlock ADC pin indices to SoC ADC channels.
      Each entry is a tuple of (wisblock-pin, adc-phandle, adc-channel).

  io-channel-map-mask:
    type: array
    description: Mask applied to the child specifier before nexus lookup.

  io-channel-map-pass-thru:
    type: array
    description: Bits passed through unchanged from child to parent specifier.

  "#io-channel-cells":
    type: int
    required: true
    description: Number of cells in an ADC specifier. Must be 1.
```

## dts/bindings/adc/zephyr,adc-emul.yaml
```yaml
# Copyright 2021 Google LLC
# SPDX-License-Identifier: Apache-2.0

description: Zephyr ADC Emulator

compatible: "zephyr,adc-emul"

include: adc-controller.yaml

properties:
  nchannels:
    type: int
    required: true
    description: Number of emulated ADC channels. Should be in 1-32 range.

  ref-internal-mv:
    type: int
    default: 0
    description:
      Internal reference voltage in mV. If not provided or set to zero,
      channel setup with ADC_REF_INTERNAL will fail.

  ref-vdd-mv:
    type: int
    default: 0
    description:
      VDD reference voltage in mV. If not provided or set to zero,
      channel setup with ADC_REF_VDD_X will fail.

  ref-external0-mv:
    type: int
    default: 0
    description:
      External 0 reference voltage in mV. If not provided or set to zero,
      channel setup with ADC_REF_EXTERNAL0 will fail.

  ref-external1-mv:
    type: int
    default: 0
    description:
      External 1 reference voltage in mV. If not provided or set to zero,
      channel setup with ADC_REF_EXTERNAL1 will fail.

io-channel-cells:
  - input
```

## dts/bindings/adc/zephyr,adc-fake.yaml
```yaml
# Copyright (c) 2026 Nordic Semiconductor ASA
# SPDX-License-Identifier: Apache-2.0

description: Fake ADC device used as stub or mock for testing

compatible: "zephyr,adc-fake"

include: adc-controller.yaml

io-channel-cells:
  - input
```

## dts/bindings/alh/intel,alh-dai.yaml
```yaml
# Copyright (c) 2022 Intel Corporation
#
# SPDX-License-Identifier: Apache-2.0

description: Intel ALH DAI controller

compatible: "intel,alh-dai"

include: base.yaml

properties:
    reg:
      required: true
```

## dts/bindings/ap_pwrseq/ap-pwrseq-sub-states.yaml
```yaml
# Copyright 2022 Intel Corporation
# SPDX-License-Identifier: Apache-2.0

description: |
  Define additional substates to be included in state machine.

compatible: "ap-pwrseq-sub-states"

description: |
  String array of additional substates, use corresponding macros to provide
  action handlers.
properties:
  chipset:
    type: string-array
    required: false
    description: |
      User defined power subtstates, use AP_POWER_CHIPSET_SUB_STATE_DEFINE, to define
      substate action handler functions.

  application:
    type: string-array
    required: false
    description: |
      User defined power subtstates, use AP_POWER_APP_SUB_STATE_DEFINE, to define
      substate action handler functions.
```

## dts/bindings/arc/arc,dccm.yaml
```yaml
# Copyright (c) 2017, synopsys
# SPDX-License-Identifier: Apache-2.0

description: ARC DCCM

compatible: "arc,dccm"

include: base.yaml

properties:
  reg:
    required: true
```

## dts/bindings/arc/arc,iccm.yaml
```yaml
# Copyright (c) 2017, synopsys
# SPDX-License-Identifier: Apache-2.0

description: ARC ICCM

compatible: "arc,iccm"

include: base.yaml

properties:
    reg:
      required: true
```

## dts/bindings/arc/arc,xccm.yaml
```yaml
# Copyright (c) 2022, synopsys
# SPDX-License-Identifier: Apache-2.0

description: |
  ARC XCCM (X Closely Coupled Memory)
  XY Memory is a feature to increase the DSP performance

compatible: "arc,xccm"

include: base.yaml

properties:
  reg:
    required: true
```

## dts/bindings/arc/arc,yccm.yaml
```yaml
# Copyright (c) 2022, synopsys
# SPDX-License-Identifier: Apache-2.0

description: |
  ARC YCCM (Y Closely Coupled Memory)
  XY Memory is a feature to increase the DSP performance

compatible: "arc,yccm"

include: base.yaml

properties:
  reg:
    required: true
```

## dts/bindings/arm/arm,axi-timing-adapter.yaml
```yaml
# SPDX-FileCopyrightText: <text>Copyright 2025-2026 Arm Limited and/or
# its affiliates <open-source-office@arm.com></text>
# SPDX-License-Identifier: Apache-2.0

compatible: "arm,axi-timing-adapter"

include: base.yaml

description: |
  The timing adapter is an AXI-to-AXI bridge for providing well-defined
  memory timing to allow performance evaluation of an AXI master. The
  bridge works by delaying the responses from the memory or, when
  enabled, clock-gating the DUT to simulate faster access times as
  observed from the DUT, according to run-time configurable parameters
  that can be set in the timing adapter. Parameters include read and
  write response latencies, number of outstanding transactions, and a
  model of interfering traffic.

  - Common tuning parameters (most users will adjust these):
    - maxr, maxw, maxrw
    - rlatency, wlatency
    - pulse-on, pulse-off
    - bwcap

  - Other parameters are available for completeness or specialized use
    (e.g. mode, performance counters, histograms). They are typically
    left at defaults.

  - Performance counter: When measuring from outside the NPU, the
    performance counter can be used to count DUT clock-off cycles.
    See timing_adapter_perfctrl_settings in the official driver:
    https://gitlab.arm.com/artificial-intelligence/ethos-u/
    ethos-u-core-platform/-/blob/main/drivers/timing_adapter/
    include/timing_adapter.h

properties:
  reg:
    type: array
    required: true
    description: TA base address

  # Optional hardware/RTL version (for info/logging)
  version:
    type: int
    description: Optional TA block version (informational).

  # --- Common tuning parameters ---
  maxr:
    type: int
    description: |
      6-bit. Maximum number of pending read operations allowed.
      0 is inferred as infinite. [Common tuning parameter]

  maxw:
    type: int
    description: |
      6-bit. Maximum number of pending write operations allowed.
      0 is inferred as infinite. [Common tuning parameter]

  maxrw:
    type: int
    description: |
      6-bit. Maximum number of pending read and write operations combined.
      0 is inferred as infinite. [Common tuning parameter]

  rlatency:
    type: int
    description: |
      12-bit. Minimum latency, in cycles, for a read operation.
      This is the duration between ARVALID and RVALID signals.
      [Common tuning parameter]

  wlatency:
    type: int
    description: |
      12-bit. Minimum latency, in cycles, for a write operation.
      This is the duration between WVALID and WLAST, with BVALID being deasserted.
      [Common tuning parameter]

  pulse-on:
    type: int
    description: |
      Number of cycles where addresses are let through
      in a pulse window (0-65535). [Common tuning parameter]

  pulse-off:
    type: int
    description: |
      Number of cycles where addresses are blocked
      in a pulse window (0-65535). [Common tuning parameter]

  bwcap:
    type: int
    description: >
      16-bit. Maximum number of bus words transferred per pulse cycle.
      A pulse cycle is defined by pulse-on and pulse-off. 0 is inferred as infinite.
      A bus word is 64 bits on Ethos-U55, and 128 bits on Ethos-U65/U85.
      [Common tuning parameter]

  # --- Other parameters (typically left at defaults) ---
  perfctrl:
    type: int
    description: |
      6-bit event selector for the performance counter.
      Commonly used to count DUT clock-on/off cycles when profiling from
      outside the NPU. See the official driver's timing_adapter_perfctrl_settings
      for enumerated values.

  perfcnt:
    type: int
    description: |
      32-bit performance counter preload/reset value.
      Optional preload before measurement; read back after the run when
      perfctrl is configured (e.g. to count DUT clock-off cycles).

  mode:
    type: int
    description: |
      Timing adapter operation mode (bits 0-11).
      On FVP only bit 0 is implemented; other bits are ignored/reserved.
      Bit 0 controls dynamic clocking:
        0 = static clocking (no dynamic adjustment).
        1 = dynamic clocking enabled to avoid underrun (recommended).
      Bit 1: 1 = enable random AR reordering (0 = default).
      Bit 2: 1 = enable random R reordering (0 = default).
      Bit 3: 1 = enable random B reordering (0 = default).

  histbin:
    type: int
    description: Histogram bin selector (0-15).

  histcnt:
    type: int
    description: Histogram bin value (32-bit).
```

## dts/bindings/arm/arm,beetle-syscon.yaml
```yaml
# Copyright (c) 2022, Kumar Gala <galak@kernel.org>
# SPDX-License-Identifier: Apache-2.0

description: ARM V2M Beetle System Control

compatible: "arm,beetle-syscon"

include: [clock-controller.yaml, base.yaml]

properties:
  reg:
    required: true

  "#clock-cells":
    required: true
    const: 0
```

## dts/bindings/arm/arm,dtcm.yaml
```yaml
# SPDX-License-Identifier: Apache-2.0

description: Cortex-M DTCM (Data Tightly Coupled Memory)

compatible: "arm,dtcm"

include: base.yaml

properties:
  reg:
    required: true
```

## dts/bindings/arm/arm,ethos-u.yaml
```yaml
# SPDX-FileCopyrightText: <text>Copyright 2022, 2025 Arm Limited and/or
# its affiliates <open-source-office@arm.com></text>
# SPDX-License-Identifier: Apache-2.0

description: |
    The Arm Ethos-U is a micro NPU that enables neural networks to be hardware
    accelerated on embedded devices. The Ethos-U NPU driver is provided as a
    Zephyr module that is hooked up into the Tensorflow Lite Micro framework
    as a 'TFLM custom operation'.

    This device tree entry defines board specific properties like the register
    map address and interrupt line, and is therefore expected to be included
    into the device specific device tree file.

compatible: "arm,ethos-u"

include: base.yaml

properties:
  reg:
    required: true

  interrupts:
    required: true

  secure-enable:
    type: boolean
    description: Configure Ethos-U NPU to operate in secure- or non-secure mode

  privilege-enable:
    type: boolean
    description: Configure Ethos-U NPU to operate in privileged- or non-privileged mode

  fast-memory-region:
    type: phandle
    description: |
      Phandle to a node compatible with "zephyr,memory-region" that represents
      a dedicated fast SRAM region used by the Ethos-U driver as scratch
      memory (spill cache). This is used by Ethos-U65/Ethos-U85 when the model has
      been compiled in Dedicated SRAM mode with Vela.
      If omitted, the driver passes NULL/0 to ethosu_init() and no fast
      scratch area is used.
```

## dts/bindings/arm/arm,itcm.yaml
```yaml
# SPDX-License-Identifier: Apache-2.0

description: Cortex-M ITCM (Instruction Tightly Coupled Memory)

compatible: "arm,itcm"

include: base.yaml

properties:
  reg:
    required: true
```

## dts/bindings/arm/arm,scc.yaml
```yaml
# Copyright (c) 2018, Linaro Limited
# SPDX-License-Identifier: Apache-2.0

description: ARM Serial Configuration Control (SCC)

compatible: "arm,scc"

include: base.yaml

properties:
    reg:
      required: true
```
