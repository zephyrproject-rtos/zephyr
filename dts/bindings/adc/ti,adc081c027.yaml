## dts/bindings/adc/ti,adc081c027.yaml
```yaml
# Copyright (c) 2026 RAKwireless Technology Limited
# SPDX-License-Identifier: Apache-2.0

description: |
  Texas Instruments ADC081C027: single-channel 8-bit I2C ADC of the ADCxx1C
  family. The ALERT output of the 021 variants is replaced by an address
  selection input, so this part cannot signal an alert to the host.

  The conversion result is left aligned in D11:D0 of the conversion result
  register.

compatible: "ti,adc081c027"

include: ti,adcxx1c-base.yaml
```

## dts/bindings/adc/ti,adc101c021.yaml
```yaml
# Copyright (c) 2026 RAKwireless Technology Limited
# SPDX-License-Identifier: Apache-2.0

description: |
  Texas Instruments ADC101C021: single-channel 10-bit I2C ADC of the ADCxx1C
  family, with a dedicated ALERT output pin.

  The conversion result is left aligned in D11:D0 of the conversion result
  register.

compatible: "ti,adc101c021"

include: ti,adcxx1c-base.yaml
```

## dts/bindings/adc/ti,adc124s021.yaml
```yaml
# Copyright (c) 2026 RBZ Embedded Logics
# SPDX-License-Identifier: Apache-2.0

description: Texas Instruments ADC124S021 4-channel 12-bit SPI ADC

compatible: "ti,adc124s021"

include: [adc-controller.yaml, spi-device.yaml]

on-bus: spi

properties:
  "#io-channel-cells":
    const: 1

io-channel-cells:
  - input
```

## dts/bindings/adc/ti,adcxx1c-base.yaml
```yaml
# Copyright (c) 2026 RAKwireless Technology Limited
# SPDX-License-Identifier: Apache-2.0

# Common fields for the Texas Instruments ADCxx1C family

include: [adc-controller.yaml, i2c-device.yaml]

properties:
  "#io-channel-cells":
    const: 1

io-channel-cells:
  - input
```

## dts/bindings/adc/ti,ads1013.yaml
```yaml
description: Texas Instrument ADS1013 I2C ADC

compatible: "ti,ads1013"

include: ti,ads1x1x-base.yaml
```

## dts/bindings/adc/ti,ads1014.yaml
```yaml
description: Texas Instrument ADS1014 I2C ADC

compatible: "ti,ads1014"

include: ti,ads1x1x-base.yaml
```

## dts/bindings/adc/ti,ads1015.yaml
```yaml
description: Texas Instrument ADS1015 I2C ADC

compatible: "ti,ads1015"

include: ti,ads1x1x-base.yaml
```

## dts/bindings/adc/ti,ads101x-base.yaml
```yaml
# Copyright (c) 2022 Matija Tudan
# SPDX-License-Identifier: Apache-2.0

include: [adc-controller.yaml, i2c-device.yaml]

properties:
    "#io-channel-cells":
      const: 1
    fsr:
      type: int
      required: true
      description: Full-Scale Range in mV (default 2048)

io-channel-cells:
    - channel
```

## dts/bindings/adc/ti,ads1112.yaml
```yaml
description: Texas Instrument ADS1112 I2C ADC

compatible: "ti,ads1112"

include: ti,ads1x1x-base.yaml
```

## dts/bindings/adc/ti,ads1113.yaml
```yaml
description: Texas Instrument ADS1113 I2C ADC

compatible: "ti,ads1113"

include: ti,ads1x1x-base.yaml
```

## dts/bindings/adc/ti,ads1114.yaml
```yaml
description: Texas Instrument ADS1114 I2C ADC

compatible: "ti,ads1114"

include: ti,ads1x1x-base.yaml
```

## dts/bindings/adc/ti,ads1115.yaml
```yaml
description: Texas Instrument ADS1115 I2C ADC

compatible: "ti,ads1115"

include: ti,ads1x1x-base.yaml
```

## dts/bindings/adc/ti,ads1118.yaml
```yaml
# Copyright (c) 2025 Testo SE & Co. KGaA
# SPDX-License-Identifier: Apache-2.0

description: Texas Instrument 4 single-ended channels/2 differential channels SPI ADC

compatible: "ti,ads1118"

include: [adc-controller.yaml, spi-device.yaml]

properties:
  "#io-channel-cells":
    const: 1

  clocks:
    type: phandle-array

  ti,temperature-mode-enable:
    type: boolean
    description: |
      Enable temperature sensor mode.
      ADC mode is active by default if this property is false or not specified.

io-channel-cells:
  - input
```

## dts/bindings/adc/ti,ads1119.yaml
```yaml
# Copyright (c) 2021, Innoseis
# SPDX-License-Identifier: Apache-2.0

description: Texas Instrument 4 channels I2C ADC

compatible: "ti,ads1119"

include: [adc-controller.yaml, i2c-device.yaml]

properties:
  "#io-channel-cells":
    const: 1
```

## dts/bindings/adc/ti,ads114s06.yaml
```yaml
# Copyright (c) 2024 The Zephyr Project Contributors
# SPDX-License-Identifier: Apache-2.0

description: Texas Instrument 6 channels 16 bit SPI ADC

compatible: "ti,ads114s06"

include: ti,ads1x4s0x-base.yaml
```

## dts/bindings/adc/ti,ads114s08.yaml
```yaml
# Copyright (c) 2023 SILA Embedded Solutions GmbH
# SPDX-License-Identifier: Apache-2.0

description: Texas Instrument 12 channels 16 bit SPI ADC

compatible: "ti,ads114s08"

include: ti,ads1x4s0x-base.yaml
```

## dts/bindings/adc/ti,ads1219.yaml
```yaml
description: Texas Instrument 4 channels 24 bit I2C ADC

compatible: "ti,ads1219"

include: [adc-controller.yaml, i2c-device.yaml]

io-channel-cells:
  - input

properties:
  "#io-channel-cells":
    const: 1
```

## dts/bindings/adc/ti,ads1220.yaml
```yaml
# Copyright (c) 2026 Vaisala Oyj
# SPDX-License-Identifier: Apache-2.0

description: Texas Instruments 2 channel 24-bit SPI ADC

compatible: "ti,ads1220"

include: [adc-controller.yaml, spi-device.yaml]

properties:
  "#io-channel-cells":
    const: 1

  drdy-gpios:
    type: phandle-array
    required: true
    description: |
      GPIO for data ready, becomes active when a conversion result is ready.
      By default, it is active low signal.

  idac-current:
    type: int
    enum:
      - 0
      - 10
      - 50
      - 100
      - 250
      - 500
      - 1000
      - 1500
    default: 0
    description: |
      IDAC current in microampere, the default value turns the current source off

io-channel-cells:
  - input
```

## dts/bindings/adc/ti,ads124s08.yaml
```yaml
# Copyright (c) 2024 The Zephyr Project Contributors
# SPDX-License-Identifier: Apache-2.0

description: Texas Instrument 12 channels 24 bit SPI ADC

compatible: "ti,ads124s08"

include: ti,ads1x4s0x-base.yaml
```

## dts/bindings/adc/ti,ads131m02.yaml
```yaml
# Copyright (c) 2024 Linumiz
# SPDX-License-Identifier: Apache-2.0

description: Texas Instrument 2 channels SPI ADC

compatible: "ti,ads131m02"

include: [adc-controller.yaml, spi-device.yaml]

properties:
  "#io-channel-cells":
    const: 1

  drdy-gpios:
    type: phandle-array
    required: true
    description: |
      GPIO for data ready, becomes active when a conversion result is ready.
      By default, it is active low signal.

io-channel-cells:
  - input
```

## dts/bindings/adc/ti,ads131m08.yaml
```yaml
# Copyright (c) 2026 Siemens AG
# SPDX-License-Identifier: Apache-2.0
description: Texas Instrument 8 channels SPI ADC

compatible: "ti,ads131m08"

include: [adc-controller.yaml, spi-device.yaml]

properties:
  "#io-channel-cells":
    const: 1

  drdy-gpios:
    type: phandle-array
    required: true
    description: |
      GPIO for Data ready; active low

  reset-gpios:
    type: phandle-array
    required: true
    description: |
      GPIO for Conversion synchronization or system reset; active low

io-channel-cells:
  - input
```

## dts/bindings/adc/ti,ads1x1x-base.yaml
```yaml
# Common fields for Texas Instruments ADS1x1x

include: [adc-controller.yaml, i2c-device.yaml]

properties:
  "#io-channel-cells":
    const: 1

  alert-rdy-gpios:
    type: phandle-array
    description: Interrupt pin. Comparator output or conversion ready

io-channel-cells:
  - input
```

## dts/bindings/adc/ti,ads1x4s0x-base.yaml
```yaml
# Copyright (c) 2023 SILA Embedded Solutions GmbH
# SPDX-License-Identifier: Apache-2.0

include: [adc-controller.yaml, spi-device.yaml]

bus: ads1x4s0x

properties:
  "#io-channel-cells":
    const: 1

  reset-gpios:
    type: phandle-array
    description: "GPIO for reset"

  drdy-gpios:
    type: phandle-array
    required: true
    description: |
      GPIO for data ready, becomes active when a conversion result is ready

  start-sync-gpios:
    type: phandle-array
    description: |
      GPIO for start/sync, used to signal the ADC that a conversion should be started

  idac-current:
    type: int
    enum:
      - 0
      - 10
      - 50
      - 100
      - 250
      - 500
      - 750
      - 1000
      - 1500
      - 2000
    default: 0
    description: |
      IDAC current in microampere, the default value turns the current source off

  vbias-level:
    type: int
    enum:
      - 0
      - 1
    default: 0
    description: |
      bias voltage level: 0 - (AVDD+AVSS)/2, 1 - (AVDD+AVSS)/12

  positive-reference-buffer-disable:
    type: boolean
    description: |
      Disables the positive reference buffer for all channels. Recommended when using external
      reference voltage and V(REFPx) is close to AVDD.

      The positive reference buffer is enabled at reset.

  negative-reference-buffer-disable:
    type: boolean
    description: |
      Disables the negative reference buffer for all channels. Recommended when using external
      reference voltage and V(REFNx) is close to AVSS.

      The negative reference buffer is disabled at reset.

io-channel-cells:
  - input
```

## dts/bindings/adc/ti,ads7052.yaml
```yaml
# Copyright (c) 2023, Google LLC
# SPDX-License-Identifier: Apache-2.0

description: Texas Instrument Single Channel SPI ADC

compatible: "ti,ads7052"

include: [adc-controller.yaml, spi-device.yaml]

on-bus: spi

properties:
  spi-cs-setup-delay-ns:
    default: 1000
  spi-cs-hold-delay-ns:
    default: 1000
  "#io-channel-cells":
    const: 1

io-channel-cells:
  - input
```

## dts/bindings/adc/ti,ads7066.yaml
```yaml
# Copyright (c) 2025 GE Healthcare Technologies, Inc.
# SPDX-License-Identifier: Apache-2.0

description: Texas Instruments ADS7066 16-bit 8-channel SPI ADC

compatible: "ti,ads7066"

include: [spi-device.yaml, adc-controller.yaml]

properties:
  mode:
    type: string
    default: "ADS7066_MODE_MANUAL"
    description: |
      Channel selection mode:
      - ADS7066_MODE_MANUAL
      - ADS7066_MODE_OTF
      - ADS7066_MODE_AUTO
    enum:
      - "ADS7066_MODE_MANUAL"
      - "ADS7066_MODE_OTF"
      - "ADS7066_MODE_AUTO"

  reference:
    type: string
    required: true
    description: |
      Reference selection:
      - ADC_REF_INTERNAL:  Internal
      - ADC_REF_EXTERNAL0: External, input 0
    enum:
      - "ADC_REF_VDD_1"     # unsupported
      - "ADC_REF_VDD_1_2"   # unsupported
      - "ADC_REF_VDD_1_3"   # unsupported
      - "ADC_REF_VDD_1_4"   # unsupported
      - "ADC_REF_INTERNAL"
      - "ADC_REF_EXTERNAL0"
      - "ADC_REF_EXTERNAL1" # unsupported

  "#io-channel-cells":
    const: 1

io-channel-cells:
  - input
```
