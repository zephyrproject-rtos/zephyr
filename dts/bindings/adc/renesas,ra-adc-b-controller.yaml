## dts/bindings/adc/renesas,ra-adc-b-controller.yaml
```yaml
# Copyright (c) 2026 Renesas Electronics Corporation
# SPDX-License-Identifier: Apache-2.0

description: |
  Renesas RA ADC_B controller.

compatible: "renesas,ra-adc-b-controller"

include: [base.yaml]

properties:
  reg:
    required: true

  clock-div:
    type: int
    required: true
    enum: [1, 2, 3, 4, 5, 6, 7, 8]
    description: |
      Divider applied to the ADC_B input clock.

  "#address-cells":
    const: 1

  "#size-cells":
    const: 0
```

## dts/bindings/adc/renesas,ra-adc-b-scan-group.yaml
```yaml
# Copyright (c) 2026 Renesas Electronics Corporation
# SPDX-License-Identifier: Apache-2.0

description: |
  Renesas RA ADC_B scan-group configuration node.

  A scan-group is a hardware unit of trigger and completion: each
  scan-group has its own scan-end interrupt and is executed by exactly
  one ADC converter (ADC0 or ADC1) selected via renesas,converter-unit-id.

  This node carries configuration only; it does not bind a driver.
  Channels become members of a scan-group via the renesas,scan-group
  phandle in their child node under an adc-unit.

  Example:
    scan_group0: scan-group@0 {
        compatible = "renesas,ra-adc-b-scan-group";
        reg = <0>;
        interrupts = <60 12>;
        interrupt-names = "scanend";
        renesas,converter-unit-id = <0>;
    };

compatible: "renesas,ra-adc-b-scan-group"

include: [base.yaml]

properties:
  reg:
    required: true
    description: Hardware scan-group ID (0-7).

  interrupts:
    description: Scan-end interrupt for this scan-group.

  interrupt-names:
    description: Must contain "scanend" when interrupts is present.

  renesas,converter-unit-id:
    type: int
    required: true
    enum: [0, 1]
    description: |
      Selects which ADC converter executes this scan-group (0 = ADC0,
      1 = ADC1). Must match the unit-id of the adc-unit that owns the
      channels referencing this scan-group; the driver enforces this
      with BUILD_ASSERT.

      An int (not a phandle) is used because adc-unit -> channel ->
      scan-group -> adc-unit would otherwise form a devicetree cycle.
```

## dts/bindings/adc/renesas,ra-adc-b.yaml
```yaml
# Copyright (c) 2026 Renesas Electronics Corporation
# SPDX-License-Identifier: Apache-2.0

description: |
  Renesas RA ADC_B converter unit node.

  Represents one ADC converter (ADC0 or ADC1) of the ADC_B controller.
  This is the Zephyr ADC device that applications reference through
  io-channels.

  Each channel child node is one virtual channel. It maps a physical
  analog input (zephyr,input-positive) to a scan-group via the
  renesas,scan-group phandle. The scan-group, in turn, selects the
  converter that runs it (see renesas,ra-adc-b-scan-group). A channel
  must therefore be placed under the adc-unit whose unit-id matches the
  scan-group's renesas,converter-unit-id.

  Example:
    zephyr,user {
        io-channels = <&adc0 0>, <&adc0 1>;
    };

    &adc0 {
        channel@0 {
            reg = <0>;
            zephyr,gain = "ADC_GAIN_1";
            zephyr,reference = "ADC_REF_INTERNAL";
            zephyr,resolution = <16>;
            zephyr,acquisition-time = <ADC_ACQ_TIME_DEFAULT>;
            zephyr,input-positive = <0>;
            zephyr,oversampling = <2>;
            renesas,scan-group = <&scan_group0>;
        };
    };

compatible: "renesas,ra-adc-b"

include: [adc-controller.yaml, pinctrl-device.yaml]

properties:
  unit-id:
    type: int
    required: true
    enum: [0, 1]
    description: |
      ADC converter ID (0 for ADC0, 1 for ADC1).

  channel-available-mask:
    type: int
    description: |
      Bitmask of physical analog channels this converter can sample.
      The driver uses it to validate zephyr,input-positive of each
      channel.

  interrupts:
    description: |
      Calibration and conversion interrupts on each converter unit.

  vref-mv:
    type: int
    description: ADC reference voltage in millivolts.

  "#io-channel-cells":
    const: 1

  "#address-cells":
    type: int
    required: true
    const: 1

  "#size-cells":
    type: int
    required: true
    const: 0

  renesas,adc-method:
    type: string
    default: "oversample"
    enum: ["sar", "oversample", "hybrid"]
    description: |
      Conversion method for this converter. Determines how each virtual
      channel under this unit is converted:

        - "sar": every channel uses Successive Approximation, one
          conversion per trigger, up to 12-bit. Digital filter disabled.
          zephyr,oversampling on a channel is ignored.

        - "oversample": every channel is oversampled, multiple conversions
          per trigger averaged in hardware, up to 16-bit. Digital filter
          enabled. zephyr,oversampling on each channel selects the average
          count (2^N samples); if omitted it defaults to no averaging.

        - "hybrid": channels may mix SAR and oversampling within the same
          converter. Each channel decides individually via
          zephyr,oversampling: 0 (or omitted) runs SAR (<=12-bit),
          >=1 runs oversampling with 2^N averaging (<=16-bit). Use this
          when some channels need speed (SAR) and others need precision
          (oversample) on the same converter.

io-channel-cells:
  - input

child-binding:
  description: |
    Virtual channel under this ADC_B unit.

  properties:
    renesas,scan-group:
      type: phandle
      required: true
      description: |
        Selects the scan-group this virtual channel belongs to. The
        scan-group's renesas,converter-unit-id MUST equal this
        adc-unit's unit-id (the driver enforces this with BUILD_ASSERT
        so a mismatch fails the build).

        zephyr,input-positive of the channel must also be within the
        channel-available-mask of this adc-unit.
```

## dts/bindings/adc/renesas,ra-adc-base.yaml
```yaml
# Copyright (c) 2025 Renesas Electronics Corporation
# SPDX-License-Identifier: Apache-2.0

include: [adc-controller.yaml, pinctrl-device.yaml]

properties:
  reg:
    required: true

  vref-mv:
    type: int
    required: true
    description: ADC reference voltage (Unit:mV)

  "#io-channel-cells":
    const: 1

  channel-available-mask:
    type: int
    required: true
    description: Mask for ADC channels existed in each board

  average-count:
    type: int
    default: 1
    enum: [1, 2, 4, 8, 16]
    description: The conversion count of the average mode
      The ADC module will take multiple samples of an analog signal
      and averages them to reduce noise and enhance accuracy

  reference:
    type: string
    enum:
      - vdd
      - internal
      - external
    default: vdd
    description: |
      ADC reference voltage source:
        - vdd: use VDD as reference
        - internal: use internal reference
        - external: use external reference

  sampling-time-ns:
    type: int
    description: |
      Sampling time in nanoseconds, i.e. the duration the ADC input
      signal is sampled before conversion starts.

  unit:
    type: int
    required: true
    description: Indicates the unit number of the ADC device.

io-channel-cells:
  - input
```

## dts/bindings/adc/renesas,ra-adc.yaml
```yaml
# Copyright (c) 2024 Renesas Electronics Corporation
# SPDX-License-Identifier: Apache-2.0

description: Renesas RA ADC node

compatible: "renesas,ra-adc"

include: [adc-controller.yaml, pinctrl-device.yaml]

properties:
  reg:
    required: true

  vref-mv:
    type: int
    required: true
    description: ADC reference voltage (Unit:mV)

  "#io-channel-cells":
    const: 1

  channel-available-mask:
    type: int
    required: true
    description: Mask for ADC channels existed in each board

  average-count:
    type: int
    default: 1
    enum: [1, 2, 4, 8, 16]
    description: The conversion count of the average mode
      The ADC module will take multiple samples of an analog signal
      and averages them to reduce noise and enhance accuracy

io-channel-cells:
  - input
```

## dts/bindings/adc/renesas,ra-adc12.yaml
```yaml
# Copyright (c) 2025 Renesas Electronics Corporation
# SPDX-License-Identifier: Apache-2.0

description: Renesas RA 12-bit resolution ADC (ADC12)

compatible: "renesas,ra-adc12"

include: renesas,ra-adc-base.yaml
```

## dts/bindings/adc/renesas,ra-adc16.yaml
```yaml
# Copyright (c) 2025 Renesas Electronics Corporation
# SPDX-License-Identifier: Apache-2.0

description: Renesas RA 16-bit resolution ADC (ADC16)

compatible: "renesas,ra-adc16"

include: renesas,ra-adc-base.yaml
```

## dts/bindings/adc/renesas,rx-adc.yaml
```yaml
# Copyright (c) 2025 Renesas Electronics Corporation
# SPDX-License-Identifier: Apache-2.0

description: Renesas RX ADC

compatible: "renesas,rx-adc"

include: [adc-controller.yaml, pinctrl-device.yaml]

properties:
  reg:
    required: true

  vref-mv:
    type: int
    required: true
    description: ADC reference voltage (Unit:mV)

  channel-count:
    type: int
    required: true
    description: The number of ADC channels

  channel-available-mask:
    type: int
    required: true
    description: Mask for ADC channels existed in each unit S12AD

  "#io-channel-cells":
    const: 1

io-channel-cells:
  - input
```

## dts/bindings/adc/renesas,rz-adc-c.yaml
```yaml
# Copyright (c) 2025 Renesas Electronics Corporation
# SPDX-License-Identifier: Apache-2.0

description: "Renesas RZ ADC-C driver"

compatible: "renesas,rz-adc-c"

include: [adc-controller.yaml, pinctrl-device.yaml]

properties:
  reg:
    required: true

  interrupts:
    required: true

  vref-mv:
    type: int
    required: true
    description: Indicates the reference voltage of the ADC in mV.

  channel-available-mask:
    type: int
    required: true
    description: Mask for ADC channels existed in each board

  "#io-channel-cells":
    const: 1

io-channel-cells:
  - input
```

## dts/bindings/adc/renesas,rz-adc.yaml
```yaml
# Copyright (c) 2024 Renesas Electronics Corporation
# SPDX-License-Identifier: Apache-2.0

description: "Renesas RZ ADC"

compatible: "renesas,rz-adc"

include: [adc-controller.yaml, pinctrl-device.yaml]

properties:
  reg:
    required: true

  interrupts:
    required: true

  vref-mv:
    type: int
    required: true
    description: Indicates the reference voltage of the ADC in mV.

  unit:
    type: int
    description: Indicates the unit number of the ADC device.
    required: true

  channel-available-mask:
    type: int
    required: true
    description: Mask for ADC channels existed in each board

  "#io-channel-cells":
    const: 1

io-channel-cells:
  - input
```

## dts/bindings/adc/renesas,rza2m-adc.yaml
```yaml
# Copyright (c) 2025 Renesas Electronics Corporation
# SPDX-License-Identifier: Apache-2.0

description: "Renesas RZ/A2M ADC driver"

compatible: "renesas,rza2m-adc"

include: [adc-controller.yaml, pinctrl-device.yaml]

properties:
  reg:
    required: true

  interrupts:
    required: true

  vref-mv:
    type: int
    required: true
    description: Indicates the reference voltage of the ADC in mV.

  channel-available-mask:
    type: int
    required: true
    description: Mask for ADC channels existed in each board

  clocks:
    required: true

  "#io-channel-cells":
    const: 1

io-channel-cells:
  - input

child-binding:
  properties:
    zephyr,acquisition-time:
      description: |
        Acquisition time for ADC sampling in ADCLK cycles (ticks).
        Only the ADC_ACQ_TIME_TICKS unit is supported on this device.
        The acquisition time value (in ticks) must be between 5 and 255.
        When ADC_ACQ_TIME_DEFAULT is specified, the hardware uses 11 ticks as the default
        acquisition time.
    zephyr,oversampling:
      description: |
        Oversampling setting to be used for the channel.
        When specified, each sample is averaged from 2^N conversion results
        (where N is the provided value).
        On this device, N = 0, 1, 2.
```

## dts/bindings/adc/renesas,smartbond-gpadc.yaml
```yaml
# Copyright (c) 2023 Renesas Electronics Corporation
# SPDX-License-Identifier: Apache-2.0

description: Renesas SmartBond(tm) ADC node

compatible: "renesas,smartbond-adc"

include: [adc-controller.yaml, pinctrl-device.yaml]

properties:
  reg:
    required: true

  interrupts:
    required: true

  "#io-channel-cells":
    const: 1

io-channel-cells:
  - input
```

## dts/bindings/adc/renesas,smartbond-sdadc.yaml
```yaml
# Copyright (c) 2023 Renesas Electronics Corporation
# SPDX-License-Identifier: Apache-2.0

description: Renesas SmartBond(tm) ADC node

compatible: "renesas,smartbond-sdadc"

include: [adc-controller.yaml, pinctrl-device.yaml]

properties:
  reg:
    required: true

  interrupts:
    required: true

  "#io-channel-cells":
    const: 1

  clock-freq:
    type: int
    description: |
      SDADC clock frequency selector;
    enum:
      - 0 # 250 kHz
      - 1 # 500 kHz
      - 2 # 1 MHz (default)
      - 3 # 2 MHz

io-channel-cells:
  - input
```

## dts/bindings/adc/sifli,sf32lb-gpadc.yaml
```yaml
# Copyright (c) 2025 Qingsong Gou <gouqs@hotmail.com>
# SPDX-License-Identifier: Apache-2.0

description: SiFli SF32LB ADC controller

compatible: "sifli,sf32lb-gpadc"

include: [adc-controller.yaml, pinctrl-device.yaml, sifli-sf32lb-cfg.yaml]

properties:
  reg:
    required: true

  interrupts:
    required: true

  clocks:
    required: true

  pinctrl-0:
    required: true

  pinctrl-names:
    required: true

  sifli,cfg:
    required: true

  "#io-channel-cells":
    const: 1

io-channel-cells:
  - input
```

## dts/bindings/adc/silabs,gecko-adc.yaml
```yaml
# Copyright (c) 2023 Antmicro <www.antmicro.com>
# SPDX-License-Identifier: Apache-2.0

description: Silicon Labs Gecko Series 1 ADC

compatible: "silabs,gecko-adc"

include: adc-controller.yaml

properties:
  reg:
    required: true

  interrupts:
    required: true

  frequency:
    type: int
    required: true

  "#io-channel-cells":
    const: 1

io-channel-cells:
  - input
```

## dts/bindings/adc/silabs,gecko-iadc.yaml
```yaml
# Copyright (c) 2023 Antmicro <www.antmicro.com>
# SPDX-License-Identifier: Apache-2.0

title: Silicon Labs Series 2 IADC (Incremental Analog to Digital Converter)

description: |
  Incremental ADC peripheral for Silicon Labs Series 2 SoCs.

compatible: "silabs,gecko-iadc"

include: [adc-controller.yaml, pinctrl-device.yaml]

properties:
  reg:
    required: true

  interrupts:
    required: true

  "#io-channel-cells":
    const: 1

io-channel-cells:
  - input
```

## dts/bindings/adc/silabs,iadc.yaml
```yaml
# Copyright (c) 2023 Antmicro <www.antmicro.com>
# Copyright (c) 2025 Silicon Laboratories Inc.
# SPDX-License-Identifier: Apache-2.0

title: Silicon Labs Series 2 IADC

description: |
  Incremental ADC peripheral for Silicon Labs Series 2 SoCs.

compatible: "silabs,iadc"

include: [adc-controller.yaml, pinctrl-device.yaml]

properties:
  reg:
    required: true

  interrupts:
    required: true

  "#io-channel-cells":
    const: 1

io-channel-cells:
  - input
```

## dts/bindings/adc/silabs,siwx91x-adc.yaml
```yaml
description: Silicon Labs siwx91x ADC

compatible: "silabs,siwx91x-adc"

include: [adc-controller.yaml, pinctrl-device.yaml]

properties:
  reg:
    required: true

  interrupts:
    required: true

  silabs,adc-ref-voltage:
    type: int
    description: |
        ADC reference volatge in mv. This voltage is common for all
        the channels.
        Valid range: 1800 - 3600
    required: true

  silabs,adc-sampling-rate:
    type: int
    default: 100000
    description: |
        ADC sampling rate in Hz (1-2500000 Hz).
    required: true

  "#io-channel-cells":
    const: 1
    description: |
        ADC channels should be declared in a sequential manner.
        Since the hardware allows any pin to be mapped to any channel,
        enforcing sequential channel declarations does not restrict
        or limit any functional capability.

io-channel-cells:
  - input
```
