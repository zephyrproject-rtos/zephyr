## dts/bindings/adc/st,stm32-adc.yaml
```yaml
# Copyright (c) 2018, Endre Karlson
# Copyright (c) 2018, Song Qiang <songqiang1304521@gmail.com>
# Copyright (c) 2025 STMicroelectronics
# SPDX-License-Identifier: Apache-2.0

description: STM32 ADC

compatible: "st,stm32-adc"

include: [adc-controller.yaml, pinctrl-device.yaml]

properties:
  reg:
    required: true

  clocks:
    required: true

  clock-names:
    required: true
    enum:
      - "adcx"
      - "adc_ker"
      - "adc_pre"
    description: |
      Expected names are the following:
      - "adcx" for the enabling the register clock (mandatory)
      - "adc_ker" for configuring the kernel clock (if applicable)
      - "adc_pre" for configuring the prescaler (if applicable)
      Kernel clock and prescaler may be shared between several ADC instances.
      In that case, the same kernel clock/prescaler Device Tree configuration
      must be used on all instances that share the kernel clock/prescaler
      to avoid conflicts.

  interrupts:
    required: true

  "#io-channel-cells":
    const: 1

  st,adc-clock-source:
    type: string
    required: true
    enum:
      - "SYNC"
      - "ASYNC"
    description: |
      Type of ADC clock source :
      - "SYNC": derived from the bus clock.
      - "ASYNC" : independent and asynchronous with the bus clock
      One of the two values may not apply to some series. Refer to the RefMan.
      If an asynchronous clock is selected, a kernel clock in the "clocks" property
      has to be defined explicitly.

  st,adc-prescaler:
    type: int
    required: true
    enum:
      - 1 # not divided
      - 2
      - 4
      - 6
      - 8
      - 10
      - 12
      - 16
      - 32
      - 64
      - 128
      - 256
    description: |
      Clock prescaler at the input of the ADC:
      Apply to synchronous or asynchronous clock depending on the STM32
      st,adc-clock-source.
      Some of the values may not apply to some series, and may depend on the
      selected clock source. Refer to the RefMan.
      On STM32F3x, this configures only the synchronous prescaler
      (use the "clocks" property to set asynchronous prescaler).

  vref-mv:
    type: int
    default: 3300
    description: Indicates the reference voltage of the ADC in mV (on the target board).

  resolutions:
    type: array
    required: true
    description: |
      List of the resolutions supported by the ADC instance. They should be
      values created with STM32_ADC_RES macro or similar. Their order is not
      important. For example for STM32F4:
        <STM32_ADC_RES(12, 0x00) STM32_ADC_RES(10, 0x01)
         STM32_ADC_RES(8, 0x02)  STM32_ADC_RES(6, 0x03)>
      The two parameters are the resolution (for example 10 bits) and the
      corresponding register value (0x01 for a 10-bit resolution).
      By design, these macros also contains all register information (address,
      field offset and field mask) necessary to properly set the resolution.

  sampling-times:
    type: array
    required: true
    description: |
      List all the sampling times supported by the ADC instance.
      Rounded up if needed. Order is important: their index matches their binary
      value in the register.

  num-sampling-time-common-channels:
    type: int
    description: |
      Number of sampling time common channels for this ADC instance, if any.

  st,adc-sequencer:
    type: string
    required: true
    enum:
      - "fixed"
      - "programmable"
    description: |
      Type of ADC sequencer:
      - "fixed": Channels of a sequence are sampled from lowest to highest.
      - "programmable": Channels of a sequence can be sampled in any order.

  st,adc-oversampler:
    type: string
    required: true
    enum:
      - "none"
      - "minimal"
      - "extended"
    description: |
      Type of ADC oversampler:
      - "none": No oversampler
      - "minimal": Oversampler with 8 possible oversampling values (2, 4, 8, ..., 256)
      - "extended": Oversampler with 1024 possible oversampling values (1..1024)

  st,adc-internal-regulator:
    type: string
    required: true
    enum:
      - "none"
      - "startup-sw-delay"
      - "startup-hw-status"
    description: |
      Presence and type of ADC internal regulator if any.
      - "none": No internal regulator.
      - "startup-sw-delay": Internal regulator is present and its startup time is checked with a
        software delay.
      - "startup-hw-status": Internal regulator is present and its startup time is checked with a
        status flag in a register.

  st,adc-has-deep-powerdown:
    type: boolean
    description: |
      If present, it indicates that the ADC instance has a deep power down feature.

  st,adc-has-channel-preselection:
    type: boolean
    description: |
      If present, it indicates that the ADC instance has a channel preselection register.

  st,adc-has-differential-support:
    type: boolean
    description: |
      If present, it indicates that the ADC instance supports differential channel inputs.

io-channel-cells:
  - input
```

## dts/bindings/adc/st,stm32wb0-adc.yaml
```yaml
# SPDX-License-Identifier: Apache-2.0

description: STM32WB0 Analog-to-Digital Converter

compatible: "st,stm32wb0-adc"

include: [adc-controller.yaml, pinctrl-device.yaml]

properties:
  reg:
    required: true

  clocks:
    required: true

  interrupts:
    required: true

  "#io-channel-cells":
    const: 1

  io-booster:
    type: boolean
    description: |
      When set, the I/O Booster block is enabled during ADC usage. Otherwise, the
      I/O Booster block is always disabled. This property MUST be set if VBAT voltage
      may reach a value below 2.7V to guarantee that the ADC behavior remains correct.

io-channel-cells:
  - input
```

## dts/bindings/adc/telink,b91-adc.yaml
```yaml
# Copyright (c) 2022, Telink Semiconductor
# SPDX-License-Identifier: Apache-2.0

description: Telink B91 ADC node

compatible: "telink,b91-adc"

include: adc-controller.yaml

properties:
    reg:
      required: true

    "#io-channel-cells":
      const: 1

    sample-freq:
      type: int
      required: true
      enum:
        - 23000
        - 48000
        - 96000
      description: |
        This property selects the ADC source frequency: 23 kHz, 48 kHz, or 96 kHz.

    vref-internal-mv:
      type: int
      required: true
      enum:
        - 900
        - 1200
      description: |
        This property selects the internal reference voltage source (in millivolts).
        The external reference source is not supported.

io-channel-cells:
    - input
```

## dts/bindings/adc/telink,b9x-adc.yaml
```yaml
# Copyright (c) 2022-2024, Telink Semiconductor
# SPDX-License-Identifier: Apache-2.0

description: Telink B9x ADC node

compatible: "telink,b9x-adc"

include: [adc-controller.yaml, pinctrl-device.yaml]

properties:
  reg:
    required: true

  "#io-channel-cells":
    const: 1

  pinctrl-0:
    required: true

  pinctrl-names:
    required: true

  sample-freq:
    type: int
    required: true
    enum:
      - 23000
      - 48000
      - 96000
    description: |
      This property selects the ADC source frequency: 23 kHz, 48 kHz, or 96 kHz.

  vref-internal-mv:
    type: int
    required: true
    enum:
      - 900
      - 1200
    description: |
      This property selects the internal reference voltage source (in millivolts).
      The external reference source is not supported.

io-channel-cells:
  - input
```

## dts/bindings/adc/telink,w91-adc.yaml
```yaml
# Copyright (c) 2024 Telink Semiconductor (Shanghai) Co., Ltd.
# SPDX-License-Identifier: Apache-2.0

description: Telink W91 ADC node

compatible: "telink,w91-adc"

include: [adc-controller.yaml, pinctrl-device.yaml]

properties:
  "#io-channel-cells":
    const: 1

  pinctrl-0:
    required: true

  pinctrl-names:
    required: true

io-channel-cells:
  - input
```

## dts/bindings/adc/ti,adc-k3.yaml
```yaml
# SPDX-License-Identifier: Apache-2.0

description: TI K3-family ADC

compatible: "ti,adc-k3"

include: [adc-controller.yaml]

properties:
  interrupts:
    required: true

  "#io-channel-cells":
    const: 1

  vref_mv:
    type: int
    required: true
    description: Internal Reference Voltage (in mV)

  fifo:
    type: int
    required: true
    enum:
      - 0
      - 1
    description: FIFO for storing conversions

io-channel-cells:
  - input

child-binding:
  properties:
    open-delay:
      type: int
      default: 0
      description: Delay before acquisition period

    zephyr,resolution:
      default: 12

    zephyr,oversampling:
      default: 0
```

## dts/bindings/adc/ti,adc081c021.yaml
```yaml
# Copyright (c) 2026 RAKwireless Technology Limited
# SPDX-License-Identifier: Apache-2.0

description: |
  Texas Instruments ADC081C021: single-channel 8-bit I2C ADC of the ADCxx1C
  family, with a dedicated ALERT output pin.

  The conversion result is left aligned in D11:D0 of the conversion result
  register.

compatible: "ti,adc081c021"

include: ti,adcxx1c-base.yaml
```
