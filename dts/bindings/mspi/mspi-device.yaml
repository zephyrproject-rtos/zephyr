## dts/bindings/mspi/nxp,flexspi-mspi-controller.yaml
```yaml
# Copyright 2026 NXP
# SPDX-License-Identifier: Apache-2.0

description: NXP FlexSPI MSPI controller

compatible: "nxp,flexspi-mspi-controller"

include: [base.yaml, pinctrl-device.yaml, mspi-controller.yaml]

properties:
  reg:
    required: true

  interrupts:
    required: true

  clocks:
    required: true

  clock-frequency:
    required: true

  ahb-bufferable:
    type: boolean
    description: |
      Enable AHB bufferable write access by setting register field
      AHBCR[BUFFERABLEEN].

  ahb-cacheable:
    type: boolean
    description: |
      Enable AHB cacheable read access by setting register field
      AHBCR[CACHEABLEEN].

  ahb-prefetch:
    type: boolean
    description: |
      Enable AHB read prefetch by setting register field AHBCR[PREFETCHEN].

  ahb-read-addr-opt:
    type: boolean
    description: |
      Remove burst start address alignment limitation by setting register
      field AHBCR[READADDROPT].

  combination-mode:
    type: boolean
    description: |
      Combine port A and port B data pins to support octal mode access by
      setting register field MCR0[COMBINATIONEN].

  sck-differential-clock:
    type: boolean
    description: |
      Enable/disable SCKB pad use as SCKA differential clock output,
      when enabled, Port B flash access is not available.

  rx-clock-source:
    type: int
    default: 0
    enum:
      - 0
      - 1
      - 2
      - 3
    description: |
      Source clock for flash read. See the RXCLKSRC field in register MCR0.

  rx-clock-source-b:
    type: int
    default: 0
    enum:
      - 0
      - 1
      - 2
      - 3
    description: |
      Source clock for flash read on port B. See the RXCLKSRC_B field
      in register MCR2.

  rx-buffer-config:
    type: array
    description: |
      Array of tuples to configure AHB RX buffers:
      <prefetch priority master_id buf_size>.

  ahb-boundary:
    type: string
    default: "no-boundary"
    enum:
      - "no-boundary"
      - "1024"
      - "512"
      - "256"
    description: |
      Sets the AHB read/write boundary. Cross-boundary accesses are split
      by hardware when enabled.
```

## dts/bindings/mspi/nxp,flexspi.yaml
```yaml
# Copyright 2024 NXP
# SPDX-License-Identifier: Apache-2.0

description: NXP FlexSPI MSPI Controller

compatible: "nxp,flexspi"

include: [mspi-controller.yaml, pinctrl-device.yaml]

properties:
  reg:
    required: true

  interrupts:
    required: true

  nxp,ahb-bufferable:
    type: boolean
    description: |
      Enable AHB bufferable write access by setting register field
      AHBCR[BUFFERABLEEN].

  nxp,ahb-cacheable:
    type: boolean
    description: |
      Enable AHB cacheable read access by setting register field
      AHBCR[CACHEABLEEN].

  nxp,ahb-prefetch:
    type: boolean
    description: |
      Enable AHB read prefetch by setting register field AHBCR[PREFETCHEN].

  nxp,ahb-read-addr-opt:
    type: boolean
    description: |
      Remove burst start address alignment limitation by setting register
      field AHBCR[READADDROPT].

  nxp,combination-mode:
    type: boolean
    description: |
      Combine port A and port B data pins to support octal mode access by
      setting register field MCR0[COMBINATIONEN].

  nxp,sck-differential-clock:
    type: boolean
    description: |
      Enable/disable SCKB pad use as SCKA differential clock output,
      when enabled, Port B flash access is not available.

  nxp,rx-clock-source:
    type: string
    default: "loopback-internal"
    enum:
      - "loopback-internal"
      - "loopback-dqs"
      - "loopback-sck"
      - "external-dqs"
    description: |
      Source clock for flash read. See the RXCLKSRC field in register MCR0.
      The default corresponds to the reset value of the register field.

  nxp,rx-clock-source-b:
    type: string
    default: "loopback-internal"
    enum:
      - "loopback-internal"
      - "loopback-dqs"
      - "loopback-sck"
      - "external-dqs"
    description: |
      Source clock for flash read on port B. Only supported by some instances
      of this IP. See the RXCLKSRC_B field in register MCR2.
      The default corresponds to the reset value of the register field.

  nxp,rx-buffer-config:
    type: array
    description: |
      Array of tuples to configure AHB RX buffers. Format is the following:
      <prefetch priority master_id buf_size>. Pass multiple tuples to configure
      multiple RX buffers (up to maximum supported by SOC).
      The tuple fields correspond to the following register bitfields:
      prefetch: AHBRXBUFxCRx[PREFETCH]
      priority: AHBRXBUFxCRx[PRIORITY]
      master_id: AHBRXBUFxCRx[MSTRID]
      buf_size: AHBRXBUFxCRx[BUFSZ]

  nxp,combination-supported:
    type: boolean
    description: |
      Set if the IP instance supports combining port A and port B to enable
      octal mode. Indicates presence of MCR0[COMBINATIONEN] bit

  nxp,sckb-invert-supported:
    type: boolean
    description: |
      Set if the IP instance supports outputting an inverted SCLK signal on
      port B. Indicates presence of MRC2[SCKBDIFFOPT] bit

  nxp,diff-rxclk-supported:
    type: boolean
    description: |
      Set if the IP instance supports a different RX clock source on port B.
      Indicates presence of MCR2[RXCLKSRC_B] bit

  nxp,xip-port:
    type: int
    default: 0
    description: |
      SOC specific value. Sets the port that the ROM uses to boot from this
      FlexSPI instance, if supported. Defaults to 0 as most NXP ROMs boot from
      port A1, some SOCs may need to override this setting.
```

## dts/bindings/mspi/nxp,qspi.yaml
```yaml
# Copyright 2026 NXP
# SPDX-License-Identifier: Apache-2.0

description: NXP QSPI controller with MSPI interface

compatible: "nxp,qspi"

include: [base.yaml, pinctrl-device.yaml, mspi-controller.yaml]

properties:
  reg:
    required: true

  pinctrl-0:
    required: true

  pinctrl-names:
    required: true

  clocks:
    required: true

  cs-setup-time:
    type: int
    default: 3
    description: |
      Chip select setup time, in serial clock cycles. Default corresponds
      to the hardware reset value.

  cs-hold-time:
    type: int
    default: 3
    description: |
      Chip select hold time, in serial clock cycles. Default corresponds
      to the hardware reset value.

  data-hold-time:
    type: int
    default: 1
    description: |
      Data output hold time, in serial clock cycles. Default corresponds
      to the hardware reset value.
```

## dts/bindings/mspi/snps,designware-ssi.yaml
```yaml
# Copyright (c) 2024 Nordic Semiconductor ASA
# SPDX-License-Identifier: Apache-2.0

description: Synopsys DesignWare Synchronous Serial Interface (SSI) node

compatible: "snps,designware-ssi"

include: [mspi-controller.yaml, pinctrl-device.yaml]

properties:
  reg:
    required: true

  interrupts:
    required: true

  packet-data-limit:
    required: true
    const: 65536

  aux-reg-enable:
    type: boolean
    description: |
      Activates auxiliary register access that is needed on some platforms.

  fifo-depth:
    required: true
    type: int
    description: |
      Number of items that can be stored in the TX FIFO. Range: 8-256.
      If the RX FIFO depth is not specified separately in the rx-fifo-depth
      property, this value specifies depth of both TX and RX FIFOs.

  rx-fifo-depth:
    type: int
    description: |
      Number of items that can be stored in the RX FIFO. Range: 8-256.

  tx-fifo-threshold:
    type: int
    description: |
      Number of entries in the TX FIFO above which the TX transfer is started.
      Maximum value is the TX FIFO depth - 1.

  rx-fifo-threshold:
    type: int
    description: |
      Number of entries in the RX FIFO above which the controller gets an RX
      interrupt. Maximum value is the RX FIFO depth - 1.

  dma-transmit-data-level:
    type: int
    description: |
      When in DMA mode, the transmit data level field controls the level at which a DMA request
      is made by the transmit logic. A request to transmit is generated when the number of
      valid data entries in the transmit FIFO is equal to or below this field value. Lower values
      mean less frequent DMA triggers with larger bursts. Higher values mean fewer, smaller bursts
      (lower latency, higher overhead). Range: 0-15

  dma-receive-data-level:
    type: int
    description: |
      When in DMA mode, the receive data level field controls the level at which a DMA request
      is made by the receive logic. A request to receive is generated when the number of
      valid data entries in the receive FIFO is greater than this value. Lower values mean
      more frequent DMA triggers and higher values mean larger less frequent bursts. Range: 0-15
```

## dts/bindings/mspi/st,mspi-nor.yaml
```yaml
# Copyright (c) 2026 EXALT Technologies.
# SPDX-License-Identifier: Apache-2.0

description: STM32 memory device on mspi bus

compatible: "st,mspi-nor"

include: jedec,nor-mspi.yaml

properties:
  st,mem-type:
    type: string
    description: |
      The type of memory to be supported by the controller.
    enum:
      - "micron"
      - "macronix"
      - "apmem"
      - "macronix_ram"
      - "hyperbus"
      - "apmem_16bits"
```

## dts/bindings/mspi/st,psram-device-mspi.yaml
```yaml
# Copyright (c) 2026 EXALT Technologies.
# SPDX-License-Identifier: Apache-2.0

description: STM32 PSRAM device on mspi bus

compatible: "st,psram-device"

include: ["mspi-device.yaml", "jedec,jesd216.yaml"]

properties:
  st,timing-config:
    type: array
    default: [0]
    description: |
      Array of tuples to configure the timing parameters.
      Currently supports only one parameter per tuple (turnaround_cycles).
      Can be extended to include more timing fields in the future.

  drive-strength:
    type: int
    default: 0
    description: |
      Drive strength code:
      - 0: Full
      - 1: Half
      - 2: 1/4
      - 3: 1/8
    enum:
      - 0
      - 1
      - 2
      - 3

  aps-version:
    type: string
    default: generic
    enum:
      - generic
      - APS256
      - APS6408L
    description: |
      Specifies the AP Memory pSRAM variant connected to the MSPI interface.

  read-command:
    required: true

  write-command:
    required: true
```

## dts/bindings/mspi/st,stm32-ospi-controller.yaml
```yaml
# Copyright (c) 2024 STMicroelectronics
# SPDX-License-Identifier: Apache-2.0

description: STM32 OSPI controller

compatible: "st,stm32-ospi-controller"

include: [base.yaml, pinctrl-device.yaml, mspi-controller.yaml]


properties:
  reg:
    required: true

  interrupts:
    required: true

  pinctrl-0:
    required: true

  pinctrl-names:
    required: true

  clock-names:
    required: true

  clocks:
    required: true

  dmas:
    description: |
      Optional DMA channel specifier, required for DMA transactions.

      For example dmas for TX/RX on MSPI
         dmas = <&dma1 5 41 0x10000>;

  dma-names:
    description: DMA channel name.
    enum:
      - "tx_rx"

  st,dlyb-bypass:
    type: boolean
    description: |
      Enables Delay Block (DLYB) Bypass.

  st,ssht-enable:
    type: boolean
    description: |
      Enables Sample Shifting half-cycle.

      It is recommended to be enabled in STR mode and disabled in DTR mode.

  st,io-low-port:
    type: string
    enum:
      - "IOPORT_NONE"
      - "IOPORT_1_LOW"
      - "IOPORT_1_HIGH"
      - "IOPORT_2_LOW"
      - "IOPORT_2_HIGH"
    description: |
      Specifies which port of the OCTOSPI IO Manager is used for the IO[3:0] pins.

      If absent, then `IOPORT_<n>_LOW` is used where `n` is the OSPI
      instance number.

      Note: You might need to enable the OCTOSPI I/O manager clock to use the
            property. Please refer to Reference Manual.
            The clock can be enabled in the devicetree.

  st,io-high-port:
    type: string
    enum:
      - "IOPORT_NONE"
      - "IOPORT_1_LOW"
      - "IOPORT_1_HIGH"
      - "IOPORT_2_LOW"
      - "IOPORT_2_HIGH"
    description: |
      Specifies which port of the OCTOSPI IO Manager is used for the IO[7:4] pins.

      If absent, then `IOPORT_<n>_HIGH` is used where `n` is the OSPI
      instance number.

      Can be set to `IOPORT_NONE` for Single SPI, Dual SPI and Quad SPI.

      Note: You might need to enable the OCTOSPI I/O manager clock to use the
            property. Please refer to Reference Manual.
            The clock can be enabled in the devicetree.

  st,clk-port:
    type: int
    enum:
      - 1
      - 2
    description: |
      Specifies which port of the OCTOSPI IO Manager is used for the clk pin.

      If absent, then n is used where `n` is the OSPI
      instance number.

      Note: You might need to enable the OCTOSPI I/O manager clock to use the
            property. Please refer to Reference Manual.
            The clock can be enabled in the devicetree.

  st,csbound:
    type: int
    default: 0
    description: |
      Limit a transaction to a boundary of aligned addresses. The size of the
      alignment is given by the value: 2^(csbound) bits.
      A csbound value of 0 means the feature is disabled.
      Feature is disabled by default. It is recommended to set this value
      according to the length of the burst wrap of the PSRAM device for the
      linear burst command.
    enum: [0, 1, 2, 3, 4, 5, 6, 7, 8, 9, 10, 11, 12, 13, 14, 15, 16, 17, 18, 19, 20,
           21, 22, 23, 24, 25, 26, 27, 28, 29, 30, 31]

  st,dqs-port:
    type: int
    enum:
      - 1
      - 2
    description: |
      Specifies which port of the OCTOSPI IO Manager is used for the dqs pin.

      If absent, then n is used where `n` is the OSPI
      instance number.

      Note: You might need to enable the OCTOSPI I/O manager clock to use the
            property. Please refer to Reference Manual.
            The clock can be enabled in the devicetree.

  st,ncs-port:
    type: int
    enum:
      - 1
      - 2
    description: |
      Specifies which port of the OCTOSPI IO Manager is used for the ncs pin.

      If absent, then n is used where `n` is the OSPI
      instance number.

      Note: You might need to enable the OCTOSPI I/O manager clock to use the
            property. Please refer to Reference Manual.
            The clock can be enabled in the devicetree.

  clock-frequency:
    required: true
```

## dts/bindings/mspi/ti,mspi-k3-controller.yaml
```yaml
# Copyright (c) 2025 Siemens Mobility GmbH
# SPDX-License-Identifier: Apache-2.0

description: TI K3 MSPI Controller

compatible: "ti,k3-mspi-controller"

include: [mspi-controller.yaml, pinctrl-device.yaml]

properties:
  reg:
    required: true
    description: |
      Address and length of the MSPI configuration register and the indirect
      write FIFO location.

  sram-allocated-for-read:
    required: true
    type: int
    description: |
      Amount of SRAM that is allocated for read data from the MSPI bus. The rest
      is allocated for data written to the MSPI bus.
      The value needs to be between 0 and 255
```

## dts/bindings/mspi/zephyr,emul-device-mspi.yaml
```yaml
# Copyright (c) 2024, Ambiq Micro Inc. <www.ambiq.com>
# SPDX-License-Identifier: Apache-2.0

description: Zephyr MSPI Emulation Device

compatible: "zephyr,emul-device-mspi"

include: mspi-device.yaml

properties:
  reg:
    required: true

  memmap-config:
    default: [0, 0, 0, 0]

  scramble-config:
    default: [0, 0, 0]

  ce-break-config:
    default: [0, 0]
```

## dts/bindings/mspi/zephyr,mspi-emul-controller.yaml
```yaml
# Copyright (c) 2024, Ambiq Micro Inc. <www.ambiq.com>
# SPDX-License-Identifier: Apache-2.0

description: Zephyr MSPI Emulation controller

compatible: "zephyr,mspi-emul-controller"

include: mspi-controller.yaml

properties:
  reg:
    required: true
```
