## dts/bindings/mspi/zephyr,mspi-emul-device.yaml
```yaml
# Copyright (c) 2024, Ambiq Micro Inc. <www.ambiq.com>
# SPDX-License-Identifier: Apache-2.0

description: Zephyr MSPI Emulation Device

compatible: "zephyr,mspi-emul-device"

include: mspi-device.yaml

properties:
  reg:
    required: true

  xip-config:
    default: [0, 0, 0, 0]

  scramble-config:
    default: [0, 0, 0]

  ce-break-config:
    default: [0, 0]
```

## dts/bindings/mspi/zephyr,peripheral-device-mspi.yaml
```yaml
# Copyright (c) 2026 Nordic Semiconductor ASA
# SPDX-License-Identifier: Apache-2.0

title: Generic MSPI peripheral device

description: |
  This node describes a device on the MSPI bus that is a peripheral (e.g. another SoC
  in peripheral mode, or an external peripheral). The local MSPI controller is the
  master; this node describes the peripheral it talks to. Use for SoC-to-SoC links,
  or any application-defined peripheral with no dedicated Zephyr driver.

compatible: "zephyr,peripheral-device"

include: mspi-device.yaml
```

## dts/bindings/mtd/andestech,qspi-nor-xip.yaml
```yaml
#
# Copyright (c) 2025, The ChromiumOS Authors.
#
# SPDX-License-Identifier: Apache-2.0
#

compatible: "andestech,qspi-nor-xip"

description:
  Flash SPI-NOR chip used for XIP, connected to an Andes SPI controller.

include: "base.yaml"

properties:
  size:
    type: int
    description: |
      The size in bytes.
```

## dts/bindings/mtd/andestech,qspi-nor.yaml
```yaml
#
# Copyright (c) 2023, Andes Technology Corporation.
#
# SPDX-License-Identifier: Apache-2.0
#

compatible: "andestech,qspi-nor"

description:
  Properties supporting Zephyr qspi-nor flash driver control of
  flash memories using the standard M25P80-based command set.

include: "jedec,spi-nor-common.yaml"

properties:
  wp-gpios:
    type: phandle-array
    description: WPn pin

  hold-gpios:
    type: phandle-array
    description: HOLDn pin

  reset-gpios:
    type: phandle-array
    description: RESETn pin
```

## dts/bindings/mtd/atmel,at24-i2c.yaml
```yaml
# Copyright (c) 2019 Vestas Wind Systems A/S
# Copyright (c) 2018, Nordic Semiconductor
# SPDX-License-Identifier: Apache-2.0

description: Atmel AT24 (or compatible) I2C EEPROM

compatible: "atmel,at24"

include: ["atmel,at2x-base.yaml", i2c-device.yaml]
```

## dts/bindings/mtd/atmel,at24-smbus.yaml
```yaml
# Copyright (c) 2023 Intel Corporation
#
# SPDX-License-Identifier: Apache-2.0

description: Atmel AT24 - compatible SMBus EEPROM

compatible: "atmel,at24"

include: ["atmel,at2x-base.yaml", smbus-device.yaml]
```

## dts/bindings/mtd/atmel,at24.yaml
```yaml
# Copyright (c) 2019 Vestas Wind Systems A/S
# Copyright (c) 2018, Nordic Semiconductor
# SPDX-License-Identifier: Apache-2.0

description: |
  I2C EEPROMs compatible with Atmel's AT24 family

  There are multiple vendors manufacturing I2C EEPROMs compatible with the programming model of the
  Atmel AT24.

  Examples of compatible EEPROM families:
  - Microchip AT24xxx
  - ST M24xxx

  Each of these can be represented by a set of common parameters (EEPROM size, page size, address
  width, and timeout) available from the datasheet of the specific EEPROM. The compatible string for
  these can list the specific EEPROM vendor and model along with the vendor EEPROM family as long as
  the least-specific compatible entry is "atmel,at24".

  Example devicetree node describing a ST M24M01 EEPROM on the i2c0 bus:

    &i2c0 {
      status = "okay";
      clock-frequency = <I2C_BITRATE_FAST>;

      eeprom@56 {
        compatible = "st,m24m01", "st,m24xxx", "atmel,at24";
        reg = <0x56>;
        size = <DT_SIZE_K(128)>;
        pagesize = <256>;
        address-width = <16>;
        timeout = <5>;
     };
   };

compatible: "atmel,at24"

include: ["atmel,at2x-base.yaml", i2c-device.yaml]
```

## dts/bindings/mtd/atmel,at24mac402.yaml
```yaml
# Copyright (c) 2022, Kumar Gala <galak@kernel.org>
# SPDX-License-Identifier: Apache-2.0

description: Atmel AT24 (or compatible) I2C EEPROM

compatible: "atmel,at24mac402"

include: [i2c-device.yaml]
```

## dts/bindings/mtd/atmel,at25.yaml
```yaml
# Copyright (c) 2019 Vestas Wind Systems A/S
# SPDX-License-Identifier: Apache-2.0

description: |
  SPI EEPROMs compatible with Atmel's AT25 family

  There are multiple vendors manufacturing SPI EEPROMs compatible with the programming model of the
  Atmel AT25.

  Examples of compatible EEPROM families:
  - Microchip AT25xxx
  - ST M95xxx

  Each of these can be represented by a set of common parameters (EEPROM size, page size, address
  width, and timeout) available from the datasheet of the specific EEPROM. The compatible string for
  these can list the specific EEPROM vendor and model along with the vendor EEPROM family as long as
  the least-specific compatible entry is "atmel,at25".

  Example devicetree node describing a ST M95256 EEPROM on the spi0 bus:

    &spi0 {
      status = "okay";

      eeprom@1 {
        compatible = "st,m95256", "st,m95xxx", "atmel,at25";
        reg = <0x1>;
        size = <DT_SIZE_K(32)>;
        pagesize = <64>;
        address-width = <16>;
        spi-max-frequency = <DT_FREQ_M(20)>;
        timeout = <5>;
      };
   };

compatible: "atmel,at25"

include: ["atmel,at2x-base.yaml", spi-device.yaml]
```
