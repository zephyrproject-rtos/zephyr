## dts/bindings/mspi/mspi-device.yaml
```yaml
# Copyright (c) 2024, Ambiq Micro Inc. <www.ambiq.com>
# SPDX-License-Identifier: Apache-2.0

# Common fields for MSPI devices

include: [base.yaml, power.yaml]

on-bus: mspi

properties:
  reg:
    required: true

  mspi-max-frequency:
    type: int
    required: true
    description: |
      Maximum clock frequency of device to configure in Hz.
      In device tree, it is normally the target operating
      frequency after initialization.

  mspi-io-mode:
    type: string
    enum:
      - "MSPI_IO_MODE_SINGLE"
      - "MSPI_IO_MODE_DUAL"
      - "MSPI_IO_MODE_DUAL_1_1_2"
      - "MSPI_IO_MODE_DUAL_1_2_2"
      - "MSPI_IO_MODE_QUAD"
      - "MSPI_IO_MODE_QUAD_1_1_4"
      - "MSPI_IO_MODE_QUAD_1_4_4"
      - "MSPI_IO_MODE_OCTAL"
      - "MSPI_IO_MODE_OCTAL_1_1_8"
      - "MSPI_IO_MODE_OCTAL_1_8_8"
      - "MSPI_IO_MODE_HEX"
      - "MSPI_IO_MODE_HEX_8_8_16"
      - "MSPI_IO_MODE_HEX_8_16_16"
    description: |
      MSPI I/O mode setting.
      In device tree, it is normally the target io mode
      after initialization.

  mspi-data-rate:
    type: string
    enum:
      - "MSPI_DATA_RATE_SINGLE"
      - "MSPI_DATA_RATE_S_S_D"
      - "MSPI_DATA_RATE_S_D_D"
      - "MSPI_DATA_RATE_DUAL"
    description:
      MSPI data rate setting.
      In device tree, it is normally the target data rate
      after initialization.

  mspi-hardware-ce-num:
    type: int
    description: |
      MSPI hardware CE number.
      MSPI controller may natively support multiple peripheral devices
      on the same MSPI instance by assigning designated CE numbers.

  mspi-cpp-mode:
    type: string
    enum:
      - "MSPI_CPP_MODE_0"
      - "MSPI_CPP_MODE_1"
      - "MSPI_CPP_MODE_2"
      - "MSPI_CPP_MODE_3"
    description: |
      MSPI clock polarity setting.
      MSPI_CPP_MODE_0: CPOL=0, CPHA=0
      MSPI_CPP_MODE_1: CPOL=0, CPHA=1
      MSPI_CPP_MODE_2: CPOL=1, CPHA=0
      MSPI_CPP_MODE_3: CPOL=1, CPHA=1

  mspi-endian:
    type: string
    enum:
      - "MSPI_LITTLE_ENDIAN"
      - "MSPI_BIG_ENDIAN"
    description: |
      MSPI transfer MSB or LSB first.

  mspi-ce-polarity:
    type: string
    enum:
      - "MSPI_CE_ACTIVE_LOW"
      - "MSPI_CE_ACTIVE_HIGH"
    description: |
      MSPI CE polarity. In most cases, it is active low.

  mspi-dqs-enable:
    type: boolean
    description: |
      Enable DQS mode for a device which supports it.
      This will be checked against dqs-support and configure
      the MSPI hardware if it supports DQS mode.

  mspi-hold-ce:
    type: boolean
    description: |
      In some cases, it is necessary for the controller to manage
      MSPI chip enable (under software control), so that multiple
      mspi transactions can be performed without releasing CE.
      A typical use case is variable length MSPI packets where
      the first mspi transaction reads the length and the second
      mspi transaction reads length bytes.

  rx-dummy:
    type: int
    description: |
      The number of data or clock cycles between addr and data
      in RX direction.
      0 means the RX dummy phase is disabled.

  tx-dummy:
    type: int
    description: |
      The number of data or clock cycles between addr and data
      in TX direction.
      0 means the TX dummy phase is disabled.

  read-command:
    type: int
    description: |
      Read command to be sent in RX direction.

  write-command:
    type: int
    description: |
      Write command to be sent in RX direction.

  command-length:
    type: string
    enum:
      - "INSTR_DISABLED"
      - "INSTR_1_BYTE"
      - "INSTR_2_BYTE"
    description: |
      Length in bytes of the write and read commands.

  address-length:
    type: string
    enum:
      - "ADDR_DISABLED"
      - "ADDR_1_BYTE"
      - "ADDR_2_BYTE"
      - "ADDR_3_BYTE"
      - "ADDR_4_BYTE"
    description: |
      Length in bytes of address to be sent in address phase.

  xip-config:
    type: array
    description: |
      Array of parameters to configure the xip feature.
      enable: whether XIP feature is enabled.
      address_offset: The offset in bytes to the start of the
                      platform specific XIP address region.
      size: The size in bytes of the XIP address region one
            wish to enable or disable.
      permission: The permission granted to the region. (RW/RO)

      For controller that support this feature. One may map the device
      memory into Soc system memory map. i.e. XIP address region
      So that the device may be used as an external RAM and execute code.

      default =
      <
        .enable         = false;
        .address_offset = 0;
        .size           = 0;
        .permission     = 0;
      >

  scramble-config:
    type: array
    description: |
      Array of parameters to configure the scrambling feature.
      enable: whether scrambling feature is enabled.
      address_offset: The offset in bytes to the start address which
                      can be the offset to the start of the platform
                      specific XIP address region or phyiscal device address.

      size: The size in bytes of the region one wish to enable or disable.
      For controller that support hardware scrambling, one may use it for
      additional security to protect data or code stored in external devices.

      default =
      <
        .enable         = false;
        .address_offset = 0;
        .size           = 0;
      >

  ce-break-config:
    type: array
    description: |
      Array of parameters to configure the auto CE break feature.
      mem_boundary: Memory boundary in bytes of a device that a transfer
                    should't cross.
      time_to_break: The maximum time of a transfer should't exceed for
                     a device in micro seconds(us).

      This is typically used with devices that has memory boundaries or
      requires periodic internal refresh. e.g. psram

      default =
      <
        .mem_boundary    = 0;
        .time_to_break   = 0;
      >
```

## dts/bindings/mspi/mspi-qspi-psram.yaml
```yaml
# Copyright (c) 2026
# SPDX-License-Identifier: Apache-2.0

description: >
  Generic QPI PSRAM device on MSPI bus.

  Two operating modes are supported:

  1. Known chip variant (chip-variant is set):
     The driver looks up all chip parameters — read/write commands, CE refresh
     interval, maximum burst size — from its internal table.
     read-command, write-command, command-length, address-length, and rx-dummy
     are still required by the MSPI controller to program its hardware registers
     (XIP/DMA mode), but CE timing (mem_boundary / time_to_break) is always
     taken from the chip table and any ce-break-config in DT is ignored.
     Supported chip variants: ESP-PSRAM64H, ISSI IS66WVS4M8BLL, IS66WVS8M8BLL.

  2. Generic mode (chip-variant is omitted):
     The driver uses the standard de-facto QPI PSRAM init sequence
     (Enter QPI 0x35, Reset 0x66+0x99, Read ID 0x9F) but skips KGD
     verification. All transfer parameters must be provided in DT:
     read-command, write-command, command-length, address-length, rx-dummy,
     and CE timing via ce-break-config or the mspi-device ce-* properties.

  STM32 users: add compatible = "st,psram-device" to the device node
  alongside this compatible to expose the st,timing-config property
  needed for OCTOSPI turnaround-cycle tuning.

compatible: "mspi-qspi-psram"

include: [mspi-device.yaml]

properties:
  size:
    type: int
    required: true
    description: Memory capacity in bits (e.g. 67108864 for 64 Mbit).

  chip-variant:
    type: string
    enum:
      - "ESP64H"          # Espressif ESP-PSRAM64H  64 Mbit (8 MB)
      - "IS66WVS4M8BLL"   # ISSI IS66WVS4M8BLL      32 Mbit (4 MB)
      - "IS66WVS8M8BLL"   # ISSI IS66WVS8M8BLL      64 Mbit (8 MB)
    description: >
      Selects the PSRAM chip variant. The driver uses this to look up
      chip-specific read/write commands and CE refresh interval from its
      internal parameter table, overriding the DT values for those fields.
      Omit this property to use generic mode, in which read-command,
      write-command, and CE timing must be specified explicitly in DT.

  mspi-io-mode:
    required: true
    description: Must be MSPI_IO_MODE_QUAD.

  mspi-max-frequency:
    required: true

  read-command:
    description: >
      QPI fast-read command byte sent by the MSPI controller in DMA/XIP mode.
      Required in generic mode (no chip-variant). When chip-variant is set,
      this value is overridden by the driver from its internal chip table.

  write-command:
    description: >
      QPI write command byte sent by the MSPI controller in DMA/XIP mode.
      Required in generic mode (no chip-variant). When chip-variant is set,
      this value is overridden by the driver from its internal chip table.

  command-length:
    description: >
      Length of the read/write command in bytes.
      Required in generic mode (no chip-variant). When chip-variant is set,
      the driver uses the value from its internal chip table (INSTR_1_BYTE
      for all supported variants) and ignores this property.

  address-length:
    description: >
      Length of the address phase in bytes.
      Required in generic mode (no chip-variant). When chip-variant is set,
      the driver uses the value from its internal chip table (ADDR_3_BYTE
      for all supported variants) and ignores this property.

  rx-dummy:
    description: >
      Read dummy cycles. Use the value from the chip datasheet for the
      chosen operating frequency (typically 6 at or below 80 MHz).
      Required in generic mode (no chip-variant). When chip-variant is set,
      the driver uses the datasheet value from its internal chip table and
      ignores this property.

  enter-qpi-cmd:
    type: int
    default: 0x35
    description: >
      SPI command to switch the chip into QPI (quad) mode.
      Default 0x35 is the de-facto standard for most QPI PSRAM vendors.
      Only used in generic mode (chip-variant not set); for known variants
      the driver takes this value from its internal chip table.

  exit-qpi-cmd:
    type: int
    default: 0xF5
    description: >
      QPI command to return the chip to SPI mode.
      Default 0xF5 is the de-facto standard.
      Only used in generic mode (chip-variant not set).

  reset-en-cmd:
    type: int
    default: 0x66
    description: >
      Reset Enable command (sent before reset-cmd).
      Default 0x66 is the de-facto standard.
      Only used in generic mode (chip-variant not set).

  reset-cmd:
    type: int
    default: 0x99
    description: >
      Reset command.
      Default 0x99 is the de-facto standard.
      Only used in generic mode (chip-variant not set).

  read-id-cmd:
    type: int
    default: 0x9F
    description: >
      Read ID command. The driver reads 3 bytes (MF / KGD / EID) at address 0.
      Default 0x9F is the de-facto standard.
      In generic mode KGD verification is skipped; the command is still
      issued so the chip presence can be confirmed via LOG_INF output.
      Only used in generic mode (chip-variant not set).

  st,timing-config:
    type: array
    default: [0]
    description: >
      STM32-specific OCTOSPI timing array.
      Element 0: turnaround_cycles — clock cycles subtracted from rx-dummy
      to compensate for the STM32 OCTOSPI controller's internal pipeline
      delay. Refer to the ST MSPI driver documentation for the correct
      value for your board's operating frequency.
      Ignored on non-STM32 platforms.
```

## dts/bindings/mspi/mxicy,mspi-controller.yaml
```yaml
#Copyright (c) 2025-2026 Macronix International Co., Ltd.
#SPDX-License-Identifier: Apache-2.0

description: Macronix MSPI controller

bus: mspi

compatible: "mxicy,mspi-controller"

include: [mspi-controller.yaml, pinctrl-device.yaml]

properties:
  reg:
    required: true
  clock-frequency:
    required: true
    type: int
    description: |
      Clock frequency the SPI peripheral is being driven at, in Hz.
  ce-ports:
    required: true
    type: uint8-array
    description: |
      Specifies the CE port number used for device communication.

      Example:

        mspi@... {
                ce-gpios = [00, 01, 02, 03];

                mspi-device@0 {
                        reg = <0>;
                        ...
                };
                mspi-device@1 {
                        reg = <1>;
                        ...
                };
                ...
        };

      The child node "mspi-device@0" specifies a mspi device with
      chip select controller ce-port 0. Similarly, "mspi-device@1" has CE GPIO
      controller ce-port 1. Additional devices can be configured in the same way.
      This controller supports up to 256 devices.
  rx-ss-a:
    required: true
    type: int
    description: |
      Ratio Of CLK_RX_A_I Frequency And CLK_SS_I Frequency.

  rx-ss-b:
    required: true
    type: int
    description: |
      Ratio Of CLK_RX_B_I Frequency And CLK_SS_I Frequency.
```

## dts/bindings/mspi/mxicy,mspi-device.yaml
```yaml
#Copyright (c) 2025-2026 Macronix International Co., Ltd.
#SPDX-License-Identifier: Apache-2.0

description: Macronix MSPI device

bus: mspi

compatible: "mxicy,mspi-device"

include: [mspi-device.yaml, "jedec,jesd216.yaml"]

properties:
  mspi-io-mode:
    required: true

  mspi-data-rate:
    required: true

  mspi-hardware-ce-num:
    type: int
    required: true
    default: 0
    description: |
      It can be only CE0 or CE1,
      but there could be multiple of CE0 or CE1 for a controller

  rx-dummy:
    required: true

  tx-dummy:
    required: true

  read-command:
    required: true

  write-command:
    required: true

  command-length:
    required: true

  address-length:
    required: true

  mxicy,timing-config-mask:
    type: int
    required: true
    description: |
      It must be defined in the board DTS based on Soc series.

  mxicy,timing-config:
    type: array
    default: [0, 0, 0, 0, 0, 0, 0, 0]
    description: |
      Array of tuples to configure the timing parameters
      default =
      <
        .ui8SioShifter    = 0,
        .ui8DQSDdrDelay   = 0,
        .ui8DdrDelay      = 0,
        .ui8SdrDelay      = 0,
        .ui32SioLowDelay  = 0,
        .ui32SioHighDelay = 0,
      >
```

## dts/bindings/mspi/nordic,nrf-exmif.yaml
```yaml
# Copyright (c) 2024 Nordic Semiconductor ASA
# SPDX-License-Identifier: Apache-2.0

description: Nordic External Memory Interface (EXMIF)

compatible: "nordic,nrf-exmif"

include: snps,designware-ssi.yaml
```

## dts/bindings/mspi/nordic,nrf-qspi-v2.yaml
```yaml
# Copyright (c) 2025 Nordic Semiconductor ASA
# SPDX-License-Identifier: Apache-2.0

description: Nordic QSPI v2 Interface using SSI IP

compatible: "nordic,nrf-qspi-v2"

include: snps,designware-ssi.yaml
properties:
  bits-per-pixel:
    type: int
    default: 0
    enum:
      - 0
      - 4
      - 8
      - 16
    description: |
      When using the peripheral to drive the display in controller mode, the wrapper needs to know
      how many bits per pixel (BPP) are being used. If 0, the reordering of the data based on the
      BPP is disabled.
```
