## dts/bindings/dai/amd,dmic-dai.yaml
```yaml
# SPDX-FileCopyrightText: Copyright (c) 2026 AMD
# SPDX-License-Identifier: Apache-2.0

description: AMD ACP DMIC (PDM) DAI (DMIC0/DMIC1)

compatible: "amd,dmic-dai"

include: [base.yaml]

properties:
  dai-index:
    type: int
    description: |
      DMIC instance index: 0=DMIC0 (PDM0), 1=DMIC1 (PDM1).
      Used by SOF to fetch the device for a given DAI index.
```

## dts/bindings/debug/infineon,cat1-trace.yaml
```yaml
# Copyright The Zephyr Project Contributors
# SPDX-License-Identifier: Apache-2.0

description: |
  Infineon CAT1 parallel trace port (Arm CoreSight SoC-600 / DEBUG600).

  Enabling this node routes the trace-clock and trace-data pins through HSIOM so
  an external trace probe can capture the ETM/ITM instruction trace off the
  trace port. This applies to the CAT1 MCUs that carry the DEBUG600 trace
  subsystem, such as PSOC Edge E84 (CAT1D) and PSOC Control C3 (CAT1B).

  On the parts with a secure world, two things can only be done by firmware
  running on the secure CM33, not by a debug host: routing the pins through HSIOM
  (a secure peripheral), and enabling the DEBUG600 trace-output clock (behind the
  SYS access port). This driver does both, so a debug host only has to program
  the trace fabric (the ETM, ATB funnel, ETF and TPIU) through the ordinary core
  access port. Without the trace clock the TPIU output path is unclocked and
  enabling it stalls the debug bus.

  The node is disabled by default. Enable it (and provide the pin group) from a
  board overlay or a trace snippet.

compatible: "infineon,cat1-trace"

include: [base.yaml, pinctrl-device.yaml]

properties:
  trace-port-width:
    type: int
    default: 4
    enum: [1, 2, 4]
    description: |
      Number of parallel trace data lanes in use. Informational: the pins that
      are actually routed are those listed in the pinctrl-0 group. Must match
      the TPIU port size the debug host programs.
```

## dts/bindings/disk/virtio,blk.yaml
```yaml
# SPDX-FileCopyrightText: Copyright (c) 2026 Process Mission
# SPDX-License-Identifier: Apache-2.0

description: VIRTIO Block device

compatible: "virtio,blk"

include: base.yaml

properties:
  disk-name:
    type: string
    required: true
    description: Disk name used by disk_access_* APIs.
```

## dts/bindings/disk/zephyr,ffat32-disk.yaml
```yaml
# Copyright (c) 2023 Nordic Semiconductor ASA
# SPDX-License-Identifier: Apache-2.0

description: |
  Fake FAT32 (FFAT32) disk
  Selects FAT32 for a fake FAT disk, use it together with the zephyr,ffat-disk
  compatible.

compatible: "zephyr,ffat32-disk"

include: zephyr,ffat-disk.yaml
```

## dts/bindings/disk/zephyr,semihost-disk.yaml
```yaml
# Copyright (c) 2026 RBR Ltd.
# SPDX-License-Identifier: Apache-2.0

description: Semihost file-backed disk

compatible: "zephyr,semihost-disk"

include:
  - base.yaml
  - name: zephyr,ram-disk.yaml
    property-allowlist:
      - disk-name
      - sector-size
      - sector-count

properties:
  filename:
    type: string
    default: "disk.bin"
    description: |
      Host-side file path for the disk backing store. Defaults to "disk.bin"
      in the working directory of the application providing semihosting
      services (typically the build folder). The file is created upon device
      initialization if it does not already exist, and extended with zeros
      to the disk size.
```

## dts/bindings/disk/zephyr,usb-msc-disk.yaml
```yaml
# Copyright (c) 2026 Espressif Systems (Shanghai) Co., Ltd.
# SPDX-License-Identifier: Apache-2.0

description: |
  Disk exposing a USB mass storage device attached to the USB host stack.

compatible: "zephyr,usb-msc-disk"

include: [base.yaml]

properties:
  disk-name:
    type: string
    required: true
    description: |
      Disk name.
```

## dts/bindings/disk/zephyr,virtual-fat-disk.yaml
```yaml
# Copyright (c) 2026 Leica Geosystems AG
# SPDX-License-Identifier: Apache-2.0

description: Virtual FAT disk device

compatible: "zephyr,virtual-fat-disk"

include: base.yaml

properties:
  sector-size:
    type: int
    default: 512
    description: |
      Reported sector size in bytes.
      Must be one of 512, 1024, 2048 or 4096.

  data-partition-size:
    type: int
    required: true
    description: |
      Size of the virtual FAT data partition in bytes.

  disk-name:
    type: string
    required: true
    description: |
      Disk name.
```

## dts/bindings/display/adi,adv7535-dsi.yaml
```yaml
# Copyright (C) 2026, Savoir-faire Linux, Inc.
# SPDX-License-Identifier: Apache-2.0

title: Analog Devices ADV7535 MIPI DSI endpoint

description: |
  MIPI DSI endpoint of an ADV7535 bridge. This is an auxiliary node: it only
  describes the DSI link so that the endpoint is enumerated by its MIPI DSI
  host parent. The corresponding I2C control device is described separately
  with an 'adi,adv7535' compatible node and has a reference to the DSI endpoint node.

compatible: "adi,adv7535-dsi"

include: mipi-dsi-device.yaml

properties:
  data-lanes:
    enum:
      - 2
      - 3
      - 4
    description: |
      Number of data lanes. ADV7535 supports from 2 to 4 DSI data lanes.
      This impacts what resolutions and refresh rates will be achievable.

  pixel-format:
    enum:
      - 0 # MIPI_DSI_PIXFMT_RGB888
    description: |
      Pixel format from dt-bindings/mipi_dsi/mipi_dsi.h. The bridge only
      supports MIPI_DSI_PIXFMT_RGB888.
```

## dts/bindings/display/adi,adv7535.yaml
```yaml
# Copyright (C) 2026, Savoir-faire Linux, Inc.
# SPDX-License-Identifier: Apache-2.0

title: Analog Devices ADV7535 MIPI DSI to HDMI bridge

description: |
  The ADV7535 is an I2C-controlled bridge that converts MIPI DSI video to HDMI.
  The MIPI DSI endpoint is represented separately as a child of the MIPI DSI host.

compatible: "adi,adv7535"

include: i2c-device.yaml

properties:
  reg:
    enum:
      - 0x39
      - 0x3d
    description: |
      Main register map I2C address. The address is 0x39 when PD/AD is pulled
      low and 0x3d when PD/AD is pulled high as power is applied.

  adi,edid-addr:
    type: int
    default: 0x3f
    description: Optional EDID I2C address. Default is the power-on reset value of the register.
  adi,packet-addr:
    type: int
    default: 0x38
    description: Optional packet I2C address. Default is the power-on reset value of the register.
  adi,cec-addr:
    type: int
    default: 0x3c
    description: Optional CEC I2C address. Default is the power-on reset value of the register.

  adi,fixed-addr:
    type: int
    default: 0x00
    description: |
      This should be set to a non-conflicting I2C address.
      Default is the power-on reset value of the register.

  dsi-device:
    type: phandle
    required: true
    description: |
      Auxiliary adi,adv7535-dsi node describing the DSI link of this
      bridge. It is a child of the MIPI DSI host the bridge is wired to.

  pd-gpios:
    type: phandle-array
    description: |
      GPIO connected to the PD/AD power-down pin. The pin level when the
      ADV7535 power supplies are applied selects both the main I2C address and
      the power-down polarity. A low level selects address 0x39 and active-high
      power-down, while a high level selects address 0x3d and active-low
      power-down. The GPIO flags must match the selected power-down polarity.
      Although this GPIO is optional, connecting it is strongly recommended
      because toggling the PD/AD pin resets more registers than a
      register-based reset. The I2C address and power-down polarity are sampled
      when power is applied. To change either setting, set the pin to the
      desired level and power-cycle the board.

  int-gpios:
    type: phandle-array
    required: true
    description: |
      Interrupt pin of ADV7535. Must be configured as active-low and pulled up.

  display-timing:
    type: phandle
    required: true
    description: |
      zephyr,panel-timing node describing the porches, sync lengths and pixel
      clock of the HDMI output. Its parent is the display controller node
      that owns the timing and carries the active area.

examples:
  - |
    #include <zephyr/dt-bindings/mipi_dsi/mipi_dsi.h>

    i2c {
      #address-cells = <1>;
      #size-cells = <0>;

      display-bridge@39 {
        compatible = "adi,adv7535";
        reg = <0x39>;
        pd-gpios = <&gpio0 0 GPIO_ACTIVE_HIGH>;
        int-gpios = <&gpio0 1 GPIO_ACTIVE_LOW>;
        dsi-device = <&adv7535_dsi>;
        display-timing = <&hdmi_timing>;

        /* Optional I2C addresses, if omitted defaults are used */
        adi,edid-addr = <0x3f>;
        adi,packet-addr = <0x38>;
        adi,cec-addr = <0x3c>;
        adi,fixed-addr = <0x00>;
      };
    };

    mipi_dsi: mipi-dsi@40000000 {
      compatible = "vnd,mipi-dsi-host";
      reg = <0x40000000 0x1000>;
      #address-cells = <1>;
      #size-cells = <0>;

      adv7535_dsi: display-bridge@0 {
        compatible = "adi,adv7535-dsi";
        reg = <0>;
        data-lanes = <4>;
        pixel-format = <MIPI_DSI_PIXFMT_RGB888>;
      };
    };

    display-controller {
      width = <1920>;
      height = <1080>;

      hdmi_timing: display-timings {
        compatible = "zephyr,panel-timing";
        clock-frequency = <148500000>;
        hsync-len = <44>;
        hfront-porch = <88>;
        hback-porch = <148>;
        vsync-len = <5>;
        vfront-porch = <4>;
        vback-porch = <36>;
        hsync-active = <1>;
        vsync-active = <1>;
        de-active = <1>;
        pixelclk-active = <1>;
      };
    };
```

## dts/bindings/display/axstechnology,axs15231b.yaml
```yaml
# SPDX-FileCopyrightText: Copyright 2026 NXP

title: Axstechnology AXS15231B Display controller

description: |
  The axstechnology AXS15231B is a 262K colors TFT-LCD controller
  with a maximum 170RGBx560 resolution.

compatible: "axstechnology,axs15231b"

include: [mipi-dbi-spi-device.yaml, display-controller.yaml]

properties:
  h-mirror:
    type: boolean
    description: Enable horizonal mirroring.

  v-mirror:
    type: boolean
    description: Enable vertical mirroring.

  swap-xy:
    type: boolean
    description: Swap X and Y coordinates.

  color-invert:
    type: boolean
    description: When present, inverts display colors.

  red-blue-swap:
    type: boolean
    description: |
      Inverting color format order (RGB->BGR or BGR->RGB)
      Panel controller expects RGB color channel order (not byte-order) instead of BGR.
```

## dts/bindings/display/chipone,co5300-common.yaml
```yaml
# Copyright 2025 NXP
# Copyright (c) 2026 Muhammad Waleed Badar
# SPDX-License-Identifier: Apache-2.0

title: Chipone CO5300 Display Controller

include: ["display-controller.yaml"]

properties:
  reset-gpios:
    type: phandle-array
    description: |
      The RESETn pin is asserted to disable the controller causing a hard
      reset.  The controller receives this as an active-low signal.

  backlight-gpios:
    type: phandle-array
    description: |
      The BLn pin is asserted to control the backlight of the panel.
      The controller receives this as an active-high signal.

  tear-effect-gpios:
    type: phandle-array
    description: |
      The tearing effect pin is asserted by the controller at a display
      VSYNC interval. This permits the controller to send new display
      data during a VSYNC interval, removing tearing.
```

## dts/bindings/display/chipone,co5300-mipi-dsi.yaml
```yaml
# Copyright 2025 NXP
# Copyright (c) 2026 Muhammad Waleed Badar
# SPDX-License-Identifier: Apache-2.0

description: Chipone CO5300 display controller on MIPI DSI bus

compatible: "chipone,co5300"

include: ["mipi-dsi-device.yaml", "chipone,co5300-common.yaml"]
```

## dts/bindings/display/chipone,co5300-mspi.yaml
```yaml
# Copyright (c) 2026 Muhammad Waleed Badar
# SPDX-License-Identifier: Apache-2.0

description: Chipone CO5300 display controller on MSPI bus

compatible: "chipone,co5300"

include: ["mspi-device.yaml", "chipone,co5300-common.yaml"]

properties:
  pixel-format:
    type: int
    required: true
    description: |
      Initial Pixel format of this controller's output data.
    enum:
      - 1 # PANEL_PIXEL_FORMAT_RGB_888
      - 16 # PANEL_PIXEL_FORMAT_RGB_565

  chunk-size:
    type: int
    default: 4096
    description: |
      Chunk size in bytes to be used for data transfers.

examples:
  - |
    #include <zephyr/dt-bindings/display/panel.h>

    co5300_display: co5300-display@0 {
      /* ... */

      pixel-format = <PANEL_PIXEL_FORMAT_RGB_565>;
    };
```

## dts/bindings/display/chipone,co5300-spi.yaml
```yaml
# Copyright (c) 2026 Muhammad Waleed Badar
# SPDX-License-Identifier: Apache-2.0

description: |
  Chipone CO5300 display controller on SPI bus.

  The CO5300's SPI protocol uses opcode/address framing: a fixed
  instruction byte (0x02) followed by a 3-byte address encoding the DCS
  command ({8'h00, CMD[7:0], 8'h00}), followed by the command's
  parameters or pixel data, all shifted out over a single data line.

compatible: "chipone,co5300"

include: ["spi-device.yaml", "chipone,co5300-common.yaml"]

properties:
  pixel-format:
    type: int
    required: true
    description: |
      Initial Pixel format of this controller's output data.
    enum:
      - 1 # PANEL_PIXEL_FORMAT_RGB_888
      - 16 # PANEL_PIXEL_FORMAT_RGB_565

examples:
  - |
    #include <zephyr/dt-bindings/display/panel.h>

    co5300_display: co5300-display@0 {
      /* ... */

      pixel-format = <PANEL_PIXEL_FORMAT_RGB_565>;
    };
```

## dts/bindings/display/display-controller.yaml
```yaml
# Copyright (c) 2021 Nordic Semiconductor ASA
# Common fields for display controllers

include: base.yaml

class: display

properties:
  height:
    type: int
    required: true
    description: |
      Height of the panel driven by the controller, with the units in pixels.

  width:
    type: int
    required: true
    description: |
      Width of the panel driven by the controller, with the units in pixels.
```

## dts/bindings/display/espressif,esp-dsi-display.yaml
```yaml
#
# Copyright (c) 2026 Espressif Systems (Shanghai) Co., Ltd.
#
# SPDX-License-Identifier: Apache-2.0
#

description: |
  Espressif ESP32 MIPI DSI DPI scanout controller.

  The DSI bridge streams a framebuffer to the DSI host DPI port, so it is
  the display controller for a video-mode panel attached to that host. It
  owns the framebuffers and is the node "zephyr,display" should point at,
  while the panel controller only performs its own initialization.

  This is a role of the MIPI DSI peripheral rather than a separate block,
  so the node is a child of the DSI host and carries no registers of its
  own. It is therefore the one child of that bus without a unit address,
  which keeps the addressed range free for the panels attached to the bus.

compatible: "espressif,esp-dsi-display"

include: [lcd-controller.yaml]

properties:
  interrupts:
    required: true

  dma-channel:
    type: int
    required: true
    min: 0
    max: 3
    description: |
      2D-DMA channel that streams the framebuffer to the DSI bridge.
```
