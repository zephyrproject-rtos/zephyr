## dts/bindings/display/espressif,esp32-dpi-display.yaml
```yaml
# Copyright (c) 2026 Espressif Systems (Shanghai) Co., Ltd.
# SPDX-License-Identifier: Apache-2.0

description: |
  Espressif ESP32 LCD_CAM parallel RGB (MIPI DPI) display controller.

  The controller streams a framebuffer over the LCD_CAM parallel RGB
  interface with HSYNC, VSYNC, DE and PCLK. This is a role of the LCD_CAM
  peripheral rather than a separate block, so the node is a child of the
  "espressif,esp32-lcd-cam" node and carries no registers of its own. Pin
  configuration and the "tx" DMA channel are taken from that parent node.

compatible: "espressif,esp32-dpi-display"

include: display-controller.yaml

properties:
  pclk-frequency:
    type: int
    required: true
    description: Pixel clock frequency in Hz

  hsync-len:
    type: int
    required: true
    description: Horizontal sync pulse width in pixel clocks

  hback-porch:
    type: int
    required: true
    description: Horizontal back porch width in pixel clocks

  hfront-porch:
    type: int
    required: true
    description: Horizontal front porch width in pixel clocks

  vsync-len:
    type: int
    required: true
    description: Vertical sync pulse width in lines

  vback-porch:
    type: int
    required: true
    description: Vertical back porch width in lines

  vfront-porch:
    type: int
    required: true
    description: Vertical front porch width in lines

  pclk-active-negative:
    type: boolean
    description: Sample data on the falling edge of PCLK

  data-width:
    type: int
    default: 16
    enum: [8, 16]
    description: Number of parallel data lines

  dma-burst-size:
    type: int
    default: 64
    enum: [16, 32, 64]
    description: GDMA burst size in bytes
```

## dts/bindings/display/espressif,esp32-lcd-cam-rgb.yaml
```yaml
# Copyright (c) 2026 Kim Bøndergaard <kim@fam-boendergaard.dk>
# SPDX-License-Identifier: Apache-2.0

description: |
  ESP32 LCD_CAM RGB display controller.

  Owns the framebuffer and streams it to a parallel RGB panel, so it is the
  node "zephyr,display" should point at. Pixel timing is given by a
  zephyr,panel-timing child node named display-timings.

compatible: "espressif,esp32-lcd-cam-rgb"

include: [base.yaml, display-controller.yaml]

properties:
  data-bus-width:
    type: int
    required: true
    enum: [16, 18, 24]
    description: Parallel RGB data bus width.

  display-controller:
    type: phandle
    description: |
      Phandle of the panel controller. Blanking calls are forwarded to it and
      it is initialized before the RGB stream starts.
```

## dts/bindings/display/espressif,esp32_rgb.yaml
```yaml
# Copyright (c) 2026 Espressif Systems (Shanghai) Co., Ltd.
# SPDX-License-Identifier: Apache-2.0

description: Espressif RGB parallel display

compatible: "espressif,esp32_rgb"

include: display-controller.yaml

properties:
  pclk-frequency:
    type: int
    required: true
    description: Pixel clock frequency in Hz

  hsync-len:
    type: int
    required: true
    description: Horizontal sync pulse width in pixel clocks

  hback-porch:
    type: int
    required: true
    description: Horizontal back porch width in pixel clocks

  hfront-porch:
    type: int
    required: true
    description: Horizontal front porch width in pixel clocks

  vsync-len:
    type: int
    required: true
    description: Vertical sync pulse width in lines

  vback-porch:
    type: int
    required: true
    description: Vertical back porch width in lines

  vfront-porch:
    type: int
    required: true
    description: Vertical front porch width in lines

  pclk-active-negative:
    type: boolean
    description: Sample data on the falling edge of PCLK

  data-width:
    type: int
    default: 16
    enum: [8, 16]
    description: Number of parallel data lines

  dma-burst-size:
    type: int
    default: 64
    enum: [16, 32, 64]
    description: GDMA burst size in bytes
```

## dts/bindings/display/fitipower,ek79007.yaml
```yaml
#
# Copyright (c) 2026 Espressif Systems (Shanghai) Co., Ltd.
#
# SPDX-License-Identifier: Apache-2.0
#

description: |
  EK79007 MIPI DSI display panel controller

compatible: "fitipower,ek79007"

include: [mipi-dsi-device.yaml, display-controller.yaml]

properties:
  reset-gpios:
    type: phandle-array
    description: |
      Reset GPIO pin (active low).

  bl-gpios:
    type: phandle-array
    description: |
      Backlight control GPIO pin (active high).
```

## dts/bindings/display/ilitek,ili9881c.yaml
```yaml
# SPDX-FileCopyrightText: 2026 Renesas Electronics Corporation
# SPDX-License-Identifier: Apache-2.0

description: |
   The Ilitek ILI9881C is a 16.7M colors TFT-LCD controller
   with a maximum 720RGBx1280 resolution.

compatible: "ilitek,ili9881c"

include: [mipi-dsi-device.yaml, display-controller.yaml]

properties:
  reset-gpios:
    type: phandle-array
    description: |
      The RESETn pin is asserted to disable the sensor causing a hard
      reset. The sensor receives this as an active-low signal.

  bl-gpios:
    type: phandle-array
    description: |
      The BLn pin is asserted to control the backlight of the panel.
      The sensor receives this as an active-high signal.
```

## dts/bindings/display/jdi,parallel.yaml
```yaml
# Copyright (c) 2026 Qingsong Gou <gouqs@hotmail.com>
# SPDX-License-Identifier: Apache-2.0

description: JDI parallel interface memory LCD display

compatible: "jdi,parallel"

include: display-controller.yaml

properties:
  clock-frequency:
    type: int
    description:
      JDI bus clock frequency in Hz. Used for parallel interface timing calculation.

  vlcd-gpios:
    type: phandle-array
    description: |
      GPIO for VLCD (LCD power rail) control.
      Active level is determined by the GPIO flags in the phandle.
      Power-on: VLCD enabled first; power-off: VLCD disabled last.

  vddp-gpios:
    type: phandle-array
    description: |
      GPIO for VDDP (logic power rail) control.
      Active level is determined by the GPIO flags in the phandle.
      Power-on: VDDP enabled after VLCD; power-off: VDDP disabled before VLCD.

  power-seq-delay-ms:
    type: int
    default: 11
    description: Delay in milliseconds between power sequencing steps (VLCD/VDDP).

  pwms:
    type: phandle-array
    description: |
      PWM specifier for the VCOM signal.
      The VCOM is a square wave (typically 60 Hz, 50% duty cycle) required
      by JDI memory-in-pixel displays to drive the liquid crystal with AC.
      The period specified here is used as the default; the driver sets
      50% duty cycle automatically.

  bank-col-head:
    type: int
    default: 0
    description: |
      Number of dummy columns at the start of each line.
      Used for JDI display timing configuration.

  valid-columns:
    type: int
    default: 0
    description: |
      Number of valid/active columns in the display.

  bank-col-tail:
    type: int
    default: 0
    description: |
      Number of dummy columns at the end of each line.

  bank-row-head:
    type: int
    default: 0
    description: |
      Number of dummy rows at the start of the frame.

  valid-rows:
    type: int
    default: 0
    description: |
      Number of valid/active rows in the display.

  bank-row-tail:
    type: int
    default: 0
    description: |
      Number of dummy rows at the end of the frame.

  enb-start-col:
    type: int
    default: 0
    description: |
      Enable signal start column position.

  enb-end-col:
    type: int
    default: 0
    description: |
      Enable signal end column position.

  enb-pol-invert:
    type: boolean
    description: |
      Invert the polarity of the ENB (enable) signal.

  hck-pol-invert:
    type: boolean
    description: |
      Invert the polarity of the HCK (horizontal clock) signal.

  hst-pol-invert:
    type: boolean
    description: |
      Invert the polarity of the HST (horizontal start) signal.

  vck-pol-invert:
    type: boolean
    description: |
      Invert the polarity of the VCK (vertical clock) signal.

  vst-pol-invert:
    type: boolean
    description: |
      Invert the polarity of the VST (vertical start) signal.
```

## dts/bindings/display/lontium,lt8912b.yaml
```yaml
# SPDX-FileCopyrightText: Copyright The Zephyr Project Contributors
# SPDX-License-Identifier: Apache-2.0

title: Lontium LT8912B MIPI DSI to HDMI bridge

description: |
    The Lontium LT8912B converts a MIPI DSI video mode stream into HDMI
    output. It is configured over I2C using three consecutive addresses
    (main page at reg, CEC/DSI page at reg+1, AVI page at reg+2).

    The video timings are declared in a display-timings child node and
    are handed both to the bridge and, through the MIPI DSI attach, to
    the DSI host.

compatible: "lontium,lt8912b"

include: [i2c-device.yaml, display-controller.yaml]

properties:
  mipi-dsi:
    type: phandle
    required: true
    description: |
      MIPI DSI host the bridge is connected to.

  data-lanes:
    type: array
    required: true
    description: |
      Number of MIPI DSI data lanes (1, 2, 3 or 4).

  reset-gpios:
    type: phandle-array
    description: |
      Reset pin. The bridge receives this as an active-low signal. If not
      provided, the power-on reset state is used.
```

## dts/bindings/display/newvision,nv3031b.yaml
```yaml
# SPDX-FileCopyrightText: Copyright The Zephyr Project Contributors
# SPDX-License-Identifier: Apache-2.0

title: NewVision NV3031B LCD (Liquid Crystal Display) controller

description: |
  NewVision NV3031B LCD controller using single-data-line SPI transfers
  with four-byte QSPI command framing. Panel-specific timing, power, and
  gamma properties contain register parameters without the command byte.

compatible: "newvision,nv3031b"

include: [spi-device.yaml, display-controller.yaml]

properties:
  reset-gpios:
    type: phandle-array
    required: true
    description: Active-low panel reset signal.

  supply-gpios:
    type: phandle-array
    description: Panel power enable signal.

  backlight-leds:
    type: phandles
    description: |
      LED child nodes that illuminate the panel. All are driven at the same
      brightness.

  brightness:
    type: int
    default: 127
    min: 0
    max: 255
    description: |
      Initial backlight brightness, from 0 (off) to 255 (maximum). Defaults
      to approximately half brightness to limit startup intensity.

  rotation:
    type: int
    default: 0
    enum: [0, 90, 180, 270]
    description: |
      Initial clockwise rotation in degrees. Width and height describe the
      panel before this rotation is applied.

  color-invert:
    type: boolean
    description: Enable display color inversion.

  red-blue-swap:
    type: boolean
    description: Set the BGR bit in the memory access control register.

  source-timing:
    type: uint8-array
    min-len: 1
    max-len: 1
    required: true
    description: Source timing register (0x60), 1 byte.

  gate-timing:
    type: uint8-array
    min-len: 2
    max-len: 2
    required: true
    description: Gate timing register (0x61), 2 bytes.

  inversion-control:
    type: uint8-array
    min-len: 1
    max-len: 1
    required: true
    description: Inversion control register (0xB4), 1 byte.

  frame-rate:
    type: uint8-array
    min-len: 3
    max-len: 3
    required: true
    description: Frame rate register (0xB1), 3 bytes.

  porch-control:
    type: uint8-array
    min-len: 4
    max-len: 4
    required: true
    description: Porch control register (0xB5), 4 bytes.

  display-function:
    type: uint8-array
    min-len: 5
    max-len: 5
    required: true
    description: Display function register (0xB6), 5 bytes.

  bias-trim:
    type: uint8-array
    min-len: 1
    max-len: 1
    required: true
    description: Bias trim register (0xDF), 1 byte.

  bias-current:
    type: uint8-array
    min-len: 1
    max-len: 1
    required: true
    description: Bias current register (0x67), 1 byte.

  power-control:
    type: uint8-array
    min-len: 4
    max-len: 4
    required: true
    description: Power control register (0x68), 4 bytes.

  gamma-positive-voltage:
    type: uint8-array
    min-len: 2
    max-len: 2
    required: true
    description: Positive gamma voltage register (0xE1), 2 bytes.

  gamma-negative-voltage:
    type: uint8-array
    min-len: 2
    max-len: 2
    required: true
    description: Negative gamma voltage register (0xE4), 2 bytes.

  gamma-positive-mid:
    type: uint8-array
    min-len: 6
    max-len: 6
    required: true
    description: Positive gamma mid-tone register (0xE2), 6 bytes.

  gamma-negative-mid:
    type: uint8-array
    min-len: 6
    max-len: 6
    required: true
    description: Negative gamma mid-tone register (0xE5), 6 bytes.

  gamma-positive:
    type: uint8-array
    min-len: 8
    max-len: 8
    required: true
    description: Positive gamma curve register (0xE0), 8 bytes.

  gamma-negative:
    type: uint8-array
    min-len: 8
    max-len: 8
    required: true
    description: Negative gamma curve register (0xE3), 8 bytes.

  power-slope:
    type: uint8-array
    min-len: 2
    max-len: 2
    required: true
    description: Power slope register (0xE6), 2 bytes.

  source-equalization:
    type: uint8-array
    min-len: 6
    max-len: 6
    required: true
    description: Source equalization register (0xE7), 6 bytes.

  source-level:
    type: uint8-array
    min-len: 3
    max-len: 3
    required: true
    description: Source output level register (0xE8), 3 bytes.

  gate-equalization:
    type: uint8-array
    min-len: 1
    max-len: 1
    required: true
    description: Gate equalization register (0xEC), 1 byte.
```
