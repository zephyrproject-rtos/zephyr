## dts/bindings/dai/nxp,dai-micfil.yaml
```yaml
# Copyright 2023 NXP
# SPDX-License-Identifier: Apache-2.0

description: NXP PDM MICFIL

compatible: "nxp,dai-micfil"

include: [base.yaml, pinctrl-device.yaml]

properties:
  reg:
    required: true
  dai-index:
    type: int
    description: |
      Use this property to specify the index of the DAI. At the
      moment, this is only used by SOF to fetch the "struct device"
      associated with the DAI whose index Linux passes to SOF
      through an IPC. If this property is not specified, the DAI
      index will be considered 0.
  fifo-depth:
    type: int
    required: true
    description: |
      Depth (in words) for each channel's FIFO.
```

## dts/bindings/dai/nxp,dai-sai.yaml
```yaml
# Copyright 2023 NXP
# SPDX-License-Identifier: Apache-2.0

description: |
  NXP Synchronous Audio Interface (SAI) node

  Below you may find some configuration examples:

  1) Configuring SAI1 for i.MX8QM MEK board

  #include <zephyr/dt-bindings/clock/imx_ccm.h>

  dai@59050000 {
    compatible = "nxp,dai-sai";
    reg = <0x59050000 DT_SIZE_K(64)>;
    interrupt-parent = <&master5>;
    interrupts = <28>;
    clocks = <&ccm IMX_CCM_SAI1_CLK 0x0 0x0>;
    clock-names = "bus";
    dai-index = <1>;
    dmas = <&edma0 15 0>, <&edma0 14 0>;
    dma-names = "tx", "rx";
    rx-fifo-watermark = <48>;
    tx-fifo-watermark = <2>;
    fifo-depth = <48>;
    rx-sync-mode = <1>;
  };

  2) Configuring SAI6 for i.MX8ULP EVK9 board

  dai@2da90000 {
    compatible = "nxp,dai-sai";
    reg = <0x2da90000 DT_SIZE_K(4)>;
    interrupt-parent = <&clic>;
    interrupts = <24 0 0>;
    dmas = <&edma2 0 72>, <&edma2 1 71>;
    dma-names = "tx", "rx";
    dai-index = <6>;
    rx-fifo-watermark = <8>;
    tx-fifo-watermark = <1>;
    fifo-depth = <8>;
    rx-sync-mode = <1>;
    tx-dataline = <2>;
  };

compatible: "nxp,dai-sai"

include: [base.yaml, pinctrl-device.yaml]

properties:
  reg:
    required: true
  mclk-is-output:
    type: boolean
    description: MCLK is configured as output.
  rx-fifo-watermark:
    type: int
    description: Watermark value (in FIFO words) of RX FIFO.
  tx-fifo-watermark:
    type: int
    description: Watermark value (in FIFO words) of TX FIFO.
  interrupts:
    required: true
  fifo-depth:
    type: int
    description: Size (in FIFO words) of the TX/RX FIFO.
  dai-index:
    type: int
    description: Index of the DAI instance. Must match Linux side.
  tx-sync-mode:
    type: int
    enum:
      - 0
      - 1
    description: |
      Transmitter synchronization mode.

      0: transmitter is ASYNC to receiver
      1: transmitter is SYNC with receiver
  rx-sync-mode:
    type: int
    enum:
      - 0
      - 1
    description: |
      Receiver synchronization mode.

      0: receiver is ASYNC to transmitter
      1: receiver is SYNC with transmitter
  tx-dataline:
    type: int
    description: |
      Index of the data line to transmit data on in multiline SAI instances.
  rx-dataline:
    type: int
    description: |
      Index of the data line to receive data on in multiline SAI instances.
```

## dts/bindings/dai/zephyr,virtual-dai.yaml
```yaml
# Copyright (c) 2025 Suraj Sonawane <surajsonawane0215@gmail.com>
# SPDX-License-Identifier: Apache-2.0

title: Zephyr binding for a Virtual DAI (Digital Audio Interface)

description: |
  This DAI is not connected to real hardware and is used for software-only
  audio routing or testing within SOF + Zephyr systems.

compatible: "zephyr,virtual-dai"

include: base.yaml

properties:
  dai-index:
    type: int
    description: |
      DAI index used to identify this virtual DAI in IPC and topology.
```

## dts/bindings/dali/nxp,dali-lpc11u6x.yaml
```yaml
description: DALI interface for nxp lpc11u6x

compatible: "nxp,dali-lpc11u6x"

include: base.yaml

properties:
  tx-rise-fall-delta-us:
    type: int
    description: |
      The time difference of the delays for falling versus the delay for
      rising edges when transmitting DALI frames. This value needs to be
      set to transmit with correct bit timings.
      The delay is measured in micro seconds.

  rx-rise-fall-delta-us:
    type: int
    description: |
      The time difference of the delays for falling versus the delay for
      rising edges when receiving DALI frames. This value needs to be set
      for correct identification of legal bit timings.
      The delay is measured in micro seconds.

  tx-rx-propagation-min-us:
    type: int
    description: |
      The minimal time from a transmitted change to read observation. This
      value needs to be set for proper collision detection.
      The delay is measured in micro seconds.

  tx-rx-propagation-max-us:
    type: int
    description: |
      The maximal time from a transmitted change to read observation.
      This value needs to be set for proper collision detection.
      The delay is measured in micro seconds.
```

## dts/bindings/dali/zephyr,dali-counter.yaml
```yaml
description: counter based DALI interface

compatible: "zephyr,dali-counter"

include: base.yaml

properties:
  counter:
    type: phandle
    required: true
    description: |
      The counter for signal transmission and receiving.

  chan-id-tx:
    type: int
    default: 0
    description: |
      Channel for Tx alarm.

  chan-id-collision:
    type: int
    default: 1
    description: |
      Channel for collision detection alarm.

  chan-id-stop:
    type: int
    default: 2
    description: |
      Channel for stop condition alarm.

  rx-gpios:
    type: phandle-array
    required: true
    description: |
      GPIO pin that connects to the DALI Rx pin.

  tx-gpios:
    type: phandle-array
    required: true
    description: |
      GPIO pin that connects to the DALI Tx pin.

  tx-flank-shift-us:
    type: int
    description: |
      Difference in propagation delay in ns between the falling and rising edge.
      If for example the high to low delay is 8 us and low to high is 22 us, then enter
      (-14) here. Keep in low µs range.

  rx-flank-shift-us:
    type: int
    description: |
      Difference in propagation delay in ns between the falling and rising edge.
      If for example the high to low delay is 47 us and low to high is 15 us, then enter
      (32) here. Keep in low µs range.

  tx-rx-propagation-max-us:
    type: int
    description: |
      The maximal time from a transmitted change to read observation.
      This value needs to be set for proper collision detection.
      The delay is measured in micro seconds.
```

## dts/bindings/dali/zephyr,dali-pwm.yaml
```yaml
description: PWM based DALI interface

compatible: "zephyr,dali-pwm"

include: base.yaml

properties:
  pwms:
    type: phandle-array
    required: true
    description: |
      The PWM unit will control the transmission of DALI frames.
      Recommended clock rate is 1 MHz. The minimum clock rate is 200 kHz to
      meet the requirements set by the DALI standard.

  counter:
    type: phandle
    required: true
    description: |
      This counter controls all the time critical actions for DALI transmitting and receiving.
      The minimum clock rate is 1 MHz to meet the requirements set by the DALI standard.

  chan-id-rx:
    type: int
    required: true
    description: |
      Counter channel for Rx-stopbit and collision timeout.

  chan-id-tx:
    type: int
    required: true
    description: |
      Counter channel for Tx re-programming.

  tx-prog-delay-us:
    type: int
    default: 0
    description: |
      Re-programming the PWM unit needs to be handled differently for different
      controllers. The re-programming is synchronized by the rx-edge-event.
      The PWM unit is programmed at the end of the PWM-period plus the tx-prog-delay-us
      value. It can be negative.

  rx-gpios:
    type: phandle-array
    required: true
    description: |
      GPIO pin that connects to the DALI Rx pin.

  tx-flank-shift-us:
    type: int
    required: true
    description: |
      Difference in propagation delay in us between the falling and rising edge when transmitting.
      If for example the high to low delay is 8 us and low to high is 22 us, then enter
      (-14) here. Keep in low us range. The value depends on the controller and the
      hardware implementation of the DALI physical interface.

  rx-flank-shift-us:
    type: int
    required: true
    description: |
      Difference in propagation delay in us between the falling and rising edge when receiving.
      If for example the high to low delay is 47 us and low to high is 15 us, then enter
      (32) here. Keep in low us range. The value depends on the controller and the
      hardware implementation of the DALI physical interface.

  tx-rx-propagation-max-us:
    type: int
    required: true
    description: |
      The maximal time from a transmitted change to read observation.
      This value needs to be set for proper collision detection.
      The delay is measured in us. The value depends on the controller and the
      hardware implementation of the DALI physical interface.

  rx-max-latency-us:
    type: int
    required: true
    description: |
      The maximal time from the change of a gpio pin state until the irq handler routine is entered.
      This value needs to be adjusted to ensure standard conforming reading of bit timings.
      The value depends on the controller and the hardware implementation of the DALI physical
      interface.

  rx-grey-area-us:
    type: int
    required: true
    description: |
      This value adds extra margin to inter-frame timings to add extra tolerances, required to
      pass test procedures.
```

## dts/bindings/debug/arm,armv7m-itm.yaml
```yaml
# Copyright 2022 NXP
# SPDX-License-Identifier: Apache-2.0

description: |
  ARMv7 instrumentation trace macrocell. Used for single wire output (SWO)

compatible: "arm,armv7m-itm"

include: arm,itm.yaml
```

## dts/bindings/debug/arm,armv8m-itm.yaml
```yaml
# Copyright 2022 NXP
# SPDX-License-Identifier: Apache-2.0

description: |
  ARMv8 instrumentation trace macrocell. Used for single wire output (SWO)

compatible: "arm,armv8m-itm"

include: arm,itm.yaml
```

## dts/bindings/debug/arm,itm.yaml
```yaml
# Copyright 2022 NXP
# SPDX-License-Identifier: Apache-2.0

# Common fields for ARM instrumentation trace macrocell
# Pin control property may be used for SWO pins

include: [base.yaml, pinctrl-device.yaml]

properties:
    swo-ref-frequency:
      type: int
      required: false
      description: Reference clock frequency for SWO if different than CPU clock.
```

## dts/bindings/debug/arm,stmesp.yaml
```yaml
# Copyright 2024 Nordic Semiconductor ASA
# SPDX-License-Identifier: Apache-2.0

# Common fields for ARM instrumentation System Trace Macrocell Extended Stimulus Port (STMESP)

description: System Trace Macrocell Extended Stimulus Port (STMESP)

compatible: "arm,stmesp"

include: base.yaml
```

## dts/bindings/debug/nordic,coresight-nrf.yaml
```yaml
# Copyright (c) 2025 Nordic Semiconductor ASA
# SPDX-License-Identifier: Apache-2.0

description: Nordic Coresight Subsystem (Trace Port Interface Unit)

compatible: "nordic,coresight-nrf"

include: [base.yaml, pinctrl-device.yaml, nordic-clockpin.yaml]

properties:
  reg:
    required: true

  mode:
    required: true
    type: string
    enum:
      - "unconfigured"
      - "stm-tpiu"
      - "stm-etr"
    description: >
      Specifies which mode to configure the Coresight subsystem in.
```

## dts/bindings/debug/silabs,pti.yaml
```yaml
# Copyright (c) 2025 Silicon Laboratories Inc.
# SPDX-License-Identifier: Apache-2.0

description: Silicon Labs Packet Trace Interface

compatible: "silabs,pti"

include: [base.yaml, pinctrl-device.yaml]

properties:
  clock-frequency:
    type: int
    description: |
      Clock frequency for PTI signal in Hz.

  mode:
    type: string
    enum:
      - disabled
      - spi
      - uart
      - uart-onewire
    description: |
      Packet Trace mode.
```

## dts/bindings/debug/wch,qingke-debug.yaml
```yaml
# Copyright (c) 2025 Michael Hope <michaelh@juju.nz>
# SPDX-License-Identifier: Apache-2.0

description: WCH QingKe Debug Module

compatible: "wch,qingke-debug"

include: base.yaml
```

## dts/bindings/dfpmcch/intel,adsp-dfpmcch.yaml
```yaml
# Copyright (c) 2022 Intel Corporation
#
# SPDX-License-Identifier: Apache-2.0

description: Intel ADSP Power Management / Clock Control (HST domain) registers

compatible: "intel,adsp-dfpmcch"

include: base.yaml

properties:
  reg:
    required: true
```

## dts/bindings/dfpmccu/intel,adsp-dfpmccu.yaml
```yaml
# Copyright (c) 2022 Intel Corporation
#
# SPDX-License-Identifier: Apache-2.0

description: Intel ADSP Power Management / Clock Control (ULP domain) Registers

compatible: "intel,adsp-dfpmccu"

include: base.yaml

properties:
  reg:
    required: true
```

## dts/bindings/digipot/adi,ad5280.yaml
```yaml
# Copyright (c) 2025 Jocelyn Masserot <jocemass@gmail.com>
# SPDX-License-Identifier: Apache-2.0

description: Driver for AD5280 Digital Potentiometer.

compatible: "adi,ad5280"

include: adi,ad528x-base.yaml
```

## dts/bindings/digipot/adi,ad528x-base.yaml
```yaml
# Copyright (c) 2025 Jocelyn Masserot <jocemass@gmail.com>
# SPDX-License-Identifier: Apache-2.0

include: [digipot-controller.yaml]

properties:
  "#io-channel-cells":
    const: 1

io-channel-cells:
  - output
```

## dts/bindings/digipot/digipot-controller.yaml
```yaml
# Copyright (c) 2025 Jocelyn Masserot <jocemass@gmail.com>
# SPDX-License-Identifier: Apache-2.0

# Common fields for Digital potentiometer controllers

include: base.yaml

properties:
  "#io-channel-cells":
    type: int
    required: true
```

## dts/bindings/disk/nvme-controller.yaml
```yaml
# Copyright (c) 2022, Intel Corporation
# SPDX-License-Identifier: Apache-2.0

description: NVME Bus controller node

compatible: "nvme-controller"

include: [base.yaml, pcie-device.yaml]
```

## dts/bindings/disk/zephyr,eeprom-disk.yaml
```yaml
# Copyright (c) 2024 Vitrolife A/S
# SPDX-License-Identifier: Apache-2.0

description: EEPROM disk

compatible: "zephyr,eeprom-disk"

include: "base.yaml"

properties:
  disk-name:
    type: string
    required: true
    description: |
      Disk name.

  disk-size:
    type: int
    required: true
    description: |
      Total disk size in bytes.

  sector-size:
    type: int
    default: 1
    description: |
      Disk sector size in bytes if the eeprom has sectors.

  eeprom-device:
    type: phandle
    required: true
    description: |
      A reference to the eeprom.
```

## dts/bindings/disk/zephyr,ffat-disk.yaml
```yaml
# Copyright (c) 2023 Nordic Semiconductor ASA
# SPDX-License-Identifier: Apache-2.0

description: |
  Fake FAT (FFAT) disk
  FFAT disk emulates a disk formatted with the FAT16 or FAT32 file system to
  export specific data or information to a host system, for example, using USB
  MSC support. This binding is a format to describe the virtual disk geometry
  as if it were a real hardware disk, so the resulting fake file system
  capacity is slightly smaller.

compatible: "zephyr,ffat-disk"

include: base.yaml

properties:
  disk-name:
    type: string
    required: true
    description: |
      Disk name.

  sector-size:
    type: int
    required: true
    enum:
      - 512
      - 1024
      - 2048
      - 4096
    description: |
      Sector size in bytes. Select it based on the granularity of the exported
      data and, for example, the bootloader protocol overhead, if any.

  sector-count:
    type: int
    required: true
    description: |
      Number of sectors, it defines the capacity of the disk. For a FFAT16 disk
      the allowed range is 4085 (0x0FF5) to 65524 (0xFFF4) and for a FFAT32 disk
      the allowed range is 65525 (0x0000FFF5) to 268435444 (0x0FFFFFF4).

  sector-per-cluster:
    type: int
    required: true
    enum:
      - 1
      - 2
      - 4
      - 8
      - 16
      - 32
      - 64
    description: |
      Number of sectors per cluster.
```
