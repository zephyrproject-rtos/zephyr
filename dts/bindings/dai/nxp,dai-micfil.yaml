## dts/bindings/disk/zephyr,ftl-dhara.yaml
```yaml
# Copyright (c) 2025 Endress+Hauser GmbH+Co. KG
# SPDX-License-Identifier: Apache-2.0

description: |
  Flash translation layer disk driver with Dhara implementation on flash partition.

compatible: "zephyr,ftl-dhara"

properties:
  partition:
    type: phandle
    required: true
    description: |
      Backing storage flash map partition.

  disk-name:
    type: string
    required: true
    description: |
      Disk name.

  buffer-size:
    type: int
    required: true
    description: |
      Buffer size in bytes for the FTL driver. Must be equal or greater than the page size of the
      backing flash.

  gc-ratio:
    type: int
    default: 15
    description: |
      Garbage collection ratio for the FTL driver. This is the ratio of garbage collection
      operations to real writes when automatic collection is active. Smaller values lead to faster
      and more predictable input/output at the expense of capacity.
```

## dts/bindings/disk/zephyr,memc-ram-disk.yaml
```yaml
# Copyright (c) 2026 Nordic Semiconductor ASA
# SPDX-License-Identifier: Apache-2.0

description: |
  RAM disk backed by an external memory device accessed through the MEMC
  subsystem API (memc_read / memc_write).

compatible: "zephyr,memc-ram-disk"

include:
  - name: zephyr,ram-disk.yaml
    property-allowlist:
      - disk-name
      - sector-size
      - sector-count

properties:
  memc:
    type: phandle
    required: true
    description: |
      Phandle to the MEMC device that manages the backing memory.
      The referenced device must implement the MEMC driver API.
```

## dts/bindings/disk/zephyr,ram-disk.yaml
```yaml
# Copyright (c) 2023 Nordic Semiconductor ASA
# Copyright (c) 2024 Siemens AG
# SPDX-License-Identifier: Apache-2.0

description: RAM disk

compatible: "zephyr,ram-disk"

include: ["base.yaml", "memory-region.yaml"]

properties:
  disk-name:
    type: string
    required: true
    description: |
      Disk name.

  sector-size:
    type: int
    required: true
    enum: [512, 1024, 2048, 4096, 8192, 16384, 32768, 65536]
    description: |
      Disk sector size in bytes.

  sector-count:
    type: int
    required: true
    description: |
      Number of sectors.

  ram-region:
    type: phandle
    description: |
      Optional phandle to the memory region to be used as a RAM disk,
      if not used, and 'zephyr,disk-image-path' property is also not used, a
      local buffer is defined for each disk instance. Use it with caution as it
      makes memory contents easily accessible.

  zephyr,disk-image-path:
    type: string
    description: |
      Optional path of a disk image, on the build host system, to be used as
      backing store of a RAM disk. Make sure that 'sector-size' matches the
      corresponding value used in the existing filesystem (if any) on the disk
      image. The value of 'sector-count' will be ignored and overridden with the
      value computed automatically from the disk image size, at build time.
```

## dts/bindings/display/backlight-pwm.yaml
```yaml
# Copyright (c) 2024, Maritn Kiepfer
# SPDX-License-Identifier: Apache-2.0

description: Backlight PWM node

compatible: "backlight-pwm"

include: [base.yaml, backlight.yaml]

properties:
  pwms:
    required: true
    type: phandle-array
    description: |
      Reference to a PWM instance.

      The period field is used by the set_brightness function of the
      Backlight-PWM API.
      Its value should at least be greater than 100 nanoseconds (for a full
      brigtness granularity) and lesser than 50 milliseconds (average visual
      persistence time of the human eye). Typical values for the PWM period
      are 10 or 20 milliseconds.

clock-cells:
  - id
```
