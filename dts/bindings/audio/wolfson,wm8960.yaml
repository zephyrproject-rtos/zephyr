## dts/bindings/auxdisplay/nxp,slcd-panel.yaml
```yaml
# SPDX-License-Identifier: Apache-2.0

description: |
  Common child-node properties for NXP SLCD panel (glass) wiring.

  A panel node is a child node of an "nxp,slcd" controller node.

  Specific panel compatibles (e.g. nxp,slcd-panel-od-6010) may further
  constrain required property values (e.g. fixed max-digits and required
  com-pins/d-pins array lengths).

include: base.yaml

properties:
  panel-name:
    type: string
    description: |
      Panel identifier string.

      The SLCD controller driver uses this to select a matching
      mcux_slcd_panel_api backend (by comparing to mcux_slcd_panel_api.name).

  max-digits:
    type: int
    description: |
      Maximum number of digits supported by this panel wiring.

      If not specified in devicetree, the panel-specific binding may provide a
      default.

  com-pins:
    type: uint8-array
    required: true
    description: LCD pin indices for COM0..COM7 (backplanes).

  d-pins:
    type: uint8-array
    required: true
    description: LCD pin indices for D0..D62 (frontplanes).

  dot-pos:
    type: uint8-array
    description: |
      List of digit indices (0-based) where a decimal point '.' is supported.

  colon-pos:
    type: uint8-array
    description: |
      List of digit indices (0-based) where a ':' separator is supported.

  colon-routing:
    type: uint8-array
    description: |
      Routing information for ':' separator segments.

      This is a list of 3-tuples:
        <pos d_idx0 d_idx1>

      Where:
        - pos is the colon position (0-based digit index)
        - d_idx0/d_idx1 are indices into the panel's d-pins[] list

      Use 255 for d_idx1 if the colon is a single segment.

  rotate-180:
    type: boolean
    description: |
      If set, the panel driver applies a 180-degree rotation remap to the
      internal 7-seg encoding before mapping to frontplane pins.
```

## dts/bindings/auxdisplay/nxp,slcd.yaml
```yaml
# Copyright 2026 NXP
# SPDX-License-Identifier: Apache-2.0

description: |
  NXP MCUX Segment LCD (SLCD) controller used as segment-style
  auxiliary display.

compatible: "nxp,slcd"

include: [base.yaml, pinctrl-device.yaml]

properties:
  reg:
    required: true

  pin-list:
    type: array
    description: |
      The list of front plane PINs of the controller that are used to control the
      segments/indicators. Set the value according to actual hardware pin-mux. For
      example, <12 13 14 15 8 9 10 11> means the panel has 8 front plane pins in
      total, and the controller uses pin 12~15 to control the panel's pin 0~3, and
      uses pin 8~11 to control the panel's pin 4~7.

  com-list:
    type: array
    description: |
      The list of back plane PINs of the controller that are used to control the
      segments/indicators. Set the value according to actual hardware pin-mux, similar
      to pin-list.

  blink-rate:
    type: int
    default: 1
    enum: [0, 1, 2, 3, 4, 5, 6, 7]
    description: |
      SLCD blink rate selection (0-7). Maps to slcd_blink_rate_t values.
      - 0: kSLCD_BlinkRate00 - LCD clock/((2^11)) or LCD clock/((2^12))
      - 1: kSLCD_BlinkRate01 - LCD clock/((2^12)) or LCD clock/((2^13))
      - 2: kSLCD_BlinkRate02 - LCD clock/((2^13)) or LCD clock/((2^14))
      - 3: kSLCD_BlinkRate03 - LCD clock/((2^14)) or LCD clock/((2^15))
      - 4: kSLCD_BlinkRate04 - LCD clock/((2^15)) or LCD clock/((2^16))
      - 5: kSLCD_BlinkRate05 - LCD clock/((2^16)) or LCD clock/((2^17))
      - 6: kSLCD_BlinkRate06 - LCD clock/((2^17)) or LCD clock/((2^18))
      - 7: kSLCD_BlinkRate07 - LCD clock/((2^18)) or LCD clock/((2^19))
      Default is 1 (kSLCD_BlinkRate01).
```

## dts/bindings/auxdisplay/ptc,pt6314.yaml
```yaml
# Copyright (c) 2023 Chen Xingyu <hi@xingrz.me>
# SPDX-License-Identifier: Apache-2.0

description: PTC PT6314 Dot Character VFD Controller/Driver IC

compatible: "ptc,pt6314"

include: [auxdisplay-device.yaml, spi-device.yaml]

properties:
  columns:
    enum:
      - 16
      - 20
      - 24

  rows:
    enum:
      - 1
      - 2
```

## dts/bindings/auxdisplay/slcd-panel-7-segment.yaml
```yaml
# Copyright 2026 NXP
# SPDX-License-Identifier: Apache-2.0

description: 7-segment LCD panel device

compatible: "slcd-7segment"

include: slcd-panel.yaml
```

## dts/bindings/auxdisplay/slcd-panel.yaml
```yaml
# Copyright 2026 NXP
# SPDX-License-Identifier: Apache-2.0

description: |
  Segment LCD Panel Device

  Represents a SLCD(segment LCD) panel connected to an SLCD controller.
  The SLCD panel defines the characteristics of the display including
  segment type, how many positions of digits/letters and indicators, the
  front plane pins and back plane COMs used by this panel, and the
  multiplexing configuration.

compatible: "slcd-panel"

include: auxdisplay-device.yaml

properties:
  segment-type:
    type: int
    default: 7
    enum: [7, 14, 16]
    description: |
      Number of segments per character position.
      - 7:  Standard 7-segment display (segments A to G, support digits 0 to 9)
      - 14: 14-segment display (not supported yet)
      - 16: 16-segment display (not supported yet)

  segment-pins:
    type: array
    description: |
      2-D array of the pins that controls each segment.

      Array dimensions: num-positions x num-segments
      For a 7-segment(segment A to G) display with 6 positions, array size
      is 6 x 7 = 42 elements

      Example: If segment A (first segment) of position 1 (zero based index) is
      controlled by pin 8 com 3, then the (1,0) element of this array is 8.

  segment-coms:
    type: array
    description: |
      2-D array of the coms that controls each segment.

      Array dimensions: num-positions x num-segments
      For a 7-segment(segment A to G) display with 6 positions, array size
      is 6 x 7 = 42 elements

      Example: If segment A (first segment) of position 1 (zero based index) is
      controlled by pin 8 com 3, then the (1,0) element of this array is 3.

  num-indicators:
    type: int
    default: 0
    description: |
      Number of special indicators on the display.
      Indicators are individual segments that are not part of standard character positions.
      For example, a colon, decimal point, or status indicator would count as one indicator.

  indicator-pins:
    type: array
    description: |
      1-D array of the pins that controls each indicator.

      Example: if indicator 0 controlled by pin 15, COM4, the first element of
      this array is 15.

  indicator-coms:
    type: array
    description: |
      1-D array of the coms that controls each indicator.

      Example: if indicator 0 controlled by pin 15, COM4, the first element of
      this array is 4.

  col-indicators:
    type: array
    description: |
      List of indicator indices for the combined colon column at each inter-digit gap.
      Length must be columns - 1. Use 0xFF for gaps that have no colon indicator.
      When writing ':', this indicator is used preferentially. If absent or 0xFF at a gap,
      the driver falls back to setting both upper-dot-indicators and lower-dot-indicators.

  upper-dot-indicators:
    type: array
    description: |
      List of indicator indices for the upper dot at each inter-digit gap.
      Length must be columns - 1. Use 0xFF for gaps with no upper dot.
      Used as fallback for ':' (together with lower-dot-indicators) when col-indicators
      is absent or 0xFF at a gap.

  lower-dot-indicators:
    type: array
    description: |
      List of indicator indices for the lower dot at each inter-digit gap.
      Length must be columns - 1. Use 0xFF for gaps with no lower dot.
      Used for '.' character and as fallback for ':' together with upper-dot-indicators.
```

## dts/bindings/auxdisplay/sparkfun,serlcd.yaml
```yaml
# Copyright (c) 2023 Jan Henke <Jan.Henke@taujhe.de>
# SPDX-License-Identifier: Apache-2.0

description: |
  SparkFun SerLCD Dot Character VFD Controller/Driver IC

  Example:
    &i2c1 {
      serlcd@72 {
        compatible = "sparkfun,serlcd";
        reg = <0x72>;
        columns = <16>;
        rows = <2>;
        command-delay = <10>;
        special-command-delay = <50>;
      };
    };

compatible: "sparkfun,serlcd"

include: [auxdisplay-device.yaml, i2c-device.yaml]

properties:
  columns:
    type: int
    default: 16
    enum:
      - 16
      - 20

  rows:
    type: int
    default: 2
    enum:
      - 2
      - 4

  command-delay-ms:
    type: int
    default: 10
    description: |
      Delay in milliseconds (defaults to 10ms if not set) after a normal command was sent.
      The default value is based on the original SparkFun SerLCD library
      implementation which assumes 100 kbps I2C configuration. This value
      might require tweaking if using I2C at a higher bitrare and/or relativily
      high update frequency of the display.

  special-command-delay-ms:
    type: int
    default: 50
    description: |
      Delay in milliseconds (defaults to 50ms if not set) after a special command was sent.
      The default value is based on the original SparkFun SerLCD library
      implementation which assumes 100 kbps I2C configuration. This value
      might require tweaking if using I2C at a higher bitrare and/or relativily
      high update frequency of the display.
```

## dts/bindings/auxdisplay/st,gh08172t.yaml
```yaml
#
# Copyright (c) 2026 Renato Mauro
#
# SPDX-License-Identifier: Apache-2.0
#

description:
  GH08172T 14 Segment LCD Controller (Glass Display Interface).
  This binding describes the internal liquid crystal display controller peripheral
  present on STM32 microcontrollers, mapped to a 14-segment auxiliary text interface.

compatible: "st,gh08172t"

include: [auxdisplay-device.yaml, pinctrl-device.yaml]

properties:
  reg:
    required: true
    description: Base address and length of the LCD peripheral register block.

  clocks:
    required: true
    description: Phandle to the clock controller and clock gating information.

  pinctrl-0:
    required: true
    description: |
      Array of phandles to pin configuration nodes (COM/SEG lines via AF11).

  pinctrl-names:
    required: true
    const:
      - default

  lcd-timeout-ms:
    type: int
    default: 100
    description: |
      Timeout in ms to wait after issuing LCD operations such as Update Request
      or waiting for Readyness.
```
