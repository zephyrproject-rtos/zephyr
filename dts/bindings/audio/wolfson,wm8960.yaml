## dts/bindings/audio/wolfson,wm8960.yaml
```yaml
# Copyright 2026 NXP
# SPDX-License-Identifier: Apache-2.0

description: Wolfson Microelectronics WM8960 Audio CODEC

include: i2c-device.yaml

compatible: "wolfson,wm8960"

properties:
  reg:
    required: true

  clk-out:
    type: boolean
    description: |
      Enable SYSCLK output on GPIO1.

  hp-jd:
    type: string
    default: "WM8960_GPIO1"
    description: |
      Selects the headphone jack detect input. Defaults to "WM8960_GPIO1",
      as this is the chip's default configuration.

      - "WM8960_GPIO1": GPIO1 pin
      - "WM8960_JD2": JD2 pin
      - "WM8960_JD3": JD3 pin
    enum:
      - "WM8960_GPIO1"
      - "WM8960_JD2"
      - "WM8960_JD3"

  gpio1-sel:
    type: string
    default: "WM8960_JDO"
    description: |
      Selects the GPIO1 function. Defaults to "WM8960_JDO", as this the chip's
      default configuration.

      - "WM8960_JDO": jack detect output
      - "WM8960_Reserved": reserved function
      - "WM8960_DJDO": debounced jack detect output
      - "WM8960_TEMP_OK": temperature status output
      - "WM8960_SYSCLK_OUT": SYSCLK output
      - "WM8960_PLL_LOCK": PLL lock status output
    enum:
      - "WM8960_JDO"
      - "WM8960_Reserved"
      - "WM8960_DJDO"
      - "WM8960_TEMP_OK"
      - "WM8960_SYSCLK_OUT"
      - "WM8960_PLL_LOCK"

  left-input:
    type: string
    default: "WM8960_IN_MUTE"
    description: |
      Selects the default left audio input. Defaults to
      "WM8960_IN_MUTE".

      - "WM8960_IN_MUTE": muted, no input
      - "WM8960_IN_MIC_SE_1": microphone, single-ended on 1
      - "WM8960_IN_MIC_SE_2": microphone, single-ended on 2
      - "WM8960_IN_MIC_SE_3": microphone, single-ended on 3
      - "WM8960_IN_MIC_DE_12": microphone, differential on 1 and 2
      - "WM8960_IN_MIC_DE_13": microphone, differential on 1 and 3
      - "WM8960_IN_MIC_DE_23": microphone, differential on 2 and 3
      - "WM8960_IN_LINE_2": line input on 2
      - "WM8960_IN_LINE_3": line input on 3
    enum:
      - "WM8960_IN_MUTE"
      - "WM8960_IN_MIC_SE_1"
      - "WM8960_IN_MIC_SE_2"
      - "WM8960_IN_MIC_SE_3"
      - "WM8960_IN_MIC_DE_12"
      - "WM8960_IN_MIC_DE_13"
      - "WM8960_IN_MIC_DE_23"
      - "WM8960_IN_LINE_2"
      - "WM8960_IN_LINE_3"

  right-input:
    type: string
    default: "WM8960_IN_MUTE"
    description: |
      Selects the default right audio input. Defaults to
      "WM8960_IN_MUTE".

      - "WM8960_IN_MUTE": muted, no input
      - "WM8960_IN_MIC_SE_1": microphone, single-ended on 1
      - "WM8960_IN_MIC_SE_2": microphone, single-ended on 2
      - "WM8960_IN_MIC_SE_3": microphone, single-ended on 3
      - "WM8960_IN_MIC_DE_12": microphone, differential on 1 and 2
      - "WM8960_IN_MIC_DE_13": microphone, differential on 1 and 3
      - "WM8960_IN_MIC_DE_23": microphone, differential on 2 and 3
      - "WM8960_IN_LINE_2": line input on 2
      - "WM8960_IN_LINE_3": line input on 3
    enum:
      - "WM8960_IN_MUTE"
      - "WM8960_IN_MIC_SE_1"
      - "WM8960_IN_MIC_SE_2"
      - "WM8960_IN_MIC_SE_3"
      - "WM8960_IN_MIC_DE_12"
      - "WM8960_IN_MIC_DE_13"
      - "WM8960_IN_MIC_DE_23"
      - "WM8960_IN_LINE_2"
      - "WM8960_IN_LINE_3"

  enable-spkr:
    type: boolean
    description: |
      Enable the speaker (Class D) audio output by default.
```

## dts/bindings/audio/wolfson,wm8962.yaml
```yaml
# Copyright 2025 NXP
# SPDX-License-Identifier: Apache-2.0

description: WM8962 audio codec

include: [i2c-device.yaml]

compatible: "wolfson,wm8962"

properties:
  reg:
    required: true
  clock-source:
    type: string
    default: "MCLK"
    description: |
      Codec's internal clock signal (SYSCLK) source selection. These options
      are available:
      - "MCLK": wm8962's MCLK pin (supplied by the host)
      - "FLL":  wm8962's FLL facility, can be free-running
      The "MCLK" option is default, as this clock signal is usually supplied
      by the host.
    enum:
      - "MCLK"
      - "FLL"
```

## dts/bindings/audio/zephyr,codec-dummy-stub.yaml
```yaml
# Copyright 2026 NXP
# SPDX-License-Identifier: Apache-2.0

description: Codec dummy stub

compatible: "zephyr,codec-dummy-stub"

include: base.yaml
```

## dts/bindings/audio/zephyr,dummy-codec.yaml
```yaml
# Copyright 2026 NXP
# SPDX-License-Identifier: Apache-2.0

description: Dummy codec

compatible: "zephyr,dummy-codec"

include: base.yaml
```

## dts/bindings/audio/zephyr,native-sim-dmic.yaml
```yaml
# Copyright 2026 NXP
# SPDX-License-Identifier: Apache-2.0

description: Native simulator Digital Microphone controller

compatible: "zephyr,native-sim-dmic"

include: base.yaml

properties:
  max-channels:
    type: int
    default: 16
    description: |
      Maximum number of PCM channels accepted by this instance.
```

## dts/bindings/audio/zephyr,pdm-dmic.yaml
```yaml
# Copyright (c) 2025 Embeint Pty Ltd
# SPDX-License-Identifier: Apache-2.0

description: Generic Digital Microphone configuration

compatible: "zephyr,pdm-dmic"

include: ["pdm-dmic.yaml"]
```

## dts/bindings/auxdisplay/auxdisplay-device.yaml
```yaml
# Copyright (c) 2022 Jamie McCrae
# SPDX-License-Identifier: Apache-2.0

# Common fields for auxiliary (text) displays

include: base.yaml

properties:
  columns:
    type: int
    required: true
    description: Number of text columns that the display has

  rows:
    type: int
    required: true
    description: Number of text rows that the display has
```

## dts/bindings/auxdisplay/gpio-7-segment.yaml
```yaml
# Copyright (c) 2024-2025 Chen Xingyu <hi@xingrz.me>
# SPDX-License-Identifier: Apache-2.0

description: |
  Common GPIO-driven 7-Segment Display

  A 7-segment display is a form of electronic display device for displaying
  decimal numerals that is an alternative to the more complex dot matrix
  displays. Seven-segment displays are widely used in digital clocks, electronic
  meters, basic calculators, and other electronic devices that display numerical
  information.

  This driver supports 7-segment displays driven by GPIOs, in a widely used
  circuit design either common anode or common cathode.

  In common anode design, digit-gpios and segment-gpios are configured as active
  high and active low respectively, meaning that the current flows from
  digit-gpios to segment-gpios. Vice versa for common cathode.

  Example:

  #include <zephyr/dt-bindings/gpio/gpio.h>

  / {
          auxdisplay_0: digi-display {
                  compatible = "gpio-7-segment";
                  columns = <3>;
                  rows = <1>;
                  segment-gpios = <&gpio0 0 GPIO_ACTIVE_LOW>, /* A */
                                  <&gpio0 1 GPIO_ACTIVE_LOW>, /* B */
                                  <&gpio0 2 GPIO_ACTIVE_LOW>, /* C */
                                  <&gpio0 3 GPIO_ACTIVE_LOW>, /* D */
                                  <&gpio0 4 GPIO_ACTIVE_LOW>, /* E */
                                  <&gpio0 5 GPIO_ACTIVE_LOW>, /* F */
                                  <&gpio0 6 GPIO_ACTIVE_LOW>, /* G */
                                  <&gpio0 7 GPIO_ACTIVE_LOW>; /* DP */
                  digit-gpios = <&gpio1 0 GPIO_ACTIVE_HIGH>,  /* DIG1 */
                                <&gpio1 1 GPIO_ACTIVE_HIGH>,  /* DIG2 */
                                <&gpio1 2 GPIO_ACTIVE_HIGH>;  /* DIG3 */
                  refresh-period-ms = <1>;
          };
  };

compatible: "gpio-7-segment"

include: auxdisplay-device.yaml

properties:
  segment-gpios:
    type: phandle-array
    required: true
    description: |
      GPIOs used to control the segments.

      Segments are usually labeled A to G, and DP for the decimal point. The
      GPIOs must be listed in the order A, B, C, D, E, F, G and an optional DP.
      The following diagram shows the segment layout:

           -- A --
          |       |
          F       B
          |       |
           -- G --
          |       |
          E       C
          |       |
           -- D --  (DP)

      The number of GPIOs must be 7 for a 7-segment display, or 8 for a 7-segment
      display with a decimal point.

  digit-gpios:
    type: phandle-array
    required: true
    description: |
      GPIOs used to control the digits (the common anodes or cathodes).

      The number of GPIOs must match the number of digits.

  refresh-period-ms:
    type: int
    required: true
    description: |
      The refresh period in milliseconds.

      This is the time between the display of each digit. The refresh period
      must be long enough to allow the segments to be driven and the digit to
      be selected.
```

## dts/bindings/auxdisplay/hit,hd44780.yaml
```yaml
#
# Copyright (c) 2023 Jamie McCrae
#
# SPDX-License-Identifier: Apache-2.0
#

description: Hitachi HD44780 LCD

compatible: "hit,hd44780"

include: [auxdisplay-device.yaml]

properties:
  mode:
    type: int
    required: true
    description: Operating mode of display, 8-bit or 4 for 4-bit mode
    enum:
      - 4
      - 8

  register-select-gpios:
    type: phandle-array
    required: true
    description: GPIO connected to Register Select (RS) of LCD

  read-write-gpios:
    type: phandle-array
    description: Optional GPIO used for selecting read or write mode

  enable-gpios:
    type: phandle-array
    required: true
    description: GPIO used for enabling commands to be sent

  data-bus-gpios:
    type: phandle-array
    required: true
    description: |
      Array of GPIOs connected to the DB lines of the display, this must
      contain 8 entries ascending from DB0 to DB7, for 4-bit interface
      displays, the first 4 must be set as `<0>`

  brightness-gpios:
    type: phandle-array
    description: Optional GPIO used for controlling the brightness (contrast)

  backlight-gpios:
    type: phandle-array
    description: Optional GPIO used for enabling the backlight

  line-addresses:
    type: uint8-array
    default: [0x00, 0x40, 0x14, 0x54]
    description: |
      Array of addresses for each row, will use defaults if not provided.
      Default is as per Hitachi HD44780 specification.

  enable-line-rise-delay-ns:
    type: int
    default: 450
    description: |
      Delay time (in ns) to wait after enable line rises before setting low.
      Default is as per Hitachi HD44780 specification.

  enable-line-fall-delay-ns:
    type: int
    default: 550
    description: |
      Delay time (in ns) to wait after enable line falls before sending
      another command. Default is as per Hitachi HD44780 specification.

  rs-line-delay-ns:
    type: int
    default: 60
    description: |
      Delay time (in ns) to wait after rs/rw line state has been set up before
      sending another command. Default is as per Hitachi HD44780 specification.

  clear-command-delay-us:
    type: int
    default: 5000
    description: |
      Delay time (in us) to wait after issuing a clear command before sending
      another command. Default is as per Hitachi HD44780 specification.

  boot-delay-ms:
    type: int
    default: 0
    description: |
      Delay time (in ms) to wait at boot time before sending a command (note:
      this will delay startup of the whole application by this time, this
      should only be used when time is needed for the display device to be
      ready before it can be configured which without any delay would cause
      the display to not function properly).
```

## dts/bindings/auxdisplay/jhd,jhd1313.yaml
```yaml
#
# Copyright (c) 2022 Jamie McCrae
#
# SPDX-License-Identifier: Apache-2.0
#

description: Jinghua Display JHD1313

compatible: "jhd,jhd1313"

include: [auxdisplay-device.yaml, i2c-device.yaml]

properties:
  backlight-addr:
    type: int
    default: 0x62
    description: I2C address for RGB backlight controller. (JHD1313 default value)
```

## dts/bindings/auxdisplay/maxim,max7219-7seg.yaml
```yaml
# Copyright (c) 2025 Maksim Salau <maksim.salau@gmail.com>
# SPDX-License-Identifier: Apache-2.0

title: Maxim MAX7219 8-Digit LED Display Driver

description: |
  The Maxim MAX7219 is a 8-Digit LED Display Driver.

compatible: "maxim,max7219-7seg"

include: [auxdisplay-device.yaml, spi-device.yaml]

properties:
  scan-limit:
    type: int
    const: 7
    enum:
      - 0
      - 1
      - 2
      - 3
      - 4
      - 5
      - 6
      - 7
    description: |
      Number of scanned digits for MAX7219.
      Display digit 0 only when scan-limit is 0, digits 0 & 1 when
      scan-limit is 1, and so on.

  intensity:
    type: int
    default: 0
    enum:
      - 0
      - 1
      - 2
      - 3
      - 4
      - 5
      - 6
      - 7
      - 8
      - 9
      - 10
      - 11
      - 12
      - 13
      - 14
      - 15
    description: Intensity for MAX7219.

  rows:
    type: int
    const: 1

  digit-order-reversed:
    type: boolean
    description: Digit order is reversed
```

## dts/bindings/auxdisplay/newhaven,nhd-k3z-common.yaml
```yaml
# SPDX-FileCopyrightText: Copyright The Zephyr Project Contributors
# SPDX-License-Identifier: Apache-2.0

title: |
  Newhaven NHD K3Z family serial character LCD character displays.

description: |
  This binding models the transport-facing module interface used by K3Z variants,
  where geometry is configurable through generic `rows` and `columns` properties.

include: auxdisplay-device.yaml

examples:
  - |
    &i2c1 {
      auxdisplay_0: nhd-k3z@72 {
        compatible = "newhaven,nhd-k3z";
        reg = <0x72>;
        rows = <2>;
        columns = <16>;
      };
    };
```

## dts/bindings/auxdisplay/newhaven,nhd-k3z-i2c.yaml
```yaml
# SPDX-FileCopyrightText: Copyright The Zephyr Project Contributors
# SPDX-License-Identifier: Apache-2.0

description: Newhaven NHD K3Z family serial character LCD character displays on I2C bus

compatible: "newhaven,nhd-k3z"

include: [i2c-device.yaml, "newhaven,nhd-k3z-common.yaml"]
```

## dts/bindings/auxdisplay/newhaven,nhd-k3z-spi.yaml
```yaml
# SPDX-FileCopyrightText: Copyright The Zephyr Project Contributors
# SPDX-License-Identifier: Apache-2.0

description: Newhaven NHD K3Z family serial character LCD character displays on SPI bus

compatible: "newhaven,nhd-k3z"

include: [spi-device.yaml, "newhaven,nhd-k3z-common.yaml"]
```

## dts/bindings/auxdisplay/newhaven,nhd-k3z-uart.yaml
```yaml
# SPDX-FileCopyrightText: Copyright The Zephyr Project Contributors
# SPDX-License-Identifier: Apache-2.0

description: Newhaven NHD K3Z family serial character LCD character displays on UART bus

compatible: "newhaven,nhd-k3z"

include: [uart-device.yaml, "newhaven,nhd-k3z-common.yaml"]
```

## dts/bindings/auxdisplay/noritake,itron.yaml
```yaml
#
# Copyright (c) 2022 Jamie McCrae
#
# SPDX-License-Identifier: Apache-2.0
#

title: Noritake Itron VFD module

description: |
    Noritake Itron VFD character display module
    from series CU-TE, CU-Y, GU-3000, GU-7000
    and GU-D.

    Example references:
    GU280X16G-7000
    CU20029-TE200K
    CU24043-Y100
    GU128X32D-D903S

compatible: "noritake,itron"

include: [auxdisplay-device.yaml, uart-device.yaml]

properties:
  reset-gpios:
    type: phandle-array
    description: Optional GPIO used to reset the display

  busy-gpios:
    type: phandle-array
    description: Optional GPIO used for busy detection
```

## dts/bindings/auxdisplay/nxp,slcd-panel-od-6010.yaml
```yaml
# SPDX-License-Identifier: Apache-2.0

description: |
  Panel (glass) wiring for NXP SLCD: OD-6010.

  This is a child node of an "nxp,slcd" controller.

compatible: "nxp,slcd-panel-od-6010"

include:
  - nxp,slcd-panel.yaml

properties:
  panel-name:
    default: "od-6010"

  max-digits:
    default: 6
    const: 6
```

## dts/bindings/auxdisplay/nxp,slcd-panel-s401m16kr.yaml
```yaml
# SPDX-License-Identifier: Apache-2.0

description: |
  Panel (glass) wiring for NXP SLCD: S401M16KR.

  This is a child node of an "nxp,slcd" controller.

compatible: "nxp,slcd-panel-s401m16kr"

include:
  - nxp,slcd-panel.yaml

properties:
  panel-name:
    default: "s401m16kr"

  max-digits:
    default: 4
    const: 4
```
