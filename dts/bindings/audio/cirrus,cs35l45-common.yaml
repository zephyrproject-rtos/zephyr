## dts/bindings/audio/cirrus,cs35l45-common.yaml
```yaml
# Copyright 2024 Cirrus Logic, Inc.
# SPDX-License-Identifier: Apache-2.0

properties:
  reset-gpios:
    type: phandle-array
    required: true
    description: |
      Active low signal used to reset the device to default state.
```

## dts/bindings/audio/cirrus,cs35l45-i2c.yaml
```yaml
# Copyright (c) 2024 Cirrus Logic, Inc.
# SPDX-Identifier: Apache-2.0

description: Cirrus Logic CS35L45 Smart Amplifier on an I2C bus

compatible: "cirrus,cs35l45"

include: ["i2c-device.yaml", "cirrus,cs35l45-common.yaml"]
```

## dts/bindings/audio/cirrus,cs35l56-common.yaml
```yaml
# Copyright 2026 Cirrus Logic, Inc.
# SPDX-License-Identifier: Apache-2.0

properties:
  reset-gpios:
    type: phandle-array
    description: |
      Active low signal used to reset the device to default state.
```

## dts/bindings/audio/cirrus,cs35l57-i2c.yaml
```yaml
# Copyright (c) 2026 Cirrus Logic, Inc.
# SPDX-Identifier: Apache-2.0

description: Cirrus Logic CS35L57 Smart Amplifier on an I2C bus

compatible: "cirrus,cs35l57"

include: ["i2c-device.yaml", "cirrus,cs35l56-common.yaml"]
```

## dts/bindings/audio/cirrus,cs43l22.yaml
```yaml
# Copyright (c) 2025 Titouan Christophe
# SPDX-License-Identifier: Apache-2.0

description: Cirrus CS43L22 audio DAC

include: [i2c-device.yaml]

compatible: "cirrus,cs43l22"

properties:
  reg:
    required: true

  reset-gpios:
    required: true
    type: phandle-array
    description: |
      RESET pin
```

## dts/bindings/audio/dlg,da7212.yaml
```yaml
# Copyright 2025 NXP
# SPDX-License-Identifier: Apache-2.0

description: Dialog DA7212 audio codec

include: [i2c-device.yaml]

compatible: "dlg,da7212"

properties:
  reg:
    required: true
  clock-source:
    type: string
    default: "MCLK"
    description: |
      Codec's internal clock (SYSCLK) source selection. Available options:
      - "MCLK": external MCLK supplied by host
    enum:
      - "MCLK"

  clocks:
    type: phandle-array
    required: true
    description: Phandle to the clock providing the codec MCLK input
  clock-names:
    type: string-array
    required: true
    description: Must contain "mclk" matching the MCLK input
    enum:
      - mclk
```

## dts/bindings/audio/infineon,pdm.yaml
```yaml
# SPDX-FileCopyrightText: <text>Copyright (c) 2026 Infineon Technologies AG,
# or an affiliate of Infineon Technologies AG.</text>
#
# SPDX-License-Identifier: Apache-2.0

description: Infineon PDM (Pulse Density Modulation) Controller

compatible: "infineon,pdm"

include: ["base.yaml", "pinctrl-device.yaml"]

properties:
  reg:
    required: true

  clocks:
    required: true

  clk-dst:
    type: int
    required: true
    description: Peripheral clock destination ID for this PDM instance

  interrupts:
    required: true

  pinctrl-0:
    required: true

  pinctrl-names:
    required: true

  dmas:
    description: |
      DMA specifier which includes the phandle reference to the
      DMA controller and the channel number.

      Example:
        dmas = <&dma0 0>;
    required: true

  dma-names:
    description: |
      Required if the dmas property exists. This should be "rx".

      Example:
        dma-names = "rx";
    required: true

  fir0-coefficients:
    type: array
    description: |
      FIR filter coefficients for the PDM. This array has 8 elements.

  fir1-coefficients:
    type: array
    description: |
      FIR filter coefficients for the PDM. This array has 14 elements.

child-binding:
  description: PDM channel specific configuration.
  include:
    - name: base.yaml
      property-allowlist:
        - reg
  properties:
    reg:
      required: true

    channel:
      type: int
      description: |
        Channel number for this PDM channel.
      required: true

    use-alt-io:
      type: boolean
      description: |
        If true, use the pdm data pin from the alternate channel
        as specified in the ROUTE_CTL register.

    cic-decimation-code:
      type: int
      enum: [0, 1, 2, 3, 4]
      description: |
        The CIC filter decimation code should be set according to the
        relative frequency of the PDM and PCM frequencies.
          0: DECIM_2
          1: DECIM_4
          2: DECIM_8
          3: DECIM_16
          4: DECIM_32 (default)

    dc-block-disable:
      type: boolean
      description: |
        Disable the DC blocker filter. For debug purposes.

    dc-block-code:
      type: int
      enum: [0, 1, 2, 3, 4, 5, 6, 7]
      description: |
        Specifies the DC blocker coefficient:
          0: alpha = 0.999755859
          1: alpha = 0.999511719 (default)
          2: alpha = 0.999023438
          3: alpha = 0.998046875
          4: alpha = 0.99609375
          5: alpha = 0.9921875
          6: alpha = 0.984375
          7: alpha = 0.96875

    fir0-enable:
      type: boolean
      description: |
        Enable FIR0 filter for the channel. Disabled by default
        and typically only used for sample frequencies of 8 and 16 kHz.

    fir0-scale:
      type: int
      description: |
        FIR0 filter PCM scaling. FIR0 filter PCM values are scaled
        (right shifted, rounded and clipped) to 26bit signed PCM
        values. This parameter specifies the right shift amount:
          0: no shift
          1: shift right by 1
          ...
          31: shift right by 31

    fir0-decimation:
      type: int
      enum: [0, 1, 2, 3, 4]
      description: |
        Sets the FIR0 filter PCM frequency relative to the CIC filter PCM frequency:
          0: PCM frequency is the same as CIC frequency (default)
          1: PCM frequency is 1/2 of CIC frequency
          2: PCM frequency is 1/3 of CIC frequency
          3: PCM frequency is 1/4 of CIC frequency
          4: PCM frequency is 1/5 of CIC frequency

    fir1-scale:
      type: int
      description: |
        FIR1 filter PCM scaling. FIR1 filter PCM values are scaled
        (right shifted, rounded and clipped) to 26bit signed PCM
        values. This parameter specifies the right shift amount:
          0: no shift
          1: shift right by 1
          ...
          31: shift right by 31

    fir1-decimation:
      type: int
      enum: [0, 1, 2, 3, 4]
      description: |
        Sets the FIR1 filter PCM frequency relative to the CIC filter PCM frequency:
          0: PCM frequency is the same as CIC frequency (default)
          1: PCM frequency is 1/2 of CIC frequency
          2: PCM frequency is 1/3 of CIC frequency
          3: PCM frequency is 1/4 of CIC frequency
          4: PCM frequency is 1/5 of CIC frequency
```

## dts/bindings/audio/intel,adsp-mic-privacy.yaml
```yaml
# Copyright (c) 2024 Intel Corporation
# SPDX-License-Identifier: Apache-2.0

description: Intel ADSP Microphone Privacy

compatible: "intel,adsp-mic-privacy"

include: base.yaml

properties:
  reg:
    required: true
```

## dts/bindings/audio/intel,dmic.yaml
```yaml
# Copyright (c) 2020 Intel Corporation
# SPDX-License-Identifier: Apache-2.0

description: Intel Digital PDM Microphone (DMIC) node

compatible: "intel,dmic"

include: base.yaml
```

## dts/bindings/audio/iron,sma1303-i2c.yaml
```yaml
# Copyright 2025 Iron Device Corporation
# SPDX-Identifier: Apache-2.0

description: Iron Device SMA1303 Audio Amplifier

compatible: "iron,sma1303"

include: ["i2c-device.yaml"]

properties:
  reg:
    required: true
```

## dts/bindings/audio/nordic,nrf-pdm.yaml
```yaml
# Copyright (c) 2019 Nordic Semiconductor ASA
# SPDX-License-Identifier: Apache-2.0

description: Nordic PDM (Pulse Density Modulation interface)

compatible: "nordic,nrf-pdm"

interrupt-source: true

include: [base.yaml, pinctrl-device.yaml]

properties:
  reg:
    required: true

  pinctrl-0:
    required: true

  clock-source:
    type: string
    default: "PCLK32M_HFXO"
    description: |
      Clock source to be used by the PDM peripheral. The following options
      are available:
      - "PCLK32M": 32 MHz peripheral clock, synchronous to HFCLK
      - "PCLK32M_HFXO": PCLK32M running off the 32 MHz crystal oscillator
        (HFXO) for better clock accuracy and jitter performance
      - "ACLK": Audio PLL clock with configurable frequency (frequency for
        this clock must be set via the "hfclkaudio-frequency" property
        in the "nordic,nrf-clock" node); this clock source is only available
        in the nRF53 Series SoCs and it requires the use of HFXO
    enum:
      - "PCLK32M"
      - "PCLK32M_HFXO"
      - "ACLK"

  queue-size:
    type: int
    default: 4
    description: |
      Size of the queue of received audio data blocks to be used
      by the driver.
```

## dts/bindings/audio/nxp,dmic.yaml
```yaml
# Copyright 2023 NXP
# SPDX-License-Identifier: Apache-2.0

description: NXP DMIC

compatible: "nxp,dmic"

include: [base.yaml, pinctrl-device.yaml]

properties:
  reg:
    required: true

  interrupts:
    required: true

  pinctrl-0:
    required: true

  clocks:
    required: true

  use2fs:
    type: boolean
    description: |
      Use 2FS output, and bypass final half band decimator. This will reduce
      the required PDM bit clock frequency by a factor of two, and can reduce
      power consumption.

# Child binding definition, describes each channel of the DMIC
child-binding:
  description: |
    NXP DMIC channel. Can be used to configure filtering and gain attributes
    of each channel
  include: base.yaml
  compatible: "nxp,dmic-channel"
  properties:
    reg:
      required: true
    dmas:
      required: true

    gainshift:
      type: int
      default: 0
      description: |
        Decimator gain shift. Sets the number of bits to shift decimated PCM
        data by, as a positive or negative number. Range of [-15,15]. Default
        is reset value of register

    compensation-2fs:
      type: string
      default: "zero"
      enum:
        - "zero"
        - "-0.16"
        - "-0.15"
        - "-0.13"
      description: |
        2FS compensation filter. See SOC reference manual for filter response
        of each value. Default value is reset value of register, and
        recommended filter setting.

    compensation-4fs:
      type: string
      default: "zero"
      enum:
        - "zero"
        - "-0.16"
        - "-0.15"
        - "-0.13"
      description: |
        4FS compensation filter. See SOC reference manual for filter response
        of each value. Default value is reset value of register, and
        recommended filter setting.

    dc-cutoff:
      type: string
      default: "flat"
      enum:
        - "flat"
        - "155hz"
        - "78hz"
        - "39hz"
      description: |
        DC cutoff filter setting. Default is reset value of register. Note that
        each cutoff frequency is based on a sample frequency of 16KHz, so
        actual cutoff values will scale up or down based on your sampling
        frequency

    dc-gain:
      type: int
      default: 0
      description: |
        DC gain fine adjustment. Number of bits to downshift the final
        conversion result. Max value of 15. Default is reset value of
        register
```

## dts/bindings/audio/nxp,micfil.yaml
```yaml
# Copyright 2025 NXP
# SPDX-License-Identifier: Apache-2.0

description: NXP PDM Microphone Interface (MICFIL)

compatible: "nxp,micfil"

include:
  - base.yaml
  - pinctrl-device.yaml

properties:
  reg:
    required: true

  interrupts:
    required: true

  clocks:
    required: true

  quality-mode:
    type: int
    enum: [0, 1, 4, 5, 6, 7]
    default: 0
    description: |
      Decimation filter quality mode.
      0 = Medium, default value, PoR reset value of register
      1 = High
      4 = VeryLow2
      5 = VeryLow1
      6 = VeryLow0
      7 = Low

  cic-decimation-rate:
    type: int
    description: |
      CIC filter decimation rate setting,
      range is SoC specific, may [0, 15] or [8, 31]
      The final OSR = (16 - cic-decimation-rate)
      CIC decimation rate = 2 * OSR; If HQ, VLQ0 mode.
      CIC decimation rate = OSR; If other modes.
      0: CIC oversampling rate = 0, default value, PoR reset value
      1: CIC oversampling rate = 1
      ...
      15: CIC oversampling rate = 15

  fifo-watermark:
    type: int
    description: |
      FIFO watermark level (implementation defined, typically 7),
      range is SoC specific, may [0, 7] or [0, 15].
      Default is PoR reset value of register.

  sample-rate:
    type: int
    enum: [8000, 12000, 16000, 24000, 32000, 48000, 96000]
    description: |
      Sample rate in Hz.

child-binding:
  description: |
    NXP MICFIL channel. Can be used to configure DC remover cutoff frequency and gain
  include:
    - name: base.yaml
      property-allowlist:
        - reg
  properties:
    reg:
      required: true
    dc-remover-cutoff-freq:
      type: int
      enum: [0, 1, 2, 3]
      default: 0
      description: |
        DC remover cutoff frequency in Hz
        0: 20Hz (FS=48KHz), default value, PoR reset value
        1: 13.3Hz (FS=48KHz)
        2: 40Hz (FS=48KHz)
        3: DC remover is bypassed

    decimation-filter-gain:
      type: int
      default: 0
      description: |
        Decimation filter gain setting, range: [0, 15].
        Default is PoR reset value of register.
```

## dts/bindings/audio/pdm-dmic.yaml
```yaml
# Copyright (c) 2025 Embeint Pty Ltd.
# SPDX-License-Identifier: Apache-2.0

# Digital microphone common configuration

properties:
  clk-frequency-min:
    type: int
    required: true
    description: |
      Minimum frequency of the PDM clock pin.
  clk-frequency-max:
    type: int
    required: true
    description: |
      Maximum frequency of the PDM clock pin.
  clk-duty-cycle-min:
    type: int
    required: true
    description: |
      Minimum duty-cycle of the PDM clock pin.
  clk-duty-cycle-max:
    type: int
    required: true
    description: |
      Maximum duty-cycle of the PDM clock pin.
  channel-left:
    type: boolean
    description: |
      Left PDM channel is present.
  channel-right:
    type: boolean
    description: |
      Right PDM channel is present.
```

## dts/bindings/audio/sifli,sf32lb-audcodec.yaml
```yaml
# Copyright (c) 2025 Qingsong Gou <gouqs@hotmail.com>
# SPDX-License-Identifier: Apache-2.0

description: |
  Sifli SF32LB audio codec.

compatible: "sifli,sf32lb-audcodec"

include: [base.yaml, pinctrl-device.yaml]

properties:
  reg:
    required: true

  clocks:
    required: true

  dmas:
    required: true

  dma-names:
    required: true

  pa-power-gpios:
    type: phandle-array
    description: |
      Power Amplifier (PA) enable GPIO.
    required: true
```

## dts/bindings/audio/st,mpxxdtyy-i2s.yaml
```yaml
# Copyright (c) 2018 STMicroelectronics
# SPDX-License-Identifier: Apache-2.0

description: STMicroelectronics MPXXDTYY digital PDM microphone family

compatible: "st,mpxxdtyy"

include: i2s-device.yaml
```
