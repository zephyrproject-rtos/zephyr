## dts/bindings/audio/st,stm32-dfsdm-dmic.yaml
```yaml
# SPDX-FileCopyrightText: Copyright (c) 2026 STMicroelectronics
# SPDX-License-Identifier: Apache-2.0

title: STMicroelectronics DFSDM DMIC

description: |
  This device represents each DFSDM child node matching a filter instance.  The
  filter handles one or multiple channels, and each filter is linked to a
  digital microphone.

  There can be up to 4 or 6 filter nodes under DFSDM base node depending on the
  hardware limitations.

compatible: "st,stm32-dfsdm-dmic"

include: ["base.yaml", "pinctrl-device.yaml"]

properties:
  reg:
    required: true

  pinctrl-0:
    required: true

  pinctrl-names:
    required: true

  filter-order:
    type: int
    default: 3
    min: 0
    max: 5
    description: |
      SinC filter order from 0 to 5.
      - 0: FastSinC
      - [1-5]: order 1 to 5.
      For audio purpose it is recommended to use order 3 to 5.

  filter0-sync:
    type: boolean
    description: |
      When set synchronize with DFSDM filter instance 0.  Used for multi
      microphones synchronization.  This option cannot be set on filter
      instance 0.

child-binding:
  description: Channel instances linked to the filter node.

  properties:
    reg:
      type: int
      required: true
```

## dts/bindings/audio/st,stm32-dfsdm.yaml
```yaml
# SPDX-FileCopyrightText: Copyright (c) 2026 STMicroelectronics
# SPDX-License-Identifier: Apache-2.0

title: STMicroelectronics DFSDM block

description: |
  This device represents the base DFSDM block, where common properties are
  handled.  The DFSDM bindings is inspired from the one implemented in the
  Linux kernel.

compatible: "st,stm32-dfsdm"

include: ["base.yaml", "reset-device.yaml"]

properties:
  reg:
    required: true

  clocks:
    required: true

  clock-names:
    required: true

  resets:
    required: true
```

## dts/bindings/audio/ti,pcm1681-i2c.yaml
```yaml
# Copyright (c) 2025 Basalte bv
# SPDX-License-Identifier: Apache-2.0

description: Texas Instruments PCM1681 and PCM1681-Q1 Audio DAC on I2C bus

compatible: "ti,pcm1681"

include: i2c-device.yaml
```

## dts/bindings/audio/ti,pcm1681-spi.yaml
```yaml
# Copyright (c) 2025 Basalte bv
# SPDX-License-Identifier: Apache-2.0

description: Texas Instruments PCM1681 and PCM1681-Q1 Audio DAC on SPI bus

compatible: "ti,pcm1681"

include: spi-device.yaml
```

## dts/bindings/audio/ti,taa3020.yaml
```yaml
description: Texas Instruments TAA3929 Audio ADC

compatible: "ti,taa3020"

include: i2c-device.yaml

properties:
  gpio1-gpios:
    type: phandle-array

  areg-internal-en:
    type: boolean
    description: |
      Enable the internal regulator. Make sure to set this correctly according
      to the datasheet. Depending on your hardware design, using the wrong value
      for this boolean might lead to hardware damage!

child-binding:
  description: Channel of TI taa3020
  include: base.yaml
  compatible: "ti,taa3020-channel"
  properties:
    reg:
      required: true

    in-type:
      type: string
      default: "microphone"
      enum:
        - "microphone"
        - "line"
      description: |
        Channel input type.

    in-src:
      type: string
      default: "differential"
      enum:
        - "differential"
        - "single-ended"
        - "pdm"
      description: |
        Channel input source selection.

    coupling:
      type: string
      default: "ac"
      enum:
        - "ac"
        - "dc"
      description: |
        Channel input coupling.

    impedance:
      type: string
      default: "2_5k"
      enum:
        - "2_5k"
        - "10k"
        - "20k"
      description: |
        Channel input impedance in ohms.

    agc-en:
      type: boolean
      description: |
        Enable or disable automatic gain controller (AGC) for this channel.
```

## dts/bindings/audio/ti,tas2563.yaml
```yaml
# Copyright (c) 2026 Linumiz
# SPDX-License-Identifier: Apache-2.0

description: Texas Instruments TAS2563 Audio Amplifier

compatible: "ti,tas2563"

include: i2c-device.yaml
```

## dts/bindings/audio/ti,tas6422dac.yaml
```yaml
# Copyright (c) 2023 Centralp
# SPDX-License-Identifier: Apache-2.0

description: Texas Instruments TAS6422 Audio Amplifier

compatible: "ti,tas6422dac"

include: i2c-device.yaml

properties:
  mute-gpios:
    type: phandle-array
```

## dts/bindings/audio/ti,tlv320aic26.yaml
```yaml
# Copyright (c) 2026 Linumiz
# SPDX-License-Identifier: Apache-2.0

description: |
  Texas Instruments TLV320AIC26 Low Power Stereo Audio Codec.

compatible: "ti,tlv320aic26"

include: [spi-device.yaml]

properties:
  mclk-frequency:
    type: int
    required: true
    description: Master clock frequency in Hz applied to the MCLK pin
```

## dts/bindings/audio/ti,tlv320aic3110.yaml
```yaml
# Copyright (c) 2025 PHYTEC America LLC
# SPDX-License-Identifier: Apache-2.0

description: Texas Instruments TLV320AIC3110 Audio DAC

compatible: "ti,tlv320aic3110"

include: i2c-device.yaml
```
