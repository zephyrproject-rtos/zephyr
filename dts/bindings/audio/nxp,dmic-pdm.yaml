## dts/bindings/audio/ti,tlv320dac.yaml
```yaml
# Copyright (c) 2018, Intel Corporation
# SPDX-License-Identifier: Apache-2.0

description: Texas Instruments TLV320DAC310x Audio DAC

compatible: "ti,tlv320dac"

include: i2c-device.yaml

properties:
  reset-gpios:
    type: phandle-array

  use-volume-control-pin:
    type: boolean
    description: |
      Control the volume of the codec using the VOL/MICDET pin. This pin is
      shared with the microphone detection function, so it will not work if
      the microphone detection function is enabled.

  use-internal-pll-with-bclk:
    type: boolean
    description: |
      Use the internal PLL to generate the required clocks from BCLK.

  round-up-slot-width-for-internal-pll:
    type: boolean
    description: |
      Some SoC (like STM32) use 32 bit slots to transport 20 or 24 bit
      samples. If this is the case with your SoC, set this boolean.

  speaker-gain:
    type: int
    default: 6
    enum:
      - 6
      - 12
      - 18
      - 24
    description: |
      Sets the gain (in dB) of the speaker driver output stage.
      The reset value is 6dB.
```

## dts/bindings/audio/wolfson,wm8904.yaml
```yaml
# Copyright 2024 NXP
# SPDX-License-Identifier: Apache-2.0

description: WM8904 audio codec

include: [i2c-device.yaml]

compatible: "wolfson,wm8904"

properties:
  reg:
    required: true
  clock-source:
    type: string
    default: "MCLK"
    description: |
      Codec's internal clock signal (SYSCLK) source selection. These options
      are available:
      - "MCLK": WM8904's MCLK pin (supplied by the host)
      - "FLL":  WM8904's FLL facility, can be free-running
      The "MCLK" option is default, as this clock signal is usually supplied
      by the host.
    enum:
      - "MCLK"
      - "FLL"
  fs-ratio:
    type: int
    default: 256
    enum: [64, 128, 192, 256, 384, 512, 768, 1024, 1408, 1536]
    description: |
      This property is intended for platforms where the MCLK frequency is
      not directly available to the driver.
      On such platforms, the driver assumes the MCLK frequency to be equal
      to (fs-ratio * <sample rate>), where the sample rate comes from the
      audio codec configuration provided at runtime.
  input-pga-select:
    type: int
    enum: [1, 2, 3]
    description: |
      Selects the WM8904 input PGA source channel.
      Only single-ended input mode is supported.
      On the 32-pin QFN package, only channels 1 and 2 are supported.
  wolfson,mic-bias-voltage:
    type: string
    description: |
      Select microphone bias voltage for the connected microphone input.
      * "avdd-9-10":  Vbias = 9/10 x AVDD
      * "avdd-10-9":  Vbias = 10/9 x AVDD
      * "avdd-7-6":   Vbias = 7/6 x AVDD
      * "avdd-4-3":   Vbias = 4/3 x AVDD
      * "avdd-3-2":   Vbias = 3/2 x AVDD

      If the property is not present, the bias voltage is not enabled.
    enum:
      - "avdd-9-10"
      - "avdd-10-9"
      - "avdd-7-6"
      - "avdd-4-3"
      - "avdd-3-2"
```

## dts/bindings/auxdisplay/newhaven,us2066-i2c.yaml
```yaml
#
# Copyright (c) 2026 Jasper Jonker
#
# SPDX-License-Identifier: Apache-2.0
#

title: Newhaven Display US2066 LCD (I2C)

description: |
  Newhaven Display US2066 character LCD using its I2C interface.

compatible: "newhaven,us2066-i2c"

include:
  - name: i2c-device.yaml
  - name: newhaven,us2066.yaml
```

## dts/bindings/auxdisplay/newhaven,us2066-spi.yaml
```yaml
#
# Copyright (c) 2026 Jasper Jonker
#
# SPDX-License-Identifier: Apache-2.0
#

title: Newhaven Display US2066 LCD (SPI)

description: |
  Newhaven Display US2066 character LCD using its SPI interface.

compatible: "newhaven,us2066-spi"

include:
  - name: spi-device.yaml
  - name: newhaven,us2066.yaml
```

## dts/bindings/auxdisplay/newhaven,us2066.yaml
```yaml
#
# Copyright (c) 2026 Jasper Jonker
#
# SPDX-License-Identifier: Apache-2.0
#

description: Newhaven Display US2066 LCD common properties

compatible: "newhaven,us2066"

include: [auxdisplay-device.yaml]

properties:
  reset-gpios:
    type: phandle-array
    description: Optional GPIO connected to Reset (RST) of display

  columns:
    type: int
    required: true
    description: Number of character columns

  rows:
    type: int
    required: true
    description: |
      Number of character rows (1, 2, 3, or 4 lines).
    enum:
      - 1
      - 2
      - 3
      - 4

  io-voltage-mv:
    type: int
    description: I/O voltage level in millivolts (3300 or 5000)
    default: 3300
    enum:
      - 3300
      - 5000

  contrast:
    type: int
    description: Display contrast level (0-255)
    default: 127

  clock-divider:
    type: int
    description: Display clock divide ratio (1-16)
    default: 1

  clock-freq:
    type: int
    description: Oscillator frequency setting (0-15)
    default: 7

  phase1-period:
    type: int
    description: Phase 1 period in DCLKs (0=2 DCLKs, 1-15=1-15 DCLKs, up to 32 total)
    default: 1

  phase2-period:
    type: int
    description: Phase 2 period in DCLKs (1-15, 0 is invalid)
    default: 15

  vcomh-level:
    type: int
    description: VCOMH deselect level (0=0.65Vcc, 1=0.71Vcc, 2=0.77Vcc, 3=0.83Vcc, 4=1.0Vcc)
    default: 4
    enum:
      - 0
      - 1
      - 2
      - 3
      - 4

  font-width:
    type: int
    description: Character font width in dots (5 or 6)
    default: 5
    enum:
      - 5
      - 6

  cursor-invert:
    type: boolean
    description: Enable black/white inverting of cursor position

  display-rotate-180:
    type: boolean
    description: |
      Rotate display 180 degrees (hardware limitation: uses BDS bit only).
      Useful when display is mounted upside down.
      Note: This sets BDS which empirically produces a 180-degree rotation.

  display-mirror-horizontal:
    type: boolean
    description: |
      Mirror display horizontally (left-right flip only).
      Hardware note: Sets both BDS and BDC bits to achieve horizontal mirroring.
      This is a hardware quirk - single BDC bit has no effect on this display.

  cursor-direction-left:
    type: boolean
    description: |
      Cursor movement direction after writing a character (RE=0, I/D bit).
      true: cursor moves left, DDRAM address decrements
      false: cursor moves right, DDRAM address increments (default)

  display-shift-on-write:
    type: boolean
    description: |
      Enable automatic display shift when writing characters (RE=0, S bit).
      true: entire display shifts on each character write (marquee effect)
      false: only cursor moves, display content stays in place (default)
```
