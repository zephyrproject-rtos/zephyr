## dts/bindings/auxdisplay/ti,mspm0-lcd.yaml
```yaml
# Copyright (c) 2026 Texas Instruments
# SPDX-License-Identifier: Apache-2.0

description: |
  TI MSPM0 LCD Segment Display Controller (SLAU847F, Chapter 20)

  Describes the LCD hardware peripheral only (COM/SEG pin assignment,
  multiplexing, voltage configuration).  Display geometry and character
  encoding live in a required child node of compatible "slcd-panel".

  Use the MSPM0_LCD_VOLTAGE_SOURCE_* and MSPM0_LCD_BIAS_MODE_* constants
  from <zephyr/dt-bindings/auxdisplay/ti-mspm0-lcd.h> for the
  voltage-source and bias-mode properties.

compatible: "ti,mspm0-lcd"

include:
  - name: base.yaml
  - name: pinctrl-device.yaml

properties:
  reg:
    required: true

  mux-mode:
    type: int
    required: true
    description: |
      LCD multiplex mode (LCDMXX in LCDCTL0).
      0=Static, 1=2-mux, 2=3-mux, 3=4-mux, 4=5-mux, 5=6-mux, 6=7-mux, 7=8-mux.
      Hardware segment blinking is only supported for modes 0-3 (Static to 4-mux).
    enum: [0, 1, 2, 3, 4, 5, 6, 7]

  bias-mode:
    type: int
    required: true
    description: |
      LCD bias mode (LCDBIASSEL in LCDVCTL).
      Use MSPM0_LCD_BIAS_MODE_* constants.
    enum: [0, 1, 2]

  frequency-divider:
    type: int
    required: true
    description: |
      LCD frequency divider value N (0-31); hardware divides by N+1.
      CLKLCD = LFCLK / ((N+1) × mux_frame_clocks).

  voltage-source:
    type: int
    required: true
    description: |
      LCD charge-pump / bias voltage generation configuration (LCDVCTL).
      Use MSPM0_LCD_VOLTAGE_SOURCE_* constants:
        MSPM0_LCD_VOLTAGE_SOURCE_EXT_REF_EXT_DIV (0):     External ref on R33, external divider.
        MSPM0_LCD_VOLTAGE_SOURCE_EXT_REF_INT_DIV (1):     External ref on R33, internal divider.
        MSPM0_LCD_VOLTAGE_SOURCE_AVDD_INT_DIV    (2):     AVDD reference, internal divider.
        MSPM0_LCD_VOLTAGE_SOURCE_CHARGE_PUMP_EXT (3):     Charge pump, external supply on R33/R13.
        MSPM0_LCD_VOLTAGE_SOURCE_CHARGE_PUMP_INT_REF (4): Charge pump, internal VREF on R13.
        MSPM0_LCD_VOLTAGE_SOURCE_AVDD_EXT_DIV    (5):     AVDD on R33, external divider.
        MSPM0_LCD_VOLTAGE_SOURCE_CHARGE_PUMP_AVDD (6):   Charge pump using AVDD as supply.
    enum: [0, 1, 2, 3, 4, 5, 6]

  high-power-drive:
    type: boolean
    description: |
      Enable high-power LCD drive mode (LCD_HP_LP = 1 in LCDVCTL).
      Selects the high-power (low-impedance) resistor ladder when the
      internal bias resistor divider is active (LCDINTBIASEN=1). Only
      meaningful for MSPM0_LCD_VOLTAGE_SOURCE_EXT_REF_INT_DIV,
      MSPM0_LCD_VOLTAGE_SOURCE_AVDD_INT_DIV, and MSPM0_LCD_VOLTAGE_SOURCE_CHARGE_PUMP_INT_REF.

  reference-mode-switched:
    type: boolean
    description: |
      Enable switched mode for the internal reference circuit
      (LCDREFMODE = 1 in LCDVCTL). Reduces power consumption by
      periodically disabling the reference. Only relevant for
      MSPM0_LCD_VOLTAGE_SOURCE_CHARGE_PUMP_INT_REF.

  voltage-boost:
    type: boolean
    description: |
      Enable the on-chip LCD voltage boost (LCDVBSTEN in LCDVCTL).
      Required when the VDDA supply voltage is below 1.6 V. This is a
      property of the board's supply rail, independent of voltage-source.

  internal-reference-voltage:
    type: int
    description: |
      Internal reference voltage in mV (VLCDx field in LCDVCTL).
      Only applicable for charge-pump-internal-ref voltage source.
    enum: [2600, 2660, 2720, 2780, 2840, 2900, 2960, 3020,
           3080, 3140, 3200, 3260, 3320, 3380, 3440, 3500]

  internal-reference-ontime:
    type: int
    description: |
      On-time of the VREF for charge pump, in CLKCP cycles
      (LCDVREFCFG.ONTIME). Only applicable for MSPM0_LCD_VOLTAGE_SOURCE_CHARGE_PUMP_INT_REF
      with reference-mode-switched enabled.
    enum: [16, 32, 128, 256]
    default: 16

  charge-pump-frequency:
    type: int
    description: |
      Charge pump frequency in Hz (LCDCPFSELx in LCDVCTL).
      Only applicable for MSPM0_LCD_VOLTAGE_SOURCE_CHARGE_PUMP_* voltage sources.
    enum: [4096, 2048, 1365, 1024, 819, 682, 585, 512, 455, 409, 372]
    default: 4096

  blink-rate:
    type: int
    description: |
      Hardware segment blink rate prescaler (LCDBLKPREx in LCDBLKCTL).
      The blink clock is derived from CLKFRAME / 2^(blink-rate+1).
        0 = ÷2  (fastest), 1 = ÷4,  2 = ÷8,   3 = ÷16,
        4 = ÷32,           5 = ÷64, 6 = ÷128, 7 = ÷256 (slowest).
      Only effective for mux modes 0-3 (Static to 4-mux).
    enum: [0, 1, 2, 3, 4, 5, 6, 7]
    default: 3

  lcd-com-pins:
    type: array
    required: true
    description: |
      LCD peripheral pin indices (0-63) used as COM lines, in COM order.

  lcd-seg-pins:
    type: array
    required: true
    description: |
      LCD peripheral pin indices (0-63) used as SEG lines.

examples:
  - |
    #include <zephyr/dt-bindings/auxdisplay/ti-mspm0-lcd.h>
    /* LP-MSPM0L2228: 6-digit 14-segment display, 4-mux, AVDD internal divider */
    auxdisplay_0: &lcd0 {
      mux-mode = <3>;
      bias-mode = <MSPM0_LCD_BIAS_MODE_1_3>;
      frequency-divider = <3>;
      voltage-source = <MSPM0_LCD_VOLTAGE_SOURCE_AVDD_INT_DIV>;
      lcd-com-pins = <24 42 43 44>;
      lcd-seg-pins = <18 19 20 23 36 37 38 39 40 41
                      45 46 47 48 49 50 51 52 53 54 55 56 57 58>;
    };
```

## dts/bindings/auxdisplay/titanmec,tm1650-common.yaml
```yaml
# SPDX-License-Identifier: Apache-2.0
# Copyright (c) 2026 Smile

description: TM1650 7-segment LED display controller

include: [auxdisplay-device.yaml]

properties:
  rows:
    type: int
    enum: [1]
    description: TM1650 only supports 1 row (up to 4 digits).

  columns:
    type: int
    enum: [1, 2, 3, 4]
    required: true
    description: |
      Number of digits connected to the TM1650. The TM1650 supports up
      to 4 of 7-segment digits.
```

## dts/bindings/auxdisplay/titanmec,tm1650-i2c.yaml
```yaml
# SPDX-License-Identifier: Apache-2.0
# Copyright (c) 2026 Smile

description: TM1650 7-segment LED display I2C controller

compatible: "titanmec,tm1650"

include: ["i2c-device.yaml", "titanmec,tm1650-common.yaml"]

examples:
  - |
    &i2c {
      status = "okay";

      auxdisplay_0: auxdisplay@24 {
        compatible = "titanmec,tm1650";
        status = "okay";
        reg = <0x24>; /* Base addresse 0x48 shifted right by 1 bit */
        columns = <4>;
        rows = <1>;
      };
    };
```

## dts/bindings/auxdisplay/titanmec,tm1650.yaml
```yaml
# SPDX-License-Identifier: Apache-2.0
# Copyright (c) 2026 Smile

description: TM1650 7-segment LED display controller

compatible: "titanmec,tm1650"

include: ["i2c-device.yaml", "auxdisplay-device.yaml"]

properties:
  rows:
    const: 1
    description: TM1650 only supports 1 row (up to 4 digits).

  columns:
    enum: [1, 2, 3, 4]
    description: |
      Number of digits connected to the TM1650. The TM1650 supports up
      to 4 of 7-segment digits.

examples:
  - |
    &i2c {
      status = "okay";

      auxdisplay_0: auxdisplay@24 {
        compatible = "titanmec,tm1650";
        status = "okay";
        reg = <0x24>; /* 7 MSB of TM1650 system command address 0x48 */
        columns = <4>;
        rows = <1>;
      };
    };
```

## dts/bindings/base/pm.yaml
```yaml
# Copyright (c) 2021 Intel Corporation.
# SPDX-License-Identifier: Apache-2.0

# Properties for Power Management (PM)

properties:
  wakeup-source:
    type: boolean
    description: |
      Property to identify that a device can be used as wake up source.

      When this property is provided a specific flag is set into the
      device that tells the system that the device is capable of
      wake up the system.

      Wake up capable devices are disabled (interruptions will not wake up
      the system) by default but they can be enabled at runtime if necessary.

  zephyr,pm-device-runtime-auto:
    type: boolean
    description: |
      Automatically configure the device for runtime power management after the
      init function runs.

  zephyr,disabling-power-states:
    type: phandles
    description: |
      List of power states that will disable this device power.

  zephyr,wakeup-disabling-power-states:
    type: phandles
    description: |
      List of power states this device cannot wake the system from, even when
      it is enabled as a wake up source. If this property is not present, the
      device is assumed to be capable of waking the system from any power state.

      Note: power states in the zephyr,disabling-power-states property are
      implicitly considered as part of this property too because unpowered
      devices cannot take any action, and are thus unable to wake the
      system. This makes it redundant to add power states present in the
      zephyr,disabling-power-states property to this one as well; only
      power states in which the device remains powered but is unable
      to wake the system (e.g., because a clock is disabled) should
      be listed in this property.
```

## dts/bindings/basic_radio/basic-radio-base.yaml
```yaml
# Copyright (c) 2026 Texas Instruments Incorporated
# SPDX-License-Identifier: Apache-2.0

description: |
  Common properties of basic_radio devices. Vendor bindings include this
  file.

  The PHY is not described in devicetree. The application passes a vendor
  PHY object to basic_radio_config(); see the vendor header under
  <zephyr/drivers/basic_radio/<vendor>/>.

include: base.yaml
```

## dts/bindings/basic_radio/basic-radio-phy-mode.yaml
```yaml
# Copyright (c) 2026 Texas Instruments Incorporated
# SPDX-License-Identifier: Apache-2.0

description: |
  Vendor-neutral description of one PHY operating mode (waveform and frame
  format). Vendor PHY catalog bindings include this file for their mode
  nodes and add the vendor properties that map the mode to radio settings.

  A PHY child of a basic-radio-base node selects a mode with its
  phy-mode phandle. BASIC_RADIO_CONFIG_DT() reads these properties from that
  mode node into struct basic_radio_config.

properties:
  modulation:
    type: string
    required: true
    enum:
      - "2-gfsk"
      - "4-gfsk"
      - "2-fsk"
      - "ook"
      - "msk"
      - "oqpsk"
      - "ofdm"
    description: Modulation scheme. The order matches enum basic_radio_modulation.

  datarate-bps:
    type: int
    required: true
    description: |
      Over-the-air bitrate in bits per second. For spread waveforms
      (O-QPSK, DSSS) this is the data rate, not the chip rate.

  deviation-hz:
    type: int
    description: FSK / GFSK frequency deviation in Hz.

  frequency-min-hz:
    type: int
    required: true
    description: Lowest characterized carrier frequency in Hz.

  frequency-max-hz:
    type: int
    required: true
    description: Highest characterized carrier frequency in Hz.

  sync-word-length:
    type: int
    description: Sync word length on air in bytes.

  preamble-length:
    type: int
    description: Preamble length in bytes.

  crc-enable:
    type: boolean
    description: The PHY generates and checks a hardware CRC.

  whitening-enable:
    type: boolean
    description: The PHY whitens the payload.

  variable-length:
    type: boolean
    description: Frames carry an explicit length field.
```

## dts/bindings/basic_radio/ti,cc23x0-basic-radio-phy.yaml
```yaml
# Copyright (c) 2026 Texas Instruments Incorporated
# SPDX-License-Identifier: Apache-2.0

description: |
  Child of a "ti,cc23x0-basic-radio" node. The first child is the boot PHY;
  basic_radio_config(dev, BASIC_RADIO_CONFIG_DT(node)) selects another one.

  Example:

    phy0: phy_default {
        compatible = "ti,cc23x0-basic-radio-phy";
        ti,radio-mode = <&ti_phy_ble_gen_1_mbps>;
        frequency-hz = <2450000000>;
        sync-word = <0x930B51DE>;
        tx-power-dbm = <5>;
    };

compatible: "ti,cc23x0-basic-radio-phy"

include: basic-radio-base.yaml

properties:
  ti,radio-mode:
    type: phandle
    required: true
    description: Operating mode node of a ti,cc23x0-radio-config.
```

## dts/bindings/basic_radio/ti,cc23x0-basic-radio.yaml
```yaml
# Copyright (c) 2026 Texas Instruments Incorporated
# SPDX-License-Identifier: Apache-2.0

description: |
  basic_radio device on TI CC23x0 SoCs, built on the Radio Control Layer.

  The boot PHY is selected with CONFIG_BASIC_RADIO_CC23X0_BOOT_PHY. Other
  PHYs are passed at runtime as struct basic_radio_cc23x0_phy objects
  (<zephyr/drivers/basic_radio/ti/cc23x0.h>).

  Example:

    / {
        basic_radio0: basic-radio {
            compatible = "ti,cc23x0-basic-radio";
            status = "okay";
        };
    };

compatible: "ti,cc23x0-basic-radio"

include: basic-radio-base.yaml
```
