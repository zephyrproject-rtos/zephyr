## dts/bindings/audio/nxp,dmic-pdm.yaml
```yaml
# Copyright 2025 NXP
# SPDX-License-Identifier: Apache-2.0

description: |
  NXP PDM Microphone Interface (MICFIL), DMA-driven variant.

  This binding drives the MICFIL peripheral through the eDMA engine using the
  fsl_pdm.h HAL. It implements the Zephyr dmic API with arbitrary logical-to-
  hardware channel maps by fanning the single MICFIL DMA request out to one
  eDMA channel per captured channel, chained together with the eDMA minor link.

  The "dmas" property must reference the base eDMA channel and the MICFIL DMA
  request source. The driver consumes "num_chan" consecutive eDMA channels
  starting from the base channel given in the first cell.

compatible: "nxp,dmic-pdm"

include:
  - base.yaml
  - pinctrl-device.yaml

properties:
  reg:
    required: true

  clocks:
    required: true

  dmas:
    required: true
    description: |
      eDMA specifier for the receive path. The channel cell is the base eDMA
      channel; the driver reserves num_chan consecutive channels from there.
      The source cell is the MICFIL DMA request source.

  dma-names:
    required: true
    description: Must contain "rx".

  quality-mode:
    type: int
    enum: [0, 1, 4, 5, 6, 7]
    default: 0
    description: |
      Decimation filter quality mode.
      0 = Medium, default value, PoR reset value of register
      1 = High
      4 = VeryLow2
      5 = VeryLow1
      6 = VeryLow0
      7 = Low

  cic-decimation-rate:
    type: int
    description: |
      CIC filter decimation rate setting,
      range is SoC specific, may [0, 15] or [8, 31].

  fifo-watermark:
    type: int
    description: |
      FIFO watermark level (implementation defined, typically 7),
      range is SoC specific, may [0, 7] or [0, 15].

  sample-rate:
    type: int
    enum: [8000, 12000, 16000, 24000, 32000, 48000, 96000]
    description: |
      Sample rate in Hz.

child-binding:
  description: |
    NXP MICFIL channel. Can be used to configure DC remover cutoff frequency and gain.
  include:
    - name: base.yaml
      property-allowlist:
        - reg
  properties:
    reg:
      required: true
    dc-remover-cutoff-freq:
      type: int
      enum: [0, 1, 2, 3]
      default: 0
      description: |
        DC remover cutoff frequency in Hz
        0: 20Hz (FS=48KHz), default value, PoR reset value
        1: 13.3Hz (FS=48KHz)
        2: 40Hz (FS=48KHz)
        3: DC remover is bypassed

    decimation-filter-gain:
      type: int
      default: 0
      description: |
        Decimation filter gain setting, range: [0, 15].
        Default is PoR reset value of register.
```

## dts/bindings/audio/raspberrypi,rp2040-pdm.yaml
```yaml
# Copyright (c) Arduino s.r.l. and/or its affiliated companies
# SPDX-License-Identifier: Apache-2.0

description: |
  RP2040 PIO-based PDM microphone

  A child of a raspberrypi,pico-pio node. One state machine generates the PDM
  clock and samples the data line; a DMA channel moves the raw bitstream to
  memory, where it is decimated to 16-bit PCM.

  The pinctrl state must provide two groups, each with a single PIO pin:
  "clk_gpio" (PDM clock output) and "din_gpio" (PDM data input).

  Example:

    &pinctrl {
      pdm_default: pdm_default {
        clk_gpio {
          pinmux = <PIO0_P23>;
        };
        din_gpio {
          pinmux = <PIO0_P22>;
          input-enable;
        };
      };
    };

    &pio0 {
      status = "okay";

      pdm {
        compatible = "raspberrypi,rp2040-pdm";
        pinctrl-0 = <&pdm_default>;
        pinctrl-names = "default";
        clocks = <&clocks RPI_PICO_CLKID_CLK_SYS>;
        dmas = <&dma 0 0 0>;
        dma-names = "rx";
      };
    };

compatible: "raspberrypi,rp2040-pdm"

include: [base.yaml, "raspberrypi,pico-pio-device.yaml"]

properties:
  pinctrl-0:
    required: true

  pinctrl-names:
    required: true

  clocks:
    required: true
    description: Clock feeding the PIO block, used to derive the PDM clock divider

  dmas:
    required: true
    description: |
      DMA channel used to read the PIO RX FIFO. The slot cell is ignored: the
      request line is taken from the state machine allocated at runtime.

  dma-names:
    required: true
    description: Must be "rx"

  gain:
    type: int
    default: 16
    description: OpenPDM filter gain (1..65535)
```

## dts/bindings/audio/renesas,ra-pdm.yaml
```yaml
# Copyright The Zephyr Project Contributors
# SPDX-License-Identifier: Apache-2.0

description: |
  One channel of the Renesas RA Pulse Density Modulation Interface (PDM-IF).

  Each channel has its own data pin, filter chain and data buffer, and is
  described by its own node. The chain is a sinc decimator, then a high pass
  filter that removes the modulator's DC bias, then a compensation filter that
  corrects the sinc filter's passband droop, then a half band low pass filter
  that rejects what the final decimation would otherwise alias into the band.
  Every coefficient below defaults to its register's reset value; together
  those are the module's voice band setting, a 100 Hz high pass corner and a
  7 kHz low pass corner, which is what capture at 16 kHz wants. A design
  capturing at another rate wants a chain designed for it, which the hardware
  manual does not tabulate. A channel samples its own PDMDATn pin on the
  rising edge of PDM_CLKn, or the pin of the channel below it on the falling
  edge, which is how two microphones sharing one data line are read.

compatible: "renesas,ra-pdm"

include: [base.yaml, pinctrl-device.yaml]

properties:
  reg:
    required: true

  channel:
    type: int
    required: true
    enum: [0, 1, 2]
    description: |
      PDM-IF channel this node describes, which selects the PDMDATn and
      PDMCLKn pins it drives.

  clocks:
    required: true

  clock-names:
    required: true
    description: |
      Must be "pclk" for the peripheral bus clock the module-stop bit belongs
      to, followed by "pdmifclk" for the node supplying PDMIFCLK. The driver
      divides the PDMIFCLK rate down to the microphone clock, so the second
      entry has to carry a "clock-frequency".

  interrupts:
    required: true

  interrupt-names:
    required: true
    description: |
      Must be "dat" for the data reception interrupt and "err" for the error
      detection interrupt of this channel.

  pinctrl-0:
    required: true

  pinctrl-names:
    required: true

  sinc-filter-order:
    type: int
    default: 4
    enum: [1, 2, 3, 4]
    description: |
      Order of the sinc filter that decimates the one-bit stream. A higher
      order rejects more of the modulator's shaped noise and needs more of the
      twenty-bit output range for the filter's own gain. The default is the
      reset value of the mode setting register.

  falling-edge:
    type: boolean
    description: |
      Sample the data pin of the channel below this one on the falling edge of
      its clock, rather than this channel's own pin on the rising edge. A PDM
      microphone whose select input is tied high drives the line on the falling
      edge, so a pair sharing one line is read as this channel and the one
      above it. Channel 0 reads channel 2's pin.

  lpf-shift:
    type: int
    default: 0
    enum: [0, 1, 2, 3]
    description: |
      Right shift applied to the low pass filter's input, in bits. Shifting
      trades headroom for resolution where a loud microphone would otherwise
      saturate the filter. The default is the reset value.

  compensation-shift:
    type: int
    default: 0
    enum: [0, 1, 2, 3]
    description: |
      Right shift applied to the compensation filter's input, in bits. The
      default is the reset value.

  hpf-shift:
    type: int
    default: 0
    enum: [0, 1, 2, 3]
    description: |
      Right shift applied to the high pass filter's input, in bits. The
      default is the reset value.

  hpf-coefficient-s0:
    type: int
    default: 0x3F61
    description: |
      High pass filter s(0) coefficient, as 16-bit signed data with fourteen
      fraction bits. The reset value puts the corner at 100 Hz.

  hpf-coefficient-k1:
    type: int
    default: 0x3EC1
    description: |
      High pass filter k(1) coefficient, in the same format as s(0).

  hpf-coefficients-h:
    type: array
    default: [0x4000, 0xC000]
    description: |
      The high pass filter's two h coefficients, h(0) and h(1).

  compensation-coefficients:
    type: array
    default: [0x1FE8, 0x0039, 0x003C, 0x1E56, 0x01DC, 0x06E1,
              0x01DC, 0x1E56, 0x003C, 0x0039, 0x1FE8]
    description: |
      The eleven h coefficients of the compensation filter, which flattens the
      droop the sinc filter leaves across the passband.

  lpf-coefficient-h0:
    type: int
    default: 0x0400
    description: |
      Centre coefficient of the half band low pass filter, which is also the
      final decimation by two. The reset values put the corner at 7 kHz.

  lpf-coefficients-h1:
    type: array
    default: [0x1FF8, 0x000A, 0x1FF0, 0x0018, 0x1FDC, 0x0034, 0x1FB3, 0x0076,
              0x1F2E, 0x0289, 0x0289, 0x1F2E, 0x0076, 0x1FB3, 0x0034, 0x1FDC,
              0x0018, 0x1FF0, 0x000A, 0x1FF8]
    description: |
      The twenty remaining coefficients of the half band low pass filter.
```

## dts/bindings/audio/st,stm32-dac-audio.yaml
```yaml
# SPDX-FileCopyrightText: Copyright (c) 2026 Draeger
# SPDX-License-Identifier: Apache-2.0

description: |
  PCM audio playback on an STM32 DAC channel, streamed by DMA and clocked by a
  basic timer's TRGO trigger.

compatible: "st,stm32-dac-audio"

include: base.yaml

properties:
  dmas:
    required: true

  io-channels:
    type: phandle-array
    required: true

  st,dac-trigger-timer:
    type: phandle
    description: |
      Selects the timer that is used to trigger the DMA transfer.
    required: true

  st,dac-trigger-source:
    type: string
    description: |
      Selects the trigger output source for DMA operation, must match the
      selected timer. Not all options are available on all series.
    default: TIM6_TRGO
    enum:
      - TIM1_TRGO
      - TIM2_TRGO
      - TIM3_TRGO
      - TIM4_TRGO
      - TIM5_TRGO
      - TIM6_TRGO
      - TIM7_TRGO
      - TIM8_TRGO
      - TIM9_TRGO
      - TIM15_TRGO
      - TIM18_TRGO
      - TIM21_TRGO
      - TIM23_TRGO
      - TIM24_TRGO
```

## dts/bindings/audio/st,stm32-mdf.yaml
```yaml
# SPDX-FileCopyrightText: Copyright (c) 2026 STMicroelectronics
# SPDX-License-Identifier: Apache-2.0

title: STM32 MDF (Multi-function Digital Filter)

description: |
  The MDF is a sigma-delta (Σ∆) analog-to-digital converter dedicated to
  interface external Σ∆ modulators to STM32 MCUs.

  It features up to 6 serial digital interfaces (SITFx) and
  digital filters (DFLTx) and up to 24-bit final resolution.


compatible: "st,stm32-mdf"

include: ["base.yaml", "reset-device.yaml"]

properties:
  reg:
    required: true

  clocks:
    required: true

  clock-names:
    required: true
    enum: [pclk, aclk]
    description: |
      "pckl" for bus clock, "aclk" for kernel source clock selection.

  resets:
    required: true

child-binding:
  description: Filter instances linked to the MDF device.

  include:
    - name: base.yaml
      property-allowlist:
        - reg
        - interrupts
    - name: pinctrl-device.yaml

  properties:
    reg:
      required: true

    interrupts:
      required: true

    pinctrl-0:
      required: true

    pinctrl-names:
      required: true

    filter-order:
      type: int
      description: |
        SinC filter order from 0 to 5.
        - 0: FastSinC
        - [1-5]: order 1 to 5.
        For audio purpose it is recommended to use order 3 to 5.
      default: 4
      enum: [0, 1, 2, 3, 4, 5]

    offset:
      type: int
      description: Offset error compensation.
      default: 0
      min: 0
      max: 67108863

    gain:
      type: int
      description: Filter gain in dB. Value must be a multiple of 3dB.
      default: 0
      min: -48
      max: 72

    st,reshape-filter-decimation:
      type: int
      description: |
        Reshape filter decimation ratio.
        Reshape filter is not enabled if this property is not present.
      enum: [1, 4]

    st,highpass-filter-cutoff:
      type: int
      description: |
        High pass filter cut-off frequency.
        - 0: 0.000625 x FPCM
        - 1: 0.00125 x FPCM
        - 2: 0.00250 x FPCM
        - 3: 0.00950 x FPCM
      enum: [0, 1, 2, 3]

    st,integrator-on:
      type: boolean
      description: Enable the integrator.

    st,sound-activity-on:
      type: boolean
      description: Enable the sound activity interrupts.
```

## dts/bindings/audio/ti,tas2560.yaml
```yaml
# SPDX-FileCopyrightText: Copyright (c) 2026 RAKwireless Technology Limited
# SPDX-License-Identifier: Apache-2.0

description: |
  Texas Instruments TAS2560 Class-D audio amplifier.

  One node is one mono amplifier. A stereo board is two nodes on the same bus,
  each with its own I2C address and ti,asi-channel.

  Playback is 16-bit I2S at 16, 48, or 96 kHz. The PLL takes BCLK and must
  stay between 512 kHz and 20 MHz. I2S has two slots, so 8 kHz would be a
  256 kHz bit clock and is rejected even though PCM_RATE can encode it. The
  PLL output is 1024 times the sample rate, which is J = 32 for 16-bit I2S.

compatible: "ti,tas2560"

include: i2c-device.yaml

properties:
  ti,asi-channel:
    type: int
    default: 0
    enum:
      - 0
      - 1
      - 2
    description: |
      I2S channel mixed into this amplifier.
      0 is left, 1 is right, 2 is (left + right) / 2.
      The driver sets ASI_MODE to I2S, so mono PCM is not available.
```

## dts/bindings/audio/ti,tlv320aic3104.yaml
```yaml
# SPDX-FileCopyrightText: Copyright The Zephyr Project Contributors
# SPDX-License-Identifier: Apache-2.0

title: Texas Instruments TLV320AIC3104 stereo audio codec

description: |
  Texas Instruments TLV320AIC3104 low-power stereo audio codec.
  I2C control interface with page-based register access (pages 0 and 1).
  Datasheet: https://www.ti.com/product/TLV320AIC3104

  The 32-pin RHB package has no interrupt output pin.

compatible: "ti,tlv320aic3104"

include: i2c-device.yaml

properties:
  reset-gpios:
    type: phandle-array
    required: true
    description: GPIO for hardware reset (active-low)

  mic-bias-level:
    type: int
    default: 0
    enum:
      - 0
      - 1
      - 2
      - 3
    description: |
      MICBIAS output level (page 0, register 25, D7-D6).
      0 = off (default, matches the part's reset state). 1 = 2 V.
      2 = 2.5 V. 3 = connected to AVDD.

  adc-high-pass-filter:
    type: int
    default: 0
    enum:
      - 0
      - 1
      - 2
      - 3
    description: |
      ADC high-pass filter corner for both channels (page 0, register 12,
      D7-D4). 0 = disabled (default, matches the part's reset state).
      1 = 0.0045 x fS(ADC). 2 = 0.0125 x fS(ADC). 3 = 0.025 x fS(ADC).

  hprcom-vcm-output:
    type: boolean
    description: |
      Drive HPRCOM as a constant common-mode voltage and power it up
      (page 0, register 38 D5-D3 = 001, and register 72).

      Set this on a board that returns the headphone load through HPRCOM
      instead of ground - a jack whose sleeve is wired to the pin rather
      than to GND. Without it HPRCOM stays at its reset state, which is
      powered down and high-impedance, and such a load has no return path:
      the two channels end up in series with a floating midpoint, so only
      their difference is audible and a mono source is silent.

      Leave it out on a board that grounds the sleeve. HPRCOM is then
      unused, and powering it would only burn current.
```
