## dts/bindings/basic_radio/ti,cc23x0-radio-config.yaml
```yaml
# Copyright (c) 2026 Texas Instruments Incorporated
# SPDX-License-Identifier: Apache-2.0

description: |
  TI CC23x0 radio configuration exported from SmartRF Studio.

  One node per export. It carries the complete LRF_Config the radio needs:
  microcode image names, every LRF register segment (with the register
  names as comments), software configs, TX shapes and the TX power table.
  The CC23x0 basic_radio driver builds LRF_Config from this node at compile
  time. No generated C file is involved.

  Files with this node are generated, either by a SmartRF Studio .dtsi
  export or by scripts/basic_radio/ti_radio_config_to_dtsi.py from a C export. Do not
  edit register words by hand: a waveform change requires a new export.

  Children (see ti-radio-config-base.yaml):
    - "reg-config": the register segments, in LRF_RegConfigList order.
      Words that hold addresses use TI_LRF_PTR_* tokens.
    - One node per operating mode (for example 1 Mbps / 2 Mbps / Coded in
      the BLE generic PHY).

  Applications reference a mode node from a ti,cc23x0-basic-radio-phy node
  (ti,radio-mode), never this node.

  Example:

    ti_phy_ble_gen: ble-gen {
        compatible = "ti,cc23x0-radio-config";
        ti,pbe-image = "generic";
        ti,mce-image = "ble5";
        ti,rfe-image = "ble5";
        ...
        reg-config {
            common {
                ti,words = <0x0000003F 0x0004A002 0x00000000
                            TI_LRF_PTR_TX_POWER_TABLE ...>;
            };
        };
        ti_phy_ble_gen_1_mbps: mode-1-mbps {
            ti,phy-feature = <0x0000>;
            modulation = "2-gfsk";
            datarate-bps = <1000000>;
            ...
        };
    };

compatible: "ti,cc23x0-radio-config"

include: ti-radio-config-base.yaml

properties:
  ti,pbe-image:
    type: string
    required: true
    enum: ["ble5", "ble_cs", "common", "generic", "ieee"]
    description: PBE microcode image (LRF_PBE_binary_<name>).

  ti,mce-image:
    type: string
    required: true
    enum: ["ble5", "ble_cs", "common", "genfsk", "ieee"]
    description: MCE microcode image (LRF_MCE_binary_<name>).

  ti,rfe-image:
    type: string
    required: true
    enum:
      - "ble5"
      - "ble5_nopll"
      - "ble_cs"
      - "ble_cs_nopll"
      - "coherent_pll"
      - "coherent_pll_nopll"
      - "common"
      - "common_nopll"
      - "genfsk"
      - "genfsk_nopll"
      - "ieee"
      - "ieee_nopll"
    description: RFE microcode image (LRF_RFE_binary_<name>).

  ti,len-pos:
    type: int
    description: |
      PBE_GENERIC_RAM.LENCFG.LENPOS, bit position of the length field.
      Present only in exports that use the generic PBE image, and required
      there; exports for other PBE images (for example ble5) have no LENCFG.

  ti,num-len-bits:
    type: int
    description: |
      PBE_GENERIC_RAM.LENCFG.NUMLENBITS, size of the length field in bits.
      Present and required under the same condition as ti,len-pos.

  ti,tx-power-table:
    type: array
    required: true
    description: |
      LRF TX power table, one cell per entry, sorted from lowest to highest
      power. Each cell is TI_LRF_TX_POWER(dbm, temp_coeff, ib, gain, mode).

  ti,sw-config-0:
    type: array
    description: |
      LRF_SwConfig, seven cells: rxIntFrequency rxFrequencyOffset
      txFrequencyOffset modFrequencyDeviation txShape bwIndex bwIndexDither.
      txShape is the index N of ti,tx-shape-N, or TI_LRF_NO_TX_SHAPE.
      Referenced from register segments by TI_LRF_PTR_SW_CONFIG_0.

  ti,sw-config-1:
    type: array
    description: Same as ti,sw-config-0, referenced by TI_LRF_PTR_SW_CONFIG_1.

  ti,sw-config-2:
    type: array
    description: Same as ti,sw-config-0, referenced by TI_LRF_PTR_SW_CONFIG_2.

  ti,sw-config-3:
    type: array
    description: Same as ti,sw-config-0, referenced by TI_LRF_PTR_SW_CONFIG_3.

  ti,tx-shape-0:
    type: uint8-array
    description: LRF_TxShape coefficients.

  ti,tx-shape-0-scale:
    type: int
    description: LRF_TxShape scale for ti,tx-shape-0.

  ti,tx-shape-1:
    type: uint8-array
    description: LRF_TxShape coefficients.

  ti,tx-shape-1-scale:
    type: int
    description: LRF_TxShape scale for ti,tx-shape-1.

  ti,tx-shape-2:
    type: uint8-array
    description: LRF_TxShape coefficients.

  ti,tx-shape-2-scale:
    type: int
    description: LRF_TxShape scale for ti,tx-shape-2.

  ti,tx-shape-3:
    type: uint8-array
    description: LRF_TxShape coefficients.

  ti,tx-shape-3-scale:
    type: int
    description: LRF_TxShape scale for ti,tx-shape-3.
```

## dts/bindings/basic_radio/ti,cc23x0-radio-phy-config.yaml
```yaml
# Copyright (c) 2026 Texas Instruments Incorporated
# SPDX-License-Identifier: Apache-2.0

description: |
  TI CC23x0 PHY: names the LRF_Config that holds the radio settings and
  describes its operating modes (basic-radio-phy-mode.yaml). The register
  data itself is C, exported from SmartRF Studio; this node only carries
  metadata the driver needs.

  Certified PHYs are listed per SoC, for example in
  <ti/cc2340r5-radio-phys.dtsi>. Their LRF_Config
  objects live in hal_ti (source/ti/radio_phys/) and are named
  LRF_config_<phy>.

  Custom PHY:
    1. Export the PHY from SmartRF Studio as C and add the .c file to the
       application (target_sources(app PRIVATE ...)).
    2. Add a node with this compatible to the application overlay, set
       ti,lrf-config to the name of the exported LRF_Config (LRF_config by
       default) and add one child per operating mode.
    3. Point phy-mode of a basic-radio-base PHY child at a mode.

  Example:

    radio-phys {
        my_phy: my-phy {
            compatible = "ti,cc23x0-radio-phy-config";
            ti,lrf-config = "LRF_config";
            ti,len-pos = <8>;
            ti,num-len-bits = <8>;

            my_phy_1_mbps: mode-1-mbps {
                ti,phy-feature = <0x0000>;
                modulation = "2-gfsk";
                datarate-bps = <1000000>;
                deviation-hz = <250000>;
                frequency-min-hz = <2400000000>;
                frequency-max-hz = <2483500000>;
                crc-enable;
                variable-length;
            };
        };
    };

  The mode properties must match the C export. The build does not check
  them against the register data.

compatible: "ti,cc23x0-radio-phy-config"

properties:
  ti,lrf-config:
    type: string
    required: true
    description: |
      C identifier of the const LRF_Config for this PHY. The driver declares
      it extern and links against it.

  ti,len-pos:
    type: int
    description: |
      PBE_GENERIC_RAM.LENCFG.LENPOS of the export: bit position of the
      length field in the frame header. Required by the generic PBE driver.

  ti,num-len-bits:
    type: int
    description: |
      PBE_GENERIC_RAM.LENCFG.NUMLENBITS of the export: size of the length
      field in bits. Required by the generic PBE driver.

child-binding:
  description: |
    One operating mode. Several modes share the LRF_Config and differ only in
    the phyFeatures word.

  include: basic-radio-phy-mode.yaml

  properties:
    ti,phy-feature:
      type: int
      required: true
      description: |
        phyFeatures word written to the radio commands. Selects which
        feature-gated register segments are applied. 0 for PHYs without
        sub-PHYs.
```

## dts/bindings/basic_radio/ti-radio-config-base.yaml
```yaml
# Copyright (c) 2026 Texas Instruments Incorporated
# SPDX-License-Identifier: Apache-2.0

description: |
  Children shared by the TI radio configuration bindings exported from
  SmartRF Studio (ti,cc23x0-radio-config, ti,cc140x-radio-config).

  A radio configuration node has two kinds of children:
    - Register containers. Each grandchild holds one register segment
      (ti,words) in the order the radio applies them.
    - Operating modes. Several modes can share one register configuration
      and differ only in the phyFeatures word. An export with a single
      mode has one mode child with ti,phy-feature = <0>.

child-binding:
  description: |
    Either a register container or an operating mode. Both share this
    binding, so mode properties cannot be marked required here; the driver
    checks them at build time for every mode an application references.

    Mode properties are derived from the register data by the exporter and
    describe what the radio does. They are read-only: to change them,
    export a new configuration from SmartRF Studio.
  properties:
    ti,phy-feature:
      type: int
      description: |
        Mode only (required). phyFeatures word written to the radio
        commands. Selects which feature-gated register segments are applied.
        If NO SubPHYs (like BLE 1M, 2M, Coded), then 0x000

    modulation:
      type: string
      enum:
        - "2-gfsk"
        - "4-gfsk"
        - "2-fsk"
        - "ook"
        - "msk"
        - "oqpsk"
        - "ofdm"
      description: |
        Mode only (required). Modulation scheme. The order matches
        enum basic_radio_modulation.

    datarate-bps:
      type: int
      description: |
        Mode only (required). Over-the-air bitrate in bits per second. For
        spread waveforms (O-QPSK, DSSS) this is the data rate, not the chip
        rate.

    deviation-hz:
      type: int
      description: Mode only. FSK / GFSK frequency deviation in Hz.

    frequency-min-hz:
      type: int
      description: Mode only (required). Lowest characterized carrier frequency in Hz.

    frequency-max-hz:
      type: int
      description: Mode only (required). Highest characterized carrier frequency in Hz.

    crc-enable:
      type: boolean
      description: Mode only. The PHY generates and checks a hardware CRC.

    variable-length:
      type: boolean
      description: Mode only. Frames carry an explicit length field.

  child-binding:
    description: One register segment (LRF_ConfigWord array), child of a register container.
    properties:
      ti,words:
        type: array
        required: true
        description: |
          Segment header word followed by region headers and values.
```
