/*
 * Copyright (c) 2017 Linaro Limited
 *
 * SPDX-License-Identifier: Apache-2.0
 */

/dts-v1/;
#include <st/stm32f469.dtsi>

/ {
	model = "STMicroelectronics STM32F469I-DISCO board";
	compatible = "st,stm32f469i-disco", "st,stm32f469";

	chosen {
		zephyr,console = &usart3;
		zephyr,sram = &sram0;
		zephyr,flash = &flash0;
	};
};

&usart3 {
	current-speed = <115200>;
	pinctrl-0 = <&usart3_pins_a>;
	pinctrl-names = "default";
	status = "ok";
};

&usart6 {
	current-speed = <115200>;
	pinctrl-0 = <&usart6_pins_a>;
	pinctrl-names = "default";
	status = "ok";
};
