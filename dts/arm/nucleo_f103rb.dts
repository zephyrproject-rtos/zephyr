/*
 * Copyright (c) 2017 Linaro Limited
 *
 * SPDX-License-Identifier: Apache-2.0
 */

/dts-v1/;
#include <st/stm32f103Xb.dtsi>

/ {
	model = "STMicroelectronics STM32F103RB-NUCLEO board";
	compatible = "st,stm32f103rb-nucleo", "st,stm32f103rb";

	chosen {
		zephyr,console = &usart2;
		zephyr,sram = &sram0;
		zephyr,flash = &flash0;
	};
};

&usart2 {
	current-speed = <115200>;
	status = "ok";
};
