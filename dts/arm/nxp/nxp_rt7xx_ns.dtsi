/*
 * Copyright 2024 NXP
 *
 * SPDX-License-Identifier: Apache-2.0
 */

#include <mem.h>

/ {
	soc {
		sram: sram@0 {
			ranges = <0x0 0x0 0x780000
				0x20000000 0x20000000 0x780000>;
		};

		peripheral: peripheral@40000000 {
			ranges = <0x0 0x40000000 0x10000000>;
		};
	};
};

#if defined SOC_MIMXRT798S_CPU0
#include "nxp_rt7xx_cpu0.dtsi"
#elif defined SOC_MIMXRT798S_CPU1
#include "nxp_rt7xx_cpu1.dtsi"
#endif
