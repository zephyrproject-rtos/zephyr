/*
 * Copyright 2026 NXP
 *
 * SPDX-License-Identifier: Apache-2.0
 */

#include <nxp/mcx/mcxa/nxp_mcxa156.dtsi>

&flash {
	reg = <0 DT_SIZE_K(512)>;
	ranges = <0x0 0x0 DT_SIZE_K(512)>;
};

&sram0 {
	reg = <0x20000000 DT_SIZE_K(80)>;
};
