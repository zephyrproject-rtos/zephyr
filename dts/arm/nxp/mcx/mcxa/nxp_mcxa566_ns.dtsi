/*
 * SPDX-FileCopyrightText: Copyright 2026 NXP
 *
 * SPDX-License-Identifier: Apache-2.0
 */

#include <nxp/mcx/mcxa/nxp_mcxa5x_ns.dtsi>

/*
 * MCXA566 has 1 MiB of flash.
 */
&flash {
	reg = <0 DT_SIZE_M(1)>;
};

/*
 * MCXA566 has 384 KiB of RAM.
 */
&sram0 {
	reg = <0x20000000 DT_SIZE_K(384)>;
};

/delete-node/ &tsi0;
