/*
 * SPDX-FileCopyrightText: Copyright 2026 NXP
 * SPDX-License-Identifier: Apache-2.0
 */

#include <nxp/mcx/mcxa/nxp_mcxa366.dtsi>

&flash {
	reg = <0 DT_SIZE_K(504)>;
	ranges = <0x0 0x0 DT_SIZE_K(504)>;
};

&sram0 {
	reg = <0x20000000 DT_SIZE_K(120)>;
};

&sramx {
	reg = <0x04000000 DT_SIZE_K(16)>;
};
