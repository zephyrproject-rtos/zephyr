/*
 * Copyright 2024-2025 NXP
 *
 * SPDX-License-Identifier: Apache-2.0
 */

#include <nxp/mcx/mcxa/nxp_mcxaxx6_common.dtsi>

&flash {
	reg = <0 DT_SIZE_K(960)>;
	ranges = <0x0 0x0 DT_SIZE_K(960)>;
};
