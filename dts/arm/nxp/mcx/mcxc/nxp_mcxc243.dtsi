/*
 * Copyright 2026 NXP
 *
 * SPDX-License-Identifier: Apache-2.0
 */

#include <nxp/mcx/mcxc/nxp_mcxc444.dtsi>

/delete-node/ &sram0;

/ {
	sram0: memory@1ffff000 {
		compatible = "mmio-sram";
		reg = <0x1ffff000 DT_SIZE_K(16)>;
	};
};

&flash0 {
	reg = <0 DT_SIZE_K(128)>;
	ranges = <0x0 0x0 DT_SIZE_K(128)>;
};
