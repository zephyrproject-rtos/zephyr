/*
 * Copyright 2026 NXP
 *
 * SPDX-License-Identifier: Apache-2.0
 */

#include "nxp_mcxn947.dtsi"

&soc {
	compatible = "nxp,mcx", "simple-bus";
};

/delete-node/ &cpu1;

/*
 * MCXN247 omits these peripheral instances from the MCXN947 superset.
 */
/delete-node/ &lpcmp2;
/delete-node/ &flexcomm8;
/delete-node/ &flexcomm9;
/delete-node/ &mbox;
/delete-node/ &micfil;
/delete-node/ &powerquad;
/delete-node/ &sai0;
/delete-node/ &sai1;
/delete-node/ &sema42;
/delete-node/ &tsi0;
/delete-node/ &usb0;
/delete-node/ &usdhc0;
