/*
 * SPDX-FileCopyrightText: Copyright 2026 NXP
 *
 * SPDX-License-Identifier: Apache-2.0
 */

#include "nxp_mcxn94x.dtsi"

/*
 * MCXN946 has 1 MiB of flash vs MCXN947's 2 MiB
 * (FSL_FEATURE_SYSCON_FLASH_SIZE_BYTES: 1048576 vs 2097152 in the vendor
 * feature headers).
 */
&flash {
	reg = <0 DT_SIZE_M(1)>;
	ranges = <0x0 0x0 DT_SIZE_M(1)>;
};

/*
 * MCXN946 has 352 KiB of RAM vs MCXN947's 512 KiB: RAMX is unchanged at
 * 96 KiB, but the main SRAM region (RAMA-RAMH) is 256 KiB instead of 416 KiB.
 */
&sram0 {
	reg = <0x20000000 DT_SIZE_K(256)>;
};

/* MCXN946 does not implement these peripherals. */
/delete-node/ &micfil;
/delete-node/ &tsi0;
/delete-node/ &usdhc0;
