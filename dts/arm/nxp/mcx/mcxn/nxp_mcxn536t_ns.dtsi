/*
 * Copyright 2026 NXP
 *
 * SPDX-License-Identifier: Apache-2.0
 */

#include "nxp_mcxn947_ns.dtsi"

&soc {
	compatible = "nxp,mcx", "simple-bus";
};

/delete-node/ &flexcan1;
/delete-node/ &dac1;
/delete-node/ &dac2;
/delete-node/ &flexpwm1;
/delete-node/ &qdc0;
/delete-node/ &qdc1;
/delete-node/ &usb0;

&flash {
	reg = <0 DT_SIZE_M(1)>;
	ranges = <0x0 0x0 DT_SIZE_M(1)>;
};

&sram0 {
	reg = <0x20000000 DT_SIZE_K(256)>;
};
