/*
 * Copyright 2026 NXP
 *
 * SPDX-License-Identifier: Apache-2.0
 */

#include "nxp_mcxn947.dtsi"

&soc {
	compatible = "nxp,mcx", "simple-bus";
};

/delete-node/ &lpcmp2;
/delete-node/ &flexpwm1;
/delete-node/ &flexcan1;
/delete-node/ &opamp0;
/delete-node/ &dac1;
/delete-node/ &opamp1;
/delete-node/ &dac2;
/delete-node/ &opamp2;
/delete-node/ &qdc1;
