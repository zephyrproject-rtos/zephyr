/*
 * Copyright (c) 2018 Linaro Limited
 *
 * SPDX-License-Identifier: Apache-2.0
 */

#include <arm/armv7-m.dtsi>
#include <nxp/nxp_lpc54xxx.dtsi>

/ {
	cpus {
		cpu@0 {
			compatible = "arm,cortex-m4f";
		};

		/delete-node/ cpu@1;
	};
};

&nvic {
	arm,num-irq-priority-bits = <3>;
};
