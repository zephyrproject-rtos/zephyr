/*
 * Copyright (c) 2019 SEAL AG
 *
 * SPDX-License-Identifier: Apache-2.0
 */

#include <mem.h>
#include <freq.h>
#include <nxp/kinetis/kv5x/nxp_kv5x.dtsi>

/ {
	/* 64KB ITCM @ 0, 128KB DTCM @ 20000000, 64KB OCRAM @ 2F000000 */

	sram0: memory@20000000 {
		compatible = "mmio-sram";
		reg = <0x20000000 DT_SIZE_K(128)>;
	};
};

&flash0 {
	reg = <0x0 DT_SIZE_K(1024)>;
	ranges = <0x0 0x10000000 DT_SIZE_K(1024)>;
};
