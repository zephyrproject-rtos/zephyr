/*
 * Copyright (c) 2017, NXP
 *
 * SPDX-License-Identifier: Apache-2.0
 */

#include <arm/armv6-m.dtsi>
#include <nxp/nxp_lpc54xxx.dtsi>

/ {
	cpus {
		/delete-node/ cpu@0;

		cpu@1 {
			compatible = "arm,cortex-m0+";
		};
	};
};

&nvic {
	arm,num-irq-priority-bits = <2>;
};
