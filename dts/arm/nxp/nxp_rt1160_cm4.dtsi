/*
 * Copyright 2025 NXP
 *
 * SPDX-License-Identifier: Apache-2.0
 */

/* SOC DTS for RT1160 cm4 core */

/* Includes the series level for cm4 core, as opposed to cm7, shared with RT1170 */
#include <nxp/nxp_rt11xx_cm4.dtsi>

/* Includes the specifics for RT1170 SOC, as opposed to RT1170 */
#include <nxp/nxp_rt1160.dtsi>
