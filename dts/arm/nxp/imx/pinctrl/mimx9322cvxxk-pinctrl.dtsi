/*
 * Copyright (c) 2023, NXP
 * SPDX-License-Identifier: Apache-2.0
 *
 * Note: File generated by imx_cfg_utils.py
 * from configuration data for MIMX9322CVXXK
 */

/*
 * Delta-deduplicated by dedup_pinctrl.py:
 * based on mimx9352cvuxk-pinctrl.dtsi with this part's differences applied
 * below (132 removed, 0 changed,
 * 0 added). Regenerate with dedup_pinctrl.py;
 * do not edit by hand.
 * target-hash: b66a4e2d2a62f881
 */

#include "mimx9352cvuxk-pinctrl.dtsi"

/delete-node/ &iomuxc1_ccm_clko2_ccmsrcgpcmix_clko_ccmsrcgpcmix_clko2;
/delete-node/ &iomuxc1_ccm_clko2_flexio_flexio_flexio1_flexio27;
/delete-node/ &iomuxc1_ccm_clko2_gpio_io_gpio3_io27;
/delete-node/ &iomuxc1_ccm_clko3_ccmsrcgpcmix_clko_ccmsrcgpcmix_clko3;
/delete-node/ &iomuxc1_ccm_clko3_flexio_flexio_flexio2_flexio28;
/delete-node/ &iomuxc1_ccm_clko3_gpio_io_gpio4_io28;
/delete-node/ &iomuxc1_ccm_clko4_ccmsrcgpcmix_clko_ccmsrcgpcmix_clko4;
/delete-node/ &iomuxc1_ccm_clko4_flexio_flexio_flexio2_flexio29;
/delete-node/ &iomuxc1_ccm_clko4_gpio_io_gpio4_io29;
/delete-node/ &iomuxc1_enet2_mdc_enet_mdc_enet1_mdc;
/delete-node/ &iomuxc1_enet2_mdc_flexio_flexio_flexio2_flexio14;
/delete-node/ &iomuxc1_enet2_mdc_gpio_io_gpio4_io14;
/delete-node/ &iomuxc1_enet2_mdc_lpuart_dcb_b_lpuart4_dcb_b;
/delete-node/ &iomuxc1_enet2_mdc_sai_rx_sync_sai2_rx_sync;
/delete-node/ &iomuxc1_enet2_mdio_enet_mdio_enet1_mdio;
/delete-node/ &iomuxc1_enet2_mdio_flexio_flexio_flexio2_flexio15;
/delete-node/ &iomuxc1_enet2_mdio_gpio_io_gpio4_io15;
/delete-node/ &iomuxc1_enet2_mdio_lpuart_rin_b_lpuart4_rin_b;
/delete-node/ &iomuxc1_enet2_mdio_sai_rx_bclk_sai2_rx_bclk;
/delete-node/ &iomuxc1_enet2_rd0_enet_rgmii_rd_enet1_rgmii_rd0;
/delete-node/ &iomuxc1_enet2_rd0_flexio_flexio_flexio2_flexio24;
/delete-node/ &iomuxc1_enet2_rd0_gpio_io_gpio4_io24;
/delete-node/ &iomuxc1_enet2_rd0_lpuart_rx_lpuart4_rx;
/delete-node/ &iomuxc1_enet2_rd0_sai_tx_data_sai2_tx_data02;
/delete-node/ &iomuxc1_enet2_rd1_enet_rgmii_rd_enet1_rgmii_rd1;
/delete-node/ &iomuxc1_enet2_rd1_flexio_flexio_flexio2_flexio25;
/delete-node/ &iomuxc1_enet2_rd1_gpio_io_gpio4_io25;
/delete-node/ &iomuxc1_enet2_rd1_sai_tx_data_sai2_tx_data03;
/delete-node/ &iomuxc1_enet2_rd1_spdif_in_spdif_in;
/delete-node/ &iomuxc1_enet2_rd2_enet_rgmii_rd_enet1_rgmii_rd2;
/delete-node/ &iomuxc1_enet2_rd2_flexio_flexio_flexio2_flexio26;
/delete-node/ &iomuxc1_enet2_rd2_gpio_io_gpio4_io26;
/delete-node/ &iomuxc1_enet2_rd2_lpuart_cts_b_lpuart4_cts_b;
/delete-node/ &iomuxc1_enet2_rd2_mqs_right_mqs2_right;
/delete-node/ &iomuxc1_enet2_rd2_sai_mclk_sai2_mclk;
/delete-node/ &iomuxc1_enet2_rd3_enet_rgmii_rd_enet1_rgmii_rd3;
/delete-node/ &iomuxc1_enet2_rd3_flexio_flexio_flexio2_flexio27;
/delete-node/ &iomuxc1_enet2_rd3_gpio_io_gpio4_io27;
/delete-node/ &iomuxc1_enet2_rd3_mqs_left_mqs2_left;
/delete-node/ &iomuxc1_enet2_rd3_spdif_in_spdif_in;
/delete-node/ &iomuxc1_enet2_rd3_spdif_out_spdif_out;
/delete-node/ &iomuxc1_enet2_rx_ctl_enet_rgmii_rx_ctl_enet1_rgmii_rx_ctl;
/delete-node/ &iomuxc1_enet2_rx_ctl_flexio_flexio_flexio2_flexio22;
/delete-node/ &iomuxc1_enet2_rx_ctl_gpio_io_gpio4_io22;
/delete-node/ &iomuxc1_enet2_rx_ctl_lpuart_dsr_b_lpuart4_dsr_b;
/delete-node/ &iomuxc1_enet2_rx_ctl_sai_tx_data_sai2_tx_data00;
/delete-node/ &iomuxc1_enet2_rxc_enet_rgmii_rxc_enet1_rgmii_rxc;
/delete-node/ &iomuxc1_enet2_rxc_enet_rx_er_enet1_rx_er;
/delete-node/ &iomuxc1_enet2_rxc_flexio_flexio_flexio2_flexio23;
/delete-node/ &iomuxc1_enet2_rxc_gpio_io_gpio4_io23;
/delete-node/ &iomuxc1_enet2_rxc_sai_tx_data_sai2_tx_data01;
/delete-node/ &iomuxc1_enet2_td0_enet_rgmii_td_enet1_rgmii_td0;
/delete-node/ &iomuxc1_enet2_td0_flexio_flexio_flexio2_flexio19;
/delete-node/ &iomuxc1_enet2_td0_gpio_io_gpio4_io19;
/delete-node/ &iomuxc1_enet2_td0_lpuart_tx_lpuart4_tx;
/delete-node/ &iomuxc1_enet2_td0_sai_rx_data_sai2_rx_data03;
/delete-node/ &iomuxc1_enet2_td1_enet_rgmii_td_enet1_rgmii_td1;
/delete-node/ &iomuxc1_enet2_td1_flexio_flexio_flexio2_flexio18;
/delete-node/ &iomuxc1_enet2_td1_gpio_io_gpio4_io18;
/delete-node/ &iomuxc1_enet2_td1_lpuart_rts_b_lpuart4_rts_b;
/delete-node/ &iomuxc1_enet2_td1_sai_rx_data_sai2_rx_data02;
/delete-node/ &iomuxc1_enet2_td2_enet_rgmii_td_enet1_rgmii_td2;
/delete-node/ &iomuxc1_enet2_td2_enet_tx_clk_enet1_tx_clk;
/delete-node/ &iomuxc1_enet2_td2_flexio_flexio_flexio2_flexio17;
/delete-node/ &iomuxc1_enet2_td2_gpio_io_gpio4_io17;
/delete-node/ &iomuxc1_enet2_td2_sai_rx_data_sai2_rx_data01;
/delete-node/ &iomuxc1_enet2_td3_enet_rgmii_td_enet1_rgmii_td3;
/delete-node/ &iomuxc1_enet2_td3_flexio_flexio_flexio2_flexio16;
/delete-node/ &iomuxc1_enet2_td3_gpio_io_gpio4_io16;
/delete-node/ &iomuxc1_enet2_td3_sai_rx_data_sai2_rx_data00;
/delete-node/ &iomuxc1_enet2_tx_ctl_enet_rgmii_tx_ctl_enet1_rgmii_tx_ctl;
/delete-node/ &iomuxc1_enet2_tx_ctl_flexio_flexio_flexio2_flexio20;
/delete-node/ &iomuxc1_enet2_tx_ctl_gpio_io_gpio4_io20;
/delete-node/ &iomuxc1_enet2_tx_ctl_lpuart_dtr_b_lpuart4_dtr_b;
/delete-node/ &iomuxc1_enet2_tx_ctl_sai_tx_sync_sai2_tx_sync;
/delete-node/ &iomuxc1_enet2_txc_enet_rgmii_txc_enet1_rgmii_txc;
/delete-node/ &iomuxc1_enet2_txc_enet_tx_er_enet1_tx_er;
/delete-node/ &iomuxc1_enet2_txc_flexio_flexio_flexio2_flexio21;
/delete-node/ &iomuxc1_enet2_txc_gpio_io_gpio4_io21;
/delete-node/ &iomuxc1_enet2_txc_sai_tx_bclk_sai2_tx_bclk;
/delete-node/ &iomuxc1_gpio_io22_flexio_flexio_flexio1_flexio22;
/delete-node/ &iomuxc1_gpio_io22_gpio_io_gpio2_io22;
/delete-node/ &iomuxc1_gpio_io22_lpi2c_sda_lpi2c5_sda;
/delete-node/ &iomuxc1_gpio_io22_mediamix_disp_data_mediamix_disp_data18;
/delete-node/ &iomuxc1_gpio_io22_spdif_in_spdif_in;
/delete-node/ &iomuxc1_gpio_io22_tpm_ch_tpm5_ch1;
/delete-node/ &iomuxc1_gpio_io22_tpm_extclk_tpm6_extclk;
/delete-node/ &iomuxc1_gpio_io22_usdhc_clk_usdhc3_clk;
/delete-node/ &iomuxc1_gpio_io23_flexio_flexio_flexio1_flexio23;
/delete-node/ &iomuxc1_gpio_io23_gpio_io_gpio2_io23;
/delete-node/ &iomuxc1_gpio_io23_lpi2c_scl_lpi2c5_scl;
/delete-node/ &iomuxc1_gpio_io23_mediamix_disp_data_mediamix_disp_data19;
/delete-node/ &iomuxc1_gpio_io23_spdif_out_spdif_out;
/delete-node/ &iomuxc1_gpio_io23_tpm_ch_tpm6_ch1;
/delete-node/ &iomuxc1_gpio_io23_usdhc_cmd_usdhc3_cmd;
/delete-node/ &iomuxc1_gpio_io24_flexio_flexio_flexio1_flexio24;
/delete-node/ &iomuxc1_gpio_io24_gpio_io_gpio2_io24;
/delete-node/ &iomuxc1_gpio_io24_jtag_mux_tdo_jtag_mux_tdo;
/delete-node/ &iomuxc1_gpio_io24_lpspi_pcs_lpspi6_pcs1;
/delete-node/ &iomuxc1_gpio_io24_mediamix_disp_data_mediamix_disp_data20;
/delete-node/ &iomuxc1_gpio_io24_tpm_ch_tpm3_ch3;
/delete-node/ &iomuxc1_gpio_io24_usdhc_data_usdhc3_data0;
/delete-node/ &iomuxc1_gpio_io25_can_tx_can2_tx;
/delete-node/ &iomuxc1_gpio_io25_flexio_flexio_flexio1_flexio25;
/delete-node/ &iomuxc1_gpio_io25_gpio_io_gpio2_io25;
/delete-node/ &iomuxc1_gpio_io25_jtag_mux_tck_jtag_mux_tck;
/delete-node/ &iomuxc1_gpio_io25_lpspi_pcs_lpspi7_pcs1;
/delete-node/ &iomuxc1_gpio_io25_mediamix_disp_data_mediamix_disp_data21;
/delete-node/ &iomuxc1_gpio_io25_tpm_ch_tpm4_ch3;
/delete-node/ &iomuxc1_gpio_io25_usdhc_data_usdhc3_data1;
/delete-node/ &iomuxc1_gpio_io26_gpio_io_gpio2_io26;
/delete-node/ &iomuxc1_gpio_io26_jtag_mux_tdi_jtag_mux_tdi;
/delete-node/ &iomuxc1_gpio_io26_lpspi_pcs_lpspi8_pcs1;
/delete-node/ &iomuxc1_gpio_io26_mediamix_disp_data_mediamix_disp_data22;
/delete-node/ &iomuxc1_gpio_io26_pdm_bit_stream_pdm_bit_stream01;
/delete-node/ &iomuxc1_gpio_io26_sai_tx_sync_sai3_tx_sync;
/delete-node/ &iomuxc1_gpio_io26_tpm_ch_tpm5_ch3;
/delete-node/ &iomuxc1_gpio_io26_usdhc_data_usdhc3_data2;
/delete-node/ &iomuxc1_gpio_io27_can_rx_can2_rx;
/delete-node/ &iomuxc1_gpio_io27_flexio_flexio_flexio1_flexio27;
/delete-node/ &iomuxc1_gpio_io27_gpio_io_gpio2_io27;
/delete-node/ &iomuxc1_gpio_io27_jtag_mux_tms_jtag_mux_tms;
/delete-node/ &iomuxc1_gpio_io27_lpspi_pcs_lpspi5_pcs1;
/delete-node/ &iomuxc1_gpio_io27_mediamix_disp_data_mediamix_disp_data23;
/delete-node/ &iomuxc1_gpio_io27_tpm_ch_tpm6_ch3;
/delete-node/ &iomuxc1_gpio_io27_usdhc_data_usdhc3_data3;
/delete-node/ &iomuxc1_gpio_io28_flexio_flexio_flexio1_flexio28;
/delete-node/ &iomuxc1_gpio_io28_gpio_io_gpio2_io28;
/delete-node/ &iomuxc1_gpio_io28_lpi2c_sda_lpi2c3_sda;
/delete-node/ &iomuxc1_gpio_io29_flexio_flexio_flexio1_flexio29;
/delete-node/ &iomuxc1_gpio_io29_gpio_io_gpio2_io29;
/delete-node/ &iomuxc1_gpio_io29_lpi2c_scl_lpi2c3_scl;
