/*
 * Copyright 2024, NXP
 * SPDX-License-Identifier: Apache-2.0
 *
 * Note: File generated by gen_soc_headers.py
 * from configuration data for MIMX9352XVVXM
 */

/*
 * Content deduplicated by dedup_pinctrl.py:
 * the pin mux data of this part is identical to mimx9352avtxm-pinctrl.dtsi.
 * Do not edit; edit the canonical file instead.
 * target-hash: f2e4dc3ec5097b8a
 */

#include "mimx9352avtxm-pinctrl.dtsi"
