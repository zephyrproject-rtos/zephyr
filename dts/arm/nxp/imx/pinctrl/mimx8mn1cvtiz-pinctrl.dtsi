/*
 * Copyright 2024, NXP
 * SPDX-License-Identifier: Apache-2.0
 *
 * Note: File generated by gen_soc_headers.py
 * from configuration data for MIMX8MN1CVTIZ
 */

/*
 * Content deduplicated by dedup_pinctrl.py:
 * the pin mux data of this part is identical to mimx8mn6cvtiz-pinctrl.dtsi.
 * Do not edit; edit the canonical file instead.
 * target-hash: cab6db60b0b9710e
 */

#include "mimx8mn6cvtiz-pinctrl.dtsi"
