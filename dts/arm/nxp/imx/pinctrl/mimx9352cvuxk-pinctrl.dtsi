/*
 * Copyright (c) 2022-2023, NXP
 * SPDX-License-Identifier: Apache-2.0
 *
 * Note: File generated by imx_cfg_utils.py
 * from configuration data for MIMX9352CVUXK
 */

/*
 * SOC level pinctrl defintions
 * These definitions define SOC level defaults for each pin,
 * and select the pinmux for the pin. Pinmux entries are a tuple of:
 * <mux_register mux_mode input_register input_daisy config_register>
 * the mux_register and input_daisy reside in the IOMUXC peripheral, and
 * the pinctrl driver will write the mux_mode and input_daisy values into
 * each register, respectively. The config_register is used to configure
 * the pin based on the devicetree properties set
 */

&iomuxc {
	/omit-if-no-ref/ iomuxc1_ccm_clko1_ccmsrcgpcmix_clko_ccmsrcgpcmix_clko1: IOMUXC1_CCM_CLKO1_CCMSRCGPCMIX_CLKO_CCMSRCGPCMIX_CLKO1 {
		pinmux = <0x443c0088 0 0x0 0 0x443c0238>;
	};
	/omit-if-no-ref/ iomuxc1_ccm_clko1_flexio_flexio_flexio1_flexio26: IOMUXC1_CCM_CLKO1_FLEXIO_FLEXIO_FLEXIO1_FLEXIO26 {
		pinmux = <0x443c0088 4 0x0 0 0x443c0238>;
	};
	/omit-if-no-ref/ iomuxc1_ccm_clko1_gpio_io_gpio3_io26: IOMUXC1_CCM_CLKO1_GPIO_IO_GPIO3_IO26 {
		pinmux = <0x443c0088 5 0x0 0 0x443c0238>;
	};
	/omit-if-no-ref/ iomuxc1_ccm_clko2_ccmsrcgpcmix_clko_ccmsrcgpcmix_clko2: IOMUXC1_CCM_CLKO2_CCMSRCGPCMIX_CLKO_CCMSRCGPCMIX_CLKO2 {
		pinmux = <0x443c008c 0 0x0 0 0x443c023c>;
	};
	/omit-if-no-ref/ iomuxc1_ccm_clko2_flexio_flexio_flexio1_flexio27: IOMUXC1_CCM_CLKO2_FLEXIO_FLEXIO_FLEXIO1_FLEXIO27 {
		pinmux = <0x443c008c 4 0x443c03c8 1 0x443c023c>;
	};
	/omit-if-no-ref/ iomuxc1_ccm_clko2_gpio_io_gpio3_io27: IOMUXC1_CCM_CLKO2_GPIO_IO_GPIO3_IO27 {
		pinmux = <0x443c008c 5 0x0 0 0x443c023c>;
	};
	/omit-if-no-ref/ iomuxc1_ccm_clko3_ccmsrcgpcmix_clko_ccmsrcgpcmix_clko3: IOMUXC1_CCM_CLKO3_CCMSRCGPCMIX_CLKO_CCMSRCGPCMIX_CLKO3 {
		pinmux = <0x443c0090 0 0x0 0 0x443c0240>;
	};
	/omit-if-no-ref/ iomuxc1_ccm_clko3_flexio_flexio_flexio2_flexio28: IOMUXC1_CCM_CLKO3_FLEXIO_FLEXIO_FLEXIO2_FLEXIO28 {
		pinmux = <0x443c0090 4 0x0 0 0x443c0240>;
	};
	/omit-if-no-ref/ iomuxc1_ccm_clko3_gpio_io_gpio4_io28: IOMUXC1_CCM_CLKO3_GPIO_IO_GPIO4_IO28 {
		pinmux = <0x443c0090 5 0x0 0 0x443c0240>;
	};
	/omit-if-no-ref/ iomuxc1_ccm_clko4_ccmsrcgpcmix_clko_ccmsrcgpcmix_clko4: IOMUXC1_CCM_CLKO4_CCMSRCGPCMIX_CLKO_CCMSRCGPCMIX_CLKO4 {
		pinmux = <0x443c0094 0 0x0 0 0x443c0244>;
	};
	/omit-if-no-ref/ iomuxc1_ccm_clko4_flexio_flexio_flexio2_flexio29: IOMUXC1_CCM_CLKO4_FLEXIO_FLEXIO_FLEXIO2_FLEXIO29 {
		pinmux = <0x443c0094 4 0x0 0 0x443c0244>;
	};
	/omit-if-no-ref/ iomuxc1_ccm_clko4_gpio_io_gpio4_io29: IOMUXC1_CCM_CLKO4_GPIO_IO_GPIO4_IO29 {
		pinmux = <0x443c0094 5 0x0 0 0x443c0244>;
	};
	/omit-if-no-ref/ iomuxc1_dap_tclk_swclk_flexio_flexio_flexio1_flexio30: IOMUXC1_DAP_TCLK_SWCLK_FLEXIO_FLEXIO_FLEXIO1_FLEXIO30 {
		pinmux = <0x443c0008 4 0x0 0 0x443c01b8>;
	};
	/omit-if-no-ref/ iomuxc1_dap_tclk_swclk_gpio_io_gpio3_io30: IOMUXC1_DAP_TCLK_SWCLK_GPIO_IO_GPIO3_IO30 {
		pinmux = <0x443c0008 5 0x0 0 0x443c01b8>;
	};
	/omit-if-no-ref/ iomuxc1_dap_tclk_swclk_jtag_mux_tck_jtag_mux_tck: IOMUXC1_DAP_TCLK_SWCLK_JTAG_MUX_TCK_JTAG_MUX_TCK {
		pinmux = <0x443c0008 0 0x443c03d4 0 0x443c01b8>;
	};
	/omit-if-no-ref/ iomuxc1_dap_tclk_swclk_lpuart_cts_b_lpuart5_cts_b: IOMUXC1_DAP_TCLK_SWCLK_LPUART_CTS_B_LPUART5_CTS_B {
		pinmux = <0x443c0008 6 0x443c042c 0 0x443c01b8>;
	};
	/omit-if-no-ref/ iomuxc1_dap_tdi_can_tx_can2_tx: IOMUXC1_DAP_TDI_CAN_TX_CAN2_TX {
		pinmux = <0x443c0000 3 0x0 0 0x443c01b0>;
	};
	/omit-if-no-ref/ iomuxc1_dap_tdi_flexio_flexio_flexio2_flexio30: IOMUXC1_DAP_TDI_FLEXIO_FLEXIO_FLEXIO2_FLEXIO30 {
		pinmux = <0x443c0000 4 0x0 0 0x443c01b0>;
	};
	/omit-if-no-ref/ iomuxc1_dap_tdi_gpio_io_gpio3_io28: IOMUXC1_DAP_TDI_GPIO_IO_GPIO3_IO28 {
		pinmux = <0x443c0000 5 0x0 0 0x443c01b0>;
	};
	/omit-if-no-ref/ iomuxc1_dap_tdi_jtag_mux_tdi_jtag_mux_tdi: IOMUXC1_DAP_TDI_JTAG_MUX_TDI_JTAG_MUX_TDI {
		pinmux = <0x443c0000 0 0x443c03d8 0 0x443c01b0>;
	};
	/omit-if-no-ref/ iomuxc1_dap_tdi_lpuart_rx_lpuart5_rx: IOMUXC1_DAP_TDI_LPUART_RX_LPUART5_RX {
		pinmux = <0x443c0000 6 0x443c0430 0 0x443c01b0>;
	};
	/omit-if-no-ref/ iomuxc1_dap_tdi_mqs_left_mqs2_left: IOMUXC1_DAP_TDI_MQS_LEFT_MQS2_LEFT {
		pinmux = <0x443c0000 1 0x0 0 0x443c01b0>;
	};
	/omit-if-no-ref/ iomuxc1_dap_tdo_traceswo_can_rx_can2_rx: IOMUXC1_DAP_TDO_TRACESWO_CAN_RX_CAN2_RX {
		pinmux = <0x443c000c 3 0x443c0364 0 0x443c01bc>;
	};
	/omit-if-no-ref/ iomuxc1_dap_tdo_traceswo_flexio_flexio_flexio1_flexio31: IOMUXC1_DAP_TDO_TRACESWO_FLEXIO_FLEXIO_FLEXIO1_FLEXIO31 {
		pinmux = <0x443c000c 4 0x0 0 0x443c01bc>;
	};
	/omit-if-no-ref/ iomuxc1_dap_tdo_traceswo_gpio_io_gpio3_io31: IOMUXC1_DAP_TDO_TRACESWO_GPIO_IO_GPIO3_IO31 {
		pinmux = <0x443c000c 5 0x0 0 0x443c01bc>;
	};
	/omit-if-no-ref/ iomuxc1_dap_tdo_traceswo_jtag_mux_tdo_jtag_mux_tdo: IOMUXC1_DAP_TDO_TRACESWO_JTAG_MUX_TDO_JTAG_MUX_TDO {
		pinmux = <0x443c000c 0 0x0 0 0x443c01bc>;
	};
	/omit-if-no-ref/ iomuxc1_dap_tdo_traceswo_lpuart_tx_lpuart5_tx: IOMUXC1_DAP_TDO_TRACESWO_LPUART_TX_LPUART5_TX {
		pinmux = <0x443c000c 6 0x443c0434 0 0x443c01bc>;
	};
	/omit-if-no-ref/ iomuxc1_dap_tdo_traceswo_mqs_right_mqs2_right: IOMUXC1_DAP_TDO_TRACESWO_MQS_RIGHT_MQS2_RIGHT {
		pinmux = <0x443c000c 1 0x0 0 0x443c01bc>;
	};
	/omit-if-no-ref/ iomuxc1_dap_tms_swdio_flexio_flexio_flexio2_flexio31: IOMUXC1_DAP_TMS_SWDIO_FLEXIO_FLEXIO_FLEXIO2_FLEXIO31 {
		pinmux = <0x443c0004 4 0x0 0 0x443c01b4>;
	};
	/omit-if-no-ref/ iomuxc1_dap_tms_swdio_gpio_io_gpio3_io29: IOMUXC1_DAP_TMS_SWDIO_GPIO_IO_GPIO3_IO29 {
		pinmux = <0x443c0004 5 0x0 0 0x443c01b4>;
	};
	/omit-if-no-ref/ iomuxc1_dap_tms_swdio_jtag_mux_tms_jtag_mux_tms: IOMUXC1_DAP_TMS_SWDIO_JTAG_MUX_TMS_JTAG_MUX_TMS {
		pinmux = <0x443c0004 0 0x443c03dc 0 0x443c01b4>;
	};
	/omit-if-no-ref/ iomuxc1_dap_tms_swdio_lpuart_rts_b_lpuart5_rts_b: IOMUXC1_DAP_TMS_SWDIO_LPUART_RTS_B_LPUART5_RTS_B {
		pinmux = <0x443c0004 6 0x0 0 0x443c01b4>;
	};
	/omit-if-no-ref/ iomuxc1_enet1_mdc_enet_qos_mdc_enet_qos_mdc: IOMUXC1_ENET1_MDC_ENET_QOS_MDC_ENET_QOS_MDC {
		pinmux = <0x443c0098 0 0x0 0 0x443c0248>;
	};
	/omit-if-no-ref/ iomuxc1_enet1_mdc_flexio_flexio_flexio2_flexio00: IOMUXC1_ENET1_MDC_FLEXIO_FLEXIO_FLEXIO2_FLEXIO00 {
		pinmux = <0x443c0098 4 0x0 0 0x443c0248>;
	};
	/omit-if-no-ref/ iomuxc1_enet1_mdc_gpio_io_gpio4_io00: IOMUXC1_ENET1_MDC_GPIO_IO_GPIO4_IO00 {
		pinmux = <0x443c0098 5 0x0 0 0x443c0248>;
	};
	/omit-if-no-ref/ iomuxc1_enet1_mdc_hsiomix_otg_id_hsiomix_otg_id1: IOMUXC1_ENET1_MDC_HSIOMIX_OTG_ID_HSIOMIX_OTG_ID1 {
		pinmux = <0x443c0098 3 0x0 0 0x443c0248>;
	};
	/omit-if-no-ref/ iomuxc1_enet1_mdc_i3c_scl_i3c2_scl: IOMUXC1_ENET1_MDC_I3C_SCL_I3C2_SCL {
		pinmux = <0x443c0098 2 0x443c03cc 0 0x443c0248>;
	};
	/omit-if-no-ref/ iomuxc1_enet1_mdc_lpuart_dcb_b_lpuart3_dcb_b: IOMUXC1_ENET1_MDC_LPUART_DCB_B_LPUART3_DCB_B {
		pinmux = <0x443c0098 1 0x0 0 0x443c0248>;
	};
	/omit-if-no-ref/ iomuxc1_enet1_mdio_enet_qos_mdio_enet_qos_mdio: IOMUXC1_ENET1_MDIO_ENET_QOS_MDIO_ENET_QOS_MDIO {
		pinmux = <0x443c009c 0 0x0 0 0x443c024c>;
	};
	/omit-if-no-ref/ iomuxc1_enet1_mdio_flexio_flexio_flexio2_flexio01: IOMUXC1_ENET1_MDIO_FLEXIO_FLEXIO_FLEXIO2_FLEXIO01 {
		pinmux = <0x443c009c 4 0x0 0 0x443c024c>;
	};
	/omit-if-no-ref/ iomuxc1_enet1_mdio_gpio_io_gpio4_io01: IOMUXC1_ENET1_MDIO_GPIO_IO_GPIO4_IO01 {
		pinmux = <0x443c009c 5 0x0 0 0x443c024c>;
	};
	/omit-if-no-ref/ iomuxc1_enet1_mdio_hsiomix_otg_pwr_hsiomix_otg_pwr1: IOMUXC1_ENET1_MDIO_HSIOMIX_OTG_PWR_HSIOMIX_OTG_PWR1 {
		pinmux = <0x443c009c 3 0x0 0 0x443c024c>;
	};
	/omit-if-no-ref/ iomuxc1_enet1_mdio_i3c_sda_i3c2_sda: IOMUXC1_ENET1_MDIO_I3C_SDA_I3C2_SDA {
		pinmux = <0x443c009c 2 0x443c03d0 0 0x443c024c>;
	};
	/omit-if-no-ref/ iomuxc1_enet1_mdio_lpuart_rin_b_lpuart3_rin_b: IOMUXC1_ENET1_MDIO_LPUART_RIN_B_LPUART3_RIN_B {
		pinmux = <0x443c009c 1 0x0 0 0x443c024c>;
	};
	/omit-if-no-ref/ iomuxc1_enet1_rd0_enet_qos_rgmii_rd_enet_qos_rgmii_rd0: IOMUXC1_ENET1_RD0_ENET_QOS_RGMII_RD_ENET_QOS_RGMII_RD0 {
		pinmux = <0x443c00c0 0 0x0 0 0x443c0270>;
	};
	/omit-if-no-ref/ iomuxc1_enet1_rd0_flexio_flexio_flexio2_flexio10: IOMUXC1_ENET1_RD0_FLEXIO_FLEXIO_FLEXIO2_FLEXIO10 {
		pinmux = <0x443c00c0 4 0x0 0 0x443c0270>;
	};
	/omit-if-no-ref/ iomuxc1_enet1_rd0_gpio_io_gpio4_io10: IOMUXC1_ENET1_RD0_GPIO_IO_GPIO4_IO10 {
		pinmux = <0x443c00c0 5 0x0 0 0x443c0270>;
	};
	/omit-if-no-ref/ iomuxc1_enet1_rd0_lpuart_rx_lpuart3_rx: IOMUXC1_ENET1_RD0_LPUART_RX_LPUART3_RX {
		pinmux = <0x443c00c0 1 0x443c0418 1 0x443c0270>;
	};
	/omit-if-no-ref/ iomuxc1_enet1_rd1_enet_qos_rgmii_rd_enet_qos_rgmii_rd1: IOMUXC1_ENET1_RD1_ENET_QOS_RGMII_RD_ENET_QOS_RGMII_RD1 {
		pinmux = <0x443c00c4 0 0x0 0 0x443c0274>;
	};
	/omit-if-no-ref/ iomuxc1_enet1_rd1_flexio_flexio_flexio2_flexio11: IOMUXC1_ENET1_RD1_FLEXIO_FLEXIO_FLEXIO2_FLEXIO11 {
		pinmux = <0x443c00c4 4 0x0 0 0x443c0274>;
	};
	/omit-if-no-ref/ iomuxc1_enet1_rd1_gpio_io_gpio4_io11: IOMUXC1_ENET1_RD1_GPIO_IO_GPIO4_IO11 {
		pinmux = <0x443c00c4 5 0x0 0 0x443c0274>;
	};
	/omit-if-no-ref/ iomuxc1_enet1_rd1_lptmr_alt_lptmr2_alt1: IOMUXC1_ENET1_RD1_LPTMR_ALT_LPTMR2_ALT1 {
		pinmux = <0x443c00c4 3 0x443c0408 0 0x443c0274>;
	};
	/omit-if-no-ref/ iomuxc1_enet1_rd1_lpuart_cts_b_lpuart3_cts_b: IOMUXC1_ENET1_RD1_LPUART_CTS_B_LPUART3_CTS_B {
		pinmux = <0x443c00c4 1 0x443c0414 1 0x443c0274>;
	};
	/omit-if-no-ref/ iomuxc1_enet1_rd2_enet_qos_rgmii_rd_enet_qos_rgmii_rd2: IOMUXC1_ENET1_RD2_ENET_QOS_RGMII_RD_ENET_QOS_RGMII_RD2 {
		pinmux = <0x443c00c8 0 0x0 0 0x443c0278>;
	};
	/omit-if-no-ref/ iomuxc1_enet1_rd2_flexio_flexio_flexio2_flexio12: IOMUXC1_ENET1_RD2_FLEXIO_FLEXIO_FLEXIO2_FLEXIO12 {
		pinmux = <0x443c00c8 4 0x0 0 0x443c0278>;
	};
	/omit-if-no-ref/ iomuxc1_enet1_rd2_gpio_io_gpio4_io12: IOMUXC1_ENET1_RD2_GPIO_IO_GPIO4_IO12 {
		pinmux = <0x443c00c8 5 0x0 0 0x443c0278>;
	};
	/omit-if-no-ref/ iomuxc1_enet1_rd2_lptmr_alt_lptmr2_alt2: IOMUXC1_ENET1_RD2_LPTMR_ALT_LPTMR2_ALT2 {
		pinmux = <0x443c00c8 3 0x443c040c 0 0x443c0278>;
	};
	/omit-if-no-ref/ iomuxc1_enet1_rd3_enet_qos_rgmii_rd_enet_qos_rgmii_rd3: IOMUXC1_ENET1_RD3_ENET_QOS_RGMII_RD_ENET_QOS_RGMII_RD3 {
		pinmux = <0x443c00cc 0 0x0 0 0x443c027c>;
	};
	/omit-if-no-ref/ iomuxc1_enet1_rd3_flexio_flexio_flexio2_flexio13: IOMUXC1_ENET1_RD3_FLEXIO_FLEXIO_FLEXIO2_FLEXIO13 {
		pinmux = <0x443c00cc 4 0x0 0 0x443c027c>;
	};
	/omit-if-no-ref/ iomuxc1_enet1_rd3_flexspi_tester_trigger_flexspi1_tester_trigger: IOMUXC1_ENET1_RD3_FLEXSPI_TESTER_TRIGGER_FLEXSPI1_TESTER_TRIGGER {
		pinmux = <0x443c00cc 2 0x0 0 0x443c027c>;
	};
	/omit-if-no-ref/ iomuxc1_enet1_rd3_gpio_io_gpio4_io13: IOMUXC1_ENET1_RD3_GPIO_IO_GPIO4_IO13 {
		pinmux = <0x443c00cc 5 0x0 0 0x443c027c>;
	};
	/omit-if-no-ref/ iomuxc1_enet1_rd3_lptmr_alt_lptmr2_alt3: IOMUXC1_ENET1_RD3_LPTMR_ALT_LPTMR2_ALT3 {
		pinmux = <0x443c00cc 3 0x443c0410 0 0x443c027c>;
	};
	/omit-if-no-ref/ iomuxc1_enet1_rxc_ccm_enet_qos_clock_generate_rx_clk_ccm_enet_qos_clock_generate_rx_clk: IOMUXC1_ENET1_RXC_CCM_ENET_QOS_CLOCK_GENERATE_RX_CLK_CCM_ENET_QOS_CLOCK_GENERATE_RX_CLK {
		pinmux = <0x443c00bc 0 0x0 0 0x443c026c>;
	};
	/omit-if-no-ref/ iomuxc1_enet1_rxc_enet_qos_rx_er_enet_qos_rx_er: IOMUXC1_ENET1_RXC_ENET_QOS_RX_ER_ENET_QOS_RX_ER {
		pinmux = <0x443c00bc 1 0x0 0 0x443c026c>;
	};
	/omit-if-no-ref/ iomuxc1_enet1_rxc_flexio_flexio_flexio2_flexio09: IOMUXC1_ENET1_RXC_FLEXIO_FLEXIO_FLEXIO2_FLEXIO09 {
		pinmux = <0x443c00bc 4 0x0 0 0x443c026c>;
	};
	/omit-if-no-ref/ iomuxc1_enet1_rxc_gpio_io_gpio4_io09: IOMUXC1_ENET1_RXC_GPIO_IO_GPIO4_IO09 {
		pinmux = <0x443c00bc 5 0x0 0 0x443c026c>;
	};
	/omit-if-no-ref/ iomuxc1_enet1_rx_ctl_enet_qos_rgmii_rx_ctl_enet_qos_rgmii_rx_ctl: IOMUXC1_ENET1_RX_CTL_ENET_QOS_RGMII_RX_CTL_ENET_QOS_RGMII_RX_CTL {
		pinmux = <0x443c00b8 0 0x0 0 0x443c0268>;
	};
	/omit-if-no-ref/ iomuxc1_enet1_rx_ctl_flexio_flexio_flexio2_flexio08: IOMUXC1_ENET1_RX_CTL_FLEXIO_FLEXIO_FLEXIO2_FLEXIO08 {
		pinmux = <0x443c00b8 4 0x0 0 0x443c0268>;
	};
	/omit-if-no-ref/ iomuxc1_enet1_rx_ctl_gpio_io_gpio4_io08: IOMUXC1_ENET1_RX_CTL_GPIO_IO_GPIO4_IO08 {
		pinmux = <0x443c00b8 5 0x0 0 0x443c0268>;
	};
	/omit-if-no-ref/ iomuxc1_enet1_rx_ctl_hsiomix_otg_pwr_hsiomix_otg_pwr2: IOMUXC1_ENET1_RX_CTL_HSIOMIX_OTG_PWR_HSIOMIX_OTG_PWR2 {
		pinmux = <0x443c00b8 3 0x0 0 0x443c0268>;
	};
	/omit-if-no-ref/ iomuxc1_enet1_rx_ctl_lpuart_dsr_b_lpuart3_dsr_b: IOMUXC1_ENET1_RX_CTL_LPUART_DSR_B_LPUART3_DSR_B {
		pinmux = <0x443c00b8 1 0x0 0 0x443c0268>;
	};
	/omit-if-no-ref/ iomuxc1_enet1_td0_enet_qos_rgmii_td_enet_qos_rgmii_td0: IOMUXC1_ENET1_TD0_ENET_QOS_RGMII_TD_ENET_QOS_RGMII_TD0 {
		pinmux = <0x443c00ac 0 0x0 0 0x443c025c>;
	};
	/omit-if-no-ref/ iomuxc1_enet1_td0_flexio_flexio_flexio2_flexio05: IOMUXC1_ENET1_TD0_FLEXIO_FLEXIO_FLEXIO2_FLEXIO05 {
		pinmux = <0x443c00ac 4 0x0 0 0x443c025c>;
	};
	/omit-if-no-ref/ iomuxc1_enet1_td0_gpio_io_gpio4_io05: IOMUXC1_ENET1_TD0_GPIO_IO_GPIO4_IO05 {
		pinmux = <0x443c00ac 5 0x0 0 0x443c025c>;
	};
	/omit-if-no-ref/ iomuxc1_enet1_td0_lpuart_tx_lpuart3_tx: IOMUXC1_ENET1_TD0_LPUART_TX_LPUART3_TX {
		pinmux = <0x443c00ac 1 0x443c041c 1 0x443c025c>;
	};
	/omit-if-no-ref/ iomuxc1_enet1_td1_enet_qos_rgmii_td_enet_qos_rgmii_td1: IOMUXC1_ENET1_TD1_ENET_QOS_RGMII_TD_ENET_QOS_RGMII_TD1 {
		pinmux = <0x443c00a8 0 0x0 0 0x443c0258>;
	};
	/omit-if-no-ref/ iomuxc1_enet1_td1_flexio_flexio_flexio2_flexio04: IOMUXC1_ENET1_TD1_FLEXIO_FLEXIO_FLEXIO2_FLEXIO04 {
		pinmux = <0x443c00a8 4 0x0 0 0x443c0258>;
	};
	/omit-if-no-ref/ iomuxc1_enet1_td1_gpio_io_gpio4_io04: IOMUXC1_ENET1_TD1_GPIO_IO_GPIO4_IO04 {
		pinmux = <0x443c00a8 5 0x0 0 0x443c0258>;
	};
	/omit-if-no-ref/ iomuxc1_enet1_td1_hsiomix_otg_oc_hsiomix_otg_oc1: IOMUXC1_ENET1_TD1_HSIOMIX_OTG_OC_HSIOMIX_OTG_OC1 {
		pinmux = <0x443c00a8 3 0x0 0 0x443c0258>;
	};
	/omit-if-no-ref/ iomuxc1_enet1_td1_i3c_pur_b_i3c2_pur_b: IOMUXC1_ENET1_TD1_I3C_PUR_B_I3C2_PUR_B {
		pinmux = <0x443c00a8 6 0x0 0 0x443c0258>;
	};
	/omit-if-no-ref/ iomuxc1_enet1_td1_i3c_pur_i3c2_pur: IOMUXC1_ENET1_TD1_I3C_PUR_I3C2_PUR {
		pinmux = <0x443c00a8 2 0x0 0 0x443c0258>;
	};
	/omit-if-no-ref/ iomuxc1_enet1_td1_lpuart_rts_b_lpuart3_rts_b: IOMUXC1_ENET1_TD1_LPUART_RTS_B_LPUART3_RTS_B {
		pinmux = <0x443c00a8 1 0x0 0 0x443c0258>;
	};
	/omit-if-no-ref/ iomuxc1_enet1_td2_can_rx_can2_rx: IOMUXC1_ENET1_TD2_CAN_RX_CAN2_RX {
		pinmux = <0x443c00a4 2 0x443c0364 2 0x443c0254>;
	};
	/omit-if-no-ref/ iomuxc1_enet1_td2_ccm_enet_qos_clock_generate_ref_clk_ccm_enet_qos_clock_generate_ref_clk: IOMUXC1_ENET1_TD2_CCM_ENET_QOS_CLOCK_GENERATE_REF_CLK_CCM_ENET_QOS_CLOCK_GENERATE_REF_CLK {
		pinmux = <0x443c00a4 1 0x0 0 0x443c0254>;
	};
	/omit-if-no-ref/ iomuxc1_enet1_td2_enet_qos_rgmii_td_enet_qos_rgmii_td2: IOMUXC1_ENET1_TD2_ENET_QOS_RGMII_TD_ENET_QOS_RGMII_TD2 {
		pinmux = <0x443c00a4 0 0x0 0 0x443c0254>;
	};
	/omit-if-no-ref/ iomuxc1_enet1_td2_flexio_flexio_flexio2_flexio03: IOMUXC1_ENET1_TD2_FLEXIO_FLEXIO_FLEXIO2_FLEXIO03 {
		pinmux = <0x443c00a4 4 0x0 0 0x443c0254>;
	};
	/omit-if-no-ref/ iomuxc1_enet1_td2_gpio_io_gpio4_io03: IOMUXC1_ENET1_TD2_GPIO_IO_GPIO4_IO03 {
		pinmux = <0x443c00a4 5 0x0 0 0x443c0254>;
	};
	/omit-if-no-ref/ iomuxc1_enet1_td2_hsiomix_otg_oc_hsiomix_otg_oc2: IOMUXC1_ENET1_TD2_HSIOMIX_OTG_OC_HSIOMIX_OTG_OC2 {
		pinmux = <0x443c00a4 3 0x0 0 0x443c0254>;
	};
	/omit-if-no-ref/ iomuxc1_enet1_td3_can_tx_can2_tx: IOMUXC1_ENET1_TD3_CAN_TX_CAN2_TX {
		pinmux = <0x443c00a0 2 0x0 0 0x443c0250>;
	};
	/omit-if-no-ref/ iomuxc1_enet1_td3_enet_qos_rgmii_td_enet_qos_rgmii_td3: IOMUXC1_ENET1_TD3_ENET_QOS_RGMII_TD_ENET_QOS_RGMII_TD3 {
		pinmux = <0x443c00a0 0 0x0 0 0x443c0250>;
	};
	/omit-if-no-ref/ iomuxc1_enet1_td3_flexio_flexio_flexio2_flexio02: IOMUXC1_ENET1_TD3_FLEXIO_FLEXIO_FLEXIO2_FLEXIO02 {
		pinmux = <0x443c00a0 4 0x0 0 0x443c0250>;
	};
	/omit-if-no-ref/ iomuxc1_enet1_td3_gpio_io_gpio4_io02: IOMUXC1_ENET1_TD3_GPIO_IO_GPIO4_IO02 {
		pinmux = <0x443c00a0 5 0x0 0 0x443c0250>;
	};
	/omit-if-no-ref/ iomuxc1_enet1_td3_hsiomix_otg_id_hsiomix_otg_id2: IOMUXC1_ENET1_TD3_HSIOMIX_OTG_ID_HSIOMIX_OTG_ID2 {
		pinmux = <0x443c00a0 3 0x0 0 0x443c0250>;
	};
	/omit-if-no-ref/ iomuxc1_enet1_txc_ccm_enet_qos_clock_generate_tx_clk_ccm_enet_qos_clock_generate_tx_clk: IOMUXC1_ENET1_TXC_CCM_ENET_QOS_CLOCK_GENERATE_TX_CLK_CCM_ENET_QOS_CLOCK_GENERATE_TX_CLK {
		pinmux = <0x443c00b4 0 0x0 0 0x443c0264>;
	};
	/omit-if-no-ref/ iomuxc1_enet1_txc_enet_qos_tx_er_enet_qos_tx_er: IOMUXC1_ENET1_TXC_ENET_QOS_TX_ER_ENET_QOS_TX_ER {
		pinmux = <0x443c00b4 1 0x0 0 0x443c0264>;
	};
	/omit-if-no-ref/ iomuxc1_enet1_txc_flexio_flexio_flexio2_flexio07: IOMUXC1_ENET1_TXC_FLEXIO_FLEXIO_FLEXIO2_FLEXIO07 {
		pinmux = <0x443c00b4 4 0x0 0 0x443c0264>;
	};
	/omit-if-no-ref/ iomuxc1_enet1_txc_gpio_io_gpio4_io07: IOMUXC1_ENET1_TXC_GPIO_IO_GPIO4_IO07 {
		pinmux = <0x443c00b4 5 0x0 0 0x443c0264>;
	};
	/omit-if-no-ref/ iomuxc1_enet1_tx_ctl_enet_qos_rgmii_tx_ctl_enet_qos_rgmii_tx_ctl: IOMUXC1_ENET1_TX_CTL_ENET_QOS_RGMII_TX_CTL_ENET_QOS_RGMII_TX_CTL {
		pinmux = <0x443c00b0 0 0x0 0 0x443c0260>;
	};
	/omit-if-no-ref/ iomuxc1_enet1_tx_ctl_flexio_flexio_flexio2_flexio06: IOMUXC1_ENET1_TX_CTL_FLEXIO_FLEXIO_FLEXIO2_FLEXIO06 {
		pinmux = <0x443c00b0 4 0x0 0 0x443c0260>;
	};
	/omit-if-no-ref/ iomuxc1_enet1_tx_ctl_gpio_io_gpio4_io06: IOMUXC1_ENET1_TX_CTL_GPIO_IO_GPIO4_IO06 {
		pinmux = <0x443c00b0 5 0x0 0 0x443c0260>;
	};
	/omit-if-no-ref/ iomuxc1_enet1_tx_ctl_lpuart_dtr_b_lpuart3_dtr_b: IOMUXC1_ENET1_TX_CTL_LPUART_DTR_B_LPUART3_DTR_B {
		pinmux = <0x443c00b0 1 0x0 0 0x443c0260>;
	};
	/omit-if-no-ref/ iomuxc1_enet2_mdc_enet_mdc_enet1_mdc: IOMUXC1_ENET2_MDC_ENET_MDC_ENET1_MDC {
		pinmux = <0x443c00d0 0 0x0 0 0x443c0280>;
	};
	/omit-if-no-ref/ iomuxc1_enet2_mdc_flexio_flexio_flexio2_flexio14: IOMUXC1_ENET2_MDC_FLEXIO_FLEXIO_FLEXIO2_FLEXIO14 {
		pinmux = <0x443c00d0 4 0x0 0 0x443c0280>;
	};
	/omit-if-no-ref/ iomuxc1_enet2_mdc_gpio_io_gpio4_io14: IOMUXC1_ENET2_MDC_GPIO_IO_GPIO4_IO14 {
		pinmux = <0x443c00d0 5 0x0 0 0x443c0280>;
	};
	/omit-if-no-ref/ iomuxc1_enet2_mdc_lpuart_dcb_b_lpuart4_dcb_b: IOMUXC1_ENET2_MDC_LPUART_DCB_B_LPUART4_DCB_B {
		pinmux = <0x443c00d0 1 0x0 0 0x443c0280>;
	};
	/omit-if-no-ref/ iomuxc1_enet2_mdc_sai_rx_sync_sai2_rx_sync: IOMUXC1_ENET2_MDC_SAI_RX_SYNC_SAI2_RX_SYNC {
		pinmux = <0x443c00d0 2 0x0 0 0x443c0280>;
	};
	/omit-if-no-ref/ iomuxc1_enet2_mdio_enet_mdio_enet1_mdio: IOMUXC1_ENET2_MDIO_ENET_MDIO_ENET1_MDIO {
		pinmux = <0x443c00d4 0 0x0 0 0x443c0284>;
	};
	/omit-if-no-ref/ iomuxc1_enet2_mdio_flexio_flexio_flexio2_flexio15: IOMUXC1_ENET2_MDIO_FLEXIO_FLEXIO_FLEXIO2_FLEXIO15 {
		pinmux = <0x443c00d4 4 0x0 0 0x443c0284>;
	};
	/omit-if-no-ref/ iomuxc1_enet2_mdio_gpio_io_gpio4_io15: IOMUXC1_ENET2_MDIO_GPIO_IO_GPIO4_IO15 {
		pinmux = <0x443c00d4 5 0x0 0 0x443c0284>;
	};
	/omit-if-no-ref/ iomuxc1_enet2_mdio_lpuart_rin_b_lpuart4_rin_b: IOMUXC1_ENET2_MDIO_LPUART_RIN_B_LPUART4_RIN_B {
		pinmux = <0x443c00d4 1 0x0 0 0x443c0284>;
	};
	/omit-if-no-ref/ iomuxc1_enet2_mdio_sai_rx_bclk_sai2_rx_bclk: IOMUXC1_ENET2_MDIO_SAI_RX_BCLK_SAI2_RX_BCLK {
		pinmux = <0x443c00d4 2 0x0 0 0x443c0284>;
	};
	/omit-if-no-ref/ iomuxc1_enet2_rd0_enet_rgmii_rd_enet1_rgmii_rd0: IOMUXC1_ENET2_RD0_ENET_RGMII_RD_ENET1_RGMII_RD0 {
		pinmux = <0x443c00f8 0 0x0 0 0x443c02a8>;
	};
	/omit-if-no-ref/ iomuxc1_enet2_rd0_flexio_flexio_flexio2_flexio24: IOMUXC1_ENET2_RD0_FLEXIO_FLEXIO_FLEXIO2_FLEXIO24 {
		pinmux = <0x443c00f8 4 0x0 0 0x443c02a8>;
	};
	/omit-if-no-ref/ iomuxc1_enet2_rd0_gpio_io_gpio4_io24: IOMUXC1_ENET2_RD0_GPIO_IO_GPIO4_IO24 {
		pinmux = <0x443c00f8 5 0x0 0 0x443c02a8>;
	};
	/omit-if-no-ref/ iomuxc1_enet2_rd0_lpuart_rx_lpuart4_rx: IOMUXC1_ENET2_RD0_LPUART_RX_LPUART4_RX {
		pinmux = <0x443c00f8 1 0x443c0424 1 0x443c02a8>;
	};
	/omit-if-no-ref/ iomuxc1_enet2_rd0_sai_tx_data_sai2_tx_data02: IOMUXC1_ENET2_RD0_SAI_TX_DATA_SAI2_TX_DATA02 {
		pinmux = <0x443c00f8 2 0x0 0 0x443c02a8>;
	};
	/omit-if-no-ref/ iomuxc1_enet2_rd1_enet_rgmii_rd_enet1_rgmii_rd1: IOMUXC1_ENET2_RD1_ENET_RGMII_RD_ENET1_RGMII_RD1 {
		pinmux = <0x443c00fc 0 0x0 0 0x443c02ac>;
	};
	/omit-if-no-ref/ iomuxc1_enet2_rd1_flexio_flexio_flexio2_flexio25: IOMUXC1_ENET2_RD1_FLEXIO_FLEXIO_FLEXIO2_FLEXIO25 {
		pinmux = <0x443c00fc 4 0x0 0 0x443c02ac>;
	};
	/omit-if-no-ref/ iomuxc1_enet2_rd1_gpio_io_gpio4_io25: IOMUXC1_ENET2_RD1_GPIO_IO_GPIO4_IO25 {
		pinmux = <0x443c00fc 5 0x0 0 0x443c02ac>;
	};
	/omit-if-no-ref/ iomuxc1_enet2_rd1_sai_tx_data_sai2_tx_data03: IOMUXC1_ENET2_RD1_SAI_TX_DATA_SAI2_TX_DATA03 {
		pinmux = <0x443c00fc 2 0x0 0 0x443c02ac>;
	};
	/omit-if-no-ref/ iomuxc1_enet2_rd1_spdif_in_spdif_in: IOMUXC1_ENET2_RD1_SPDIF_IN_SPDIF_IN {
		pinmux = <0x443c00fc 1 0x443c0454 1 0x443c02ac>;
	};
	/omit-if-no-ref/ iomuxc1_enet2_rd2_enet_rgmii_rd_enet1_rgmii_rd2: IOMUXC1_ENET2_RD2_ENET_RGMII_RD_ENET1_RGMII_RD2 {
		pinmux = <0x443c0100 0 0x0 0 0x443c02b0>;
	};
	/omit-if-no-ref/ iomuxc1_enet2_rd2_flexio_flexio_flexio2_flexio26: IOMUXC1_ENET2_RD2_FLEXIO_FLEXIO_FLEXIO2_FLEXIO26 {
		pinmux = <0x443c0100 4 0x0 0 0x443c02b0>;
	};
	/omit-if-no-ref/ iomuxc1_enet2_rd2_gpio_io_gpio4_io26: IOMUXC1_ENET2_RD2_GPIO_IO_GPIO4_IO26 {
		pinmux = <0x443c0100 5 0x0 0 0x443c02b0>;
	};
	/omit-if-no-ref/ iomuxc1_enet2_rd2_lpuart_cts_b_lpuart4_cts_b: IOMUXC1_ENET2_RD2_LPUART_CTS_B_LPUART4_CTS_B {
		pinmux = <0x443c0100 1 0x443c0420 1 0x443c02b0>;
	};
	/omit-if-no-ref/ iomuxc1_enet2_rd2_mqs_right_mqs2_right: IOMUXC1_ENET2_RD2_MQS_RIGHT_MQS2_RIGHT {
		pinmux = <0x443c0100 3 0x0 0 0x443c02b0>;
	};
	/omit-if-no-ref/ iomuxc1_enet2_rd2_sai_mclk_sai2_mclk: IOMUXC1_ENET2_RD2_SAI_MCLK_SAI2_MCLK {
		pinmux = <0x443c0100 2 0x0 0 0x443c02b0>;
	};
	/omit-if-no-ref/ iomuxc1_enet2_rd3_enet_rgmii_rd_enet1_rgmii_rd3: IOMUXC1_ENET2_RD3_ENET_RGMII_RD_ENET1_RGMII_RD3 {
		pinmux = <0x443c0104 0 0x0 0 0x443c02b4>;
	};
	/omit-if-no-ref/ iomuxc1_enet2_rd3_flexio_flexio_flexio2_flexio27: IOMUXC1_ENET2_RD3_FLEXIO_FLEXIO_FLEXIO2_FLEXIO27 {
		pinmux = <0x443c0104 4 0x0 0 0x443c02b4>;
	};
	/omit-if-no-ref/ iomuxc1_enet2_rd3_gpio_io_gpio4_io27: IOMUXC1_ENET2_RD3_GPIO_IO_GPIO4_IO27 {
		pinmux = <0x443c0104 5 0x0 0 0x443c02b4>;
	};
	/omit-if-no-ref/ iomuxc1_enet2_rd3_mqs_left_mqs2_left: IOMUXC1_ENET2_RD3_MQS_LEFT_MQS2_LEFT {
		pinmux = <0x443c0104 3 0x0 0 0x443c02b4>;
	};
	/omit-if-no-ref/ iomuxc1_enet2_rd3_spdif_in_spdif_in: IOMUXC1_ENET2_RD3_SPDIF_IN_SPDIF_IN {
		pinmux = <0x443c0104 2 0x443c0454 2 0x443c02b4>;
	};
	/omit-if-no-ref/ iomuxc1_enet2_rd3_spdif_out_spdif_out: IOMUXC1_ENET2_RD3_SPDIF_OUT_SPDIF_OUT {
		pinmux = <0x443c0104 1 0x0 0 0x443c02b4>;
	};
	/omit-if-no-ref/ iomuxc1_enet2_rxc_enet_rgmii_rxc_enet1_rgmii_rxc: IOMUXC1_ENET2_RXC_ENET_RGMII_RXC_ENET1_RGMII_RXC {
		pinmux = <0x443c00f4 0 0x0 0 0x443c02a4>;
	};
	/omit-if-no-ref/ iomuxc1_enet2_rxc_enet_rx_er_enet1_rx_er: IOMUXC1_ENET2_RXC_ENET_RX_ER_ENET1_RX_ER {
		pinmux = <0x443c00f4 1 0x0 0 0x443c02a4>;
	};
	/omit-if-no-ref/ iomuxc1_enet2_rxc_flexio_flexio_flexio2_flexio23: IOMUXC1_ENET2_RXC_FLEXIO_FLEXIO_FLEXIO2_FLEXIO23 {
		pinmux = <0x443c00f4 4 0x0 0 0x443c02a4>;
	};
	/omit-if-no-ref/ iomuxc1_enet2_rxc_gpio_io_gpio4_io23: IOMUXC1_ENET2_RXC_GPIO_IO_GPIO4_IO23 {
		pinmux = <0x443c00f4 5 0x0 0 0x443c02a4>;
	};
	/omit-if-no-ref/ iomuxc1_enet2_rxc_sai_tx_data_sai2_tx_data01: IOMUXC1_ENET2_RXC_SAI_TX_DATA_SAI2_TX_DATA01 {
		pinmux = <0x443c00f4 2 0x0 0 0x443c02a4>;
	};
	/omit-if-no-ref/ iomuxc1_enet2_rx_ctl_enet_rgmii_rx_ctl_enet1_rgmii_rx_ctl: IOMUXC1_ENET2_RX_CTL_ENET_RGMII_RX_CTL_ENET1_RGMII_RX_CTL {
		pinmux = <0x443c00f0 0 0x0 0 0x443c02a0>;
	};
	/omit-if-no-ref/ iomuxc1_enet2_rx_ctl_flexio_flexio_flexio2_flexio22: IOMUXC1_ENET2_RX_CTL_FLEXIO_FLEXIO_FLEXIO2_FLEXIO22 {
		pinmux = <0x443c00f0 4 0x0 0 0x443c02a0>;
	};
	/omit-if-no-ref/ iomuxc1_enet2_rx_ctl_gpio_io_gpio4_io22: IOMUXC1_ENET2_RX_CTL_GPIO_IO_GPIO4_IO22 {
		pinmux = <0x443c00f0 5 0x0 0 0x443c02a0>;
	};
	/omit-if-no-ref/ iomuxc1_enet2_rx_ctl_lpuart_dsr_b_lpuart4_dsr_b: IOMUXC1_ENET2_RX_CTL_LPUART_DSR_B_LPUART4_DSR_B {
		pinmux = <0x443c00f0 1 0x0 0 0x443c02a0>;
	};
	/omit-if-no-ref/ iomuxc1_enet2_rx_ctl_sai_tx_data_sai2_tx_data00: IOMUXC1_ENET2_RX_CTL_SAI_TX_DATA_SAI2_TX_DATA00 {
		pinmux = <0x443c00f0 2 0x0 0 0x443c02a0>;
	};
	/omit-if-no-ref/ iomuxc1_enet2_td0_enet_rgmii_td_enet1_rgmii_td0: IOMUXC1_ENET2_TD0_ENET_RGMII_TD_ENET1_RGMII_TD0 {
		pinmux = <0x443c00e4 0 0x0 0 0x443c0294>;
	};
	/omit-if-no-ref/ iomuxc1_enet2_td0_flexio_flexio_flexio2_flexio19: IOMUXC1_ENET2_TD0_FLEXIO_FLEXIO_FLEXIO2_FLEXIO19 {
		pinmux = <0x443c00e4 4 0x0 0 0x443c0294>;
	};
	/omit-if-no-ref/ iomuxc1_enet2_td0_gpio_io_gpio4_io19: IOMUXC1_ENET2_TD0_GPIO_IO_GPIO4_IO19 {
		pinmux = <0x443c00e4 5 0x0 0 0x443c0294>;
	};
	/omit-if-no-ref/ iomuxc1_enet2_td0_lpuart_tx_lpuart4_tx: IOMUXC1_ENET2_TD0_LPUART_TX_LPUART4_TX {
		pinmux = <0x443c00e4 1 0x443c0428 1 0x443c0294>;
	};
	/omit-if-no-ref/ iomuxc1_enet2_td0_sai_rx_data_sai2_rx_data03: IOMUXC1_ENET2_TD0_SAI_RX_DATA_SAI2_RX_DATA03 {
		pinmux = <0x443c00e4 2 0x0 0 0x443c0294>;
	};
	/omit-if-no-ref/ iomuxc1_enet2_td1_enet_rgmii_td_enet1_rgmii_td1: IOMUXC1_ENET2_TD1_ENET_RGMII_TD_ENET1_RGMII_TD1 {
		pinmux = <0x443c00e0 0 0x0 0 0x443c0290>;
	};
	/omit-if-no-ref/ iomuxc1_enet2_td1_flexio_flexio_flexio2_flexio18: IOMUXC1_ENET2_TD1_FLEXIO_FLEXIO_FLEXIO2_FLEXIO18 {
		pinmux = <0x443c00e0 4 0x0 0 0x443c0290>;
	};
	/omit-if-no-ref/ iomuxc1_enet2_td1_gpio_io_gpio4_io18: IOMUXC1_ENET2_TD1_GPIO_IO_GPIO4_IO18 {
		pinmux = <0x443c00e0 5 0x0 0 0x443c0290>;
	};
	/omit-if-no-ref/ iomuxc1_enet2_td1_lpuart_rts_b_lpuart4_rts_b: IOMUXC1_ENET2_TD1_LPUART_RTS_B_LPUART4_RTS_B {
		pinmux = <0x443c00e0 1 0x0 0 0x443c0290>;
	};
	/omit-if-no-ref/ iomuxc1_enet2_td1_sai_rx_data_sai2_rx_data02: IOMUXC1_ENET2_TD1_SAI_RX_DATA_SAI2_RX_DATA02 {
		pinmux = <0x443c00e0 2 0x0 0 0x443c0290>;
	};
	/omit-if-no-ref/ iomuxc1_enet2_td2_enet_rgmii_td_enet1_rgmii_td2: IOMUXC1_ENET2_TD2_ENET_RGMII_TD_ENET1_RGMII_TD2 {
		pinmux = <0x443c00dc 0 0x0 0 0x443c028c>;
	};
	/omit-if-no-ref/ iomuxc1_enet2_td2_enet_tx_clk_enet1_tx_clk: IOMUXC1_ENET2_TD2_ENET_TX_CLK_ENET1_TX_CLK {
		pinmux = <0x443c00dc 1 0x0 0 0x443c028c>;
	};
	/omit-if-no-ref/ iomuxc1_enet2_td2_flexio_flexio_flexio2_flexio17: IOMUXC1_ENET2_TD2_FLEXIO_FLEXIO_FLEXIO2_FLEXIO17 {
		pinmux = <0x443c00dc 4 0x0 0 0x443c028c>;
	};
	/omit-if-no-ref/ iomuxc1_enet2_td2_gpio_io_gpio4_io17: IOMUXC1_ENET2_TD2_GPIO_IO_GPIO4_IO17 {
		pinmux = <0x443c00dc 5 0x0 0 0x443c028c>;
	};
	/omit-if-no-ref/ iomuxc1_enet2_td2_sai_rx_data_sai2_rx_data01: IOMUXC1_ENET2_TD2_SAI_RX_DATA_SAI2_RX_DATA01 {
		pinmux = <0x443c00dc 2 0x0 0 0x443c028c>;
	};
	/omit-if-no-ref/ iomuxc1_enet2_td3_enet_rgmii_td_enet1_rgmii_td3: IOMUXC1_ENET2_TD3_ENET_RGMII_TD_ENET1_RGMII_TD3 {
		pinmux = <0x443c00d8 0 0x0 0 0x443c0288>;
	};
	/omit-if-no-ref/ iomuxc1_enet2_td3_flexio_flexio_flexio2_flexio16: IOMUXC1_ENET2_TD3_FLEXIO_FLEXIO_FLEXIO2_FLEXIO16 {
		pinmux = <0x443c00d8 4 0x0 0 0x443c0288>;
	};
	/omit-if-no-ref/ iomuxc1_enet2_td3_gpio_io_gpio4_io16: IOMUXC1_ENET2_TD3_GPIO_IO_GPIO4_IO16 {
		pinmux = <0x443c00d8 5 0x0 0 0x443c0288>;
	};
	/omit-if-no-ref/ iomuxc1_enet2_td3_sai_rx_data_sai2_rx_data00: IOMUXC1_ENET2_TD3_SAI_RX_DATA_SAI2_RX_DATA00 {
		pinmux = <0x443c00d8 2 0x0 0 0x443c0288>;
	};
	/omit-if-no-ref/ iomuxc1_enet2_txc_enet_rgmii_txc_enet1_rgmii_txc: IOMUXC1_ENET2_TXC_ENET_RGMII_TXC_ENET1_RGMII_TXC {
		pinmux = <0x443c00ec 0 0x0 0 0x443c029c>;
	};
	/omit-if-no-ref/ iomuxc1_enet2_txc_enet_tx_er_enet1_tx_er: IOMUXC1_ENET2_TXC_ENET_TX_ER_ENET1_TX_ER {
		pinmux = <0x443c00ec 1 0x0 0 0x443c029c>;
	};
	/omit-if-no-ref/ iomuxc1_enet2_txc_flexio_flexio_flexio2_flexio21: IOMUXC1_ENET2_TXC_FLEXIO_FLEXIO_FLEXIO2_FLEXIO21 {
		pinmux = <0x443c00ec 4 0x0 0 0x443c029c>;
	};
	/omit-if-no-ref/ iomuxc1_enet2_txc_gpio_io_gpio4_io21: IOMUXC1_ENET2_TXC_GPIO_IO_GPIO4_IO21 {
		pinmux = <0x443c00ec 5 0x0 0 0x443c029c>;
	};
	/omit-if-no-ref/ iomuxc1_enet2_txc_sai_tx_bclk_sai2_tx_bclk: IOMUXC1_ENET2_TXC_SAI_TX_BCLK_SAI2_TX_BCLK {
		pinmux = <0x443c00ec 2 0x0 0 0x443c029c>;
	};
	/omit-if-no-ref/ iomuxc1_enet2_tx_ctl_enet_rgmii_tx_ctl_enet1_rgmii_tx_ctl: IOMUXC1_ENET2_TX_CTL_ENET_RGMII_TX_CTL_ENET1_RGMII_TX_CTL {
		pinmux = <0x443c00e8 0 0x0 0 0x443c0298>;
	};
	/omit-if-no-ref/ iomuxc1_enet2_tx_ctl_flexio_flexio_flexio2_flexio20: IOMUXC1_ENET2_TX_CTL_FLEXIO_FLEXIO_FLEXIO2_FLEXIO20 {
		pinmux = <0x443c00e8 4 0x0 0 0x443c0298>;
	};
	/omit-if-no-ref/ iomuxc1_enet2_tx_ctl_gpio_io_gpio4_io20: IOMUXC1_ENET2_TX_CTL_GPIO_IO_GPIO4_IO20 {
		pinmux = <0x443c00e8 5 0x0 0 0x443c0298>;
	};
	/omit-if-no-ref/ iomuxc1_enet2_tx_ctl_lpuart_dtr_b_lpuart4_dtr_b: IOMUXC1_ENET2_TX_CTL_LPUART_DTR_B_LPUART4_DTR_B {
		pinmux = <0x443c00e8 1 0x0 0 0x443c0298>;
	};
	/omit-if-no-ref/ iomuxc1_enet2_tx_ctl_sai_tx_sync_sai2_tx_sync: IOMUXC1_ENET2_TX_CTL_SAI_TX_SYNC_SAI2_TX_SYNC {
		pinmux = <0x443c00e8 2 0x0 0 0x443c0298>;
	};
	/omit-if-no-ref/ iomuxc1_gpio_io00_flexio_flexio_flexio1_flexio00: IOMUXC1_GPIO_IO00_FLEXIO_FLEXIO_FLEXIO1_FLEXIO00 {
		pinmux = <0x443c0010 7 0x443c036c 0 0x443c01c0>;
	};
	/omit-if-no-ref/ iomuxc1_gpio_io00_gpio_io_gpio2_io00: IOMUXC1_GPIO_IO00_GPIO_IO_GPIO2_IO00 {
		pinmux = <0x443c0010 0 0x0 0 0x443c01c0>;
	};
	/omit-if-no-ref/ iomuxc1_gpio_io00_lpi2c_sda_lpi2c3_sda: IOMUXC1_GPIO_IO00_LPI2C_SDA_LPI2C3_SDA {
		pinmux = <0x443c0010 1 0x443c03e4 0 0x443c01c0>;
	};
	/omit-if-no-ref/ iomuxc1_gpio_io00_lpi2c_sda_lpi2c5_sda: IOMUXC1_GPIO_IO00_LPI2C_SDA_LPI2C5_SDA {
		pinmux = <0x443c0010 6 0x443c03ec 0 0x443c01c0>;
	};
	/omit-if-no-ref/ iomuxc1_gpio_io00_lpspi_pcs_lpspi6_pcs0: IOMUXC1_GPIO_IO00_LPSPI_PCS_LPSPI6_PCS0 {
		pinmux = <0x443c0010 4 0x0 0 0x443c01c0>;
	};
	/omit-if-no-ref/ iomuxc1_gpio_io00_lpuart_tx_lpuart5_tx: IOMUXC1_GPIO_IO00_LPUART_TX_LPUART5_TX {
		pinmux = <0x443c0010 5 0x443c0434 1 0x443c01c0>;
	};
	/omit-if-no-ref/ iomuxc1_gpio_io00_mediamix_cam_clk_mediamix_cam_clk: IOMUXC1_GPIO_IO00_MEDIAMIX_CAM_CLK_MEDIAMIX_CAM_CLK {
		pinmux = <0x443c0010 2 0x0 0 0x443c01c0>;
	};
	/omit-if-no-ref/ iomuxc1_gpio_io00_mediamix_disp_clk_mediamix_disp_clk: IOMUXC1_GPIO_IO00_MEDIAMIX_DISP_CLK_MEDIAMIX_DISP_CLK {
		pinmux = <0x443c0010 3 0x0 0 0x443c01c0>;
	};
	/omit-if-no-ref/ iomuxc1_gpio_io01_flexio_flexio_flexio1_flexio01: IOMUXC1_GPIO_IO01_FLEXIO_FLEXIO_FLEXIO1_FLEXIO01 {
		pinmux = <0x443c0014 7 0x443c0370 0 0x443c01c4>;
	};
	/omit-if-no-ref/ iomuxc1_gpio_io01_gpio_io_gpio2_io01: IOMUXC1_GPIO_IO01_GPIO_IO_GPIO2_IO01 {
		pinmux = <0x443c0014 0 0x0 0 0x443c01c4>;
	};
	/omit-if-no-ref/ iomuxc1_gpio_io01_lpi2c_scl_lpi2c3_scl: IOMUXC1_GPIO_IO01_LPI2C_SCL_LPI2C3_SCL {
		pinmux = <0x443c0014 1 0x443c03e0 0 0x443c01c4>;
	};
	/omit-if-no-ref/ iomuxc1_gpio_io01_lpi2c_scl_lpi2c5_scl: IOMUXC1_GPIO_IO01_LPI2C_SCL_LPI2C5_SCL {
		pinmux = <0x443c0014 6 0x443c03e8 0 0x443c01c4>;
	};
	/omit-if-no-ref/ iomuxc1_gpio_io01_lpspi_sin_lpspi6_sin: IOMUXC1_GPIO_IO01_LPSPI_SIN_LPSPI6_SIN {
		pinmux = <0x443c0014 4 0x0 0 0x443c01c4>;
	};
	/omit-if-no-ref/ iomuxc1_gpio_io01_lpuart_rx_lpuart5_rx: IOMUXC1_GPIO_IO01_LPUART_RX_LPUART5_RX {
		pinmux = <0x443c0014 5 0x443c0430 1 0x443c01c4>;
	};
	/omit-if-no-ref/ iomuxc1_gpio_io01_mediamix_cam_data_mediamix_cam_data00: IOMUXC1_GPIO_IO01_MEDIAMIX_CAM_DATA_MEDIAMIX_CAM_DATA00 {
		pinmux = <0x443c0014 2 0x0 0 0x443c01c4>;
	};
	/omit-if-no-ref/ iomuxc1_gpio_io01_mediamix_disp_de_mediamix_disp_de: IOMUXC1_GPIO_IO01_MEDIAMIX_DISP_DE_MEDIAMIX_DISP_DE {
		pinmux = <0x443c0014 3 0x0 0 0x443c01c4>;
	};
	/omit-if-no-ref/ iomuxc1_gpio_io02_flexio_flexio_flexio1_flexio02: IOMUXC1_GPIO_IO02_FLEXIO_FLEXIO_FLEXIO1_FLEXIO02 {
		pinmux = <0x443c0018 7 0x443c0374 0 0x443c01c8>;
	};
	/omit-if-no-ref/ iomuxc1_gpio_io02_gpio_io_gpio2_io02: IOMUXC1_GPIO_IO02_GPIO_IO_GPIO2_IO02 {
		pinmux = <0x443c0018 0 0x0 0 0x443c01c8>;
	};
	/omit-if-no-ref/ iomuxc1_gpio_io02_lpi2c_sda_lpi2c4_sda: IOMUXC1_GPIO_IO02_LPI2C_SDA_LPI2C4_SDA {
		pinmux = <0x443c0018 1 0x0 0 0x443c01c8>;
	};
	/omit-if-no-ref/ iomuxc1_gpio_io02_lpi2c_sda_lpi2c6_sda: IOMUXC1_GPIO_IO02_LPI2C_SDA_LPI2C6_SDA {
		pinmux = <0x443c0018 6 0x443c03f4 0 0x443c01c8>;
	};
	/omit-if-no-ref/ iomuxc1_gpio_io02_lpspi_sout_lpspi6_sout: IOMUXC1_GPIO_IO02_LPSPI_SOUT_LPSPI6_SOUT {
		pinmux = <0x443c0018 4 0x0 0 0x443c01c8>;
	};
	/omit-if-no-ref/ iomuxc1_gpio_io02_lpuart_cts_b_lpuart5_cts_b: IOMUXC1_GPIO_IO02_LPUART_CTS_B_LPUART5_CTS_B {
		pinmux = <0x443c0018 5 0x443c042c 1 0x443c01c8>;
	};
	/omit-if-no-ref/ iomuxc1_gpio_io02_mediamix_cam_vsync_mediamix_cam_vsync: IOMUXC1_GPIO_IO02_MEDIAMIX_CAM_VSYNC_MEDIAMIX_CAM_VSYNC {
		pinmux = <0x443c0018 2 0x0 0 0x443c01c8>;
	};
	/omit-if-no-ref/ iomuxc1_gpio_io02_mediamix_disp_vsync_mediamix_disp_vsync: IOMUXC1_GPIO_IO02_MEDIAMIX_DISP_VSYNC_MEDIAMIX_DISP_VSYNC {
		pinmux = <0x443c0018 3 0x0 0 0x443c01c8>;
	};
	/omit-if-no-ref/ iomuxc1_gpio_io03_flexio_flexio_flexio1_flexio03: IOMUXC1_GPIO_IO03_FLEXIO_FLEXIO_FLEXIO1_FLEXIO03 {
		pinmux = <0x443c001c 7 0x443c0378 0 0x443c01cc>;
	};
	/omit-if-no-ref/ iomuxc1_gpio_io03_gpio_io_gpio2_io03: IOMUXC1_GPIO_IO03_GPIO_IO_GPIO2_IO03 {
		pinmux = <0x443c001c 0 0x0 0 0x443c01cc>;
	};
	/omit-if-no-ref/ iomuxc1_gpio_io03_lpi2c_scl_lpi2c4_scl: IOMUXC1_GPIO_IO03_LPI2C_SCL_LPI2C4_SCL {
		pinmux = <0x443c001c 1 0x0 0 0x443c01cc>;
	};
	/omit-if-no-ref/ iomuxc1_gpio_io03_lpi2c_scl_lpi2c6_scl: IOMUXC1_GPIO_IO03_LPI2C_SCL_LPI2C6_SCL {
		pinmux = <0x443c001c 6 0x443c03f0 0 0x443c01cc>;
	};
	/omit-if-no-ref/ iomuxc1_gpio_io03_lpspi_sck_lpspi6_sck: IOMUXC1_GPIO_IO03_LPSPI_SCK_LPSPI6_SCK {
		pinmux = <0x443c001c 4 0x0 0 0x443c01cc>;
	};
	/omit-if-no-ref/ iomuxc1_gpio_io03_lpuart_rts_b_lpuart5_rts_b: IOMUXC1_GPIO_IO03_LPUART_RTS_B_LPUART5_RTS_B {
		pinmux = <0x443c001c 5 0x0 0 0x443c01cc>;
	};
	/omit-if-no-ref/ iomuxc1_gpio_io03_mediamix_cam_hsync_mediamix_cam_hsync: IOMUXC1_GPIO_IO03_MEDIAMIX_CAM_HSYNC_MEDIAMIX_CAM_HSYNC {
		pinmux = <0x443c001c 2 0x0 0 0x443c01cc>;
	};
	/omit-if-no-ref/ iomuxc1_gpio_io03_mediamix_disp_hsync_mediamix_disp_hsync: IOMUXC1_GPIO_IO03_MEDIAMIX_DISP_HSYNC_MEDIAMIX_DISP_HSYNC {
		pinmux = <0x443c001c 3 0x0 0 0x443c01cc>;
	};
	/omit-if-no-ref/ iomuxc1_gpio_io04_flexio_flexio_flexio1_flexio04: IOMUXC1_GPIO_IO04_FLEXIO_FLEXIO_FLEXIO1_FLEXIO04 {
		pinmux = <0x443c0020 7 0x443c037c 0 0x443c01d0>;
	};
	/omit-if-no-ref/ iomuxc1_gpio_io04_gpio_io_gpio2_io04: IOMUXC1_GPIO_IO04_GPIO_IO_GPIO2_IO04 {
		pinmux = <0x443c0020 0 0x0 0 0x443c01d0>;
	};
	/omit-if-no-ref/ iomuxc1_gpio_io04_lpi2c_sda_lpi2c6_sda: IOMUXC1_GPIO_IO04_LPI2C_SDA_LPI2C6_SDA {
		pinmux = <0x443c0020 6 0x443c03f4 1 0x443c01d0>;
	};
	/omit-if-no-ref/ iomuxc1_gpio_io04_lpspi_pcs_lpspi7_pcs0: IOMUXC1_GPIO_IO04_LPSPI_PCS_LPSPI7_PCS0 {
		pinmux = <0x443c0020 4 0x0 0 0x443c01d0>;
	};
	/omit-if-no-ref/ iomuxc1_gpio_io04_lpuart_tx_lpuart6_tx: IOMUXC1_GPIO_IO04_LPUART_TX_LPUART6_TX {
		pinmux = <0x443c0020 5 0x0 0 0x443c01d0>;
	};
	/omit-if-no-ref/ iomuxc1_gpio_io04_mediamix_disp_data_mediamix_disp_data00: IOMUXC1_GPIO_IO04_MEDIAMIX_DISP_DATA_MEDIAMIX_DISP_DATA00 {
		pinmux = <0x443c0020 3 0x0 0 0x443c01d0>;
	};
	/omit-if-no-ref/ iomuxc1_gpio_io04_pdm_clk_pdm_clk: IOMUXC1_GPIO_IO04_PDM_CLK_PDM_CLK {
		pinmux = <0x443c0020 2 0x0 0 0x443c01d0>;
	};
	/omit-if-no-ref/ iomuxc1_gpio_io04_tpm_ch_tpm3_ch0: IOMUXC1_GPIO_IO04_TPM_CH_TPM3_CH0 {
		pinmux = <0x443c0020 1 0x0 0 0x443c01d0>;
	};
	/omit-if-no-ref/ iomuxc1_gpio_io05_flexio_flexio_flexio1_flexio05: IOMUXC1_GPIO_IO05_FLEXIO_FLEXIO_FLEXIO1_FLEXIO05 {
		pinmux = <0x443c0024 7 0x443c0380 0 0x443c01d4>;
	};
	/omit-if-no-ref/ iomuxc1_gpio_io05_gpio_io_gpio2_io05: IOMUXC1_GPIO_IO05_GPIO_IO_GPIO2_IO05 {
		pinmux = <0x443c0024 0 0x0 0 0x443c01d4>;
	};
	/omit-if-no-ref/ iomuxc1_gpio_io05_lpi2c_scl_lpi2c6_scl: IOMUXC1_GPIO_IO05_LPI2C_SCL_LPI2C6_SCL {
		pinmux = <0x443c0024 6 0x443c03f0 1 0x443c01d4>;
	};
	/omit-if-no-ref/ iomuxc1_gpio_io05_lpspi_sin_lpspi7_sin: IOMUXC1_GPIO_IO05_LPSPI_SIN_LPSPI7_SIN {
		pinmux = <0x443c0024 4 0x0 0 0x443c01d4>;
	};
	/omit-if-no-ref/ iomuxc1_gpio_io05_lpuart_rx_lpuart6_rx: IOMUXC1_GPIO_IO05_LPUART_RX_LPUART6_RX {
		pinmux = <0x443c0024 5 0x0 0 0x443c01d4>;
	};
	/omit-if-no-ref/ iomuxc1_gpio_io05_mediamix_disp_data_mediamix_disp_data01: IOMUXC1_GPIO_IO05_MEDIAMIX_DISP_DATA_MEDIAMIX_DISP_DATA01 {
		pinmux = <0x443c0024 3 0x0 0 0x443c01d4>;
	};
	/omit-if-no-ref/ iomuxc1_gpio_io05_pdm_bit_stream_pdm_bit_stream00: IOMUXC1_GPIO_IO05_PDM_BIT_STREAM_PDM_BIT_STREAM00 {
		pinmux = <0x443c0024 2 0x443c0438 0 0x443c01d4>;
	};
	/omit-if-no-ref/ iomuxc1_gpio_io05_tpm_ch_tpm4_ch0: IOMUXC1_GPIO_IO05_TPM_CH_TPM4_CH0 {
		pinmux = <0x443c0024 1 0x0 0 0x443c01d4>;
	};
	/omit-if-no-ref/ iomuxc1_gpio_io06_flexio_flexio_flexio1_flexio06: IOMUXC1_GPIO_IO06_FLEXIO_FLEXIO_FLEXIO1_FLEXIO06 {
		pinmux = <0x443c0028 7 0x443c0384 0 0x443c01d8>;
	};
	/omit-if-no-ref/ iomuxc1_gpio_io06_gpio_io_gpio2_io06: IOMUXC1_GPIO_IO06_GPIO_IO_GPIO2_IO06 {
		pinmux = <0x443c0028 0 0x0 0 0x443c01d8>;
	};
	/omit-if-no-ref/ iomuxc1_gpio_io06_lpi2c_sda_lpi2c7_sda: IOMUXC1_GPIO_IO06_LPI2C_SDA_LPI2C7_SDA {
		pinmux = <0x443c0028 6 0x443c03fc 0 0x443c01d8>;
	};
	/omit-if-no-ref/ iomuxc1_gpio_io06_lpspi_sout_lpspi7_sout: IOMUXC1_GPIO_IO06_LPSPI_SOUT_LPSPI7_SOUT {
		pinmux = <0x443c0028 4 0x0 0 0x443c01d8>;
	};
	/omit-if-no-ref/ iomuxc1_gpio_io06_lpuart_cts_b_lpuart6_cts_b: IOMUXC1_GPIO_IO06_LPUART_CTS_B_LPUART6_CTS_B {
		pinmux = <0x443c0028 5 0x0 0 0x443c01d8>;
	};
	/omit-if-no-ref/ iomuxc1_gpio_io06_mediamix_disp_data_mediamix_disp_data02: IOMUXC1_GPIO_IO06_MEDIAMIX_DISP_DATA_MEDIAMIX_DISP_DATA02 {
		pinmux = <0x443c0028 3 0x0 0 0x443c01d8>;
	};
	/omit-if-no-ref/ iomuxc1_gpio_io06_pdm_bit_stream_pdm_bit_stream01: IOMUXC1_GPIO_IO06_PDM_BIT_STREAM_PDM_BIT_STREAM01 {
		pinmux = <0x443c0028 2 0x443c043c 0 0x443c01d8>;
	};
	/omit-if-no-ref/ iomuxc1_gpio_io06_tpm_ch_tpm5_ch0: IOMUXC1_GPIO_IO06_TPM_CH_TPM5_CH0 {
		pinmux = <0x443c0028 1 0x0 0 0x443c01d8>;
	};
	/omit-if-no-ref/ iomuxc1_gpio_io07_flexio_flexio_flexio1_flexio07: IOMUXC1_GPIO_IO07_FLEXIO_FLEXIO_FLEXIO1_FLEXIO07 {
		pinmux = <0x443c002c 7 0x443c0388 0 0x443c01dc>;
	};
	/omit-if-no-ref/ iomuxc1_gpio_io07_gpio_io_gpio2_io07: IOMUXC1_GPIO_IO07_GPIO_IO_GPIO2_IO07 {
		pinmux = <0x443c002c 0 0x0 0 0x443c01dc>;
	};
	/omit-if-no-ref/ iomuxc1_gpio_io07_lpi2c_scl_lpi2c7_scl: IOMUXC1_GPIO_IO07_LPI2C_SCL_LPI2C7_SCL {
		pinmux = <0x443c002c 6 0x443c03f8 0 0x443c01dc>;
	};
	/omit-if-no-ref/ iomuxc1_gpio_io07_lpspi_pcs_lpspi3_pcs1: IOMUXC1_GPIO_IO07_LPSPI_PCS_LPSPI3_PCS1 {
		pinmux = <0x443c002c 1 0x0 0 0x443c01dc>;
	};
	/omit-if-no-ref/ iomuxc1_gpio_io07_lpspi_sck_lpspi7_sck: IOMUXC1_GPIO_IO07_LPSPI_SCK_LPSPI7_SCK {
		pinmux = <0x443c002c 4 0x0 0 0x443c01dc>;
	};
	/omit-if-no-ref/ iomuxc1_gpio_io07_lpuart_rts_b_lpuart6_rts_b: IOMUXC1_GPIO_IO07_LPUART_RTS_B_LPUART6_RTS_B {
		pinmux = <0x443c002c 5 0x0 0 0x443c01dc>;
	};
	/omit-if-no-ref/ iomuxc1_gpio_io07_mediamix_cam_data_mediamix_cam_data01: IOMUXC1_GPIO_IO07_MEDIAMIX_CAM_DATA_MEDIAMIX_CAM_DATA01 {
		pinmux = <0x443c002c 2 0x0 0 0x443c01dc>;
	};
	/omit-if-no-ref/ iomuxc1_gpio_io07_mediamix_disp_data_mediamix_disp_data03: IOMUXC1_GPIO_IO07_MEDIAMIX_DISP_DATA_MEDIAMIX_DISP_DATA03 {
		pinmux = <0x443c002c 3 0x0 0 0x443c01dc>;
	};
	/omit-if-no-ref/ iomuxc1_gpio_io08_flexio_flexio_flexio1_flexio08: IOMUXC1_GPIO_IO08_FLEXIO_FLEXIO_FLEXIO1_FLEXIO08 {
		pinmux = <0x443c0030 7 0x443c038c 0 0x443c01e0>;
	};
	/omit-if-no-ref/ iomuxc1_gpio_io08_gpio_io_gpio2_io08: IOMUXC1_GPIO_IO08_GPIO_IO_GPIO2_IO08 {
		pinmux = <0x443c0030 0 0x0 0 0x443c01e0>;
	};
	/omit-if-no-ref/ iomuxc1_gpio_io08_lpi2c_sda_lpi2c7_sda: IOMUXC1_GPIO_IO08_LPI2C_SDA_LPI2C7_SDA {
		pinmux = <0x443c0030 6 0x443c03fc 1 0x443c01e0>;
	};
	/omit-if-no-ref/ iomuxc1_gpio_io08_lpspi_pcs_lpspi3_pcs0: IOMUXC1_GPIO_IO08_LPSPI_PCS_LPSPI3_PCS0 {
		pinmux = <0x443c0030 1 0x0 0 0x443c01e0>;
	};
	/omit-if-no-ref/ iomuxc1_gpio_io08_lpuart_tx_lpuart7_tx: IOMUXC1_GPIO_IO08_LPUART_TX_LPUART7_TX {
		pinmux = <0x443c0030 5 0x0 0 0x443c01e0>;
	};
	/omit-if-no-ref/ iomuxc1_gpio_io08_mediamix_cam_data_mediamix_cam_data02: IOMUXC1_GPIO_IO08_MEDIAMIX_CAM_DATA_MEDIAMIX_CAM_DATA02 {
		pinmux = <0x443c0030 2 0x0 0 0x443c01e0>;
	};
	/omit-if-no-ref/ iomuxc1_gpio_io08_mediamix_disp_data_mediamix_disp_data04: IOMUXC1_GPIO_IO08_MEDIAMIX_DISP_DATA_MEDIAMIX_DISP_DATA04 {
		pinmux = <0x443c0030 3 0x0 0 0x443c01e0>;
	};
	/omit-if-no-ref/ iomuxc1_gpio_io08_tpm_ch_tpm6_ch0: IOMUXC1_GPIO_IO08_TPM_CH_TPM6_CH0 {
		pinmux = <0x443c0030 4 0x0 0 0x443c01e0>;
	};
	/omit-if-no-ref/ iomuxc1_gpio_io09_flexio_flexio_flexio1_flexio09: IOMUXC1_GPIO_IO09_FLEXIO_FLEXIO_FLEXIO1_FLEXIO09 {
		pinmux = <0x443c0034 7 0x443c0390 0 0x443c01e4>;
	};
	/omit-if-no-ref/ iomuxc1_gpio_io09_gpio_io_gpio2_io09: IOMUXC1_GPIO_IO09_GPIO_IO_GPIO2_IO09 {
		pinmux = <0x443c0034 0 0x0 0 0x443c01e4>;
	};
	/omit-if-no-ref/ iomuxc1_gpio_io09_lpi2c_scl_lpi2c7_scl: IOMUXC1_GPIO_IO09_LPI2C_SCL_LPI2C7_SCL {
		pinmux = <0x443c0034 6 0x443c03f8 1 0x443c01e4>;
	};
	/omit-if-no-ref/ iomuxc1_gpio_io09_lpspi_sin_lpspi3_sin: IOMUXC1_GPIO_IO09_LPSPI_SIN_LPSPI3_SIN {
		pinmux = <0x443c0034 1 0x0 0 0x443c01e4>;
	};
	/omit-if-no-ref/ iomuxc1_gpio_io09_lpuart_rx_lpuart7_rx: IOMUXC1_GPIO_IO09_LPUART_RX_LPUART7_RX {
		pinmux = <0x443c0034 5 0x0 0 0x443c01e4>;
	};
	/omit-if-no-ref/ iomuxc1_gpio_io09_mediamix_cam_data_mediamix_cam_data03: IOMUXC1_GPIO_IO09_MEDIAMIX_CAM_DATA_MEDIAMIX_CAM_DATA03 {
		pinmux = <0x443c0034 2 0x0 0 0x443c01e4>;
	};
	/omit-if-no-ref/ iomuxc1_gpio_io09_mediamix_disp_data_mediamix_disp_data05: IOMUXC1_GPIO_IO09_MEDIAMIX_DISP_DATA_MEDIAMIX_DISP_DATA05 {
		pinmux = <0x443c0034 3 0x0 0 0x443c01e4>;
	};
	/omit-if-no-ref/ iomuxc1_gpio_io09_tpm_extclk_tpm3_extclk: IOMUXC1_GPIO_IO09_TPM_EXTCLK_TPM3_EXTCLK {
		pinmux = <0x443c0034 4 0x0 0 0x443c01e4>;
	};
	/omit-if-no-ref/ iomuxc1_gpio_io10_flexio_flexio_flexio1_flexio10: IOMUXC1_GPIO_IO10_FLEXIO_FLEXIO_FLEXIO1_FLEXIO10 {
		pinmux = <0x443c0038 7 0x443c0394 0 0x443c01e8>;
	};
	/omit-if-no-ref/ iomuxc1_gpio_io10_gpio_io_gpio2_io10: IOMUXC1_GPIO_IO10_GPIO_IO_GPIO2_IO10 {
		pinmux = <0x443c0038 0 0x0 0 0x443c01e8>;
	};
	/omit-if-no-ref/ iomuxc1_gpio_io10_lpi2c_sda_lpi2c8_sda: IOMUXC1_GPIO_IO10_LPI2C_SDA_LPI2C8_SDA {
		pinmux = <0x443c0038 6 0x443c0404 0 0x443c01e8>;
	};
	/omit-if-no-ref/ iomuxc1_gpio_io10_lpspi_sout_lpspi3_sout: IOMUXC1_GPIO_IO10_LPSPI_SOUT_LPSPI3_SOUT {
		pinmux = <0x443c0038 1 0x0 0 0x443c01e8>;
	};
	/omit-if-no-ref/ iomuxc1_gpio_io10_lpuart_cts_b_lpuart7_cts_b: IOMUXC1_GPIO_IO10_LPUART_CTS_B_LPUART7_CTS_B {
		pinmux = <0x443c0038 5 0x0 0 0x443c01e8>;
	};
	/omit-if-no-ref/ iomuxc1_gpio_io10_mediamix_cam_data_mediamix_cam_data04: IOMUXC1_GPIO_IO10_MEDIAMIX_CAM_DATA_MEDIAMIX_CAM_DATA04 {
		pinmux = <0x443c0038 2 0x0 0 0x443c01e8>;
	};
	/omit-if-no-ref/ iomuxc1_gpio_io10_mediamix_disp_data_mediamix_disp_data06: IOMUXC1_GPIO_IO10_MEDIAMIX_DISP_DATA_MEDIAMIX_DISP_DATA06 {
		pinmux = <0x443c0038 3 0x0 0 0x443c01e8>;
	};
	/omit-if-no-ref/ iomuxc1_gpio_io10_tpm_extclk_tpm4_extclk: IOMUXC1_GPIO_IO10_TPM_EXTCLK_TPM4_EXTCLK {
		pinmux = <0x443c0038 4 0x0 0 0x443c01e8>;
	};
	/omit-if-no-ref/ iomuxc1_gpio_io11_flexio_flexio_flexio1_flexio11: IOMUXC1_GPIO_IO11_FLEXIO_FLEXIO_FLEXIO1_FLEXIO11 {
		pinmux = <0x443c003c 7 0x443c0398 0 0x443c01ec>;
	};
	/omit-if-no-ref/ iomuxc1_gpio_io11_gpio_io_gpio2_io11: IOMUXC1_GPIO_IO11_GPIO_IO_GPIO2_IO11 {
		pinmux = <0x443c003c 0 0x0 0 0x443c01ec>;
	};
	/omit-if-no-ref/ iomuxc1_gpio_io11_lpi2c_scl_lpi2c8_scl: IOMUXC1_GPIO_IO11_LPI2C_SCL_LPI2C8_SCL {
		pinmux = <0x443c003c 6 0x443c0400 0 0x443c01ec>;
	};
	/omit-if-no-ref/ iomuxc1_gpio_io11_lpspi_sck_lpspi3_sck: IOMUXC1_GPIO_IO11_LPSPI_SCK_LPSPI3_SCK {
		pinmux = <0x443c003c 1 0x0 0 0x443c01ec>;
	};
	/omit-if-no-ref/ iomuxc1_gpio_io11_lpuart_rts_b_lpuart7_rts_b: IOMUXC1_GPIO_IO11_LPUART_RTS_B_LPUART7_RTS_B {
		pinmux = <0x443c003c 5 0x0 0 0x443c01ec>;
	};
	/omit-if-no-ref/ iomuxc1_gpio_io11_mediamix_cam_data_mediamix_cam_data05: IOMUXC1_GPIO_IO11_MEDIAMIX_CAM_DATA_MEDIAMIX_CAM_DATA05 {
		pinmux = <0x443c003c 2 0x0 0 0x443c01ec>;
	};
	/omit-if-no-ref/ iomuxc1_gpio_io11_mediamix_disp_data_mediamix_disp_data07: IOMUXC1_GPIO_IO11_MEDIAMIX_DISP_DATA_MEDIAMIX_DISP_DATA07 {
		pinmux = <0x443c003c 3 0x0 0 0x443c01ec>;
	};
	/omit-if-no-ref/ iomuxc1_gpio_io11_tpm_extclk_tpm5_extclk: IOMUXC1_GPIO_IO11_TPM_EXTCLK_TPM5_EXTCLK {
		pinmux = <0x443c003c 4 0x0 0 0x443c01ec>;
	};
	/omit-if-no-ref/ iomuxc1_gpio_io12_gpio_io_gpio2_io12: IOMUXC1_GPIO_IO12_GPIO_IO_GPIO2_IO12 {
		pinmux = <0x443c0040 0 0x0 0 0x443c01f0>;
	};
	/omit-if-no-ref/ iomuxc1_gpio_io12_lpi2c_sda_lpi2c8_sda: IOMUXC1_GPIO_IO12_LPI2C_SDA_LPI2C8_SDA {
		pinmux = <0x443c0040 6 0x443c0404 1 0x443c01f0>;
	};
	/omit-if-no-ref/ iomuxc1_gpio_io12_lpspi_pcs_lpspi8_pcs0: IOMUXC1_GPIO_IO12_LPSPI_PCS_LPSPI8_PCS0 {
		pinmux = <0x443c0040 4 0x0 0 0x443c01f0>;
	};
	/omit-if-no-ref/ iomuxc1_gpio_io12_lpuart_tx_lpuart8_tx: IOMUXC1_GPIO_IO12_LPUART_TX_LPUART8_TX {
		pinmux = <0x443c0040 5 0x0 0 0x443c01f0>;
	};
	/omit-if-no-ref/ iomuxc1_gpio_io12_mediamix_disp_data_mediamix_disp_data08: IOMUXC1_GPIO_IO12_MEDIAMIX_DISP_DATA_MEDIAMIX_DISP_DATA08 {
		pinmux = <0x443c0040 3 0x0 0 0x443c01f0>;
	};
	/omit-if-no-ref/ iomuxc1_gpio_io12_pdm_bit_stream_pdm_bit_stream02: IOMUXC1_GPIO_IO12_PDM_BIT_STREAM_PDM_BIT_STREAM02 {
		pinmux = <0x443c0040 2 0x443c0440 0 0x443c01f0>;
	};
	/omit-if-no-ref/ iomuxc1_gpio_io12_sai_rx_sync_sai3_rx_sync: IOMUXC1_GPIO_IO12_SAI_RX_SYNC_SAI3_RX_SYNC {
		pinmux = <0x443c0040 7 0x443c0450 0 0x443c01f0>;
	};
	/omit-if-no-ref/ iomuxc1_gpio_io12_tpm_ch_tpm3_ch2: IOMUXC1_GPIO_IO12_TPM_CH_TPM3_CH2 {
		pinmux = <0x443c0040 1 0x0 0 0x443c01f0>;
	};
	/omit-if-no-ref/ iomuxc1_gpio_io13_flexio_flexio_flexio1_flexio13: IOMUXC1_GPIO_IO13_FLEXIO_FLEXIO_FLEXIO1_FLEXIO13 {
		pinmux = <0x443c0044 7 0x443c039c 0 0x443c01f4>;
	};
	/omit-if-no-ref/ iomuxc1_gpio_io13_gpio_io_gpio2_io13: IOMUXC1_GPIO_IO13_GPIO_IO_GPIO2_IO13 {
		pinmux = <0x443c0044 0 0x0 0 0x443c01f4>;
	};
	/omit-if-no-ref/ iomuxc1_gpio_io13_lpi2c_scl_lpi2c8_scl: IOMUXC1_GPIO_IO13_LPI2C_SCL_LPI2C8_SCL {
		pinmux = <0x443c0044 6 0x443c0400 1 0x443c01f4>;
	};
	/omit-if-no-ref/ iomuxc1_gpio_io13_lpspi_sin_lpspi8_sin: IOMUXC1_GPIO_IO13_LPSPI_SIN_LPSPI8_SIN {
		pinmux = <0x443c0044 4 0x0 0 0x443c01f4>;
	};
	/omit-if-no-ref/ iomuxc1_gpio_io13_lpuart_rx_lpuart8_rx: IOMUXC1_GPIO_IO13_LPUART_RX_LPUART8_RX {
		pinmux = <0x443c0044 5 0x0 0 0x443c01f4>;
	};
	/omit-if-no-ref/ iomuxc1_gpio_io13_mediamix_disp_data_mediamix_disp_data09: IOMUXC1_GPIO_IO13_MEDIAMIX_DISP_DATA_MEDIAMIX_DISP_DATA09 {
		pinmux = <0x443c0044 3 0x0 0 0x443c01f4>;
	};
	/omit-if-no-ref/ iomuxc1_gpio_io13_pdm_bit_stream_pdm_bit_stream03: IOMUXC1_GPIO_IO13_PDM_BIT_STREAM_PDM_BIT_STREAM03 {
		pinmux = <0x443c0044 2 0x443c0444 0 0x443c01f4>;
	};
	/omit-if-no-ref/ iomuxc1_gpio_io13_tpm_ch_tpm4_ch2: IOMUXC1_GPIO_IO13_TPM_CH_TPM4_CH2 {
		pinmux = <0x443c0044 1 0x0 0 0x443c01f4>;
	};
	/omit-if-no-ref/ iomuxc1_gpio_io14_flexio_flexio_flexio1_flexio14: IOMUXC1_GPIO_IO14_FLEXIO_FLEXIO_FLEXIO1_FLEXIO14 {
		pinmux = <0x443c0048 7 0x443c03a0 0 0x443c01f8>;
	};
	/omit-if-no-ref/ iomuxc1_gpio_io14_gpio_io_gpio2_io14: IOMUXC1_GPIO_IO14_GPIO_IO_GPIO2_IO14 {
		pinmux = <0x443c0048 0 0x0 0 0x443c01f8>;
	};
	/omit-if-no-ref/ iomuxc1_gpio_io14_lpspi_sout_lpspi8_sout: IOMUXC1_GPIO_IO14_LPSPI_SOUT_LPSPI8_SOUT {
		pinmux = <0x443c0048 4 0x0 0 0x443c01f8>;
	};
	/omit-if-no-ref/ iomuxc1_gpio_io14_lpuart_cts_b_lpuart8_cts_b: IOMUXC1_GPIO_IO14_LPUART_CTS_B_LPUART8_CTS_B {
		pinmux = <0x443c0048 5 0x0 0 0x443c01f8>;
	};
	/omit-if-no-ref/ iomuxc1_gpio_io14_lpuart_tx_lpuart3_tx: IOMUXC1_GPIO_IO14_LPUART_TX_LPUART3_TX {
		pinmux = <0x443c0048 1 0x443c041c 0 0x443c01f8>;
	};
	/omit-if-no-ref/ iomuxc1_gpio_io14_lpuart_tx_lpuart4_tx: IOMUXC1_GPIO_IO14_LPUART_TX_LPUART4_TX {
		pinmux = <0x443c0048 6 0x443c0428 0 0x443c01f8>;
	};
	/omit-if-no-ref/ iomuxc1_gpio_io14_mediamix_cam_data_mediamix_cam_data06: IOMUXC1_GPIO_IO14_MEDIAMIX_CAM_DATA_MEDIAMIX_CAM_DATA06 {
		pinmux = <0x443c0048 2 0x0 0 0x443c01f8>;
	};
	/omit-if-no-ref/ iomuxc1_gpio_io14_mediamix_disp_data_mediamix_disp_data10: IOMUXC1_GPIO_IO14_MEDIAMIX_DISP_DATA_MEDIAMIX_DISP_DATA10 {
		pinmux = <0x443c0048 3 0x0 0 0x443c01f8>;
	};
	/omit-if-no-ref/ iomuxc1_gpio_io15_flexio_flexio_flexio1_flexio15: IOMUXC1_GPIO_IO15_FLEXIO_FLEXIO_FLEXIO1_FLEXIO15 {
		pinmux = <0x443c004c 7 0x443c03a4 0 0x443c01fc>;
	};
	/omit-if-no-ref/ iomuxc1_gpio_io15_gpio_io_gpio2_io15: IOMUXC1_GPIO_IO15_GPIO_IO_GPIO2_IO15 {
		pinmux = <0x443c004c 0 0x0 0 0x443c01fc>;
	};
	/omit-if-no-ref/ iomuxc1_gpio_io15_lpspi_sck_lpspi8_sck: IOMUXC1_GPIO_IO15_LPSPI_SCK_LPSPI8_SCK {
		pinmux = <0x443c004c 4 0x0 0 0x443c01fc>;
	};
	/omit-if-no-ref/ iomuxc1_gpio_io15_lpuart_rts_b_lpuart8_rts_b: IOMUXC1_GPIO_IO15_LPUART_RTS_B_LPUART8_RTS_B {
		pinmux = <0x443c004c 5 0x0 0 0x443c01fc>;
	};
	/omit-if-no-ref/ iomuxc1_gpio_io15_lpuart_rx_lpuart3_rx: IOMUXC1_GPIO_IO15_LPUART_RX_LPUART3_RX {
		pinmux = <0x443c004c 1 0x443c0418 0 0x443c01fc>;
	};
	/omit-if-no-ref/ iomuxc1_gpio_io15_lpuart_rx_lpuart4_rx: IOMUXC1_GPIO_IO15_LPUART_RX_LPUART4_RX {
		pinmux = <0x443c004c 6 0x443c0424 0 0x443c01fc>;
	};
	/omit-if-no-ref/ iomuxc1_gpio_io15_mediamix_cam_data_mediamix_cam_data07: IOMUXC1_GPIO_IO15_MEDIAMIX_CAM_DATA_MEDIAMIX_CAM_DATA07 {
		pinmux = <0x443c004c 2 0x0 0 0x443c01fc>;
	};
	/omit-if-no-ref/ iomuxc1_gpio_io15_mediamix_disp_data_mediamix_disp_data11: IOMUXC1_GPIO_IO15_MEDIAMIX_DISP_DATA_MEDIAMIX_DISP_DATA11 {
		pinmux = <0x443c004c 3 0x0 0 0x443c01fc>;
	};
	/omit-if-no-ref/ iomuxc1_gpio_io16_flexio_flexio_flexio1_flexio16: IOMUXC1_GPIO_IO16_FLEXIO_FLEXIO_FLEXIO1_FLEXIO16 {
		pinmux = <0x443c0050 7 0x443c03a8 0 0x443c0200>;
	};
	/omit-if-no-ref/ iomuxc1_gpio_io16_gpio_io_gpio2_io16: IOMUXC1_GPIO_IO16_GPIO_IO_GPIO2_IO16 {
		pinmux = <0x443c0050 0 0x0 0 0x443c0200>;
	};
	/omit-if-no-ref/ iomuxc1_gpio_io16_lpspi_pcs_lpspi4_pcs2: IOMUXC1_GPIO_IO16_LPSPI_PCS_LPSPI4_PCS2 {
		pinmux = <0x443c0050 5 0x0 0 0x443c0200>;
	};
	/omit-if-no-ref/ iomuxc1_gpio_io16_lpuart_cts_b_lpuart3_cts_b: IOMUXC1_GPIO_IO16_LPUART_CTS_B_LPUART3_CTS_B {
		pinmux = <0x443c0050 4 0x443c0414 0 0x443c0200>;
	};
	/omit-if-no-ref/ iomuxc1_gpio_io16_lpuart_cts_b_lpuart4_cts_b: IOMUXC1_GPIO_IO16_LPUART_CTS_B_LPUART4_CTS_B {
		pinmux = <0x443c0050 6 0x443c0420 0 0x443c0200>;
	};
	/omit-if-no-ref/ iomuxc1_gpio_io16_mediamix_disp_data_mediamix_disp_data12: IOMUXC1_GPIO_IO16_MEDIAMIX_DISP_DATA_MEDIAMIX_DISP_DATA12 {
		pinmux = <0x443c0050 3 0x0 0 0x443c0200>;
	};
	/omit-if-no-ref/ iomuxc1_gpio_io16_pdm_bit_stream_pdm_bit_stream02: IOMUXC1_GPIO_IO16_PDM_BIT_STREAM_PDM_BIT_STREAM02 {
		pinmux = <0x443c0050 2 0x443c0440 1 0x443c0200>;
	};
	/omit-if-no-ref/ iomuxc1_gpio_io16_sai_tx_bclk_sai3_tx_bclk: IOMUXC1_GPIO_IO16_SAI_TX_BCLK_SAI3_TX_BCLK {
		pinmux = <0x443c0050 1 0x0 0 0x443c0200>;
	};
	/omit-if-no-ref/ iomuxc1_gpio_io17_flexio_flexio_flexio1_flexio17: IOMUXC1_GPIO_IO17_FLEXIO_FLEXIO_FLEXIO1_FLEXIO17 {
		pinmux = <0x443c0054 7 0x443c03ac 0 0x443c0204>;
	};
	/omit-if-no-ref/ iomuxc1_gpio_io17_gpio_io_gpio2_io17: IOMUXC1_GPIO_IO17_GPIO_IO_GPIO2_IO17 {
		pinmux = <0x443c0054 0 0x0 0 0x443c0204>;
	};
	/omit-if-no-ref/ iomuxc1_gpio_io17_lpspi_pcs_lpspi4_pcs1: IOMUXC1_GPIO_IO17_LPSPI_PCS_LPSPI4_PCS1 {
		pinmux = <0x443c0054 5 0x0 0 0x443c0204>;
	};
	/omit-if-no-ref/ iomuxc1_gpio_io17_lpuart_rts_b_lpuart3_rts_b: IOMUXC1_GPIO_IO17_LPUART_RTS_B_LPUART3_RTS_B {
		pinmux = <0x443c0054 4 0x0 0 0x443c0204>;
	};
	/omit-if-no-ref/ iomuxc1_gpio_io17_lpuart_rts_b_lpuart4_rts_b: IOMUXC1_GPIO_IO17_LPUART_RTS_B_LPUART4_RTS_B {
		pinmux = <0x443c0054 6 0x0 0 0x443c0204>;
	};
	/omit-if-no-ref/ iomuxc1_gpio_io17_mediamix_cam_data_mediamix_cam_data08: IOMUXC1_GPIO_IO17_MEDIAMIX_CAM_DATA_MEDIAMIX_CAM_DATA08 {
		pinmux = <0x443c0054 2 0x0 0 0x443c0204>;
	};
	/omit-if-no-ref/ iomuxc1_gpio_io17_mediamix_disp_data_mediamix_disp_data13: IOMUXC1_GPIO_IO17_MEDIAMIX_DISP_DATA_MEDIAMIX_DISP_DATA13 {
		pinmux = <0x443c0054 3 0x0 0 0x443c0204>;
	};
	/omit-if-no-ref/ iomuxc1_gpio_io17_sai_mclk_sai3_mclk: IOMUXC1_GPIO_IO17_SAI_MCLK_SAI3_MCLK {
		pinmux = <0x443c0054 1 0x0 0 0x443c0204>;
	};
	/omit-if-no-ref/ iomuxc1_gpio_io18_flexio_flexio_flexio1_flexio18: IOMUXC1_GPIO_IO18_FLEXIO_FLEXIO_FLEXIO1_FLEXIO18 {
		pinmux = <0x443c0058 7 0x443c03b0 0 0x443c0208>;
	};
	/omit-if-no-ref/ iomuxc1_gpio_io18_gpio_io_gpio2_io18: IOMUXC1_GPIO_IO18_GPIO_IO_GPIO2_IO18 {
		pinmux = <0x443c0058 0 0x0 0 0x443c0208>;
	};
	/omit-if-no-ref/ iomuxc1_gpio_io18_lpspi_pcs_lpspi4_pcs0: IOMUXC1_GPIO_IO18_LPSPI_PCS_LPSPI4_PCS0 {
		pinmux = <0x443c0058 5 0x0 0 0x443c0208>;
	};
	/omit-if-no-ref/ iomuxc1_gpio_io18_lpspi_pcs_lpspi5_pcs0: IOMUXC1_GPIO_IO18_LPSPI_PCS_LPSPI5_PCS0 {
		pinmux = <0x443c0058 4 0x0 0 0x443c0208>;
	};
	/omit-if-no-ref/ iomuxc1_gpio_io18_mediamix_cam_data_mediamix_cam_data09: IOMUXC1_GPIO_IO18_MEDIAMIX_CAM_DATA_MEDIAMIX_CAM_DATA09 {
		pinmux = <0x443c0058 2 0x0 0 0x443c0208>;
	};
	/omit-if-no-ref/ iomuxc1_gpio_io18_mediamix_disp_data_mediamix_disp_data14: IOMUXC1_GPIO_IO18_MEDIAMIX_DISP_DATA_MEDIAMIX_DISP_DATA14 {
		pinmux = <0x443c0058 3 0x0 0 0x443c0208>;
	};
	/omit-if-no-ref/ iomuxc1_gpio_io18_sai_rx_bclk_sai3_rx_bclk: IOMUXC1_GPIO_IO18_SAI_RX_BCLK_SAI3_RX_BCLK {
		pinmux = <0x443c0058 1 0x443c044c 0 0x443c0208>;
	};
	/omit-if-no-ref/ iomuxc1_gpio_io18_tpm_ch_tpm5_ch2: IOMUXC1_GPIO_IO18_TPM_CH_TPM5_CH2 {
		pinmux = <0x443c0058 6 0x0 0 0x443c0208>;
	};
	/omit-if-no-ref/ iomuxc1_gpio_io19_gpio_io_gpio2_io19: IOMUXC1_GPIO_IO19_GPIO_IO_GPIO2_IO19 {
		pinmux = <0x443c005c 0 0x0 0 0x443c020c>;
	};
	/omit-if-no-ref/ iomuxc1_gpio_io19_lpspi_sin_lpspi4_sin: IOMUXC1_GPIO_IO19_LPSPI_SIN_LPSPI4_SIN {
		pinmux = <0x443c005c 5 0x0 0 0x443c020c>;
	};
	/omit-if-no-ref/ iomuxc1_gpio_io19_lpspi_sin_lpspi5_sin: IOMUXC1_GPIO_IO19_LPSPI_SIN_LPSPI5_SIN {
		pinmux = <0x443c005c 4 0x0 0 0x443c020c>;
	};
	/omit-if-no-ref/ iomuxc1_gpio_io19_mediamix_disp_data_mediamix_disp_data15: IOMUXC1_GPIO_IO19_MEDIAMIX_DISP_DATA_MEDIAMIX_DISP_DATA15 {
		pinmux = <0x443c005c 3 0x0 0 0x443c020c>;
	};
	/omit-if-no-ref/ iomuxc1_gpio_io19_pdm_bit_stream_pdm_bit_stream03: IOMUXC1_GPIO_IO19_PDM_BIT_STREAM_PDM_BIT_STREAM03 {
		pinmux = <0x443c005c 2 0x443c0444 1 0x443c020c>;
	};
	/omit-if-no-ref/ iomuxc1_gpio_io19_sai_rx_sync_sai3_rx_sync: IOMUXC1_GPIO_IO19_SAI_RX_SYNC_SAI3_RX_SYNC {
		pinmux = <0x443c005c 1 0x443c0450 1 0x443c020c>;
	};
	/omit-if-no-ref/ iomuxc1_gpio_io19_sai_tx_data_sai3_tx_data00: IOMUXC1_GPIO_IO19_SAI_TX_DATA_SAI3_TX_DATA00 {
		pinmux = <0x443c005c 7 0x0 0 0x443c020c>;
	};
	/omit-if-no-ref/ iomuxc1_gpio_io19_tpm_ch_tpm6_ch2: IOMUXC1_GPIO_IO19_TPM_CH_TPM6_CH2 {
		pinmux = <0x443c005c 6 0x0 0 0x443c020c>;
	};
	/omit-if-no-ref/ iomuxc1_gpio_io20_flexio_flexio_flexio1_flexio20: IOMUXC1_GPIO_IO20_FLEXIO_FLEXIO_FLEXIO1_FLEXIO20 {
		pinmux = <0x443c0060 7 0x443c03b4 0 0x443c0210>;
	};
	/omit-if-no-ref/ iomuxc1_gpio_io20_gpio_io_gpio2_io20: IOMUXC1_GPIO_IO20_GPIO_IO_GPIO2_IO20 {
		pinmux = <0x443c0060 0 0x0 0 0x443c0210>;
	};
	/omit-if-no-ref/ iomuxc1_gpio_io20_lpspi_sout_lpspi4_sout: IOMUXC1_GPIO_IO20_LPSPI_SOUT_LPSPI4_SOUT {
		pinmux = <0x443c0060 5 0x0 0 0x443c0210>;
	};
	/omit-if-no-ref/ iomuxc1_gpio_io20_lpspi_sout_lpspi5_sout: IOMUXC1_GPIO_IO20_LPSPI_SOUT_LPSPI5_SOUT {
		pinmux = <0x443c0060 4 0x0 0 0x443c0210>;
	};
	/omit-if-no-ref/ iomuxc1_gpio_io20_mediamix_disp_data_mediamix_disp_data16: IOMUXC1_GPIO_IO20_MEDIAMIX_DISP_DATA_MEDIAMIX_DISP_DATA16 {
		pinmux = <0x443c0060 3 0x0 0 0x443c0210>;
	};
	/omit-if-no-ref/ iomuxc1_gpio_io20_pdm_bit_stream_pdm_bit_stream00: IOMUXC1_GPIO_IO20_PDM_BIT_STREAM_PDM_BIT_STREAM00 {
		pinmux = <0x443c0060 2 0x443c0438 1 0x443c0210>;
	};
	/omit-if-no-ref/ iomuxc1_gpio_io20_sai_rx_data_sai3_rx_data00: IOMUXC1_GPIO_IO20_SAI_RX_DATA_SAI3_RX_DATA00 {
		pinmux = <0x443c0060 1 0x0 0 0x443c0210>;
	};
	/omit-if-no-ref/ iomuxc1_gpio_io20_tpm_ch_tpm3_ch1: IOMUXC1_GPIO_IO20_TPM_CH_TPM3_CH1 {
		pinmux = <0x443c0060 6 0x0 0 0x443c0210>;
	};
	/omit-if-no-ref/ iomuxc1_gpio_io21_gpio_io_gpio2_io21: IOMUXC1_GPIO_IO21_GPIO_IO_GPIO2_IO21 {
		pinmux = <0x443c0064 0 0x0 0 0x443c0214>;
	};
	/omit-if-no-ref/ iomuxc1_gpio_io21_lpspi_sck_lpspi4_sck: IOMUXC1_GPIO_IO21_LPSPI_SCK_LPSPI4_SCK {
		pinmux = <0x443c0064 5 0x0 0 0x443c0214>;
	};
	/omit-if-no-ref/ iomuxc1_gpio_io21_lpspi_sck_lpspi5_sck: IOMUXC1_GPIO_IO21_LPSPI_SCK_LPSPI5_SCK {
		pinmux = <0x443c0064 4 0x0 0 0x443c0214>;
	};
	/omit-if-no-ref/ iomuxc1_gpio_io21_mediamix_disp_data_mediamix_disp_data17: IOMUXC1_GPIO_IO21_MEDIAMIX_DISP_DATA_MEDIAMIX_DISP_DATA17 {
		pinmux = <0x443c0064 3 0x0 0 0x443c0214>;
	};
	/omit-if-no-ref/ iomuxc1_gpio_io21_pdm_clk_pdm_clk: IOMUXC1_GPIO_IO21_PDM_CLK_PDM_CLK {
		pinmux = <0x443c0064 2 0x0 0 0x443c0214>;
	};
	/omit-if-no-ref/ iomuxc1_gpio_io21_sai_rx_bclk_sai3_rx_bclk: IOMUXC1_GPIO_IO21_SAI_RX_BCLK_SAI3_RX_BCLK {
		pinmux = <0x443c0064 7 0x443c044c 1 0x443c0214>;
	};
	/omit-if-no-ref/ iomuxc1_gpio_io21_sai_tx_data_sai3_tx_data00: IOMUXC1_GPIO_IO21_SAI_TX_DATA_SAI3_TX_DATA00 {
		pinmux = <0x443c0064 1 0x0 0 0x443c0214>;
	};
	/omit-if-no-ref/ iomuxc1_gpio_io21_tpm_ch_tpm4_ch1: IOMUXC1_GPIO_IO21_TPM_CH_TPM4_CH1 {
		pinmux = <0x443c0064 6 0x0 0 0x443c0214>;
	};
	/omit-if-no-ref/ iomuxc1_gpio_io22_flexio_flexio_flexio1_flexio22: IOMUXC1_GPIO_IO22_FLEXIO_FLEXIO_FLEXIO1_FLEXIO22 {
		pinmux = <0x443c0068 7 0x443c03b8 0 0x443c0218>;
	};
	/omit-if-no-ref/ iomuxc1_gpio_io22_gpio_io_gpio2_io22: IOMUXC1_GPIO_IO22_GPIO_IO_GPIO2_IO22 {
		pinmux = <0x443c0068 0 0x0 0 0x443c0218>;
	};
	/omit-if-no-ref/ iomuxc1_gpio_io22_lpi2c_sda_lpi2c5_sda: IOMUXC1_GPIO_IO22_LPI2C_SDA_LPI2C5_SDA {
		pinmux = <0x443c0068 6 0x443c03ec 1 0x443c0218>;
	};
	/omit-if-no-ref/ iomuxc1_gpio_io22_mediamix_disp_data_mediamix_disp_data18: IOMUXC1_GPIO_IO22_MEDIAMIX_DISP_DATA_MEDIAMIX_DISP_DATA18 {
		pinmux = <0x443c0068 3 0x0 0 0x443c0218>;
	};
	/omit-if-no-ref/ iomuxc1_gpio_io22_spdif_in_spdif_in: IOMUXC1_GPIO_IO22_SPDIF_IN_SPDIF_IN {
		pinmux = <0x443c0068 2 0x443c0454 0 0x443c0218>;
	};
	/omit-if-no-ref/ iomuxc1_gpio_io22_tpm_ch_tpm5_ch1: IOMUXC1_GPIO_IO22_TPM_CH_TPM5_CH1 {
		pinmux = <0x443c0068 4 0x0 0 0x443c0218>;
	};
	/omit-if-no-ref/ iomuxc1_gpio_io22_tpm_extclk_tpm6_extclk: IOMUXC1_GPIO_IO22_TPM_EXTCLK_TPM6_EXTCLK {
		pinmux = <0x443c0068 5 0x0 0 0x443c0218>;
	};
	/omit-if-no-ref/ iomuxc1_gpio_io22_usdhc_clk_usdhc3_clk: IOMUXC1_GPIO_IO22_USDHC_CLK_USDHC3_CLK {
		pinmux = <0x443c0068 1 0x443c0458 0 0x443c0218>;
	};
	/omit-if-no-ref/ iomuxc1_gpio_io23_flexio_flexio_flexio1_flexio23: IOMUXC1_GPIO_IO23_FLEXIO_FLEXIO_FLEXIO1_FLEXIO23 {
		pinmux = <0x443c006c 7 0x443c03bc 0 0x443c021c>;
	};
	/omit-if-no-ref/ iomuxc1_gpio_io23_gpio_io_gpio2_io23: IOMUXC1_GPIO_IO23_GPIO_IO_GPIO2_IO23 {
		pinmux = <0x443c006c 0 0x0 0 0x443c021c>;
	};
	/omit-if-no-ref/ iomuxc1_gpio_io23_lpi2c_scl_lpi2c5_scl: IOMUXC1_GPIO_IO23_LPI2C_SCL_LPI2C5_SCL {
		pinmux = <0x443c006c 6 0x443c03e8 1 0x443c021c>;
	};
	/omit-if-no-ref/ iomuxc1_gpio_io23_mediamix_disp_data_mediamix_disp_data19: IOMUXC1_GPIO_IO23_MEDIAMIX_DISP_DATA_MEDIAMIX_DISP_DATA19 {
		pinmux = <0x443c006c 3 0x0 0 0x443c021c>;
	};
	/omit-if-no-ref/ iomuxc1_gpio_io23_spdif_out_spdif_out: IOMUXC1_GPIO_IO23_SPDIF_OUT_SPDIF_OUT {
		pinmux = <0x443c006c 2 0x0 0 0x443c021c>;
	};
	/omit-if-no-ref/ iomuxc1_gpio_io23_tpm_ch_tpm6_ch1: IOMUXC1_GPIO_IO23_TPM_CH_TPM6_CH1 {
		pinmux = <0x443c006c 4 0x0 0 0x443c021c>;
	};
	/omit-if-no-ref/ iomuxc1_gpio_io23_usdhc_cmd_usdhc3_cmd: IOMUXC1_GPIO_IO23_USDHC_CMD_USDHC3_CMD {
		pinmux = <0x443c006c 1 0x443c045c 0 0x443c021c>;
	};
	/omit-if-no-ref/ iomuxc1_gpio_io24_flexio_flexio_flexio1_flexio24: IOMUXC1_GPIO_IO24_FLEXIO_FLEXIO_FLEXIO1_FLEXIO24 {
		pinmux = <0x443c0070 7 0x443c03c0 0 0x443c0220>;
	};
	/omit-if-no-ref/ iomuxc1_gpio_io24_gpio_io_gpio2_io24: IOMUXC1_GPIO_IO24_GPIO_IO_GPIO2_IO24 {
		pinmux = <0x443c0070 0 0x0 0 0x443c0220>;
	};
	/omit-if-no-ref/ iomuxc1_gpio_io24_jtag_mux_tdo_jtag_mux_tdo: IOMUXC1_GPIO_IO24_JTAG_MUX_TDO_JTAG_MUX_TDO {
		pinmux = <0x443c0070 5 0x0 0 0x443c0220>;
	};
	/omit-if-no-ref/ iomuxc1_gpio_io24_lpspi_pcs_lpspi6_pcs1: IOMUXC1_GPIO_IO24_LPSPI_PCS_LPSPI6_PCS1 {
		pinmux = <0x443c0070 6 0x0 0 0x443c0220>;
	};
	/omit-if-no-ref/ iomuxc1_gpio_io24_mediamix_disp_data_mediamix_disp_data20: IOMUXC1_GPIO_IO24_MEDIAMIX_DISP_DATA_MEDIAMIX_DISP_DATA20 {
		pinmux = <0x443c0070 3 0x0 0 0x443c0220>;
	};
	/omit-if-no-ref/ iomuxc1_gpio_io24_tpm_ch_tpm3_ch3: IOMUXC1_GPIO_IO24_TPM_CH_TPM3_CH3 {
		pinmux = <0x443c0070 4 0x0 0 0x443c0220>;
	};
	/omit-if-no-ref/ iomuxc1_gpio_io24_usdhc_data_usdhc3_data0: IOMUXC1_GPIO_IO24_USDHC_DATA_USDHC3_DATA0 {
		pinmux = <0x443c0070 1 0x443c0460 0 0x443c0220>;
	};
	/omit-if-no-ref/ iomuxc1_gpio_io25_can_tx_can2_tx: IOMUXC1_GPIO_IO25_CAN_TX_CAN2_TX {
		pinmux = <0x443c0074 2 0x0 0 0x443c0224>;
	};
	/omit-if-no-ref/ iomuxc1_gpio_io25_flexio_flexio_flexio1_flexio25: IOMUXC1_GPIO_IO25_FLEXIO_FLEXIO_FLEXIO1_FLEXIO25 {
		pinmux = <0x443c0074 7 0x443c03c4 0 0x443c0224>;
	};
	/omit-if-no-ref/ iomuxc1_gpio_io25_gpio_io_gpio2_io25: IOMUXC1_GPIO_IO25_GPIO_IO_GPIO2_IO25 {
		pinmux = <0x443c0074 0 0x0 0 0x443c0224>;
	};
	/omit-if-no-ref/ iomuxc1_gpio_io25_jtag_mux_tck_jtag_mux_tck: IOMUXC1_GPIO_IO25_JTAG_MUX_TCK_JTAG_MUX_TCK {
		pinmux = <0x443c0074 5 0x443c03d4 1 0x443c0224>;
	};
	/omit-if-no-ref/ iomuxc1_gpio_io25_lpspi_pcs_lpspi7_pcs1: IOMUXC1_GPIO_IO25_LPSPI_PCS_LPSPI7_PCS1 {
		pinmux = <0x443c0074 6 0x0 0 0x443c0224>;
	};
	/omit-if-no-ref/ iomuxc1_gpio_io25_mediamix_disp_data_mediamix_disp_data21: IOMUXC1_GPIO_IO25_MEDIAMIX_DISP_DATA_MEDIAMIX_DISP_DATA21 {
		pinmux = <0x443c0074 3 0x0 0 0x443c0224>;
	};
	/omit-if-no-ref/ iomuxc1_gpio_io25_tpm_ch_tpm4_ch3: IOMUXC1_GPIO_IO25_TPM_CH_TPM4_CH3 {
		pinmux = <0x443c0074 4 0x0 0 0x443c0224>;
	};
	/omit-if-no-ref/ iomuxc1_gpio_io25_usdhc_data_usdhc3_data1: IOMUXC1_GPIO_IO25_USDHC_DATA_USDHC3_DATA1 {
		pinmux = <0x443c0074 1 0x443c0464 0 0x443c0224>;
	};
	/omit-if-no-ref/ iomuxc1_gpio_io26_gpio_io_gpio2_io26: IOMUXC1_GPIO_IO26_GPIO_IO_GPIO2_IO26 {
		pinmux = <0x443c0078 0 0x0 0 0x443c0228>;
	};
	/omit-if-no-ref/ iomuxc1_gpio_io26_jtag_mux_tdi_jtag_mux_tdi: IOMUXC1_GPIO_IO26_JTAG_MUX_TDI_JTAG_MUX_TDI {
		pinmux = <0x443c0078 5 0x443c03d8 1 0x443c0228>;
	};
	/omit-if-no-ref/ iomuxc1_gpio_io26_lpspi_pcs_lpspi8_pcs1: IOMUXC1_GPIO_IO26_LPSPI_PCS_LPSPI8_PCS1 {
		pinmux = <0x443c0078 6 0x0 0 0x443c0228>;
	};
	/omit-if-no-ref/ iomuxc1_gpio_io26_mediamix_disp_data_mediamix_disp_data22: IOMUXC1_GPIO_IO26_MEDIAMIX_DISP_DATA_MEDIAMIX_DISP_DATA22 {
		pinmux = <0x443c0078 3 0x0 0 0x443c0228>;
	};
	/omit-if-no-ref/ iomuxc1_gpio_io26_pdm_bit_stream_pdm_bit_stream01: IOMUXC1_GPIO_IO26_PDM_BIT_STREAM_PDM_BIT_STREAM01 {
		pinmux = <0x443c0078 2 0x443c043c 1 0x443c0228>;
	};
	/omit-if-no-ref/ iomuxc1_gpio_io26_sai_tx_sync_sai3_tx_sync: IOMUXC1_GPIO_IO26_SAI_TX_SYNC_SAI3_TX_SYNC {
		pinmux = <0x443c0078 7 0x0 0 0x443c0228>;
	};
	/omit-if-no-ref/ iomuxc1_gpio_io26_tpm_ch_tpm5_ch3: IOMUXC1_GPIO_IO26_TPM_CH_TPM5_CH3 {
		pinmux = <0x443c0078 4 0x0 0 0x443c0228>;
	};
	/omit-if-no-ref/ iomuxc1_gpio_io26_usdhc_data_usdhc3_data2: IOMUXC1_GPIO_IO26_USDHC_DATA_USDHC3_DATA2 {
		pinmux = <0x443c0078 1 0x443c0468 0 0x443c0228>;
	};
	/omit-if-no-ref/ iomuxc1_gpio_io27_can_rx_can2_rx: IOMUXC1_GPIO_IO27_CAN_RX_CAN2_RX {
		pinmux = <0x443c007c 2 0x443c0364 1 0x443c022c>;
	};
	/omit-if-no-ref/ iomuxc1_gpio_io27_flexio_flexio_flexio1_flexio27: IOMUXC1_GPIO_IO27_FLEXIO_FLEXIO_FLEXIO1_FLEXIO27 {
		pinmux = <0x443c007c 7 0x443c03c8 0 0x443c022c>;
	};
	/omit-if-no-ref/ iomuxc1_gpio_io27_gpio_io_gpio2_io27: IOMUXC1_GPIO_IO27_GPIO_IO_GPIO2_IO27 {
		pinmux = <0x443c007c 0 0x0 0 0x443c022c>;
	};
	/omit-if-no-ref/ iomuxc1_gpio_io27_jtag_mux_tms_jtag_mux_tms: IOMUXC1_GPIO_IO27_JTAG_MUX_TMS_JTAG_MUX_TMS {
		pinmux = <0x443c007c 5 0x443c03dc 1 0x443c022c>;
	};
	/omit-if-no-ref/ iomuxc1_gpio_io27_lpspi_pcs_lpspi5_pcs1: IOMUXC1_GPIO_IO27_LPSPI_PCS_LPSPI5_PCS1 {
		pinmux = <0x443c007c 6 0x0 0 0x443c022c>;
	};
	/omit-if-no-ref/ iomuxc1_gpio_io27_mediamix_disp_data_mediamix_disp_data23: IOMUXC1_GPIO_IO27_MEDIAMIX_DISP_DATA_MEDIAMIX_DISP_DATA23 {
		pinmux = <0x443c007c 3 0x0 0 0x443c022c>;
	};
	/omit-if-no-ref/ iomuxc1_gpio_io27_tpm_ch_tpm6_ch3: IOMUXC1_GPIO_IO27_TPM_CH_TPM6_CH3 {
		pinmux = <0x443c007c 4 0x0 0 0x443c022c>;
	};
	/omit-if-no-ref/ iomuxc1_gpio_io27_usdhc_data_usdhc3_data3: IOMUXC1_GPIO_IO27_USDHC_DATA_USDHC3_DATA3 {
		pinmux = <0x443c007c 1 0x443c046c 0 0x443c022c>;
	};
	/omit-if-no-ref/ iomuxc1_gpio_io28_flexio_flexio_flexio1_flexio28: IOMUXC1_GPIO_IO28_FLEXIO_FLEXIO_FLEXIO1_FLEXIO28 {
		pinmux = <0x443c0080 7 0x0 0 0x443c0230>;
	};
	/omit-if-no-ref/ iomuxc1_gpio_io28_gpio_io_gpio2_io28: IOMUXC1_GPIO_IO28_GPIO_IO_GPIO2_IO28 {
		pinmux = <0x443c0080 0 0x0 0 0x443c0230>;
	};
	/omit-if-no-ref/ iomuxc1_gpio_io28_lpi2c_sda_lpi2c3_sda: IOMUXC1_GPIO_IO28_LPI2C_SDA_LPI2C3_SDA {
		pinmux = <0x443c0080 1 0x443c03e4 1 0x443c0230>;
	};
	/omit-if-no-ref/ iomuxc1_gpio_io29_flexio_flexio_flexio1_flexio29: IOMUXC1_GPIO_IO29_FLEXIO_FLEXIO_FLEXIO1_FLEXIO29 {
		pinmux = <0x443c0084 7 0x0 0 0x443c0234>;
	};
	/omit-if-no-ref/ iomuxc1_gpio_io29_gpio_io_gpio2_io29: IOMUXC1_GPIO_IO29_GPIO_IO_GPIO2_IO29 {
		pinmux = <0x443c0084 0 0x0 0 0x443c0234>;
	};
	/omit-if-no-ref/ iomuxc1_gpio_io29_lpi2c_scl_lpi2c3_scl: IOMUXC1_GPIO_IO29_LPI2C_SCL_LPI2C3_SCL {
		pinmux = <0x443c0084 1 0x443c03e0 1 0x443c0234>;
	};
	/omit-if-no-ref/ iomuxc1_i2c1_scl_gpio_io_gpio1_io00: IOMUXC1_I2C1_SCL_GPIO_IO_GPIO1_IO00 {
		pinmux = <0x443c0170 5 0x0 0 0x443c0320>;
	};
	/omit-if-no-ref/ iomuxc1_i2c1_scl_i3c_scl_i3c1_scl: IOMUXC1_I2C1_SCL_I3C_SCL_I3C1_SCL {
		pinmux = <0x443c0170 1 0x0 0 0x443c0320>;
	};
	/omit-if-no-ref/ iomuxc1_i2c1_scl_lpi2c_scl_lpi2c1_scl: IOMUXC1_I2C1_SCL_LPI2C_SCL_LPI2C1_SCL {
		pinmux = <0x443c0170 0 0x0 0 0x443c0320>;
	};
	/omit-if-no-ref/ iomuxc1_i2c1_scl_lpuart_dcb_b_lpuart1_dcb_b: IOMUXC1_I2C1_SCL_LPUART_DCB_B_LPUART1_DCB_B {
		pinmux = <0x443c0170 2 0x0 0 0x443c0320>;
	};
	/omit-if-no-ref/ iomuxc1_i2c1_scl_tpm_ch_tpm2_ch0: IOMUXC1_I2C1_SCL_TPM_CH_TPM2_CH0 {
		pinmux = <0x443c0170 3 0x0 0 0x443c0320>;
	};
	/omit-if-no-ref/ iomuxc1_i2c1_sda_gpio_io_gpio1_io01: IOMUXC1_I2C1_SDA_GPIO_IO_GPIO1_IO01 {
		pinmux = <0x443c0174 5 0x0 0 0x443c0324>;
	};
	/omit-if-no-ref/ iomuxc1_i2c1_sda_i3c_sda_i3c1_sda: IOMUXC1_I2C1_SDA_I3C_SDA_I3C1_SDA {
		pinmux = <0x443c0174 1 0x0 0 0x443c0324>;
	};
	/omit-if-no-ref/ iomuxc1_i2c1_sda_lpi2c_sda_lpi2c1_sda: IOMUXC1_I2C1_SDA_LPI2C_SDA_LPI2C1_SDA {
		pinmux = <0x443c0174 0 0x0 0 0x443c0324>;
	};
	/omit-if-no-ref/ iomuxc1_i2c1_sda_lpuart_rin_b_lpuart1_rin_b: IOMUXC1_I2C1_SDA_LPUART_RIN_B_LPUART1_RIN_B {
		pinmux = <0x443c0174 2 0x0 0 0x443c0324>;
	};
	/omit-if-no-ref/ iomuxc1_i2c1_sda_tpm_ch_tpm2_ch1: IOMUXC1_I2C1_SDA_TPM_CH_TPM2_CH1 {
		pinmux = <0x443c0174 3 0x0 0 0x443c0324>;
	};
	/omit-if-no-ref/ iomuxc1_i2c2_scl_gpio_io_gpio1_io02: IOMUXC1_I2C2_SCL_GPIO_IO_GPIO1_IO02 {
		pinmux = <0x443c0178 5 0x0 0 0x443c0328>;
	};
	/omit-if-no-ref/ iomuxc1_i2c2_scl_i3c_pur_b_i3c1_pur_b: IOMUXC1_I2C2_SCL_I3C_PUR_B_I3C1_PUR_B {
		pinmux = <0x443c0178 6 0x0 0 0x443c0328>;
	};
	/omit-if-no-ref/ iomuxc1_i2c2_scl_i3c_pur_i3c1_pur: IOMUXC1_I2C2_SCL_I3C_PUR_I3C1_PUR {
		pinmux = <0x443c0178 1 0x0 0 0x443c0328>;
	};
	/omit-if-no-ref/ iomuxc1_i2c2_scl_lpi2c_scl_lpi2c2_scl: IOMUXC1_I2C2_SCL_LPI2C_SCL_LPI2C2_SCL {
		pinmux = <0x443c0178 0 0x0 0 0x443c0328>;
	};
	/omit-if-no-ref/ iomuxc1_i2c2_scl_lpuart_dcb_b_lpuart2_dcb_b: IOMUXC1_I2C2_SCL_LPUART_DCB_B_LPUART2_DCB_B {
		pinmux = <0x443c0178 2 0x0 0 0x443c0328>;
	};
	/omit-if-no-ref/ iomuxc1_i2c2_scl_sai_rx_sync_sai1_rx_sync: IOMUXC1_I2C2_SCL_SAI_RX_SYNC_SAI1_RX_SYNC {
		pinmux = <0x443c0178 4 0x0 0 0x443c0328>;
	};
	/omit-if-no-ref/ iomuxc1_i2c2_scl_tpm_ch_tpm2_ch2: IOMUXC1_I2C2_SCL_TPM_CH_TPM2_CH2 {
		pinmux = <0x443c0178 3 0x0 0 0x443c0328>;
	};
	/omit-if-no-ref/ iomuxc1_i2c2_sda_gpio_io_gpio1_io03: IOMUXC1_I2C2_SDA_GPIO_IO_GPIO1_IO03 {
		pinmux = <0x443c017c 5 0x0 0 0x443c032c>;
	};
	/omit-if-no-ref/ iomuxc1_i2c2_sda_lpi2c_sda_lpi2c2_sda: IOMUXC1_I2C2_SDA_LPI2C_SDA_LPI2C2_SDA {
		pinmux = <0x443c017c 0 0x0 0 0x443c032c>;
	};
	/omit-if-no-ref/ iomuxc1_i2c2_sda_lpuart_rin_b_lpuart2_rin_b: IOMUXC1_I2C2_SDA_LPUART_RIN_B_LPUART2_RIN_B {
		pinmux = <0x443c017c 2 0x0 0 0x443c032c>;
	};
	/omit-if-no-ref/ iomuxc1_i2c2_sda_sai_rx_bclk_sai1_rx_bclk: IOMUXC1_I2C2_SDA_SAI_RX_BCLK_SAI1_RX_BCLK {
		pinmux = <0x443c017c 4 0x0 0 0x443c032c>;
	};
	/omit-if-no-ref/ iomuxc1_i2c2_sda_tpm_ch_tpm2_ch3: IOMUXC1_I2C2_SDA_TPM_CH_TPM2_CH3 {
		pinmux = <0x443c017c 3 0x0 0 0x443c032c>;
	};
	/omit-if-no-ref/ iomuxc1_pdm_bit_stream0_can_rx_can1_rx: IOMUXC1_PDM_BIT_STREAM0_CAN_RX_CAN1_RX {
		pinmux = <0x443c0194 6 0x443c0360 0 0x443c0344>;
	};
	/omit-if-no-ref/ iomuxc1_pdm_bit_stream0_gpio_io_gpio1_io09: IOMUXC1_PDM_BIT_STREAM0_GPIO_IO_GPIO1_IO09 {
		pinmux = <0x443c0194 5 0x0 0 0x443c0344>;
	};
	/omit-if-no-ref/ iomuxc1_pdm_bit_stream0_lpspi_pcs_lpspi1_pcs1: IOMUXC1_PDM_BIT_STREAM0_LPSPI_PCS_LPSPI1_PCS1 {
		pinmux = <0x443c0194 2 0x0 0 0x443c0344>;
	};
	/omit-if-no-ref/ iomuxc1_pdm_bit_stream0_lptmr_alt_lptmr1_alt2: IOMUXC1_PDM_BIT_STREAM0_LPTMR_ALT_LPTMR1_ALT2 {
		pinmux = <0x443c0194 4 0x0 0 0x443c0344>;
	};
	/omit-if-no-ref/ iomuxc1_pdm_bit_stream0_mqs_right_mqs1_right: IOMUXC1_PDM_BIT_STREAM0_MQS_RIGHT_MQS1_RIGHT {
		pinmux = <0x443c0194 1 0x0 0 0x443c0344>;
	};
	/omit-if-no-ref/ iomuxc1_pdm_bit_stream0_pdm_bit_stream_pdm_bit_stream00: IOMUXC1_PDM_BIT_STREAM0_PDM_BIT_STREAM_PDM_BIT_STREAM00 {
		pinmux = <0x443c0194 0 0x443c0438 2 0x443c0344>;
	};
	/omit-if-no-ref/ iomuxc1_pdm_bit_stream0_tpm_extclk_tpm1_extclk: IOMUXC1_PDM_BIT_STREAM0_TPM_EXTCLK_TPM1_EXTCLK {
		pinmux = <0x443c0194 3 0x0 0 0x443c0344>;
	};
	/omit-if-no-ref/ iomuxc1_pdm_bit_stream1_ccmsrcgpcmix_ext_clk_ccmsrcgpcmix_ext_clk1: IOMUXC1_PDM_BIT_STREAM1_CCMSRCGPCMIX_EXT_CLK_CCMSRCGPCMIX_EXT_CLK1 {
		pinmux = <0x443c0198 6 0x443c0368 1 0x443c0348>;
	};
	/omit-if-no-ref/ iomuxc1_pdm_bit_stream1_gpio_io_gpio1_io10: IOMUXC1_PDM_BIT_STREAM1_GPIO_IO_GPIO1_IO10 {
		pinmux = <0x443c0198 5 0x0 0 0x443c0348>;
	};
	/omit-if-no-ref/ iomuxc1_pdm_bit_stream1_lpspi_pcs_lpspi2_pcs1: IOMUXC1_PDM_BIT_STREAM1_LPSPI_PCS_LPSPI2_PCS1 {
		pinmux = <0x443c0198 2 0x0 0 0x443c0348>;
	};
	/omit-if-no-ref/ iomuxc1_pdm_bit_stream1_lptmr_alt_lptmr1_alt3: IOMUXC1_PDM_BIT_STREAM1_LPTMR_ALT_LPTMR1_ALT3 {
		pinmux = <0x443c0198 4 0x0 0 0x443c0348>;
	};
	/omit-if-no-ref/ iomuxc1_pdm_bit_stream1_pdm_bit_stream_pdm_bit_stream01: IOMUXC1_PDM_BIT_STREAM1_PDM_BIT_STREAM_PDM_BIT_STREAM01 {
		pinmux = <0x443c0198 0 0x443c043c 2 0x443c0348>;
	};
	/omit-if-no-ref/ iomuxc1_pdm_bit_stream1_tpm_extclk_tpm2_extclk: IOMUXC1_PDM_BIT_STREAM1_TPM_EXTCLK_TPM2_EXTCLK {
		pinmux = <0x443c0198 3 0x0 0 0x443c0348>;
	};
	/omit-if-no-ref/ iomuxc1_pdm_clk_can_tx_can1_tx: IOMUXC1_PDM_CLK_CAN_TX_CAN1_TX {
		pinmux = <0x443c0190 6 0x0 0 0x443c0340>;
	};
	/omit-if-no-ref/ iomuxc1_pdm_clk_gpio_io_gpio1_io08: IOMUXC1_PDM_CLK_GPIO_IO_GPIO1_IO08 {
		pinmux = <0x443c0190 5 0x0 0 0x443c0340>;
	};
	/omit-if-no-ref/ iomuxc1_pdm_clk_lptmr_alt_lptmr1_alt1: IOMUXC1_PDM_CLK_LPTMR_ALT_LPTMR1_ALT1 {
		pinmux = <0x443c0190 4 0x0 0 0x443c0340>;
	};
	/omit-if-no-ref/ iomuxc1_pdm_clk_mqs_left_mqs1_left: IOMUXC1_PDM_CLK_MQS_LEFT_MQS1_LEFT {
		pinmux = <0x443c0190 1 0x0 0 0x443c0340>;
	};
	/omit-if-no-ref/ iomuxc1_pdm_clk_pdm_clk_pdm_clk: IOMUXC1_PDM_CLK_PDM_CLK_PDM_CLK {
		pinmux = <0x443c0190 0 0x0 0 0x443c0340>;
	};
	/omit-if-no-ref/ iomuxc1_sai1_rxd0_gpio_io_gpio1_io14: IOMUXC1_SAI1_RXD0_GPIO_IO_GPIO1_IO14 {
		pinmux = <0x443c01a8 5 0x0 0 0x443c0358>;
	};
	/omit-if-no-ref/ iomuxc1_sai1_rxd0_lpspi_sout_lpspi1_sout: IOMUXC1_SAI1_RXD0_LPSPI_SOUT_LPSPI1_SOUT {
		pinmux = <0x443c01a8 2 0x0 0 0x443c0358>;
	};
	/omit-if-no-ref/ iomuxc1_sai1_rxd0_lpuart_dsr_b_lpuart2_dsr_b: IOMUXC1_SAI1_RXD0_LPUART_DSR_B_LPUART2_DSR_B {
		pinmux = <0x443c01a8 3 0x0 0 0x443c0358>;
	};
	/omit-if-no-ref/ iomuxc1_sai1_rxd0_mqs_right_mqs1_right: IOMUXC1_SAI1_RXD0_MQS_RIGHT_MQS1_RIGHT {
		pinmux = <0x443c01a8 4 0x0 0 0x443c0358>;
	};
	/omit-if-no-ref/ iomuxc1_sai1_rxd0_sai_mclk_sai1_mclk: IOMUXC1_SAI1_RXD0_SAI_MCLK_SAI1_MCLK {
		pinmux = <0x443c01a8 1 0x443c0448 1 0x443c0358>;
	};
	/omit-if-no-ref/ iomuxc1_sai1_rxd0_sai_rx_data_sai1_rx_data00: IOMUXC1_SAI1_RXD0_SAI_RX_DATA_SAI1_RX_DATA00 {
		pinmux = <0x443c01a8 0 0x0 0 0x443c0358>;
	};
	/omit-if-no-ref/ iomuxc1_sai1_txc_can_rx_can1_rx: IOMUXC1_SAI1_TXC_CAN_RX_CAN1_RX {
		pinmux = <0x443c01a0 4 0x443c0360 1 0x443c0350>;
	};
	/omit-if-no-ref/ iomuxc1_sai1_txc_gpio_io_gpio1_io12: IOMUXC1_SAI1_TXC_GPIO_IO_GPIO1_IO12 {
		pinmux = <0x443c01a0 5 0x0 0 0x443c0350>;
	};
	/omit-if-no-ref/ iomuxc1_sai1_txc_lpspi_sin_lpspi1_sin: IOMUXC1_SAI1_TXC_LPSPI_SIN_LPSPI1_SIN {
		pinmux = <0x443c01a0 2 0x0 0 0x443c0350>;
	};
	/omit-if-no-ref/ iomuxc1_sai1_txc_lpuart_cts_b_lpuart2_cts_b: IOMUXC1_SAI1_TXC_LPUART_CTS_B_LPUART2_CTS_B {
		pinmux = <0x443c01a0 1 0x0 0 0x443c0350>;
	};
	/omit-if-no-ref/ iomuxc1_sai1_txc_lpuart_dsr_b_lpuart1_dsr_b: IOMUXC1_SAI1_TXC_LPUART_DSR_B_LPUART1_DSR_B {
		pinmux = <0x443c01a0 3 0x0 0 0x443c0350>;
	};
	/omit-if-no-ref/ iomuxc1_sai1_txc_sai_tx_bclk_sai1_tx_bclk: IOMUXC1_SAI1_TXC_SAI_TX_BCLK_SAI1_TX_BCLK {
		pinmux = <0x443c01a0 0 0x0 0 0x443c0350>;
	};
	/omit-if-no-ref/ iomuxc1_sai1_txd0_can_tx_can1_tx: IOMUXC1_SAI1_TXD0_CAN_TX_CAN1_TX {
		pinmux = <0x443c01a4 4 0x0 0 0x443c0354>;
	};
	/omit-if-no-ref/ iomuxc1_sai1_txd0_gpio_io_gpio1_io13: IOMUXC1_SAI1_TXD0_GPIO_IO_GPIO1_IO13 {
		pinmux = <0x443c01a4 5 0x0 0 0x443c0354>;
	};
	/omit-if-no-ref/ iomuxc1_sai1_txd0_lpspi_sck_lpspi1_sck: IOMUXC1_SAI1_TXD0_LPSPI_SCK_LPSPI1_SCK {
		pinmux = <0x443c01a4 2 0x0 0 0x443c0354>;
	};
	/omit-if-no-ref/ iomuxc1_sai1_txd0_lpuart_dtr_b_lpuart1_dtr_b: IOMUXC1_SAI1_TXD0_LPUART_DTR_B_LPUART1_DTR_B {
		pinmux = <0x443c01a4 3 0x0 0 0x443c0354>;
	};
	/omit-if-no-ref/ iomuxc1_sai1_txd0_lpuart_rts_b_lpuart2_rts_b: IOMUXC1_SAI1_TXD0_LPUART_RTS_B_LPUART2_RTS_B {
		pinmux = <0x443c01a4 1 0x0 0 0x443c0354>;
	};
	/omit-if-no-ref/ iomuxc1_sai1_txd0_sai_tx_data_sai1_tx_data00: IOMUXC1_SAI1_TXD0_SAI_TX_DATA_SAI1_TX_DATA00 {
		pinmux = <0x443c01a4 0 0x0 0 0x443c0354>;
	};
	/omit-if-no-ref/ iomuxc1_sai1_txfs_gpio_io_gpio1_io11: IOMUXC1_SAI1_TXFS_GPIO_IO_GPIO1_IO11 {
		pinmux = <0x443c019c 5 0x0 0 0x443c034c>;
	};
	/omit-if-no-ref/ iomuxc1_sai1_txfs_lpspi_pcs_lpspi1_pcs0: IOMUXC1_SAI1_TXFS_LPSPI_PCS_LPSPI1_PCS0 {
		pinmux = <0x443c019c 2 0x0 0 0x443c034c>;
	};
	/omit-if-no-ref/ iomuxc1_sai1_txfs_lpuart_dtr_b_lpuart2_dtr_b: IOMUXC1_SAI1_TXFS_LPUART_DTR_B_LPUART2_DTR_B {
		pinmux = <0x443c019c 3 0x0 0 0x443c034c>;
	};
	/omit-if-no-ref/ iomuxc1_sai1_txfs_mqs_left_mqs1_left: IOMUXC1_SAI1_TXFS_MQS_LEFT_MQS1_LEFT {
		pinmux = <0x443c019c 4 0x0 0 0x443c034c>;
	};
	/omit-if-no-ref/ iomuxc1_sai1_txfs_sai_tx_data_sai1_tx_data01: IOMUXC1_SAI1_TXFS_SAI_TX_DATA_SAI1_TX_DATA01 {
		pinmux = <0x443c019c 1 0x0 0 0x443c034c>;
	};
	/omit-if-no-ref/ iomuxc1_sai1_txfs_sai_tx_sync_sai1_tx_sync: IOMUXC1_SAI1_TXFS_SAI_TX_SYNC_SAI1_TX_SYNC {
		pinmux = <0x443c019c 0 0x0 0 0x443c034c>;
	};
	/omit-if-no-ref/ iomuxc1_sd1_clk_flexio_flexio_flexio1_flexio08: IOMUXC1_SD1_CLK_FLEXIO_FLEXIO_FLEXIO1_FLEXIO08 {
		pinmux = <0x443c0108 4 0x443c038c 1 0x443c02b8>;
	};
	/omit-if-no-ref/ iomuxc1_sd1_clk_gpio_io_gpio3_io08: IOMUXC1_SD1_CLK_GPIO_IO_GPIO3_IO08 {
		pinmux = <0x443c0108 5 0x0 0 0x443c02b8>;
	};
	/omit-if-no-ref/ iomuxc1_sd1_clk_usdhc_clk_usdhc1_clk: IOMUXC1_SD1_CLK_USDHC_CLK_USDHC1_CLK {
		pinmux = <0x443c0108 0 0x0 0 0x443c02b8>;
	};
	/omit-if-no-ref/ iomuxc1_sd1_cmd_flexio_flexio_flexio1_flexio09: IOMUXC1_SD1_CMD_FLEXIO_FLEXIO_FLEXIO1_FLEXIO09 {
		pinmux = <0x443c010c 4 0x443c0390 1 0x443c02bc>;
	};
	/omit-if-no-ref/ iomuxc1_sd1_cmd_gpio_io_gpio3_io09: IOMUXC1_SD1_CMD_GPIO_IO_GPIO3_IO09 {
		pinmux = <0x443c010c 5 0x0 0 0x443c02bc>;
	};
	/omit-if-no-ref/ iomuxc1_sd1_cmd_usdhc_cmd_usdhc1_cmd: IOMUXC1_SD1_CMD_USDHC_CMD_USDHC1_CMD {
		pinmux = <0x443c010c 0 0x0 0 0x443c02bc>;
	};
	/omit-if-no-ref/ iomuxc1_sd1_data0_flexio_flexio_flexio1_flexio10: IOMUXC1_SD1_DATA0_FLEXIO_FLEXIO_FLEXIO1_FLEXIO10 {
		pinmux = <0x443c0110 4 0x443c0394 1 0x443c02c0>;
	};
	/omit-if-no-ref/ iomuxc1_sd1_data0_gpio_io_gpio3_io10: IOMUXC1_SD1_DATA0_GPIO_IO_GPIO3_IO10 {
		pinmux = <0x443c0110 5 0x0 0 0x443c02c0>;
	};
	/omit-if-no-ref/ iomuxc1_sd1_data0_usdhc_data_usdhc1_data0: IOMUXC1_SD1_DATA0_USDHC_DATA_USDHC1_DATA0 {
		pinmux = <0x443c0110 0 0x0 0 0x443c02c0>;
	};
	/omit-if-no-ref/ iomuxc1_sd1_data1_ccmsrcgpcmix_int_boot_ccmsrcgpcmix_int_boot: IOMUXC1_SD1_DATA1_CCMSRCGPCMIX_INT_BOOT_CCMSRCGPCMIX_INT_BOOT {
		pinmux = <0x443c0114 6 0x0 0 0x443c02c4>;
	};
	/omit-if-no-ref/ iomuxc1_sd1_data1_flexio_flexio_flexio1_flexio11: IOMUXC1_SD1_DATA1_FLEXIO_FLEXIO_FLEXIO1_FLEXIO11 {
		pinmux = <0x443c0114 4 0x443c0398 1 0x443c02c4>;
	};
	/omit-if-no-ref/ iomuxc1_sd1_data1_gpio_io_gpio3_io11: IOMUXC1_SD1_DATA1_GPIO_IO_GPIO3_IO11 {
		pinmux = <0x443c0114 5 0x0 0 0x443c02c4>;
	};
	/omit-if-no-ref/ iomuxc1_sd1_data1_usdhc_data_usdhc1_data1: IOMUXC1_SD1_DATA1_USDHC_DATA_USDHC1_DATA1 {
		pinmux = <0x443c0114 0 0x0 0 0x443c02c4>;
	};
	/omit-if-no-ref/ iomuxc1_sd1_data2_ccmsrcgpcmix_pmic_ready_ccmsrcgpcmix_pmic_ready: IOMUXC1_SD1_DATA2_CCMSRCGPCMIX_PMIC_READY_CCMSRCGPCMIX_PMIC_READY {
		pinmux = <0x443c0118 6 0x0 0 0x443c02c8>;
	};
	/omit-if-no-ref/ iomuxc1_sd1_data2_flexio_flexio_flexio1_flexio12: IOMUXC1_SD1_DATA2_FLEXIO_FLEXIO_FLEXIO1_FLEXIO12 {
		pinmux = <0x443c0118 4 0x0 0 0x443c02c8>;
	};
	/omit-if-no-ref/ iomuxc1_sd1_data2_gpio_io_gpio3_io12: IOMUXC1_SD1_DATA2_GPIO_IO_GPIO3_IO12 {
		pinmux = <0x443c0118 5 0x0 0 0x443c02c8>;
	};
	/omit-if-no-ref/ iomuxc1_sd1_data2_usdhc_data_usdhc1_data2: IOMUXC1_SD1_DATA2_USDHC_DATA_USDHC1_DATA2 {
		pinmux = <0x443c0118 0 0x0 0 0x443c02c8>;
	};
	/omit-if-no-ref/ iomuxc1_sd1_data3_flexio_flexio_flexio1_flexio13: IOMUXC1_SD1_DATA3_FLEXIO_FLEXIO_FLEXIO1_FLEXIO13 {
		pinmux = <0x443c011c 4 0x443c039c 1 0x443c02cc>;
	};
	/omit-if-no-ref/ iomuxc1_sd1_data3_flexspi_a_ss_b_flexspi1_a_ss1_b: IOMUXC1_SD1_DATA3_FLEXSPI_A_SS_B_FLEXSPI1_A_SS1_B {
		pinmux = <0x443c011c 1 0x0 0 0x443c02cc>;
	};
	/omit-if-no-ref/ iomuxc1_sd1_data3_gpio_io_gpio3_io13: IOMUXC1_SD1_DATA3_GPIO_IO_GPIO3_IO13 {
		pinmux = <0x443c011c 5 0x0 0 0x443c02cc>;
	};
	/omit-if-no-ref/ iomuxc1_sd1_data3_usdhc_data_usdhc1_data3: IOMUXC1_SD1_DATA3_USDHC_DATA_USDHC1_DATA3 {
		pinmux = <0x443c011c 0 0x0 0 0x443c02cc>;
	};
	/omit-if-no-ref/ iomuxc1_sd1_data4_flexio_flexio_flexio1_flexio14: IOMUXC1_SD1_DATA4_FLEXIO_FLEXIO_FLEXIO1_FLEXIO14 {
		pinmux = <0x443c0120 4 0x443c03a0 1 0x443c02d0>;
	};
	/omit-if-no-ref/ iomuxc1_sd1_data4_flexspi_a_data_flexspi1_a_data04: IOMUXC1_SD1_DATA4_FLEXSPI_A_DATA_FLEXSPI1_A_DATA04 {
		pinmux = <0x443c0120 1 0x0 0 0x443c02d0>;
	};
	/omit-if-no-ref/ iomuxc1_sd1_data4_gpio_io_gpio3_io14: IOMUXC1_SD1_DATA4_GPIO_IO_GPIO3_IO14 {
		pinmux = <0x443c0120 5 0x0 0 0x443c02d0>;
	};
	/omit-if-no-ref/ iomuxc1_sd1_data4_usdhc_data_usdhc1_data4: IOMUXC1_SD1_DATA4_USDHC_DATA_USDHC1_DATA4 {
		pinmux = <0x443c0120 0 0x0 0 0x443c02d0>;
	};
	/omit-if-no-ref/ iomuxc1_sd1_data5_flexio_flexio_flexio1_flexio15: IOMUXC1_SD1_DATA5_FLEXIO_FLEXIO_FLEXIO1_FLEXIO15 {
		pinmux = <0x443c0124 4 0x443c03a4 1 0x443c02d4>;
	};
	/omit-if-no-ref/ iomuxc1_sd1_data5_flexspi_a_data_flexspi1_a_data05: IOMUXC1_SD1_DATA5_FLEXSPI_A_DATA_FLEXSPI1_A_DATA05 {
		pinmux = <0x443c0124 1 0x0 0 0x443c02d4>;
	};
	/omit-if-no-ref/ iomuxc1_sd1_data5_gpio_io_gpio3_io15: IOMUXC1_SD1_DATA5_GPIO_IO_GPIO3_IO15 {
		pinmux = <0x443c0124 5 0x0 0 0x443c02d4>;
	};
	/omit-if-no-ref/ iomuxc1_sd1_data5_usdhc_data_usdhc1_data5: IOMUXC1_SD1_DATA5_USDHC_DATA_USDHC1_DATA5 {
		pinmux = <0x443c0124 0 0x0 0 0x443c02d4>;
	};
	/omit-if-no-ref/ iomuxc1_sd1_data5_usdhc_reset_b_usdhc1_reset_b: IOMUXC1_SD1_DATA5_USDHC_RESET_B_USDHC1_RESET_B {
		pinmux = <0x443c0124 2 0x0 0 0x443c02d4>;
	};
	/omit-if-no-ref/ iomuxc1_sd1_data6_flexio_flexio_flexio1_flexio16: IOMUXC1_SD1_DATA6_FLEXIO_FLEXIO_FLEXIO1_FLEXIO16 {
		pinmux = <0x443c0128 4 0x443c03a8 1 0x443c02d8>;
	};
	/omit-if-no-ref/ iomuxc1_sd1_data6_flexspi_a_data_flexspi1_a_data06: IOMUXC1_SD1_DATA6_FLEXSPI_A_DATA_FLEXSPI1_A_DATA06 {
		pinmux = <0x443c0128 1 0x0 0 0x443c02d8>;
	};
	/omit-if-no-ref/ iomuxc1_sd1_data6_gpio_io_gpio3_io16: IOMUXC1_SD1_DATA6_GPIO_IO_GPIO3_IO16 {
		pinmux = <0x443c0128 5 0x0 0 0x443c02d8>;
	};
	/omit-if-no-ref/ iomuxc1_sd1_data6_usdhc_cd_b_usdhc1_cd_b: IOMUXC1_SD1_DATA6_USDHC_CD_B_USDHC1_CD_B {
		pinmux = <0x443c0128 2 0x0 0 0x443c02d8>;
	};
	/omit-if-no-ref/ iomuxc1_sd1_data6_usdhc_data_usdhc1_data6: IOMUXC1_SD1_DATA6_USDHC_DATA_USDHC1_DATA6 {
		pinmux = <0x443c0128 0 0x0 0 0x443c02d8>;
	};
	/omit-if-no-ref/ iomuxc1_sd1_data7_flexio_flexio_flexio1_flexio17: IOMUXC1_SD1_DATA7_FLEXIO_FLEXIO_FLEXIO1_FLEXIO17 {
		pinmux = <0x443c012c 4 0x443c03ac 1 0x443c02dc>;
	};
	/omit-if-no-ref/ iomuxc1_sd1_data7_flexspi_a_data_flexspi1_a_data07: IOMUXC1_SD1_DATA7_FLEXSPI_A_DATA_FLEXSPI1_A_DATA07 {
		pinmux = <0x443c012c 1 0x0 0 0x443c02dc>;
	};
	/omit-if-no-ref/ iomuxc1_sd1_data7_gpio_io_gpio3_io17: IOMUXC1_SD1_DATA7_GPIO_IO_GPIO3_IO17 {
		pinmux = <0x443c012c 5 0x0 0 0x443c02dc>;
	};
	/omit-if-no-ref/ iomuxc1_sd1_data7_usdhc_data_usdhc1_data7: IOMUXC1_SD1_DATA7_USDHC_DATA_USDHC1_DATA7 {
		pinmux = <0x443c012c 0 0x0 0 0x443c02dc>;
	};
	/omit-if-no-ref/ iomuxc1_sd1_data7_usdhc_wp_usdhc1_wp: IOMUXC1_SD1_DATA7_USDHC_WP_USDHC1_WP {
		pinmux = <0x443c012c 2 0x0 0 0x443c02dc>;
	};
	/omit-if-no-ref/ iomuxc1_sd1_strobe_flexio_flexio_flexio1_flexio18: IOMUXC1_SD1_STROBE_FLEXIO_FLEXIO_FLEXIO1_FLEXIO18 {
		pinmux = <0x443c0130 4 0x443c03b0 1 0x443c02e0>;
	};
	/omit-if-no-ref/ iomuxc1_sd1_strobe_flexspi_a_dqs_flexspi1_a_dqs: IOMUXC1_SD1_STROBE_FLEXSPI_A_DQS_FLEXSPI1_A_DQS {
		pinmux = <0x443c0130 1 0x0 0 0x443c02e0>;
	};
	/omit-if-no-ref/ iomuxc1_sd1_strobe_gpio_io_gpio3_io18: IOMUXC1_SD1_STROBE_GPIO_IO_GPIO3_IO18 {
		pinmux = <0x443c0130 5 0x0 0 0x443c02e0>;
	};
	/omit-if-no-ref/ iomuxc1_sd1_strobe_usdhc_strobe_usdhc1_strobe: IOMUXC1_SD1_STROBE_USDHC_STROBE_USDHC1_STROBE {
		pinmux = <0x443c0130 0 0x0 0 0x443c02e0>;
	};
	/omit-if-no-ref/ iomuxc1_sd2_cd_b_enet_qos_1588_event0_in_enet_qos_1588_event0_in: IOMUXC1_SD2_CD_B_ENET_QOS_1588_EVENT0_IN_ENET_QOS_1588_EVENT0_IN {
		pinmux = <0x443c0150 1 0x0 0 0x443c0300>;
	};
	/omit-if-no-ref/ iomuxc1_sd2_cd_b_flexio_flexio_flexio1_flexio00: IOMUXC1_SD2_CD_B_FLEXIO_FLEXIO_FLEXIO1_FLEXIO00 {
		pinmux = <0x443c0150 4 0x443c036c 1 0x443c0300>;
	};
	/omit-if-no-ref/ iomuxc1_sd2_cd_b_gpio_io_gpio3_io00: IOMUXC1_SD2_CD_B_GPIO_IO_GPIO3_IO00 {
		pinmux = <0x443c0150 5 0x0 0 0x443c0300>;
	};
	/omit-if-no-ref/ iomuxc1_sd2_cd_b_i3c_scl_i3c2_scl: IOMUXC1_SD2_CD_B_I3C_SCL_I3C2_SCL {
		pinmux = <0x443c0150 2 0x443c03cc 1 0x443c0300>;
	};
	/omit-if-no-ref/ iomuxc1_sd2_cd_b_usdhc_cd_b_usdhc2_cd_b: IOMUXC1_SD2_CD_B_USDHC_CD_B_USDHC2_CD_B {
		pinmux = <0x443c0150 0 0x0 0 0x443c0300>;
	};
	/omit-if-no-ref/ iomuxc1_sd2_clk_ccmsrcgpcmix_observe_ccmsrcgpcmix_observe0: IOMUXC1_SD2_CLK_CCMSRCGPCMIX_OBSERVE_CCMSRCGPCMIX_OBSERVE0 {
		pinmux = <0x443c0154 6 0x0 0 0x443c0304>;
	};
	/omit-if-no-ref/ iomuxc1_sd2_clk_enet_qos_1588_event0_out_enet_qos_1588_event0_out: IOMUXC1_SD2_CLK_ENET_QOS_1588_EVENT0_OUT_ENET_QOS_1588_EVENT0_OUT {
		pinmux = <0x443c0154 1 0x0 0 0x443c0304>;
	};
	/omit-if-no-ref/ iomuxc1_sd2_clk_flexio_flexio_flexio1_flexio01: IOMUXC1_SD2_CLK_FLEXIO_FLEXIO_FLEXIO1_FLEXIO01 {
		pinmux = <0x443c0154 4 0x443c0370 1 0x443c0304>;
	};
	/omit-if-no-ref/ iomuxc1_sd2_clk_gpio_io_gpio3_io01: IOMUXC1_SD2_CLK_GPIO_IO_GPIO3_IO01 {
		pinmux = <0x443c0154 5 0x0 0 0x443c0304>;
	};
	/omit-if-no-ref/ iomuxc1_sd2_clk_i3c_sda_i3c2_sda: IOMUXC1_SD2_CLK_I3C_SDA_I3C2_SDA {
		pinmux = <0x443c0154 2 0x443c03d0 1 0x443c0304>;
	};
	/omit-if-no-ref/ iomuxc1_sd2_clk_usdhc_clk_usdhc2_clk: IOMUXC1_SD2_CLK_USDHC_CLK_USDHC2_CLK {
		pinmux = <0x443c0154 0 0x0 0 0x443c0304>;
	};
	/omit-if-no-ref/ iomuxc1_sd2_cmd_ccmsrcgpcmix_observe_ccmsrcgpcmix_observe1: IOMUXC1_SD2_CMD_CCMSRCGPCMIX_OBSERVE_CCMSRCGPCMIX_OBSERVE1 {
		pinmux = <0x443c0158 6 0x0 0 0x443c0308>;
	};
	/omit-if-no-ref/ iomuxc1_sd2_cmd_enet1_1588_event0_in_enet1_1588_event0_in: IOMUXC1_SD2_CMD_ENET1_1588_EVENT0_IN_ENET1_1588_EVENT0_IN {
		pinmux = <0x443c0158 1 0x0 0 0x443c0308>;
	};
	/omit-if-no-ref/ iomuxc1_sd2_cmd_flexio_flexio_flexio1_flexio02: IOMUXC1_SD2_CMD_FLEXIO_FLEXIO_FLEXIO1_FLEXIO02 {
		pinmux = <0x443c0158 4 0x443c0374 1 0x443c0308>;
	};
	/omit-if-no-ref/ iomuxc1_sd2_cmd_gpio_io_gpio3_io02: IOMUXC1_SD2_CMD_GPIO_IO_GPIO3_IO02 {
		pinmux = <0x443c0158 5 0x0 0 0x443c0308>;
	};
	/omit-if-no-ref/ iomuxc1_sd2_cmd_i3c_pur_b_i3c2_pur_b: IOMUXC1_SD2_CMD_I3C_PUR_B_I3C2_PUR_B {
		pinmux = <0x443c0158 3 0x0 0 0x443c0308>;
	};
	/omit-if-no-ref/ iomuxc1_sd2_cmd_i3c_pur_i3c2_pur: IOMUXC1_SD2_CMD_I3C_PUR_I3C2_PUR {
		pinmux = <0x443c0158 2 0x0 0 0x443c0308>;
	};
	/omit-if-no-ref/ iomuxc1_sd2_cmd_usdhc_cmd_usdhc2_cmd: IOMUXC1_SD2_CMD_USDHC_CMD_USDHC2_CMD {
		pinmux = <0x443c0158 0 0x0 0 0x443c0308>;
	};
	/omit-if-no-ref/ iomuxc1_sd2_data0_can_tx_can2_tx: IOMUXC1_SD2_DATA0_CAN_TX_CAN2_TX {
		pinmux = <0x443c015c 2 0x0 0 0x443c030c>;
	};
	/omit-if-no-ref/ iomuxc1_sd2_data0_ccmsrcgpcmix_observe_ccmsrcgpcmix_observe2: IOMUXC1_SD2_DATA0_CCMSRCGPCMIX_OBSERVE_CCMSRCGPCMIX_OBSERVE2 {
		pinmux = <0x443c015c 6 0x0 0 0x443c030c>;
	};
	/omit-if-no-ref/ iomuxc1_sd2_data0_enet1_1588_event0_out_enet1_1588_event0_out: IOMUXC1_SD2_DATA0_ENET1_1588_EVENT0_OUT_ENET1_1588_EVENT0_OUT {
		pinmux = <0x443c015c 1 0x0 0 0x443c030c>;
	};
	/omit-if-no-ref/ iomuxc1_sd2_data0_flexio_flexio_flexio1_flexio03: IOMUXC1_SD2_DATA0_FLEXIO_FLEXIO_FLEXIO1_FLEXIO03 {
		pinmux = <0x443c015c 4 0x443c0378 1 0x443c030c>;
	};
	/omit-if-no-ref/ iomuxc1_sd2_data0_gpio_io_gpio3_io03: IOMUXC1_SD2_DATA0_GPIO_IO_GPIO3_IO03 {
		pinmux = <0x443c015c 5 0x0 0 0x443c030c>;
	};
	/omit-if-no-ref/ iomuxc1_sd2_data0_usdhc_data_usdhc2_data0: IOMUXC1_SD2_DATA0_USDHC_DATA_USDHC2_DATA0 {
		pinmux = <0x443c015c 0 0x0 0 0x443c030c>;
	};
	/omit-if-no-ref/ iomuxc1_sd2_data1_can_rx_can2_rx: IOMUXC1_SD2_DATA1_CAN_RX_CAN2_RX {
		pinmux = <0x443c0160 2 0x443c0364 3 0x443c0310>;
	};
	/omit-if-no-ref/ iomuxc1_sd2_data1_ccmsrcgpcmix_wait_ccmsrcgpcmix_wait: IOMUXC1_SD2_DATA1_CCMSRCGPCMIX_WAIT_CCMSRCGPCMIX_WAIT {
		pinmux = <0x443c0160 6 0x0 0 0x443c0310>;
	};
	/omit-if-no-ref/ iomuxc1_sd2_data1_enet1_1588_event1_in_enet1_1588_event1_in: IOMUXC1_SD2_DATA1_ENET1_1588_EVENT1_IN_ENET1_1588_EVENT1_IN {
		pinmux = <0x443c0160 1 0x0 0 0x443c0310>;
	};
	/omit-if-no-ref/ iomuxc1_sd2_data1_flexio_flexio_flexio1_flexio04: IOMUXC1_SD2_DATA1_FLEXIO_FLEXIO_FLEXIO1_FLEXIO04 {
		pinmux = <0x443c0160 4 0x443c037c 1 0x443c0310>;
	};
	/omit-if-no-ref/ iomuxc1_sd2_data1_gpio_io_gpio3_io04: IOMUXC1_SD2_DATA1_GPIO_IO_GPIO3_IO04 {
		pinmux = <0x443c0160 5 0x0 0 0x443c0310>;
	};
	/omit-if-no-ref/ iomuxc1_sd2_data1_usdhc_data_usdhc2_data1: IOMUXC1_SD2_DATA1_USDHC_DATA_USDHC2_DATA1 {
		pinmux = <0x443c0160 0 0x0 0 0x443c0310>;
	};
	/omit-if-no-ref/ iomuxc1_sd2_data2_ccmsrcgpcmix_stop_ccmsrcgpcmix_stop: IOMUXC1_SD2_DATA2_CCMSRCGPCMIX_STOP_CCMSRCGPCMIX_STOP {
		pinmux = <0x443c0164 6 0x0 0 0x443c0314>;
	};
	/omit-if-no-ref/ iomuxc1_sd2_data2_enet1_1588_event1_out_enet1_1588_event1_out: IOMUXC1_SD2_DATA2_ENET1_1588_EVENT1_OUT_ENET1_1588_EVENT1_OUT {
		pinmux = <0x443c0164 1 0x0 0 0x443c0314>;
	};
	/omit-if-no-ref/ iomuxc1_sd2_data2_flexio_flexio_flexio1_flexio05: IOMUXC1_SD2_DATA2_FLEXIO_FLEXIO_FLEXIO1_FLEXIO05 {
		pinmux = <0x443c0164 4 0x443c0380 1 0x443c0314>;
	};
	/omit-if-no-ref/ iomuxc1_sd2_data2_gpio_io_gpio3_io05: IOMUXC1_SD2_DATA2_GPIO_IO_GPIO3_IO05 {
		pinmux = <0x443c0164 5 0x0 0 0x443c0314>;
	};
	/omit-if-no-ref/ iomuxc1_sd2_data2_mqs_right_mqs2_right: IOMUXC1_SD2_DATA2_MQS_RIGHT_MQS2_RIGHT {
		pinmux = <0x443c0164 2 0x0 0 0x443c0314>;
	};
	/omit-if-no-ref/ iomuxc1_sd2_data2_usdhc_data_usdhc2_data2: IOMUXC1_SD2_DATA2_USDHC_DATA_USDHC2_DATA2 {
		pinmux = <0x443c0164 0 0x0 0 0x443c0314>;
	};
	/omit-if-no-ref/ iomuxc1_sd2_data3_ccmsrcgpcmix_early_reset_ccmsrcgpcmix_early_reset: IOMUXC1_SD2_DATA3_CCMSRCGPCMIX_EARLY_RESET_CCMSRCGPCMIX_EARLY_RESET {
		pinmux = <0x443c0168 6 0x0 0 0x443c0318>;
	};
	/omit-if-no-ref/ iomuxc1_sd2_data3_flexio_flexio_flexio1_flexio06: IOMUXC1_SD2_DATA3_FLEXIO_FLEXIO_FLEXIO1_FLEXIO06 {
		pinmux = <0x443c0168 4 0x443c0384 1 0x443c0318>;
	};
	/omit-if-no-ref/ iomuxc1_sd2_data3_gpio_io_gpio3_io06: IOMUXC1_SD2_DATA3_GPIO_IO_GPIO3_IO06 {
		pinmux = <0x443c0168 5 0x0 0 0x443c0318>;
	};
	/omit-if-no-ref/ iomuxc1_sd2_data3_lptmr_alt_lptmr2_alt1: IOMUXC1_SD2_DATA3_LPTMR_ALT_LPTMR2_ALT1 {
		pinmux = <0x443c0168 1 0x443c0408 1 0x443c0318>;
	};
	/omit-if-no-ref/ iomuxc1_sd2_data3_mqs_left_mqs2_left: IOMUXC1_SD2_DATA3_MQS_LEFT_MQS2_LEFT {
		pinmux = <0x443c0168 2 0x0 0 0x443c0318>;
	};
	/omit-if-no-ref/ iomuxc1_sd2_data3_usdhc_data_usdhc2_data3: IOMUXC1_SD2_DATA3_USDHC_DATA_USDHC2_DATA3 {
		pinmux = <0x443c0168 0 0x0 0 0x443c0318>;
	};
	/omit-if-no-ref/ iomuxc1_sd2_reset_b_ccmsrcgpcmix_system_reset_ccmsrcgpcmix_system_reset: IOMUXC1_SD2_RESET_B_CCMSRCGPCMIX_SYSTEM_RESET_CCMSRCGPCMIX_SYSTEM_RESET {
		pinmux = <0x443c016c 6 0x0 0 0x443c031c>;
	};
	/omit-if-no-ref/ iomuxc1_sd2_reset_b_flexio_flexio_flexio1_flexio07: IOMUXC1_SD2_RESET_B_FLEXIO_FLEXIO_FLEXIO1_FLEXIO07 {
		pinmux = <0x443c016c 4 0x443c0388 1 0x443c031c>;
	};
	/omit-if-no-ref/ iomuxc1_sd2_reset_b_gpio_io_gpio3_io07: IOMUXC1_SD2_RESET_B_GPIO_IO_GPIO3_IO07 {
		pinmux = <0x443c016c 5 0x0 0 0x443c031c>;
	};
	/omit-if-no-ref/ iomuxc1_sd2_reset_b_lptmr_alt_lptmr2_alt2: IOMUXC1_SD2_RESET_B_LPTMR_ALT_LPTMR2_ALT2 {
		pinmux = <0x443c016c 1 0x443c040c 1 0x443c031c>;
	};
	/omit-if-no-ref/ iomuxc1_sd2_reset_b_usdhc_reset_b_usdhc2_reset_b: IOMUXC1_SD2_RESET_B_USDHC_RESET_B_USDHC2_RESET_B {
		pinmux = <0x443c016c 0 0x0 0 0x443c031c>;
	};
	/omit-if-no-ref/ iomuxc1_sd2_vselect_ccmsrcgpcmix_ext_clk_ccmsrcgpcmix_ext_clk1: IOMUXC1_SD2_VSELECT_CCMSRCGPCMIX_EXT_CLK_CCMSRCGPCMIX_EXT_CLK1 {
		pinmux = <0x443c0134 6 0x443c0368 0 0x443c02e4>;
	};
	/omit-if-no-ref/ iomuxc1_sd2_vselect_flexio_flexio_flexio1_flexio19: IOMUXC1_SD2_VSELECT_FLEXIO_FLEXIO_FLEXIO1_FLEXIO19 {
		pinmux = <0x443c0134 4 0x0 0 0x443c02e4>;
	};
	/omit-if-no-ref/ iomuxc1_sd2_vselect_gpio_io_gpio3_io19: IOMUXC1_SD2_VSELECT_GPIO_IO_GPIO3_IO19 {
		pinmux = <0x443c0134 5 0x0 0 0x443c02e4>;
	};
	/omit-if-no-ref/ iomuxc1_sd2_vselect_lptmr_alt_lptmr2_alt3: IOMUXC1_SD2_VSELECT_LPTMR_ALT_LPTMR2_ALT3 {
		pinmux = <0x443c0134 2 0x443c0410 1 0x443c02e4>;
	};
	/omit-if-no-ref/ iomuxc1_sd2_vselect_usdhc_vselect_usdhc2_vselect: IOMUXC1_SD2_VSELECT_USDHC_VSELECT_USDHC2_VSELECT {
		pinmux = <0x443c0134 0 0x0 0 0x443c02e4>;
	};
	/omit-if-no-ref/ iomuxc1_sd2_vselect_usdhc_wp_usdhc2_wp: IOMUXC1_SD2_VSELECT_USDHC_WP_USDHC2_WP {
		pinmux = <0x443c0134 1 0x0 0 0x443c02e4>;
	};
	/omit-if-no-ref/ iomuxc1_sd3_clk_flexio_flexio_flexio1_flexio20: IOMUXC1_SD3_CLK_FLEXIO_FLEXIO_FLEXIO1_FLEXIO20 {
		pinmux = <0x443c0138 4 0x443c03b4 1 0x443c02e8>;
	};
	/omit-if-no-ref/ iomuxc1_sd3_clk_flexspi_a_sclk_flexspi1_a_sclk: IOMUXC1_SD3_CLK_FLEXSPI_A_SCLK_FLEXSPI1_A_SCLK {
		pinmux = <0x443c0138 1 0x0 0 0x443c02e8>;
	};
	/omit-if-no-ref/ iomuxc1_sd3_clk_gpio_io_gpio3_io20: IOMUXC1_SD3_CLK_GPIO_IO_GPIO3_IO20 {
		pinmux = <0x443c0138 5 0x0 0 0x443c02e8>;
	};
	/omit-if-no-ref/ iomuxc1_sd3_clk_usdhc_clk_usdhc3_clk: IOMUXC1_SD3_CLK_USDHC_CLK_USDHC3_CLK {
		pinmux = <0x443c0138 0 0x443c0458 1 0x443c02e8>;
	};
	/omit-if-no-ref/ iomuxc1_sd3_cmd_flexio_flexio_flexio1_flexio21: IOMUXC1_SD3_CMD_FLEXIO_FLEXIO_FLEXIO1_FLEXIO21 {
		pinmux = <0x443c013c 4 0x0 0 0x443c02ec>;
	};
	/omit-if-no-ref/ iomuxc1_sd3_cmd_flexspi_a_ss_b_flexspi1_a_ss0_b: IOMUXC1_SD3_CMD_FLEXSPI_A_SS_B_FLEXSPI1_A_SS0_B {
		pinmux = <0x443c013c 1 0x0 0 0x443c02ec>;
	};
	/omit-if-no-ref/ iomuxc1_sd3_cmd_gpio_io_gpio3_io21: IOMUXC1_SD3_CMD_GPIO_IO_GPIO3_IO21 {
		pinmux = <0x443c013c 5 0x0 0 0x443c02ec>;
	};
	/omit-if-no-ref/ iomuxc1_sd3_cmd_usdhc_cmd_usdhc3_cmd: IOMUXC1_SD3_CMD_USDHC_CMD_USDHC3_CMD {
		pinmux = <0x443c013c 0 0x443c045c 1 0x443c02ec>;
	};
	/omit-if-no-ref/ iomuxc1_sd3_data0_flexio_flexio_flexio1_flexio22: IOMUXC1_SD3_DATA0_FLEXIO_FLEXIO_FLEXIO1_FLEXIO22 {
		pinmux = <0x443c0140 4 0x443c03b8 1 0x443c02f0>;
	};
	/omit-if-no-ref/ iomuxc1_sd3_data0_flexspi_a_data_flexspi1_a_data00: IOMUXC1_SD3_DATA0_FLEXSPI_A_DATA_FLEXSPI1_A_DATA00 {
		pinmux = <0x443c0140 1 0x0 0 0x443c02f0>;
	};
	/omit-if-no-ref/ iomuxc1_sd3_data0_gpio_io_gpio3_io22: IOMUXC1_SD3_DATA0_GPIO_IO_GPIO3_IO22 {
		pinmux = <0x443c0140 5 0x0 0 0x443c02f0>;
	};
	/omit-if-no-ref/ iomuxc1_sd3_data0_usdhc_data_usdhc3_data0: IOMUXC1_SD3_DATA0_USDHC_DATA_USDHC3_DATA0 {
		pinmux = <0x443c0140 0 0x443c0460 1 0x443c02f0>;
	};
	/omit-if-no-ref/ iomuxc1_sd3_data1_flexio_flexio_flexio1_flexio23: IOMUXC1_SD3_DATA1_FLEXIO_FLEXIO_FLEXIO1_FLEXIO23 {
		pinmux = <0x443c0144 4 0x443c03bc 1 0x443c02f4>;
	};
	/omit-if-no-ref/ iomuxc1_sd3_data1_flexspi_a_data_flexspi1_a_data01: IOMUXC1_SD3_DATA1_FLEXSPI_A_DATA_FLEXSPI1_A_DATA01 {
		pinmux = <0x443c0144 1 0x0 0 0x443c02f4>;
	};
	/omit-if-no-ref/ iomuxc1_sd3_data1_gpio_io_gpio3_io23: IOMUXC1_SD3_DATA1_GPIO_IO_GPIO3_IO23 {
		pinmux = <0x443c0144 5 0x0 0 0x443c02f4>;
	};
	/omit-if-no-ref/ iomuxc1_sd3_data1_usdhc_data_usdhc3_data1: IOMUXC1_SD3_DATA1_USDHC_DATA_USDHC3_DATA1 {
		pinmux = <0x443c0144 0 0x443c0464 1 0x443c02f4>;
	};
	/omit-if-no-ref/ iomuxc1_sd3_data2_flexio_flexio_flexio1_flexio24: IOMUXC1_SD3_DATA2_FLEXIO_FLEXIO_FLEXIO1_FLEXIO24 {
		pinmux = <0x443c0148 4 0x443c03c0 1 0x443c02f8>;
	};
	/omit-if-no-ref/ iomuxc1_sd3_data2_flexspi_a_data_flexspi1_a_data02: IOMUXC1_SD3_DATA2_FLEXSPI_A_DATA_FLEXSPI1_A_DATA02 {
		pinmux = <0x443c0148 1 0x0 0 0x443c02f8>;
	};
	/omit-if-no-ref/ iomuxc1_sd3_data2_gpio_io_gpio3_io24: IOMUXC1_SD3_DATA2_GPIO_IO_GPIO3_IO24 {
		pinmux = <0x443c0148 5 0x0 0 0x443c02f8>;
	};
	/omit-if-no-ref/ iomuxc1_sd3_data2_usdhc_data_usdhc3_data2: IOMUXC1_SD3_DATA2_USDHC_DATA_USDHC3_DATA2 {
		pinmux = <0x443c0148 0 0x443c0468 1 0x443c02f8>;
	};
	/omit-if-no-ref/ iomuxc1_sd3_data3_flexio_flexio_flexio1_flexio25: IOMUXC1_SD3_DATA3_FLEXIO_FLEXIO_FLEXIO1_FLEXIO25 {
		pinmux = <0x443c014c 4 0x443c03c4 1 0x443c02fc>;
	};
	/omit-if-no-ref/ iomuxc1_sd3_data3_flexspi_a_data_flexspi1_a_data03: IOMUXC1_SD3_DATA3_FLEXSPI_A_DATA_FLEXSPI1_A_DATA03 {
		pinmux = <0x443c014c 1 0x0 0 0x443c02fc>;
	};
	/omit-if-no-ref/ iomuxc1_sd3_data3_gpio_io_gpio3_io25: IOMUXC1_SD3_DATA3_GPIO_IO_GPIO3_IO25 {
		pinmux = <0x443c014c 5 0x0 0 0x443c02fc>;
	};
	/omit-if-no-ref/ iomuxc1_sd3_data3_usdhc_data_usdhc3_data3: IOMUXC1_SD3_DATA3_USDHC_DATA_USDHC3_DATA3 {
		pinmux = <0x443c014c 0 0x443c046c 1 0x443c02fc>;
	};
	/omit-if-no-ref/ iomuxc1_uart1_rxd_gpio_io_gpio1_io04: IOMUXC1_UART1_RXD_GPIO_IO_GPIO1_IO04 {
		pinmux = <0x443c0180 5 0x0 0 0x443c0330>;
	};
	/omit-if-no-ref/ iomuxc1_uart1_rxd_lpspi_sin_lpspi2_sin: IOMUXC1_UART1_RXD_LPSPI_SIN_LPSPI2_SIN {
		pinmux = <0x443c0180 2 0x0 0 0x443c0330>;
	};
	/omit-if-no-ref/ iomuxc1_uart1_rxd_lpuart_rx_lpuart1_rx: IOMUXC1_UART1_RXD_LPUART_RX_LPUART1_RX {
		pinmux = <0x443c0180 0 0x0 0 0x443c0330>;
	};
	/omit-if-no-ref/ iomuxc1_uart1_rxd_s400_uart_rx_s400_uart_rx: IOMUXC1_UART1_RXD_S400_UART_RX_S400_UART_RX {
		pinmux = <0x443c0180 1 0x0 0 0x443c0330>;
	};
	/omit-if-no-ref/ iomuxc1_uart1_rxd_tpm_ch_tpm1_ch0: IOMUXC1_UART1_RXD_TPM_CH_TPM1_CH0 {
		pinmux = <0x443c0180 3 0x0 0 0x443c0330>;
	};
	/omit-if-no-ref/ iomuxc1_uart1_txd_gpio_io_gpio1_io05: IOMUXC1_UART1_TXD_GPIO_IO_GPIO1_IO05 {
		pinmux = <0x443c0184 5 0x0 0 0x443c0334>;
	};
	/omit-if-no-ref/ iomuxc1_uart1_txd_lpspi_pcs_lpspi2_pcs0: IOMUXC1_UART1_TXD_LPSPI_PCS_LPSPI2_PCS0 {
		pinmux = <0x443c0184 2 0x0 0 0x443c0334>;
	};
	/omit-if-no-ref/ iomuxc1_uart1_txd_lpuart_tx_lpuart1_tx: IOMUXC1_UART1_TXD_LPUART_TX_LPUART1_TX {
		pinmux = <0x443c0184 0 0x0 0 0x443c0334>;
	};
	/omit-if-no-ref/ iomuxc1_uart1_txd_s400_uart_tx_s400_uart_tx: IOMUXC1_UART1_TXD_S400_UART_TX_S400_UART_TX {
		pinmux = <0x443c0184 1 0x0 0 0x443c0334>;
	};
	/omit-if-no-ref/ iomuxc1_uart1_txd_tpm_ch_tpm1_ch1: IOMUXC1_UART1_TXD_TPM_CH_TPM1_CH1 {
		pinmux = <0x443c0184 3 0x0 0 0x443c0334>;
	};
	/omit-if-no-ref/ iomuxc1_uart2_rxd_gpio_io_gpio1_io06: IOMUXC1_UART2_RXD_GPIO_IO_GPIO1_IO06 {
		pinmux = <0x443c0188 5 0x0 0 0x443c0338>;
	};
	/omit-if-no-ref/ iomuxc1_uart2_rxd_lpspi_sout_lpspi2_sout: IOMUXC1_UART2_RXD_LPSPI_SOUT_LPSPI2_SOUT {
		pinmux = <0x443c0188 2 0x0 0 0x443c0338>;
	};
	/omit-if-no-ref/ iomuxc1_uart2_rxd_lpuart_cts_b_lpuart1_cts_b: IOMUXC1_UART2_RXD_LPUART_CTS_B_LPUART1_CTS_B {
		pinmux = <0x443c0188 1 0x0 0 0x443c0338>;
	};
	/omit-if-no-ref/ iomuxc1_uart2_rxd_lpuart_rx_lpuart2_rx: IOMUXC1_UART2_RXD_LPUART_RX_LPUART2_RX {
		pinmux = <0x443c0188 0 0x0 0 0x443c0338>;
	};
	/omit-if-no-ref/ iomuxc1_uart2_rxd_sai_mclk_sai1_mclk: IOMUXC1_UART2_RXD_SAI_MCLK_SAI1_MCLK {
		pinmux = <0x443c0188 4 0x443c0448 0 0x443c0338>;
	};
	/omit-if-no-ref/ iomuxc1_uart2_rxd_tpm_ch_tpm1_ch2: IOMUXC1_UART2_RXD_TPM_CH_TPM1_CH2 {
		pinmux = <0x443c0188 3 0x0 0 0x443c0338>;
	};
	/omit-if-no-ref/ iomuxc1_uart2_txd_gpio_io_gpio1_io07: IOMUXC1_UART2_TXD_GPIO_IO_GPIO1_IO07 {
		pinmux = <0x443c018c 5 0x0 0 0x443c033c>;
	};
	/omit-if-no-ref/ iomuxc1_uart2_txd_lpspi_sck_lpspi2_sck: IOMUXC1_UART2_TXD_LPSPI_SCK_LPSPI2_SCK {
		pinmux = <0x443c018c 2 0x0 0 0x443c033c>;
	};
	/omit-if-no-ref/ iomuxc1_uart2_txd_lpuart_rts_b_lpuart1_rts_b: IOMUXC1_UART2_TXD_LPUART_RTS_B_LPUART1_RTS_B {
		pinmux = <0x443c018c 1 0x0 0 0x443c033c>;
	};
	/omit-if-no-ref/ iomuxc1_uart2_txd_lpuart_tx_lpuart2_tx: IOMUXC1_UART2_TXD_LPUART_TX_LPUART2_TX {
		pinmux = <0x443c018c 0 0x0 0 0x443c033c>;
	};
	/omit-if-no-ref/ iomuxc1_uart2_txd_tpm_ch_tpm1_ch3: IOMUXC1_UART2_TXD_TPM_CH_TPM1_CH3 {
		pinmux = <0x443c018c 3 0x0 0 0x443c033c>;
	};
	/omit-if-no-ref/ iomuxc1_wdog_any_gpio_io_gpio1_io15: IOMUXC1_WDOG_ANY_GPIO_IO_GPIO1_IO15 {
		pinmux = <0x443c01ac 5 0x0 0 0x443c035c>;
	};
	/omit-if-no-ref/ iomuxc1_wdog_any_wdog_wdog_any_wdog1_wdog_any: IOMUXC1_WDOG_ANY_WDOG_WDOG_ANY_WDOG1_WDOG_ANY {
		pinmux = <0x443c01ac 0 0x0 0 0x443c035c>;
	};
};
