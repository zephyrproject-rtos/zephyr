/*
 *
 *
 * Note: File generated by gen_soc_headers.py
 * from configuration data for MIMX94398AVMM
 */

/*
 * Delta-deduplicated by dedup_pinctrl.py:
 * based on mimx94398avkm-pinctrl.dtsi with this part's differences applied
 * below (364 removed, 0 changed,
 * 180 added). Regenerate with dedup_pinctrl.py;
 * do not edit by hand.
 * target-hash: 63d825dd8cc23a7f
 */

#include "mimx94398avkm-pinctrl.dtsi"

/delete-node/ &iomuxc_ccm_clko1_xbar_xbar_in_xbar1_xbar_inout22;
/delete-node/ &iomuxc_ccm_clko1_xbar_xbar_out_xbar1_xbar_inout22;
/delete-node/ &iomuxc_ccm_clko2_xbar_xbar_in_xbar1_xbar_inout23;
/delete-node/ &iomuxc_ccm_clko2_xbar_xbar_out_xbar1_xbar_inout23;
/delete-node/ &iomuxc_ccm_clko3_netc_enetc_ref_clk_root_netc_enetc_ref_clk_root;
/delete-node/ &iomuxc_ccm_clko4_xbar_xbar_in_xbar1_xbar_inout25;
/delete-node/ &iomuxc_ccm_clko4_xbar_xbar_out_xbar1_xbar_inout25;
/delete-node/ &iomuxc_dap_tclk_swclk_xbar_xbar_in_xbar1_xbar_inout28;
/delete-node/ &iomuxc_dap_tclk_swclk_xbar_xbar_out_xbar1_xbar_inout28;
/delete-node/ &iomuxc_dap_tdi_xbar_xbar_in_xbar1_xbar_inout26;
/delete-node/ &iomuxc_dap_tdi_xbar_xbar_out_xbar1_xbar_inout26;
/delete-node/ &iomuxc_dap_tdo_traceswo_xbar_xbar_in_xbar1_xbar_inout29;
/delete-node/ &iomuxc_dap_tdo_traceswo_xbar_xbar_out_xbar1_xbar_inout29;
/delete-node/ &iomuxc_dap_tms_swdio_xbar_xbar_in_xbar1_xbar_inout27;
/delete-node/ &iomuxc_dap_tms_swdio_xbar_xbar_out_xbar1_xbar_inout27;
/delete-node/ &iomuxc_eth0_col_netc_swt_eth_col_netc_swt_eth0_col;
/delete-node/ &iomuxc_eth0_col_xbar_xbar_in_xbar1_xbar_inout9;
/delete-node/ &iomuxc_eth0_col_xbar_xbar_out_xbar1_xbar_inout9;
/delete-node/ &iomuxc_eth0_crs_netc_swt_eth_crs_netc_swt_eth0_crs;
/delete-node/ &iomuxc_eth0_crs_xbar_xbar_in_xbar1_xbar_inout8;
/delete-node/ &iomuxc_eth0_crs_xbar_xbar_out_xbar1_xbar_inout8;
/delete-node/ &iomuxc_eth0_rx_clk_netc_swt_eth_rx_clk_netc_swt_eth0_rx_clk;
/delete-node/ &iomuxc_eth0_rx_dv_netc_swt_eth_rx_dv_netc_swt_eth0_rx_dv;
/delete-node/ &iomuxc_eth0_rx_er_netc_swt_eth_rx_er_netc_swt_eth0_rx_er;
/delete-node/ &iomuxc_eth0_rxd0_netc_swt_eth_rxd_netc_swt_eth0_rxd0;
/delete-node/ &iomuxc_eth0_rxd1_netc_swt_eth_rxd_netc_swt_eth0_rxd1;
/delete-node/ &iomuxc_eth0_rxd2_netc_swt_eth_rxd_netc_swt_eth0_rxd2;
/delete-node/ &iomuxc_eth0_rxd3_netc_swt_eth_rxd_netc_swt_eth0_rxd3;
/delete-node/ &iomuxc_eth0_tx_clk_netc_swt_eth_tx_clk_netc_swt_eth0_tx_clk;
/delete-node/ &iomuxc_eth0_tx_en_netc_swt_eth_tx_en_netc_swt_eth0_tx_en;
/delete-node/ &iomuxc_eth0_tx_er_netc_swt_eth_tx_er_netc_swt_eth0_tx_er;
/delete-node/ &iomuxc_eth0_txd0_netc_swt_eth_txd_netc_swt_eth0_txd0;
/delete-node/ &iomuxc_eth0_txd1_netc_swt_eth_txd_netc_swt_eth0_txd1;
/delete-node/ &iomuxc_eth0_txd2_netc_swt_eth_rmii_ref_clk_netc_swt_eth0_rmii_ref50_clk;
/delete-node/ &iomuxc_eth0_txd2_netc_swt_eth_txd_netc_swt_eth0_txd2;
/delete-node/ &iomuxc_eth0_txd3_netc_swt_eth_txd_netc_swt_eth0_txd3;
/delete-node/ &iomuxc_eth1_col_netc_swt_eth_col_netc_swt_eth1_col;
/delete-node/ &iomuxc_eth1_col_xbar_xbar_in_xbar1_xbar_inout11;
/delete-node/ &iomuxc_eth1_col_xbar_xbar_out_xbar1_xbar_inout11;
/delete-node/ &iomuxc_eth1_crs_netc_swt_eth_crs_netc_swt_eth1_crs;
/delete-node/ &iomuxc_eth1_crs_xbar_xbar_in_xbar1_xbar_inout10;
/delete-node/ &iomuxc_eth1_crs_xbar_xbar_out_xbar1_xbar_inout10;
/delete-node/ &iomuxc_eth1_rx_clk_netc_swt_eth_rx_clk_netc_swt_eth1_rx_clk;
/delete-node/ &iomuxc_eth1_rx_dv_netc_swt_eth_rx_dv_netc_swt_eth1_rx_dv;
/delete-node/ &iomuxc_eth1_rx_er_netc_swt_eth_rx_er_netc_swt_eth1_rx_er;
/delete-node/ &iomuxc_eth1_rxd0_netc_swt_eth_rxd_netc_swt_eth1_rxd0;
/delete-node/ &iomuxc_eth1_rxd1_netc_swt_eth_rxd_netc_swt_eth1_rxd1;
/delete-node/ &iomuxc_eth1_rxd2_netc_swt_eth_rxd_netc_swt_eth1_rxd2;
/delete-node/ &iomuxc_eth1_rxd3_netc_swt_eth_rxd_netc_swt_eth1_rxd3;
/delete-node/ &iomuxc_eth1_tx_clk_netc_swt_eth_tx_clk_netc_swt_eth1_tx_clk;
/delete-node/ &iomuxc_eth1_tx_en_netc_swt_eth_tx_en_netc_swt_eth1_tx_en;
/delete-node/ &iomuxc_eth1_tx_er_netc_swt_eth_tx_er_netc_swt_eth1_tx_er;
/delete-node/ &iomuxc_eth1_txd0_netc_swt_eth_txd_netc_swt_eth1_txd0;
/delete-node/ &iomuxc_eth1_txd1_netc_swt_eth_txd_netc_swt_eth1_txd1;
/delete-node/ &iomuxc_eth1_txd2_netc_swt_eth_rmii_ref_clk_netc_swt_eth1_rmii_ref50_clk;
/delete-node/ &iomuxc_eth1_txd2_netc_swt_eth_txd_netc_swt_eth1_txd2;
/delete-node/ &iomuxc_eth1_txd3_netc_swt_eth_txd_netc_swt_eth1_txd3;
/delete-node/ &iomuxc_eth2_mdc_gpio1_netc_enetc_swt_eth_slv_mdc_netc_enetc2_swt_eth2_slv_mdc;
/delete-node/ &iomuxc_eth2_mdc_gpio1_xbar_xbar_in_xbar1_xbar_inout30;
/delete-node/ &iomuxc_eth2_mdc_gpio1_xbar_xbar_out_xbar1_xbar_inout30;
/delete-node/ &iomuxc_eth2_mdio_gpio2_netc_enetc_swt_eth_slv_mdio_netc_enetc2_swt_eth2_slv_mdio;
/delete-node/ &iomuxc_eth2_mdio_gpio2_xbar_xbar_in_xbar1_xbar_inout31;
/delete-node/ &iomuxc_eth2_mdio_gpio2_xbar_xbar_out_xbar1_xbar_inout31;
/delete-node/ &iomuxc_eth2_rx_clk_netc_enetc_swt_eth_rx_clk_netc_enetc2_swt_eth2_rx_clk;
/delete-node/ &iomuxc_eth2_rx_clk_xbar_xbar_in_xbar1_xbar_inout38;
/delete-node/ &iomuxc_eth2_rx_clk_xbar_xbar_out_xbar1_xbar_inout38;
/delete-node/ &iomuxc_eth2_rx_ctl_netc_enetc_swt_eth_rx_ctl_netc_enetc2_swt_eth2_rx_ctl;
/delete-node/ &iomuxc_eth2_rxd0_netc_enetc_swt_eth_rxd_netc_enetc2_swt_eth2_rxd0;
/delete-node/ &iomuxc_eth2_rxd0_xbar_xbar_in_xbar1_xbar_inout39;
/delete-node/ &iomuxc_eth2_rxd0_xbar_xbar_out_xbar1_xbar_inout39;
/delete-node/ &iomuxc_eth2_rxd1_netc_enetc_swt_eth_rxd_netc_enetc2_swt_eth2_rxd1;
/delete-node/ &iomuxc_eth2_rxd1_xbar_xbar_in_xbar1_xbar_inout40;
/delete-node/ &iomuxc_eth2_rxd1_xbar_xbar_out_xbar1_xbar_inout40;
/delete-node/ &iomuxc_eth2_rxd2_netc_enetc_swt_eth_rxd_netc_enetc2_swt_eth2_rxd2;
/delete-node/ &iomuxc_eth2_rxd2_xbar_xbar_in_xbar1_xbar_inout41;
/delete-node/ &iomuxc_eth2_rxd2_xbar_xbar_out_xbar1_xbar_inout41;
/delete-node/ &iomuxc_eth2_rxd3_netc_enetc_swt_eth_rxd_netc_enetc2_swt_eth2_rxd3;
/delete-node/ &iomuxc_eth2_rxd3_xbar_xbar_in_xbar1_xbar_inout42;
/delete-node/ &iomuxc_eth2_rxd3_xbar_xbar_out_xbar1_xbar_inout42;
/delete-node/ &iomuxc_eth2_tx_clk_netc_enetc_swt_eth_tx_clk_netc_enetc2_swt_eth2_tx_clk;
/delete-node/ &iomuxc_eth2_tx_clk_xbar_xbar_in_xbar1_xbar_inout37;
/delete-node/ &iomuxc_eth2_tx_clk_xbar_xbar_out_xbar1_xbar_inout37;
/delete-node/ &iomuxc_eth2_tx_ctl_netc_enetc_swt_eth_tx_ctl_netc_enetc2_swt_eth2_tx_ctl;
/delete-node/ &iomuxc_eth2_tx_ctl_xbar_xbar_in_xbar1_xbar_inout36;
/delete-node/ &iomuxc_eth2_tx_ctl_xbar_xbar_out_xbar1_xbar_inout36;
/delete-node/ &iomuxc_eth2_txd0_netc_enetc_swt_eth_txd_netc_enetc2_swt_eth2_txd0;
/delete-node/ &iomuxc_eth2_txd0_xbar_xbar_in_xbar1_xbar_inout35;
/delete-node/ &iomuxc_eth2_txd0_xbar_xbar_out_xbar1_xbar_inout35;
/delete-node/ &iomuxc_eth2_txd1_netc_enetc_swt_eth_txd_netc_enetc2_swt_eth2_txd1;
/delete-node/ &iomuxc_eth2_txd1_xbar_xbar_in_xbar1_xbar_inout34;
/delete-node/ &iomuxc_eth2_txd1_xbar_xbar_out_xbar1_xbar_inout34;
/delete-node/ &iomuxc_eth2_txd2_netc_enetc_swt_eth_rmii_ref_clk_netc_enetc2_swt_eth2_rmii_ref50_clk;
/delete-node/ &iomuxc_eth2_txd2_netc_enetc_swt_eth_txd_netc_enetc2_swt_eth2_txd2;
/delete-node/ &iomuxc_eth2_txd2_xbar_xbar_in_xbar1_xbar_inout33;
/delete-node/ &iomuxc_eth2_txd2_xbar_xbar_out_xbar1_xbar_inout33;
/delete-node/ &iomuxc_eth2_txd3_netc_enetc_swt_eth_txd_netc_enetc2_swt_eth2_txd3;
/delete-node/ &iomuxc_eth2_txd3_xbar_xbar_in_xbar1_xbar_inout32;
/delete-node/ &iomuxc_eth2_txd3_xbar_xbar_out_xbar1_xbar_inout32;
/delete-node/ &iomuxc_eth3_mdc_gpio1_netc_enetc_eth_slv_mdc_netc_enetc1_eth3_slv_mdc;
/delete-node/ &iomuxc_eth3_mdio_gpio2_netc_enetc_eth_slv_mdio_netc_enetc1_eth3_slv_mdio;
/delete-node/ &iomuxc_eth3_rx_clk_netc_enetc_eth_rx_clk_netc_enetc1_eth3_rx_clk;
/delete-node/ &iomuxc_eth3_rx_clk_xbar_xbar_in_xbar1_xbar_inout44;
/delete-node/ &iomuxc_eth3_rx_clk_xbar_xbar_out_xbar1_xbar_inout44;
/delete-node/ &iomuxc_eth3_rx_clk_xspi_slv_data3_xspi_slv_data3;
/delete-node/ &iomuxc_eth3_rx_ctl_netc_enetc_eth_rx_ctl_netc_enetc1_eth3_rx_ctl;
/delete-node/ &iomuxc_eth3_rx_ctl_xbar_xbar_in_xbar1_xbar_inout43;
/delete-node/ &iomuxc_eth3_rx_ctl_xbar_xbar_out_xbar1_xbar_inout43;
/delete-node/ &iomuxc_eth3_rxd0_netc_enetc_eth_rxd_netc_enetc1_eth3_rxd0;
/delete-node/ &iomuxc_eth3_rxd0_xbar_xbar_in_xbar1_xbar_inout45;
/delete-node/ &iomuxc_eth3_rxd0_xbar_xbar_out_xbar1_xbar_inout45;
/delete-node/ &iomuxc_eth3_rxd0_xspi_slv_data2_xspi_slv_data2;
/delete-node/ &iomuxc_eth3_rxd1_netc_enetc_eth_rxd_netc_enetc1_eth3_rxd1;
/delete-node/ &iomuxc_eth3_rxd1_xbar_xbar_in_xbar1_xbar_inout46;
/delete-node/ &iomuxc_eth3_rxd1_xbar_xbar_out_xbar1_xbar_inout46;
/delete-node/ &iomuxc_eth3_rxd1_xspi_slv_data1_xspi_slv_data1;
/delete-node/ &iomuxc_eth3_rxd2_netc_enetc_eth_rxd_netc_enetc1_eth3_rxd2;
/delete-node/ &iomuxc_eth3_rxd2_xbar_xbar_in_xbar1_xbar_inout47;
/delete-node/ &iomuxc_eth3_rxd2_xbar_xbar_out_xbar1_xbar_inout47;
/delete-node/ &iomuxc_eth3_rxd2_xspi_slv_data0_xspi_slv_data0;
/delete-node/ &iomuxc_eth3_rxd3_netc_enetc_eth_rxd_netc_enetc1_eth3_rxd3;
/delete-node/ &iomuxc_eth3_rxd3_xbar_xbar_in_xbar1_xbar_inout48;
/delete-node/ &iomuxc_eth3_rxd3_xbar_xbar_out_xbar1_xbar_inout48;
/delete-node/ &iomuxc_eth3_tx_clk_netc_enetc_eth_tx_clk_netc_enetc1_eth3_tx_clk;
/delete-node/ &iomuxc_eth3_tx_ctl_netc_enetc_eth_tx_ctl_netc_enetc1_eth3_tx_ctl;
/delete-node/ &iomuxc_eth3_txd0_netc_enetc_eth_txd_netc_enetc1_eth3_txd0;
/delete-node/ &iomuxc_eth3_txd0_xspi_slv_data4_xspi_slv_data4;
/delete-node/ &iomuxc_eth3_txd1_netc_enetc_eth_txd_netc_enetc1_eth3_txd1;
/delete-node/ &iomuxc_eth3_txd1_xspi_slv_data5_xspi_slv_data5;
/delete-node/ &iomuxc_eth3_txd2_netc_enetc_eth_rmii_ref_clk_netc_enetc1_eth3_rmii_ref50_clk;
/delete-node/ &iomuxc_eth3_txd2_netc_enetc_eth_txd_netc_enetc1_eth3_txd2;
/delete-node/ &iomuxc_eth3_txd2_xspi_slv_data6_xspi_slv_data6;
/delete-node/ &iomuxc_eth3_txd3_netc_enetc_eth_txd_netc_enetc1_eth3_txd3;
/delete-node/ &iomuxc_eth3_txd3_xspi_slv_data7_xspi_slv_data7;
/delete-node/ &iomuxc_eth4_mdc_gpio1_flexio_1_3_mux2_flexio12_flexio_1_3_mux2_flexio12;
/delete-node/ &iomuxc_eth4_mdio_gpio2_flexio_1_3_mux2_flexio13_flexio_1_3_mux2_flexio13;
/delete-node/ &iomuxc_eth4_mdio_gpio2_netc_enet_ref_clk_root_netc_enet_ref_clk_root;
/delete-node/ &iomuxc_eth4_rx_clk_flexio_1_3_mux2_flexio11_flexio_1_3_mux2_flexio11;
/delete-node/ &iomuxc_eth4_rx_clk_flexio_2_4_mux1_flexio15_flexio_2_4_mux1_flexio15;
/delete-node/ &iomuxc_eth4_rx_clk_netc_enetc_eth_rx_clk_netc_enetc0_eth4_rx_clk;
/delete-node/ &iomuxc_eth4_rx_clk_xbar_xbar_in_xbar1_xbar_inout7;
/delete-node/ &iomuxc_eth4_rx_clk_xbar_xbar_out_xbar1_xbar_inout7;
/delete-node/ &iomuxc_eth4_rx_ctl_flexio_1_3_mux2_flexio10_flexio_1_3_mux2_flexio10;
/delete-node/ &iomuxc_eth4_rx_ctl_flexio_2_4_mux1_flexio14_flexio_2_4_mux1_flexio14;
/delete-node/ &iomuxc_eth4_rx_ctl_netc_enetc_eth_rx_ctl_netc_enetc0_eth4_rx_ctl;
/delete-node/ &iomuxc_eth4_rx_ctl_xbar_xbar_in_xbar1_xbar_inout6;
/delete-node/ &iomuxc_eth4_rx_ctl_xbar_xbar_out_xbar1_xbar_inout6;
/delete-node/ &iomuxc_eth4_rxd0_flexio_1_3_mux2_flexio6_flexio_1_3_mux2_flexio6;
/delete-node/ &iomuxc_eth4_rxd0_netc_enetc_eth_rxd_netc_enetc0_eth4_rxd0;
/delete-node/ &iomuxc_eth4_rxd1_flexio_1_3_mux2_flexio7_flexio_1_3_mux2_flexio7;
/delete-node/ &iomuxc_eth4_rxd1_flexio_2_4_mux1_flexio11_flexio_2_4_mux1_flexio11;
/delete-node/ &iomuxc_eth4_rxd1_netc_enetc_eth_rxd_netc_enetc0_eth4_rxd1;
/delete-node/ &iomuxc_eth4_rxd2_flexio_1_3_mux2_flexio8_flexio_1_3_mux2_flexio8;
/delete-node/ &iomuxc_eth4_rxd2_flexio_2_4_mux1_flexio12_flexio_2_4_mux1_flexio12;
/delete-node/ &iomuxc_eth4_rxd2_netc_enetc_eth_rxd_netc_enetc0_eth4_rxd2;
/delete-node/ &iomuxc_eth4_rxd2_xbar_xbar_in_xbar1_xbar_inout4;
/delete-node/ &iomuxc_eth4_rxd2_xbar_xbar_out_xbar1_xbar_inout4;
/delete-node/ &iomuxc_eth4_rxd3_flexio_1_3_mux2_flexio9_flexio_1_3_mux2_flexio9;
/delete-node/ &iomuxc_eth4_rxd3_flexio_2_4_mux1_flexio13_flexio_2_4_mux1_flexio13;
/delete-node/ &iomuxc_eth4_rxd3_netc_enet_ref_clk_root_netc_enet_ref_clk_root;
/delete-node/ &iomuxc_eth4_rxd3_netc_enetc_eth_rxd_netc_enetc0_eth4_rxd3;
/delete-node/ &iomuxc_eth4_rxd3_xbar_xbar_in_xbar1_xbar_inout5;
/delete-node/ &iomuxc_eth4_rxd3_xbar_xbar_out_xbar1_xbar_inout5;
/delete-node/ &iomuxc_eth4_tx_clk_flexio_1_3_mux2_flexio0_flexio_1_3_mux2_flexio0;
/delete-node/ &iomuxc_eth4_tx_clk_netc_enetc_eth_tx_clk_netc_enetc0_eth4_tx_clk;
/delete-node/ &iomuxc_eth4_tx_clk_xbar_xbar_in_xbar1_xbar_inout30;
/delete-node/ &iomuxc_eth4_tx_clk_xbar_xbar_out_xbar1_xbar_inout30;
/delete-node/ &iomuxc_eth4_tx_ctl_flexio_1_3_mux2_flexio1_flexio_1_3_mux2_flexio1;
/delete-node/ &iomuxc_eth4_tx_ctl_netc_enetc_eth_tx_ctl_netc_enetc0_eth4_tx_ctl;
/delete-node/ &iomuxc_eth4_tx_ctl_xbar_xbar_in_xbar1_xbar_inout31;
/delete-node/ &iomuxc_eth4_tx_ctl_xbar_xbar_out_xbar1_xbar_inout31;
/delete-node/ &iomuxc_eth4_txd0_flexio_1_3_mux2_flexio2_flexio_1_3_mux2_flexio2;
/delete-node/ &iomuxc_eth4_txd0_netc_enetc_eth_txd_netc_enetc0_eth4_txd0;
/delete-node/ &iomuxc_eth4_txd0_xbar_xbar_in_xbar1_xbar_inout32;
/delete-node/ &iomuxc_eth4_txd0_xbar_xbar_out_xbar1_xbar_inout32;
/delete-node/ &iomuxc_eth4_txd1_flexio_1_3_mux2_flexio3_flexio_1_3_mux2_flexio3;
/delete-node/ &iomuxc_eth4_txd1_netc_enetc_eth_txd_netc_enetc0_eth4_txd1;
/delete-node/ &iomuxc_eth4_txd1_xbar_xbar_in_xbar1_xbar_inout33;
/delete-node/ &iomuxc_eth4_txd1_xbar_xbar_out_xbar1_xbar_inout33;
/delete-node/ &iomuxc_eth4_txd2_flexio_1_3_mux2_flexio4_flexio_1_3_mux2_flexio4;
/delete-node/ &iomuxc_eth4_txd2_netc_enetc_eth_rmii_ref_clk_netc_enetc0_eth4_rmii_ref50_clk;
/delete-node/ &iomuxc_eth4_txd2_netc_enetc_eth_txd_netc_enetc0_eth4_txd2;
/delete-node/ &iomuxc_eth4_txd3_flexio_1_3_mux2_flexio5_flexio_1_3_mux2_flexio5;
/delete-node/ &iomuxc_eth4_txd3_netc_enetc_eth_txd_netc_enetc0_eth4_txd3;
/delete-node/ &iomuxc_eth4_txd3_xbar_xbar_in_xbar1_xbar_inout35;
/delete-node/ &iomuxc_eth4_txd3_xbar_xbar_out_xbar1_xbar_inout35;
/delete-node/ &iomuxc_gpio_io00_xbar_xbar_in_xbar1_xbar_inout39;
/delete-node/ &iomuxc_gpio_io00_xbar_xbar_out_xbar1_xbar_inout39;
/delete-node/ &iomuxc_gpio_io01_xbar_xbar_in_xbar1_xbar_inout40;
/delete-node/ &iomuxc_gpio_io01_xbar_xbar_out_xbar1_xbar_inout40;
/delete-node/ &iomuxc_gpio_io02_xbar_xbar_in_xbar1_xbar_inout41;
/delete-node/ &iomuxc_gpio_io02_xbar_xbar_out_xbar1_xbar_inout41;
/delete-node/ &iomuxc_gpio_io03_xbar_xbar_in_xbar1_xbar_inout42;
/delete-node/ &iomuxc_gpio_io03_xbar_xbar_out_xbar1_xbar_inout42;
/delete-node/ &iomuxc_gpio_io07_xbar_xbar_in_xbar1_xbar_inout43;
/delete-node/ &iomuxc_gpio_io07_xbar_xbar_out_xbar1_xbar_inout43;
/delete-node/ &iomuxc_gpio_io09_xbar_xbar_in_xbar1_xbar_inout44;
/delete-node/ &iomuxc_gpio_io09_xbar_xbar_out_xbar1_xbar_inout44;
/delete-node/ &iomuxc_gpio_io10_xbar_xbar_in_xbar1_xbar_inout45;
/delete-node/ &iomuxc_gpio_io10_xbar_xbar_out_xbar1_xbar_inout45;
/delete-node/ &iomuxc_gpio_io11_xbar_xbar_in_xbar1_xbar_inout46;
/delete-node/ &iomuxc_gpio_io11_xbar_xbar_out_xbar1_xbar_inout46;
/delete-node/ &iomuxc_gpio_io13_xbar_xbar_in_xbar1_xbar_inout47;
/delete-node/ &iomuxc_gpio_io13_xbar_xbar_out_xbar1_xbar_inout47;
/delete-node/ &iomuxc_gpio_io14_xbar_xbar_in_xbar1_xbar_inout48;
/delete-node/ &iomuxc_gpio_io14_xbar_xbar_out_xbar1_xbar_inout48;
/delete-node/ &iomuxc_gpio_io15_xbar_xbar_in_xbar1_xbar_inout8;
/delete-node/ &iomuxc_gpio_io15_xbar_xbar_out_xbar1_xbar_inout8;
/delete-node/ &iomuxc_gpio_io16_xbar_xbar_in_xbar1_xbar_inout30;
/delete-node/ &iomuxc_gpio_io16_xbar_xbar_out_xbar1_xbar_inout30;
/delete-node/ &iomuxc_gpio_io17_xbar_xbar_in_xbar1_xbar_inout31;
/delete-node/ &iomuxc_gpio_io17_xbar_xbar_out_xbar1_xbar_inout31;
/delete-node/ &iomuxc_gpio_io18_xbar_xbar_in_xbar1_xbar_inout32;
/delete-node/ &iomuxc_gpio_io18_xbar_xbar_out_xbar1_xbar_inout32;
/delete-node/ &iomuxc_gpio_io19_xbar_xbar_in_xbar1_xbar_inout33;
/delete-node/ &iomuxc_gpio_io19_xbar_xbar_out_xbar1_xbar_inout33;
/delete-node/ &iomuxc_gpio_io20_xbar_xbar_in_xbar1_xbar_inout34;
/delete-node/ &iomuxc_gpio_io20_xbar_xbar_out_xbar1_xbar_inout34;
/delete-node/ &iomuxc_gpio_io21_xbar_xbar_in_xbar1_xbar_inout35;
/delete-node/ &iomuxc_gpio_io21_xbar_xbar_out_xbar1_xbar_inout35;
/delete-node/ &iomuxc_gpio_io22_xbar_xbar_in_xbar1_xbar_inout9;
/delete-node/ &iomuxc_gpio_io22_xbar_xbar_out_xbar1_xbar_inout9;
/delete-node/ &iomuxc_gpio_io23_xbar_xbar_in_xbar1_xbar_inout10;
/delete-node/ &iomuxc_gpio_io23_xbar_xbar_out_xbar1_xbar_inout10;
/delete-node/ &iomuxc_gpio_io24_xbar_xbar_in_xbar1_xbar_inout36;
/delete-node/ &iomuxc_gpio_io24_xbar_xbar_out_xbar1_xbar_inout36;
/delete-node/ &iomuxc_gpio_io25_xbar_xbar_in_xbar1_xbar_inout37;
/delete-node/ &iomuxc_gpio_io25_xbar_xbar_out_xbar1_xbar_inout37;
/delete-node/ &iomuxc_gpio_io26_flexio_1_3_mux1_flexio0_flexio_1_3_mux1_flexio0;
/delete-node/ &iomuxc_gpio_io26_xbar_xbar_in_xbar1_xbar_inout38;
/delete-node/ &iomuxc_gpio_io26_xbar_xbar_out_xbar1_xbar_inout38;
/delete-node/ &iomuxc_gpio_io27_flexio_1_3_mux1_flexio1_flexio_1_3_mux1_flexio1;
/delete-node/ &iomuxc_gpio_io28_flexio_1_3_mux1_flexio2_flexio_1_3_mux1_flexio2;
/delete-node/ &iomuxc_gpio_io28_xbar_xbar_in_xbar1_xbar_inout4;
/delete-node/ &iomuxc_gpio_io28_xbar_xbar_out_xbar1_xbar_inout4;
/delete-node/ &iomuxc_gpio_io29_flexio_1_3_mux1_flexio3_flexio_1_3_mux1_flexio3;
/delete-node/ &iomuxc_gpio_io29_xbar_xbar_in_xbar1_xbar_inout5;
/delete-node/ &iomuxc_gpio_io29_xbar_xbar_out_xbar1_xbar_inout5;
/delete-node/ &iomuxc_gpio_io30_flexio_1_3_mux1_flexio4_flexio_1_3_mux1_flexio4;
/delete-node/ &iomuxc_gpio_io30_xbar_xbar_in_xbar1_xbar_inout6;
/delete-node/ &iomuxc_gpio_io30_xbar_xbar_out_xbar1_xbar_inout6;
/delete-node/ &iomuxc_gpio_io31_flexio_1_3_mux1_flexio5_flexio_1_3_mux1_flexio5;
/delete-node/ &iomuxc_gpio_io31_xbar_xbar_in_xbar1_xbar_inout7;
/delete-node/ &iomuxc_gpio_io31_xbar_xbar_out_xbar1_xbar_inout7;
/delete-node/ &iomuxc_gpio_io32_flexio_1_3_mux1_flexio6_flexio_1_3_mux1_flexio6;
/delete-node/ &iomuxc_gpio_io32_xbar_xbar_in_xbar1_xbar_inout8;
/delete-node/ &iomuxc_gpio_io32_xbar_xbar_out_xbar1_xbar_inout8;
/delete-node/ &iomuxc_gpio_io33_flexio_1_3_mux1_flexio7_flexio_1_3_mux1_flexio7;
/delete-node/ &iomuxc_gpio_io33_xbar_xbar_in_xbar1_xbar_inout9;
/delete-node/ &iomuxc_gpio_io33_xbar_xbar_out_xbar1_xbar_inout9;
/delete-node/ &iomuxc_gpio_io34_flexio_1_3_mux1_flexio8_flexio_1_3_mux1_flexio8;
/delete-node/ &iomuxc_gpio_io34_xbar_xbar_in_xbar1_xbar_inout10;
/delete-node/ &iomuxc_gpio_io34_xbar_xbar_out_xbar1_xbar_inout10;
/delete-node/ &iomuxc_gpio_io35_flexio_1_3_mux1_flexio9_flexio_1_3_mux1_flexio9;
/delete-node/ &iomuxc_gpio_io35_xbar_xbar_in_xbar1_xbar_inout11;
/delete-node/ &iomuxc_gpio_io35_xbar_xbar_out_xbar1_xbar_inout11;
/delete-node/ &iomuxc_gpio_io36_flexio_1_3_mux1_flexio10_flexio_1_3_mux1_flexio10;
/delete-node/ &iomuxc_gpio_io36_xbar_xbar_in_xbar1_xbar_inout12;
/delete-node/ &iomuxc_gpio_io36_xbar_xbar_out_xbar1_xbar_inout12;
/delete-node/ &iomuxc_gpio_io37_flexio_1_3_mux1_flexio11_flexio_1_3_mux1_flexio11;
/delete-node/ &iomuxc_gpio_io37_xbar_xbar_in_xbar1_xbar_inout13;
/delete-node/ &iomuxc_gpio_io37_xbar_xbar_out_xbar1_xbar_inout13;
/delete-node/ &iomuxc_gpio_io38_flexio_1_3_mux1_flexio12_flexio_1_3_mux1_flexio12;
/delete-node/ &iomuxc_gpio_io38_xbar_xbar_in_xbar1_xbar_inout14;
/delete-node/ &iomuxc_gpio_io38_xbar_xbar_out_xbar1_xbar_inout14;
/delete-node/ &iomuxc_gpio_io39_flexio_1_3_mux1_flexio13_flexio_1_3_mux1_flexio13;
/delete-node/ &iomuxc_gpio_io39_xbar_xbar_in_xbar1_xbar_inout15;
/delete-node/ &iomuxc_gpio_io39_xbar_xbar_out_xbar1_xbar_inout15;
/delete-node/ &iomuxc_gpio_io40_flexio_1_3_mux1_flexio14_flexio_1_3_mux1_flexio14;
/delete-node/ &iomuxc_gpio_io40_xbar_xbar_in_xbar1_xbar_inout16;
/delete-node/ &iomuxc_gpio_io40_xbar_xbar_out_xbar1_xbar_inout16;
/delete-node/ &iomuxc_gpio_io41_flexio_1_3_mux1_flexio15_flexio_1_3_mux1_flexio15;
/delete-node/ &iomuxc_gpio_io41_xbar_xbar_in_xbar1_xbar_inout17;
/delete-node/ &iomuxc_gpio_io41_xbar_xbar_out_xbar1_xbar_inout17;
/delete-node/ &iomuxc_gpio_io42_xbar_xbar_in_xbar1_xbar_inout11;
/delete-node/ &iomuxc_gpio_io42_xbar_xbar_out_xbar1_xbar_inout11;
/delete-node/ &iomuxc_gpio_io43_xbar_xbar_in_xbar1_xbar_inout12;
/delete-node/ &iomuxc_gpio_io43_xbar_xbar_out_xbar1_xbar_inout12;
/delete-node/ &iomuxc_gpio_io49_xbar_xbar_in_xbar1_xbar_inout13;
/delete-node/ &iomuxc_gpio_io49_xbar_xbar_out_xbar1_xbar_inout13;
/delete-node/ &iomuxc_gpio_io50_xbar_xbar_in_xbar1_xbar_inout14;
/delete-node/ &iomuxc_gpio_io50_xbar_xbar_out_xbar1_xbar_inout14;
/delete-node/ &iomuxc_gpio_io54_xbar_xbar_in_xbar1_xbar_inout18;
/delete-node/ &iomuxc_gpio_io54_xbar_xbar_out_xbar1_xbar_inout18;
/delete-node/ &iomuxc_gpio_io55_xbar_xbar_in_xbar1_xbar_inout19;
/delete-node/ &iomuxc_gpio_io55_xbar_xbar_out_xbar1_xbar_inout19;
/delete-node/ &iomuxc_gpio_io56_xbar_xbar_in_xbar1_xbar_inout20;
/delete-node/ &iomuxc_gpio_io56_xbar_xbar_out_xbar1_xbar_inout20;
/delete-node/ &iomuxc_gpio_io57_netc_enetc_ref_clk_root_netc_enetc_ref_clk_root;
/delete-node/ &iomuxc_sd1_clk_flexio_2_4_mux1_flexio0_flexio_2_4_mux1_flexio0;
/delete-node/ &iomuxc_sd1_cmd_flexio_2_4_mux1_flexio1_flexio_2_4_mux1_flexio1;
/delete-node/ &iomuxc_sd1_data0_flexio_2_4_mux1_flexio2_flexio_2_4_mux1_flexio2;
/delete-node/ &iomuxc_sd1_data1_flexio_2_4_mux1_flexio3_flexio_2_4_mux1_flexio3;
/delete-node/ &iomuxc_sd1_data2_flexio_2_4_mux1_flexio4_flexio_2_4_mux1_flexio4;
/delete-node/ &iomuxc_sd1_data3_flexio_2_4_mux1_flexio5_flexio_2_4_mux1_flexio5;
/delete-node/ &iomuxc_sd1_data4_flexio_2_4_mux1_flexio6_flexio_2_4_mux1_flexio6;
/delete-node/ &iomuxc_sd1_data5_flexio_2_4_mux1_flexio7_flexio_2_4_mux1_flexio7;
/delete-node/ &iomuxc_sd1_data6_flexio_2_4_mux1_flexio8_flexio_2_4_mux1_flexio8;
/delete-node/ &iomuxc_sd1_data7_flexio_2_4_mux1_flexio9_flexio_2_4_mux1_flexio9;
/delete-node/ &iomuxc_sd1_strobe_flexio_2_4_mux1_flexio10_flexio_2_4_mux1_flexio10;
/delete-node/ &iomuxc_sd2_cd_b_flexio_2_4_mux2_flexio0_flexio_2_4_mux2_flexio0;
/delete-node/ &iomuxc_sd2_cd_b_netc_enetc_eth_rx_ctl_netc_enetc0_eth4_rx_ctl;
/delete-node/ &iomuxc_sd2_cd_b_xbar_xbar_in_xbar1_xbar_inout13;
/delete-node/ &iomuxc_sd2_cd_b_xbar_xbar_out_xbar1_xbar_inout13;
/delete-node/ &iomuxc_sd2_clk_flexio_2_4_mux2_flexio1_flexio_2_4_mux2_flexio1;
/delete-node/ &iomuxc_sd2_clk_netc_enetc_eth_tx_clk_netc_enetc0_eth4_tx_clk;
/delete-node/ &iomuxc_sd2_cmd_flexio_2_4_mux2_flexio2_flexio_2_4_mux2_flexio2;
/delete-node/ &iomuxc_sd2_cmd_netc_enetc_eth_tx_ctl_netc_enetc0_eth4_tx_ctl;
/delete-node/ &iomuxc_sd2_data0_flexio_2_4_mux2_flexio3_flexio_2_4_mux2_flexio3;
/delete-node/ &iomuxc_sd2_data0_netc_enetc_eth_txd_netc_enetc0_eth4_txd0;
/delete-node/ &iomuxc_sd2_data1_flexio_2_4_mux2_flexio4_flexio_2_4_mux2_flexio4;
/delete-node/ &iomuxc_sd2_data1_netc_enetc_eth_txd_netc_enetc0_eth4_txd1;
/delete-node/ &iomuxc_sd2_data1_xbar_xbar_in_xbar1_xbar_inout14;
/delete-node/ &iomuxc_sd2_data1_xbar_xbar_out_xbar1_xbar_inout14;
/delete-node/ &iomuxc_sd2_data2_flexio_2_4_mux2_flexio5_flexio_2_4_mux2_flexio5;
/delete-node/ &iomuxc_sd2_data2_netc_enetc_eth_txd_netc_enetc0_eth4_txd2;
/delete-node/ &iomuxc_sd2_data2_xbar_xbar_in_xbar1_xbar_inout15;
/delete-node/ &iomuxc_sd2_data2_xbar_xbar_out_xbar1_xbar_inout15;
/delete-node/ &iomuxc_sd2_data3_flexio_2_4_mux2_flexio6_flexio_2_4_mux2_flexio6;
/delete-node/ &iomuxc_sd2_data3_netc_enetc_eth_txd_netc_enetc0_eth4_txd3;
/delete-node/ &iomuxc_sd2_data3_xbar_xbar_in_xbar1_xbar_inout16;
/delete-node/ &iomuxc_sd2_data3_xbar_xbar_out_xbar1_xbar_inout16;
/delete-node/ &iomuxc_sd2_gpio0_flexio_2_4_mux2_flexio8_flexio_2_4_mux2_flexio8;
/delete-node/ &iomuxc_sd2_gpio0_netc_enetc_eth_rxd_netc_enetc0_eth4_rxd1;
/delete-node/ &iomuxc_sd2_gpio0_xbar_xbar_in_xbar1_xbar_inout18;
/delete-node/ &iomuxc_sd2_gpio0_xbar_xbar_out_xbar1_xbar_inout18;
/delete-node/ &iomuxc_sd2_gpio1_flexio_2_4_mux2_flexio9_flexio_2_4_mux2_flexio9;
/delete-node/ &iomuxc_sd2_gpio1_netc_enetc_eth_rxd_netc_enetc0_eth4_rxd2;
/delete-node/ &iomuxc_sd2_gpio1_xbar_xbar_in_xbar1_xbar_inout19;
/delete-node/ &iomuxc_sd2_gpio1_xbar_xbar_out_xbar1_xbar_inout19;
/delete-node/ &iomuxc_sd2_gpio2_flexio_2_4_mux2_flexio10_flexio_2_4_mux2_flexio10;
/delete-node/ &iomuxc_sd2_gpio2_netc_enetc_eth_rxd_netc_enetc0_eth4_rxd3;
/delete-node/ &iomuxc_sd2_gpio2_xbar_xbar_in_xbar1_xbar_inout20;
/delete-node/ &iomuxc_sd2_gpio2_xbar_xbar_out_xbar1_xbar_inout20;
/delete-node/ &iomuxc_sd2_gpio3_flexio_2_4_mux2_flexio11_flexio_2_4_mux2_flexio11;
/delete-node/ &iomuxc_sd2_gpio3_netc_enetc_eth_rx_clk_netc_enetc0_eth4_rx_clk;
/delete-node/ &iomuxc_sd2_gpio3_xbar_xbar_in_xbar1_xbar_inout21;
/delete-node/ &iomuxc_sd2_gpio3_xbar_xbar_out_xbar1_xbar_inout21;
/delete-node/ &iomuxc_sd2_reset_b_flexio_2_4_mux2_flexio7_flexio_2_4_mux2_flexio7;
/delete-node/ &iomuxc_sd2_reset_b_netc_enetc_eth_rxd_netc_enetc0_eth4_rxd0;
/delete-node/ &iomuxc_sd2_reset_b_xbar_xbar_in_xbar1_xbar_inout17;
/delete-node/ &iomuxc_sd2_reset_b_xbar_xbar_out_xbar1_xbar_inout17;
/delete-node/ &iomuxc_sd2_vselect_flexio_2_4_mux1_flexio11_flexio_2_4_mux1_flexio11;
/delete-node/ &iomuxc_sd2_vselect_xbar_xbar_in_xbar1_xbar_inout12;
/delete-node/ &iomuxc_sd2_vselect_xbar_xbar_out_xbar1_xbar_inout12;
/delete-node/ &iomuxc_xspi1_data0_flexio_1_3_mux3_flexio0_flexio_1_3_mux3_flexio0;
/delete-node/ &iomuxc_xspi1_data0_xspi_slv_data0_xspi_slv_data0;
/delete-node/ &iomuxc_xspi1_data1_flexio_1_3_mux3_flexio1_flexio_1_3_mux3_flexio1;
/delete-node/ &iomuxc_xspi1_data1_xspi_slv_data1_xspi_slv_data1;
/delete-node/ &iomuxc_xspi1_data2_flexio_1_3_mux3_flexio2_flexio_1_3_mux3_flexio2;
/delete-node/ &iomuxc_xspi1_data2_xspi_slv_data2_xspi_slv_data2;
/delete-node/ &iomuxc_xspi1_data3_flexio_1_3_mux3_flexio3_flexio_1_3_mux3_flexio3;
/delete-node/ &iomuxc_xspi1_data3_xspi_slv_data3_xspi_slv_data3;
/delete-node/ &iomuxc_xspi1_data4_flexio_1_3_mux3_flexio4_flexio_1_3_mux3_flexio4;
/delete-node/ &iomuxc_xspi1_data4_xspi_slv_data4_xspi_slv_data4;
/delete-node/ &iomuxc_xspi1_data5_flexio_1_3_mux3_flexio5_flexio_1_3_mux3_flexio5;
/delete-node/ &iomuxc_xspi1_data5_xspi_slv_data5_xspi_slv_data5;
/delete-node/ &iomuxc_xspi1_data6_flexio_1_3_mux3_flexio6_flexio_1_3_mux3_flexio6;
/delete-node/ &iomuxc_xspi1_data6_xspi_slv_data6_xspi_slv_data6;
/delete-node/ &iomuxc_xspi1_data7_flexio_1_3_mux3_flexio7_flexio_1_3_mux3_flexio7;
/delete-node/ &iomuxc_xspi1_data7_xspi_slv_data7_xspi_slv_data7;
/delete-node/ &iomuxc_xspi1_dqs_flexio_1_3_mux3_flexio8_flexio_1_3_mux3_flexio8;
/delete-node/ &iomuxc_xspi1_sclk_flexio_1_3_mux3_flexio9_flexio_1_3_mux3_flexio9;
/delete-node/ &iomuxc_xspi1_ss0_b_flexio_1_3_mux3_flexio10_flexio_1_3_mux3_flexio10;
/delete-node/ &iomuxc_xspi1_ss1_b_flexio_1_3_mux3_flexio11_flexio_1_3_mux3_flexio11;

&scmi_iomuxc {
	/omit-if-no-ref/ iomuxc_ccm_clko3_enet_ref_clk_root_enet_ref_clk_root: IOMUXC_CCM_CLKO3_ENET_REF_CLK_ROOT_ENET_REF_CLK_ROOT {
		pinmux = <0x443c0100 7 0x0 0 0x443c0404>;
	};
	/omit-if-no-ref/ iomuxc_eth0_col_netc_pinmux_eth_col_netc_pinmux_eth0_col: IOMUXC_ETH0_COL_NETC_PINMUX_ETH_COL_NETC_PINMUX_ETH0_COL {
		pinmux = <0x443c01ec 0 0x0 0 0x443c04f0>;
	};
	/omit-if-no-ref/ iomuxc_eth0_crs_netc_pinmux_eth_crs_netc_pinmux_eth0_crs: IOMUXC_ETH0_CRS_NETC_PINMUX_ETH_CRS_NETC_PINMUX_ETH0_CRS {
		pinmux = <0x443c01e8 0 0x0 0 0x443c04ec>;
	};
	/omit-if-no-ref/ iomuxc_eth0_rx_clk_netc_pinmux_eth_rx_clk_netc_pinmux_eth0_rx_clk: IOMUXC_ETH0_RX_CLK_NETC_PINMUX_ETH_RX_CLK_NETC_PINMUX_ETH0_RX_CLK {
		pinmux = <0x443c01dc 0 0x0 0 0x443c04e0>;
	};
	/omit-if-no-ref/ iomuxc_eth0_rx_dv_netc_pinmux_eth_rx_dv_netc_pinmux_eth0_rx_dv: IOMUXC_ETH0_RX_DV_NETC_PINMUX_ETH_RX_DV_NETC_PINMUX_ETH0_RX_DV {
		pinmux = <0x443c01c8 0 0x0 0 0x443c04cc>;
	};
	/omit-if-no-ref/ iomuxc_eth0_rx_er_netc_pinmux_eth_rx_er_netc_pinmux_eth0_rx_er: IOMUXC_ETH0_RX_ER_NETC_PINMUX_ETH_RX_ER_NETC_PINMUX_ETH0_RX_ER {
		pinmux = <0x443c01e0 0 0x0 0 0x443c04e4>;
	};
	/omit-if-no-ref/ iomuxc_eth0_rxd0_netc_pinmux_eth_rxd_netc_pinmux_eth0_rxd0: IOMUXC_ETH0_RXD0_NETC_PINMUX_ETH_RXD_NETC_PINMUX_ETH0_RXD0 {
		pinmux = <0x443c01c0 0 0x0 0 0x443c04c4>;
	};
	/omit-if-no-ref/ iomuxc_eth0_rxd1_netc_pinmux_eth_rxd_netc_pinmux_eth0_rxd1: IOMUXC_ETH0_RXD1_NETC_PINMUX_ETH_RXD_NETC_PINMUX_ETH0_RXD1 {
		pinmux = <0x443c01c4 0 0x0 0 0x443c04c8>;
	};
	/omit-if-no-ref/ iomuxc_eth0_rxd2_netc_pinmux_eth_rxd_netc_pinmux_eth0_rxd2: IOMUXC_ETH0_RXD2_NETC_PINMUX_ETH_RXD_NETC_PINMUX_ETH0_RXD2 {
		pinmux = <0x443c01d4 0 0x0 0 0x443c04d8>;
	};
	/omit-if-no-ref/ iomuxc_eth0_rxd3_netc_pinmux_eth_rxd_netc_pinmux_eth0_rxd3: IOMUXC_ETH0_RXD3_NETC_PINMUX_ETH_RXD_NETC_PINMUX_ETH0_RXD3 {
		pinmux = <0x443c01d8 0 0x0 0 0x443c04dc>;
	};
	/omit-if-no-ref/ iomuxc_eth0_tx_clk_netc_pinmux_eth_tx_clk_netc_pinmux_eth0_tx_clk: IOMUXC_ETH0_TX_CLK_NETC_PINMUX_ETH_TX_CLK_NETC_PINMUX_ETH0_TX_CLK {
		pinmux = <0x443c01bc 0 0x0 0 0x443c04c0>;
	};
	/omit-if-no-ref/ iomuxc_eth0_tx_en_netc_pinmux_eth_tx_en_netc_pinmux_eth0_tx_en: IOMUXC_ETH0_TX_EN_NETC_PINMUX_ETH_TX_EN_NETC_PINMUX_ETH0_TX_EN {
		pinmux = <0x443c01b8 0 0x0 0 0x443c04bc>;
	};
	/omit-if-no-ref/ iomuxc_eth0_tx_er_netc_pinmux_eth_tx_er_netc_pinmux_eth0_tx_er: IOMUXC_ETH0_TX_ER_NETC_PINMUX_ETH_TX_ER_NETC_PINMUX_ETH0_TX_ER {
		pinmux = <0x443c01e4 0 0x0 0 0x443c04e8>;
	};
	/omit-if-no-ref/ iomuxc_eth0_txd0_netc_pinmux_eth_txd_netc_pinmux_eth0_txd0: IOMUXC_ETH0_TXD0_NETC_PINMUX_ETH_TXD_NETC_PINMUX_ETH0_TXD0 {
		pinmux = <0x443c01b0 0 0x0 0 0x443c04b4>;
	};
	/omit-if-no-ref/ iomuxc_eth0_txd1_netc_pinmux_eth_txd_netc_pinmux_eth0_txd1: IOMUXC_ETH0_TXD1_NETC_PINMUX_ETH_TXD_NETC_PINMUX_ETH0_TXD1 {
		pinmux = <0x443c01b4 0 0x0 0 0x443c04b8>;
	};
	/omit-if-no-ref/ iomuxc_eth0_txd2_eth_rmii_ref_clk_eth0_rmii_ref50_clk: IOMUXC_ETH0_TXD2_ETH_RMII_REF_CLK_ETH0_RMII_REF50_CLK {
		pinmux = <0x443c01cc 2 0x0 0 0x443c04d0>;
	};
	/omit-if-no-ref/ iomuxc_eth0_txd2_netc_pinmux_eth_txd_netc_pinmux_eth0_txd2: IOMUXC_ETH0_TXD2_NETC_PINMUX_ETH_TXD_NETC_PINMUX_ETH0_TXD2 {
		pinmux = <0x443c01cc 0 0x0 0 0x443c04d0>;
	};
	/omit-if-no-ref/ iomuxc_eth0_txd3_netc_pinmux_eth_txd_netc_pinmux_eth0_txd3: IOMUXC_ETH0_TXD3_NETC_PINMUX_ETH_TXD_NETC_PINMUX_ETH0_TXD3 {
		pinmux = <0x443c01d0 0 0x0 0 0x443c04d4>;
	};
	/omit-if-no-ref/ iomuxc_eth1_col_netc_pinmux_eth_col_netc_pinmux_eth1_col: IOMUXC_ETH1_COL_NETC_PINMUX_ETH_COL_NETC_PINMUX_ETH1_COL {
		pinmux = <0x443c022c 0 0x0 0 0x443c0530>;
	};
	/omit-if-no-ref/ iomuxc_eth1_crs_netc_pinmux_eth_crs_netc_pinmux_eth1_crs: IOMUXC_ETH1_CRS_NETC_PINMUX_ETH_CRS_NETC_PINMUX_ETH1_CRS {
		pinmux = <0x443c0228 0 0x0 0 0x443c052c>;
	};
	/omit-if-no-ref/ iomuxc_eth1_rx_clk_netc_pinmux_eth_rx_clk_netc_pinmux_eth1_rx_clk: IOMUXC_ETH1_RX_CLK_NETC_PINMUX_ETH_RX_CLK_NETC_PINMUX_ETH1_RX_CLK {
		pinmux = <0x443c021c 0 0x0 0 0x443c0520>;
	};
	/omit-if-no-ref/ iomuxc_eth1_rx_dv_netc_pinmux_eth_rx_dv_netc_pinmux_eth1_rx_dv: IOMUXC_ETH1_RX_DV_NETC_PINMUX_ETH_RX_DV_NETC_PINMUX_ETH1_RX_DV {
		pinmux = <0x443c0208 0 0x0 0 0x443c050c>;
	};
	/omit-if-no-ref/ iomuxc_eth1_rx_er_netc_pinmux_eth_rx_er_netc_pinmux_eth1_rx_er: IOMUXC_ETH1_RX_ER_NETC_PINMUX_ETH_RX_ER_NETC_PINMUX_ETH1_RX_ER {
		pinmux = <0x443c0220 0 0x0 0 0x443c0524>;
	};
	/omit-if-no-ref/ iomuxc_eth1_rxd0_netc_pinmux_eth_rxd_netc_pinmux_eth1_rxd0: IOMUXC_ETH1_RXD0_NETC_PINMUX_ETH_RXD_NETC_PINMUX_ETH1_RXD0 {
		pinmux = <0x443c0200 0 0x0 0 0x443c0504>;
	};
	/omit-if-no-ref/ iomuxc_eth1_rxd1_netc_pinmux_eth_rxd_netc_pinmux_eth1_rxd1: IOMUXC_ETH1_RXD1_NETC_PINMUX_ETH_RXD_NETC_PINMUX_ETH1_RXD1 {
		pinmux = <0x443c0204 0 0x0 0 0x443c0508>;
	};
	/omit-if-no-ref/ iomuxc_eth1_rxd2_netc_pinmux_eth_rxd_netc_pinmux_eth1_rxd2: IOMUXC_ETH1_RXD2_NETC_PINMUX_ETH_RXD_NETC_PINMUX_ETH1_RXD2 {
		pinmux = <0x443c0214 0 0x0 0 0x443c0518>;
	};
	/omit-if-no-ref/ iomuxc_eth1_rxd3_netc_pinmux_eth_rxd_netc_pinmux_eth1_rxd3: IOMUXC_ETH1_RXD3_NETC_PINMUX_ETH_RXD_NETC_PINMUX_ETH1_RXD3 {
		pinmux = <0x443c0218 0 0x0 0 0x443c051c>;
	};
	/omit-if-no-ref/ iomuxc_eth1_tx_clk_netc_pinmux_eth_tx_clk_netc_pinmux_eth1_tx_clk: IOMUXC_ETH1_TX_CLK_NETC_PINMUX_ETH_TX_CLK_NETC_PINMUX_ETH1_TX_CLK {
		pinmux = <0x443c01fc 0 0x0 0 0x443c0500>;
	};
	/omit-if-no-ref/ iomuxc_eth1_tx_en_netc_pinmux_eth_tx_en_netc_pinmux_eth1_tx_en: IOMUXC_ETH1_TX_EN_NETC_PINMUX_ETH_TX_EN_NETC_PINMUX_ETH1_TX_EN {
		pinmux = <0x443c01f8 0 0x0 0 0x443c04fc>;
	};
	/omit-if-no-ref/ iomuxc_eth1_tx_er_netc_pinmux_eth_tx_er_netc_pinmux_eth1_tx_er: IOMUXC_ETH1_TX_ER_NETC_PINMUX_ETH_TX_ER_NETC_PINMUX_ETH1_TX_ER {
		pinmux = <0x443c0224 0 0x0 0 0x443c0528>;
	};
	/omit-if-no-ref/ iomuxc_eth1_txd0_netc_pinmux_eth_txd_netc_pinmux_eth1_txd0: IOMUXC_ETH1_TXD0_NETC_PINMUX_ETH_TXD_NETC_PINMUX_ETH1_TXD0 {
		pinmux = <0x443c01f0 0 0x0 0 0x443c04f4>;
	};
	/omit-if-no-ref/ iomuxc_eth1_txd1_netc_pinmux_eth_txd_netc_pinmux_eth1_txd1: IOMUXC_ETH1_TXD1_NETC_PINMUX_ETH_TXD_NETC_PINMUX_ETH1_TXD1 {
		pinmux = <0x443c01f4 0 0x0 0 0x443c04f8>;
	};
	/omit-if-no-ref/ iomuxc_eth1_txd2_eth_rmii_ref_clk_eth1_rmii_ref50_clk: IOMUXC_ETH1_TXD2_ETH_RMII_REF_CLK_ETH1_RMII_REF50_CLK {
		pinmux = <0x443c020c 2 0x0 0 0x443c0510>;
	};
	/omit-if-no-ref/ iomuxc_eth1_txd2_netc_pinmux_eth_txd_netc_pinmux_eth1_txd2: IOMUXC_ETH1_TXD2_NETC_PINMUX_ETH_TXD_NETC_PINMUX_ETH1_TXD2 {
		pinmux = <0x443c020c 0 0x0 0 0x443c0510>;
	};
	/omit-if-no-ref/ iomuxc_eth1_txd3_netc_pinmux_eth_txd_netc_pinmux_eth1_txd3: IOMUXC_ETH1_TXD3_NETC_PINMUX_ETH_TXD_NETC_PINMUX_ETH1_TXD3 {
		pinmux = <0x443c0210 0 0x0 0 0x443c0514>;
	};
	/omit-if-no-ref/ iomuxc_eth2_mdc_gpio1_netc_eth_slv_mdc_netc_eth2_slv_mdc: IOMUXC_ETH2_MDC_GPIO1_NETC_ETH_SLV_MDC_NETC_ETH2_SLV_MDC {
		pinmux = <0x443c0108 1 0x0 0 0x443c040c>;
	};
	/omit-if-no-ref/ iomuxc_eth2_mdio_gpio2_netc_eth_slv_mdio_netc_eth2_slv_mdio: IOMUXC_ETH2_MDIO_GPIO2_NETC_ETH_SLV_MDIO_NETC_ETH2_SLV_MDIO {
		pinmux = <0x443c010c 1 0x0 0 0x443c0410>;
	};
	/omit-if-no-ref/ iomuxc_eth2_rx_clk_netc_pinmux_eth_rx_clk_netc_pinmux_eth2_rx_clk: IOMUXC_ETH2_RX_CLK_NETC_PINMUX_ETH_RX_CLK_NETC_PINMUX_ETH2_RX_CLK {
		pinmux = <0x443c012c 0 0x0 0 0x443c0430>;
	};
	/omit-if-no-ref/ iomuxc_eth2_rx_ctl_netc_pinmux_eth_rx_ctl_netc_pinmux_eth2_rx_ctl: IOMUXC_ETH2_RX_CTL_NETC_PINMUX_ETH_RX_CTL_NETC_PINMUX_ETH2_RX_CTL {
		pinmux = <0x443c0128 0 0x0 0 0x443c042c>;
	};
	/omit-if-no-ref/ iomuxc_eth2_rxd0_netc_pinmux_eth_rxd_netc_pinmux_eth2_rxd0: IOMUXC_ETH2_RXD0_NETC_PINMUX_ETH_RXD_NETC_PINMUX_ETH2_RXD0 {
		pinmux = <0x443c0130 0 0x0 0 0x443c0434>;
	};
	/omit-if-no-ref/ iomuxc_eth2_rxd1_netc_pinmux_eth_rxd_netc_pinmux_eth2_rxd1: IOMUXC_ETH2_RXD1_NETC_PINMUX_ETH_RXD_NETC_PINMUX_ETH2_RXD1 {
		pinmux = <0x443c0134 0 0x0 0 0x443c0438>;
	};
	/omit-if-no-ref/ iomuxc_eth2_rxd2_netc_pinmux_eth_rxd_netc_pinmux_eth2_rxd2: IOMUXC_ETH2_RXD2_NETC_PINMUX_ETH_RXD_NETC_PINMUX_ETH2_RXD2 {
		pinmux = <0x443c0138 0 0x0 0 0x443c043c>;
	};
	/omit-if-no-ref/ iomuxc_eth2_rxd3_netc_pinmux_eth_rxd_netc_pinmux_eth2_rxd3: IOMUXC_ETH2_RXD3_NETC_PINMUX_ETH_RXD_NETC_PINMUX_ETH2_RXD3 {
		pinmux = <0x443c013c 0 0x0 0 0x443c0440>;
	};
	/omit-if-no-ref/ iomuxc_eth2_tx_clk_netc_pinmux_eth_tx_clk_netc_pinmux_eth2_tx_clk: IOMUXC_ETH2_TX_CLK_NETC_PINMUX_ETH_TX_CLK_NETC_PINMUX_ETH2_TX_CLK {
		pinmux = <0x443c0124 0 0x0 0 0x443c0428>;
	};
	/omit-if-no-ref/ iomuxc_eth2_tx_ctl_netc_pinmux_eth_tx_ctl_netc_pinmux_eth2_tx_ctl: IOMUXC_ETH2_TX_CTL_NETC_PINMUX_ETH_TX_CTL_NETC_PINMUX_ETH2_TX_CTL {
		pinmux = <0x443c0120 0 0x0 0 0x443c0424>;
	};
	/omit-if-no-ref/ iomuxc_eth2_txd0_netc_pinmux_eth_txd_netc_pinmux_eth2_txd0: IOMUXC_ETH2_TXD0_NETC_PINMUX_ETH_TXD_NETC_PINMUX_ETH2_TXD0 {
		pinmux = <0x443c011c 0 0x0 0 0x443c0420>;
	};
	/omit-if-no-ref/ iomuxc_eth2_txd1_netc_pinmux_eth_txd_netc_pinmux_eth2_txd1: IOMUXC_ETH2_TXD1_NETC_PINMUX_ETH_TXD_NETC_PINMUX_ETH2_TXD1 {
		pinmux = <0x443c0118 0 0x0 0 0x443c041c>;
	};
	/omit-if-no-ref/ iomuxc_eth2_txd2_eth_rmii_ref_clk_eth2_rmii_ref50_clk: IOMUXC_ETH2_TXD2_ETH_RMII_REF_CLK_ETH2_RMII_REF50_CLK {
		pinmux = <0x443c0114 1 0x0 0 0x443c0418>;
	};
	/omit-if-no-ref/ iomuxc_eth2_txd2_netc_pinmux_eth_txd_netc_pinmux_eth2_txd2: IOMUXC_ETH2_TXD2_NETC_PINMUX_ETH_TXD_NETC_PINMUX_ETH2_TXD2 {
		pinmux = <0x443c0114 0 0x0 0 0x443c0418>;
	};
	/omit-if-no-ref/ iomuxc_eth2_txd3_netc_pinmux_eth_txd_netc_pinmux_eth2_txd3: IOMUXC_ETH2_TXD3_NETC_PINMUX_ETH_TXD_NETC_PINMUX_ETH2_TXD3 {
		pinmux = <0x443c0110 0 0x0 0 0x443c0414>;
	};
	/omit-if-no-ref/ iomuxc_eth3_mdc_gpio1_netc_eth_slv_mdc_netc_eth3_slv_mdc: IOMUXC_ETH3_MDC_GPIO1_NETC_ETH_SLV_MDC_NETC_ETH3_SLV_MDC {
		pinmux = <0x443c0140 2 0x0 0 0x443c0444>;
	};
	/omit-if-no-ref/ iomuxc_eth3_mdio_gpio2_netc_eth_slv_mdio_netc_eth3_slv_mdio: IOMUXC_ETH3_MDIO_GPIO2_NETC_ETH_SLV_MDIO_NETC_ETH3_SLV_MDIO {
		pinmux = <0x443c0144 2 0x0 0 0x443c0448>;
	};
	/omit-if-no-ref/ iomuxc_eth3_rx_clk_netc_pinmux_eth_rx_clk_netc_pinmux_eth3_rx_clk: IOMUXC_ETH3_RX_CLK_NETC_PINMUX_ETH_RX_CLK_NETC_PINMUX_ETH3_RX_CLK {
		pinmux = <0x443c0164 0 0x0 0 0x443c0468>;
	};
	/omit-if-no-ref/ iomuxc_eth3_rx_clk_xspi_slv_data_xspi_slv_data3: IOMUXC_ETH3_RX_CLK_XSPI_SLV_DATA_XSPI_SLV_DATA3 {
		pinmux = <0x443c0164 2 0x443c0914 0 0x443c0468>;
	};
	/omit-if-no-ref/ iomuxc_eth3_rx_ctl_netc_pinmux_eth_rx_ctl_netc_pinmux_eth3_rx_ctl: IOMUXC_ETH3_RX_CTL_NETC_PINMUX_ETH_RX_CTL_NETC_PINMUX_ETH3_RX_CTL {
		pinmux = <0x443c0160 0 0x0 0 0x443c0464>;
	};
	/omit-if-no-ref/ iomuxc_eth3_rxd0_netc_pinmux_eth_rxd_netc_pinmux_eth3_rxd0: IOMUXC_ETH3_RXD0_NETC_PINMUX_ETH_RXD_NETC_PINMUX_ETH3_RXD0 {
		pinmux = <0x443c0168 0 0x0 0 0x443c046c>;
	};
	/omit-if-no-ref/ iomuxc_eth3_rxd0_xspi_slv_data_xspi_slv_data2: IOMUXC_ETH3_RXD0_XSPI_SLV_DATA_XSPI_SLV_DATA2 {
		pinmux = <0x443c0168 2 0x443c0910 0 0x443c046c>;
	};
	/omit-if-no-ref/ iomuxc_eth3_rxd1_netc_pinmux_eth_rxd_netc_pinmux_eth3_rxd1: IOMUXC_ETH3_RXD1_NETC_PINMUX_ETH_RXD_NETC_PINMUX_ETH3_RXD1 {
		pinmux = <0x443c016c 0 0x0 0 0x443c0470>;
	};
	/omit-if-no-ref/ iomuxc_eth3_rxd1_xspi_slv_data_xspi_slv_data1: IOMUXC_ETH3_RXD1_XSPI_SLV_DATA_XSPI_SLV_DATA1 {
		pinmux = <0x443c016c 2 0x443c090c 0 0x443c0470>;
	};
	/omit-if-no-ref/ iomuxc_eth3_rxd2_netc_pinmux_eth_rxd_netc_pinmux_eth3_rxd2: IOMUXC_ETH3_RXD2_NETC_PINMUX_ETH_RXD_NETC_PINMUX_ETH3_RXD2 {
		pinmux = <0x443c0170 0 0x0 0 0x443c0474>;
	};
	/omit-if-no-ref/ iomuxc_eth3_rxd2_xspi_slv_data_xspi_slv_data0: IOMUXC_ETH3_RXD2_XSPI_SLV_DATA_XSPI_SLV_DATA0 {
		pinmux = <0x443c0170 2 0x443c0908 0 0x443c0474>;
	};
	/omit-if-no-ref/ iomuxc_eth3_rxd3_netc_pinmux_eth_rxd_netc_pinmux_eth3_rxd3: IOMUXC_ETH3_RXD3_NETC_PINMUX_ETH_RXD_NETC_PINMUX_ETH3_RXD3 {
		pinmux = <0x443c0174 0 0x0 0 0x443c0478>;
	};
	/omit-if-no-ref/ iomuxc_eth3_tx_clk_netc_pinmux_eth_tx_clk_netc_pinmux_eth3_tx_clk: IOMUXC_ETH3_TX_CLK_NETC_PINMUX_ETH_TX_CLK_NETC_PINMUX_ETH3_TX_CLK {
		pinmux = <0x443c015c 0 0x0 0 0x443c0460>;
	};
	/omit-if-no-ref/ iomuxc_eth3_tx_ctl_netc_pinmux_eth_tx_ctl_netc_pinmux_eth3_tx_ctl: IOMUXC_ETH3_TX_CTL_NETC_PINMUX_ETH_TX_CTL_NETC_PINMUX_ETH3_TX_CTL {
		pinmux = <0x443c0158 0 0x0 0 0x443c045c>;
	};
	/omit-if-no-ref/ iomuxc_eth3_txd0_netc_pinmux_eth_txd_netc_pinmux_eth3_txd0: IOMUXC_ETH3_TXD0_NETC_PINMUX_ETH_TXD_NETC_PINMUX_ETH3_TXD0 {
		pinmux = <0x443c0154 0 0x0 0 0x443c0458>;
	};
	/omit-if-no-ref/ iomuxc_eth3_txd0_xspi_slv_data_xspi_slv_data4: IOMUXC_ETH3_TXD0_XSPI_SLV_DATA_XSPI_SLV_DATA4 {
		pinmux = <0x443c0154 2 0x443c0918 0 0x443c0458>;
	};
	/omit-if-no-ref/ iomuxc_eth3_txd1_netc_pinmux_eth_txd_netc_pinmux_eth3_txd1: IOMUXC_ETH3_TXD1_NETC_PINMUX_ETH_TXD_NETC_PINMUX_ETH3_TXD1 {
		pinmux = <0x443c0150 0 0x0 0 0x443c0454>;
	};
	/omit-if-no-ref/ iomuxc_eth3_txd1_xspi_slv_data_xspi_slv_data5: IOMUXC_ETH3_TXD1_XSPI_SLV_DATA_XSPI_SLV_DATA5 {
		pinmux = <0x443c0150 2 0x443c091c 0 0x443c0454>;
	};
	/omit-if-no-ref/ iomuxc_eth3_txd2_eth_rmii_ref_clk_eth3_rmii_ref50_clk: IOMUXC_ETH3_TXD2_ETH_RMII_REF_CLK_ETH3_RMII_REF50_CLK {
		pinmux = <0x443c014c 1 0x0 0 0x443c0450>;
	};
	/omit-if-no-ref/ iomuxc_eth3_txd2_netc_pinmux_eth_txd_netc_pinmux_eth3_txd2: IOMUXC_ETH3_TXD2_NETC_PINMUX_ETH_TXD_NETC_PINMUX_ETH3_TXD2 {
		pinmux = <0x443c014c 0 0x0 0 0x443c0450>;
	};
	/omit-if-no-ref/ iomuxc_eth3_txd2_xspi_slv_data_xspi_slv_data6: IOMUXC_ETH3_TXD2_XSPI_SLV_DATA_XSPI_SLV_DATA6 {
		pinmux = <0x443c014c 2 0x443c0920 0 0x443c0450>;
	};
	/omit-if-no-ref/ iomuxc_eth3_txd3_netc_pinmux_eth_txd_netc_pinmux_eth3_txd3: IOMUXC_ETH3_TXD3_NETC_PINMUX_ETH_TXD_NETC_PINMUX_ETH3_TXD3 {
		pinmux = <0x443c0148 0 0x0 0 0x443c044c>;
	};
	/omit-if-no-ref/ iomuxc_eth3_txd3_xspi_slv_data_xspi_slv_data7: IOMUXC_ETH3_TXD3_XSPI_SLV_DATA_XSPI_SLV_DATA7 {
		pinmux = <0x443c0148 2 0x443c0924 0 0x443c044c>;
	};
	/omit-if-no-ref/ iomuxc_eth4_mdc_gpio1_flexio1_3_2_flexio12_flexio1_3_2_flexio12: IOMUXC_ETH4_MDC_GPIO1_FLEXIO1_3_2_FLEXIO12_FLEXIO1_3_2_FLEXIO12 {
		pinmux = <0x443c0178 4 0x0 0 0x443c047c>;
	};
	/omit-if-no-ref/ iomuxc_eth4_mdio_gpio2_enet_ref_clk_root_enet_ref_clk_root: IOMUXC_ETH4_MDIO_GPIO2_ENET_REF_CLK_ROOT_ENET_REF_CLK_ROOT {
		pinmux = <0x443c017c 2 0x0 0 0x443c0480>;
	};
	/omit-if-no-ref/ iomuxc_eth4_mdio_gpio2_flexio1_3_2_flexio13_flexio1_3_2_flexio13: IOMUXC_ETH4_MDIO_GPIO2_FLEXIO1_3_2_FLEXIO13_FLEXIO1_3_2_FLEXIO13 {
		pinmux = <0x443c017c 4 0x0 0 0x443c0480>;
	};
	/omit-if-no-ref/ iomuxc_eth4_rx_clk_flexio1_3_2_flexio11_flexio1_3_2_flexio11: IOMUXC_ETH4_RX_CLK_FLEXIO1_3_2_FLEXIO11_FLEXIO1_3_2_FLEXIO11 {
		pinmux = <0x443c01ac 4 0x0 0 0x443c04b0>;
	};
	/omit-if-no-ref/ iomuxc_eth4_rx_clk_flexio2_4_1_flexio15_flexio2_4_1_flexio15: IOMUXC_ETH4_RX_CLK_FLEXIO2_4_1_FLEXIO15_FLEXIO2_4_1_FLEXIO15 {
		pinmux = <0x443c01ac 3 0x0 0 0x443c04b0>;
	};
	/omit-if-no-ref/ iomuxc_eth4_rx_clk_netc_pinmux_eth_rx_clk_netc_pinmux_eth4_rx_clk: IOMUXC_ETH4_RX_CLK_NETC_PINMUX_ETH_RX_CLK_NETC_PINMUX_ETH4_RX_CLK {
		pinmux = <0x443c01ac 0 0x443c0630 0 0x443c04b0>;
	};
	/omit-if-no-ref/ iomuxc_eth4_rx_ctl_flexio1_3_2_flexio10_flexio1_3_2_flexio10: IOMUXC_ETH4_RX_CTL_FLEXIO1_3_2_FLEXIO10_FLEXIO1_3_2_FLEXIO10 {
		pinmux = <0x443c01a8 4 0x0 0 0x443c04ac>;
	};
	/omit-if-no-ref/ iomuxc_eth4_rx_ctl_flexio2_4_1_flexio14_flexio2_4_1_flexio14: IOMUXC_ETH4_RX_CTL_FLEXIO2_4_1_FLEXIO14_FLEXIO2_4_1_FLEXIO14 {
		pinmux = <0x443c01a8 3 0x0 0 0x443c04ac>;
	};
	/omit-if-no-ref/ iomuxc_eth4_rx_ctl_netc_pinmux_eth_rx_ctl_netc_pinmux_eth4_rx_ctl: IOMUXC_ETH4_RX_CTL_NETC_PINMUX_ETH_RX_CTL_NETC_PINMUX_ETH4_RX_CTL {
		pinmux = <0x443c01a8 0 0x443c0634 0 0x443c04ac>;
	};
	/omit-if-no-ref/ iomuxc_eth4_rxd0_flexio1_3_2_flexio6_flexio1_3_2_flexio6: IOMUXC_ETH4_RXD0_FLEXIO1_3_2_FLEXIO6_FLEXIO1_3_2_FLEXIO6 {
		pinmux = <0x443c0198 4 0x0 0 0x443c049c>;
	};
	/omit-if-no-ref/ iomuxc_eth4_rxd0_netc_pinmux_eth_rxd_netc_pinmux_eth4_rxd0: IOMUXC_ETH4_RXD0_NETC_PINMUX_ETH_RXD_NETC_PINMUX_ETH4_RXD0 {
		pinmux = <0x443c0198 0 0x443c0638 0 0x443c049c>;
	};
	/omit-if-no-ref/ iomuxc_eth4_rxd1_flexio1_3_2_flexio7_flexio1_3_2_flexio7: IOMUXC_ETH4_RXD1_FLEXIO1_3_2_FLEXIO7_FLEXIO1_3_2_FLEXIO7 {
		pinmux = <0x443c019c 4 0x0 0 0x443c04a0>;
	};
	/omit-if-no-ref/ iomuxc_eth4_rxd1_flexio2_4_1_flexio11_flexio2_4_1_flexio11: IOMUXC_ETH4_RXD1_FLEXIO2_4_1_FLEXIO11_FLEXIO2_4_1_FLEXIO11 {
		pinmux = <0x443c019c 3 0x443c0694 0 0x443c04a0>;
	};
	/omit-if-no-ref/ iomuxc_eth4_rxd1_netc_pinmux_eth_rxd_netc_pinmux_eth4_rxd1: IOMUXC_ETH4_RXD1_NETC_PINMUX_ETH_RXD_NETC_PINMUX_ETH4_RXD1 {
		pinmux = <0x443c019c 0 0x443c063c 0 0x443c04a0>;
	};
	/omit-if-no-ref/ iomuxc_eth4_rxd2_flexio1_3_2_flexio8_flexio1_3_2_flexio8: IOMUXC_ETH4_RXD2_FLEXIO1_3_2_FLEXIO8_FLEXIO1_3_2_FLEXIO8 {
		pinmux = <0x443c01a0 4 0x0 0 0x443c04a4>;
	};
	/omit-if-no-ref/ iomuxc_eth4_rxd2_flexio2_4_1_flexio12_flexio2_4_1_flexio12: IOMUXC_ETH4_RXD2_FLEXIO2_4_1_FLEXIO12_FLEXIO2_4_1_FLEXIO12 {
		pinmux = <0x443c01a0 3 0x0 0 0x443c04a4>;
	};
	/omit-if-no-ref/ iomuxc_eth4_rxd2_netc_pinmux_eth_rxd_netc_pinmux_eth4_rxd2: IOMUXC_ETH4_RXD2_NETC_PINMUX_ETH_RXD_NETC_PINMUX_ETH4_RXD2 {
		pinmux = <0x443c01a0 0 0x443c0640 0 0x443c04a4>;
	};
	/omit-if-no-ref/ iomuxc_eth4_rxd3_enet_ref_clk_root_enet_ref_clk_root: IOMUXC_ETH4_RXD3_ENET_REF_CLK_ROOT_ENET_REF_CLK_ROOT {
		pinmux = <0x443c01a4 1 0x0 0 0x443c04a8>;
	};
	/omit-if-no-ref/ iomuxc_eth4_rxd3_flexio1_3_2_flexio9_flexio1_3_2_flexio9: IOMUXC_ETH4_RXD3_FLEXIO1_3_2_FLEXIO9_FLEXIO1_3_2_FLEXIO9 {
		pinmux = <0x443c01a4 4 0x0 0 0x443c04a8>;
	};
	/omit-if-no-ref/ iomuxc_eth4_rxd3_flexio2_4_1_flexio13_flexio2_4_1_flexio13: IOMUXC_ETH4_RXD3_FLEXIO2_4_1_FLEXIO13_FLEXIO2_4_1_FLEXIO13 {
		pinmux = <0x443c01a4 3 0x0 0 0x443c04a8>;
	};
	/omit-if-no-ref/ iomuxc_eth4_rxd3_netc_pinmux_eth_rxd_netc_pinmux_eth4_rxd3: IOMUXC_ETH4_RXD3_NETC_PINMUX_ETH_RXD_NETC_PINMUX_ETH4_RXD3 {
		pinmux = <0x443c01a4 0 0x443c0644 0 0x443c04a8>;
	};
	/omit-if-no-ref/ iomuxc_eth4_tx_clk_flexio1_3_2_flexio0_flexio1_3_2_flexio0: IOMUXC_ETH4_TX_CLK_FLEXIO1_3_2_FLEXIO0_FLEXIO1_3_2_FLEXIO0 {
		pinmux = <0x443c0180 4 0x0 0 0x443c0484>;
	};
	/omit-if-no-ref/ iomuxc_eth4_tx_clk_netc_pinmux_eth_tx_clk_netc_pinmux_eth4_tx_clk: IOMUXC_ETH4_TX_CLK_NETC_PINMUX_ETH_TX_CLK_NETC_PINMUX_ETH4_TX_CLK {
		pinmux = <0x443c0180 0 0x443c0648 0 0x443c0484>;
	};
	/omit-if-no-ref/ iomuxc_eth4_tx_ctl_flexio1_3_2_flexio1_flexio1_3_2_flexio1: IOMUXC_ETH4_TX_CTL_FLEXIO1_3_2_FLEXIO1_FLEXIO1_3_2_FLEXIO1 {
		pinmux = <0x443c0184 4 0x0 0 0x443c0488>;
	};
	/omit-if-no-ref/ iomuxc_eth4_tx_ctl_netc_pinmux_eth_tx_ctl_netc_pinmux_eth4_tx_ctl: IOMUXC_ETH4_TX_CTL_NETC_PINMUX_ETH_TX_CTL_NETC_PINMUX_ETH4_TX_CTL {
		pinmux = <0x443c0184 0 0x0 0 0x443c0488>;
	};
	/omit-if-no-ref/ iomuxc_eth4_txd0_flexio1_3_2_flexio2_flexio1_3_2_flexio2: IOMUXC_ETH4_TXD0_FLEXIO1_3_2_FLEXIO2_FLEXIO1_3_2_FLEXIO2 {
		pinmux = <0x443c0188 4 0x0 0 0x443c048c>;
	};
	/omit-if-no-ref/ iomuxc_eth4_txd0_netc_pinmux_eth_txd_netc_pinmux_eth4_txd0: IOMUXC_ETH4_TXD0_NETC_PINMUX_ETH_TXD_NETC_PINMUX_ETH4_TXD0 {
		pinmux = <0x443c0188 0 0x0 0 0x443c048c>;
	};
	/omit-if-no-ref/ iomuxc_eth4_txd1_flexio1_3_2_flexio3_flexio1_3_2_flexio3: IOMUXC_ETH4_TXD1_FLEXIO1_3_2_FLEXIO3_FLEXIO1_3_2_FLEXIO3 {
		pinmux = <0x443c018c 4 0x0 0 0x443c0490>;
	};
	/omit-if-no-ref/ iomuxc_eth4_txd1_netc_pinmux_eth_txd_netc_pinmux_eth4_txd1: IOMUXC_ETH4_TXD1_NETC_PINMUX_ETH_TXD_NETC_PINMUX_ETH4_TXD1 {
		pinmux = <0x443c018c 0 0x0 0 0x443c0490>;
	};
	/omit-if-no-ref/ iomuxc_eth4_txd2_eth_rmii_ref_clk_eth4_rmii_ref50_clk: IOMUXC_ETH4_TXD2_ETH_RMII_REF_CLK_ETH4_RMII_REF50_CLK {
		pinmux = <0x443c0190 7 0x0 0 0x443c0494>;
	};
	/omit-if-no-ref/ iomuxc_eth4_txd2_flexio1_3_2_flexio4_flexio1_3_2_flexio4: IOMUXC_ETH4_TXD2_FLEXIO1_3_2_FLEXIO4_FLEXIO1_3_2_FLEXIO4 {
		pinmux = <0x443c0190 4 0x0 0 0x443c0494>;
	};
	/omit-if-no-ref/ iomuxc_eth4_txd2_netc_pinmux_eth_txd_netc_pinmux_eth4_txd2: IOMUXC_ETH4_TXD2_NETC_PINMUX_ETH_TXD_NETC_PINMUX_ETH4_TXD2 {
		pinmux = <0x443c0190 0 0x0 0 0x443c0494>;
	};
	/omit-if-no-ref/ iomuxc_eth4_txd3_flexio1_3_2_flexio5_flexio1_3_2_flexio5: IOMUXC_ETH4_TXD3_FLEXIO1_3_2_FLEXIO5_FLEXIO1_3_2_FLEXIO5 {
		pinmux = <0x443c0194 4 0x0 0 0x443c0498>;
	};
	/omit-if-no-ref/ iomuxc_eth4_txd3_netc_pinmux_eth_txd_netc_pinmux_eth4_txd3: IOMUXC_ETH4_TXD3_NETC_PINMUX_ETH_TXD_NETC_PINMUX_ETH4_TXD3 {
		pinmux = <0x443c0194 0 0x0 0 0x443c0498>;
	};
	/omit-if-no-ref/ iomuxc_gpio_io26_flexio1_3_1_flexio0_flexio1_3_1_flexio0: IOMUXC_GPIO_IO26_FLEXIO1_3_1_FLEXIO0_FLEXIO1_3_1_FLEXIO0 {
		pinmux = <0x443c0078 4 0x0 0 0x443c037c>;
	};
	/omit-if-no-ref/ iomuxc_gpio_io27_flexio1_3_1_flexio1_flexio1_3_1_flexio1: IOMUXC_GPIO_IO27_FLEXIO1_3_1_FLEXIO1_FLEXIO1_3_1_FLEXIO1 {
		pinmux = <0x443c007c 4 0x0 0 0x443c0380>;
	};
	/omit-if-no-ref/ iomuxc_gpio_io28_flexio1_3_1_flexio2_flexio1_3_1_flexio2: IOMUXC_GPIO_IO28_FLEXIO1_3_1_FLEXIO2_FLEXIO1_3_1_FLEXIO2 {
		pinmux = <0x443c0080 4 0x0 0 0x443c0384>;
	};
	/omit-if-no-ref/ iomuxc_gpio_io29_flexio1_3_1_flexio3_flexio1_3_1_flexio3: IOMUXC_GPIO_IO29_FLEXIO1_3_1_FLEXIO3_FLEXIO1_3_1_FLEXIO3 {
		pinmux = <0x443c0084 4 0x0 0 0x443c0388>;
	};
	/omit-if-no-ref/ iomuxc_gpio_io30_flexio1_3_1_flexio4_flexio1_3_1_flexio4: IOMUXC_GPIO_IO30_FLEXIO1_3_1_FLEXIO4_FLEXIO1_3_1_FLEXIO4 {
		pinmux = <0x443c0088 4 0x0 0 0x443c038c>;
	};
	/omit-if-no-ref/ iomuxc_gpio_io31_flexio1_3_1_flexio5_flexio1_3_1_flexio5: IOMUXC_GPIO_IO31_FLEXIO1_3_1_FLEXIO5_FLEXIO1_3_1_FLEXIO5 {
		pinmux = <0x443c008c 4 0x0 0 0x443c0390>;
	};
	/omit-if-no-ref/ iomuxc_gpio_io32_flexio1_3_1_flexio6_flexio1_3_1_flexio6: IOMUXC_GPIO_IO32_FLEXIO1_3_1_FLEXIO6_FLEXIO1_3_1_FLEXIO6 {
		pinmux = <0x443c0090 4 0x0 0 0x443c0394>;
	};
	/omit-if-no-ref/ iomuxc_gpio_io33_flexio1_3_1_flexio7_flexio1_3_1_flexio7: IOMUXC_GPIO_IO33_FLEXIO1_3_1_FLEXIO7_FLEXIO1_3_1_FLEXIO7 {
		pinmux = <0x443c0094 4 0x0 0 0x443c0398>;
	};
	/omit-if-no-ref/ iomuxc_gpio_io34_flexio1_3_1_flexio8_flexio1_3_1_flexio8: IOMUXC_GPIO_IO34_FLEXIO1_3_1_FLEXIO8_FLEXIO1_3_1_FLEXIO8 {
		pinmux = <0x443c0098 4 0x0 0 0x443c039c>;
	};
	/omit-if-no-ref/ iomuxc_gpio_io35_flexio1_3_1_flexio9_flexio1_3_1_flexio9: IOMUXC_GPIO_IO35_FLEXIO1_3_1_FLEXIO9_FLEXIO1_3_1_FLEXIO9 {
		pinmux = <0x443c009c 4 0x0 0 0x443c03a0>;
	};
	/omit-if-no-ref/ iomuxc_gpio_io36_flexio1_3_1_flexio10_flexio1_3_1_flexio10: IOMUXC_GPIO_IO36_FLEXIO1_3_1_FLEXIO10_FLEXIO1_3_1_FLEXIO10 {
		pinmux = <0x443c00a0 4 0x0 0 0x443c03a4>;
	};
	/omit-if-no-ref/ iomuxc_gpio_io37_flexio1_3_1_flexio11_flexio1_3_1_flexio11: IOMUXC_GPIO_IO37_FLEXIO1_3_1_FLEXIO11_FLEXIO1_3_1_FLEXIO11 {
		pinmux = <0x443c00a4 4 0x0 0 0x443c03a8>;
	};
	/omit-if-no-ref/ iomuxc_gpio_io38_flexio1_3_1_flexio12_flexio1_3_1_flexio12: IOMUXC_GPIO_IO38_FLEXIO1_3_1_FLEXIO12_FLEXIO1_3_1_FLEXIO12 {
		pinmux = <0x443c00a8 4 0x0 0 0x443c03ac>;
	};
	/omit-if-no-ref/ iomuxc_gpio_io39_flexio1_3_1_flexio13_flexio1_3_1_flexio13: IOMUXC_GPIO_IO39_FLEXIO1_3_1_FLEXIO13_FLEXIO1_3_1_FLEXIO13 {
		pinmux = <0x443c00ac 4 0x0 0 0x443c03b0>;
	};
	/omit-if-no-ref/ iomuxc_gpio_io40_flexio1_3_1_flexio14_flexio1_3_1_flexio14: IOMUXC_GPIO_IO40_FLEXIO1_3_1_FLEXIO14_FLEXIO1_3_1_FLEXIO14 {
		pinmux = <0x443c00b0 4 0x0 0 0x443c03b4>;
	};
	/omit-if-no-ref/ iomuxc_gpio_io41_flexio1_3_1_flexio15_flexio1_3_1_flexio15: IOMUXC_GPIO_IO41_FLEXIO1_3_1_FLEXIO15_FLEXIO1_3_1_FLEXIO15 {
		pinmux = <0x443c00b4 4 0x0 0 0x443c03b8>;
	};
	/omit-if-no-ref/ iomuxc_gpio_io57_enet_ref_clk_root_enet_ref_clk_root: IOMUXC_GPIO_IO57_ENET_REF_CLK_ROOT_ENET_REF_CLK_ROOT {
		pinmux = <0x443c00f4 7 0x0 0 0x443c03f8>;
	};
	/omit-if-no-ref/ iomuxc_sd1_clk_flexio2_4_1_flexio0_flexio2_4_1_flexio0: IOMUXC_SD1_CLK_FLEXIO2_4_1_FLEXIO0_FLEXIO2_4_1_FLEXIO0 {
		pinmux = <0x443c0230 4 0x0 0 0x443c0534>;
	};
	/omit-if-no-ref/ iomuxc_sd1_cmd_flexio2_4_1_flexio1_flexio2_4_1_flexio1: IOMUXC_SD1_CMD_FLEXIO2_4_1_FLEXIO1_FLEXIO2_4_1_FLEXIO1 {
		pinmux = <0x443c0234 4 0x0 0 0x443c0538>;
	};
	/omit-if-no-ref/ iomuxc_sd1_data0_flexio2_4_1_flexio2_flexio2_4_1_flexio2: IOMUXC_SD1_DATA0_FLEXIO2_4_1_FLEXIO2_FLEXIO2_4_1_FLEXIO2 {
		pinmux = <0x443c0238 4 0x0 0 0x443c053c>;
	};
	/omit-if-no-ref/ iomuxc_sd1_data1_flexio2_4_1_flexio3_flexio2_4_1_flexio3: IOMUXC_SD1_DATA1_FLEXIO2_4_1_FLEXIO3_FLEXIO2_4_1_FLEXIO3 {
		pinmux = <0x443c023c 4 0x0 0 0x443c0540>;
	};
	/omit-if-no-ref/ iomuxc_sd1_data2_flexio2_4_1_flexio4_flexio2_4_1_flexio4: IOMUXC_SD1_DATA2_FLEXIO2_4_1_FLEXIO4_FLEXIO2_4_1_FLEXIO4 {
		pinmux = <0x443c0240 4 0x0 0 0x443c0544>;
	};
	/omit-if-no-ref/ iomuxc_sd1_data3_flexio2_4_1_flexio5_flexio2_4_1_flexio5: IOMUXC_SD1_DATA3_FLEXIO2_4_1_FLEXIO5_FLEXIO2_4_1_FLEXIO5 {
		pinmux = <0x443c0244 4 0x0 0 0x443c0548>;
	};
	/omit-if-no-ref/ iomuxc_sd1_data4_flexio2_4_1_flexio6_flexio2_4_1_flexio6: IOMUXC_SD1_DATA4_FLEXIO2_4_1_FLEXIO6_FLEXIO2_4_1_FLEXIO6 {
		pinmux = <0x443c0248 4 0x0 0 0x443c054c>;
	};
	/omit-if-no-ref/ iomuxc_sd1_data5_flexio2_4_1_flexio7_flexio2_4_1_flexio7: IOMUXC_SD1_DATA5_FLEXIO2_4_1_FLEXIO7_FLEXIO2_4_1_FLEXIO7 {
		pinmux = <0x443c024c 4 0x0 0 0x443c0550>;
	};
	/omit-if-no-ref/ iomuxc_sd1_data6_flexio2_4_1_flexio8_flexio2_4_1_flexio8: IOMUXC_SD1_DATA6_FLEXIO2_4_1_FLEXIO8_FLEXIO2_4_1_FLEXIO8 {
		pinmux = <0x443c0250 4 0x0 0 0x443c0554>;
	};
	/omit-if-no-ref/ iomuxc_sd1_data7_flexio2_4_1_flexio9_flexio2_4_1_flexio9: IOMUXC_SD1_DATA7_FLEXIO2_4_1_FLEXIO9_FLEXIO2_4_1_FLEXIO9 {
		pinmux = <0x443c0254 4 0x0 0 0x443c0558>;
	};
	/omit-if-no-ref/ iomuxc_sd1_strobe_flexio2_4_1_flexio10_flexio2_4_1_flexio10: IOMUXC_SD1_STROBE_FLEXIO2_4_1_FLEXIO10_FLEXIO2_4_1_FLEXIO10 {
		pinmux = <0x443c0258 4 0x0 0 0x443c055c>;
	};
	/omit-if-no-ref/ iomuxc_sd2_cd_b_flexio2_4_2_flexio0_flexio2_4_2_flexio0: IOMUXC_SD2_CD_B_FLEXIO2_4_2_FLEXIO0_FLEXIO2_4_2_FLEXIO0 {
		pinmux = <0x443c0290 4 0x0 0 0x443c0594>;
	};
	/omit-if-no-ref/ iomuxc_sd2_cd_b_netc_pinmux_eth_rx_ctl_netc_pinmux_eth4_rx_ctl: IOMUXC_SD2_CD_B_NETC_PINMUX_ETH_RX_CTL_NETC_PINMUX_ETH4_RX_CTL {
		pinmux = <0x443c0290 1 0x443c0634 1 0x443c0594>;
	};
	/omit-if-no-ref/ iomuxc_sd2_clk_flexio2_4_2_flexio1_flexio2_4_2_flexio1: IOMUXC_SD2_CLK_FLEXIO2_4_2_FLEXIO1_FLEXIO2_4_2_FLEXIO1 {
		pinmux = <0x443c0294 4 0x0 0 0x443c0598>;
	};
	/omit-if-no-ref/ iomuxc_sd2_clk_netc_pinmux_eth_tx_clk_netc_pinmux_eth4_tx_clk: IOMUXC_SD2_CLK_NETC_PINMUX_ETH_TX_CLK_NETC_PINMUX_ETH4_TX_CLK {
		pinmux = <0x443c0294 1 0x443c0648 1 0x443c0598>;
	};
	/omit-if-no-ref/ iomuxc_sd2_cmd_flexio2_4_2_flexio2_flexio2_4_2_flexio2: IOMUXC_SD2_CMD_FLEXIO2_4_2_FLEXIO2_FLEXIO2_4_2_FLEXIO2 {
		pinmux = <0x443c0298 4 0x0 0 0x443c059c>;
	};
	/omit-if-no-ref/ iomuxc_sd2_cmd_netc_pinmux_eth_tx_ctl_netc_pinmux_eth4_tx_ctl: IOMUXC_SD2_CMD_NETC_PINMUX_ETH_TX_CTL_NETC_PINMUX_ETH4_TX_CTL {
		pinmux = <0x443c0298 1 0x0 0 0x443c059c>;
	};
	/omit-if-no-ref/ iomuxc_sd2_data0_flexio2_4_2_flexio3_flexio2_4_2_flexio3: IOMUXC_SD2_DATA0_FLEXIO2_4_2_FLEXIO3_FLEXIO2_4_2_FLEXIO3 {
		pinmux = <0x443c029c 4 0x0 0 0x443c05a0>;
	};
	/omit-if-no-ref/ iomuxc_sd2_data0_netc_pinmux_eth_txd_netc_pinmux_eth4_txd0: IOMUXC_SD2_DATA0_NETC_PINMUX_ETH_TXD_NETC_PINMUX_ETH4_TXD0 {
		pinmux = <0x443c029c 1 0x0 0 0x443c05a0>;
	};
	/omit-if-no-ref/ iomuxc_sd2_data1_flexio2_4_2_flexio4_flexio2_4_2_flexio4: IOMUXC_SD2_DATA1_FLEXIO2_4_2_FLEXIO4_FLEXIO2_4_2_FLEXIO4 {
		pinmux = <0x443c02a0 4 0x0 0 0x443c05a4>;
	};
	/omit-if-no-ref/ iomuxc_sd2_data1_netc_pinmux_eth_txd_netc_pinmux_eth4_txd1: IOMUXC_SD2_DATA1_NETC_PINMUX_ETH_TXD_NETC_PINMUX_ETH4_TXD1 {
		pinmux = <0x443c02a0 1 0x0 0 0x443c05a4>;
	};
	/omit-if-no-ref/ iomuxc_sd2_data2_flexio2_4_2_flexio5_flexio2_4_2_flexio5: IOMUXC_SD2_DATA2_FLEXIO2_4_2_FLEXIO5_FLEXIO2_4_2_FLEXIO5 {
		pinmux = <0x443c02a4 4 0x0 0 0x443c05a8>;
	};
	/omit-if-no-ref/ iomuxc_sd2_data2_netc_pinmux_eth_txd_netc_pinmux_eth4_txd2: IOMUXC_SD2_DATA2_NETC_PINMUX_ETH_TXD_NETC_PINMUX_ETH4_TXD2 {
		pinmux = <0x443c02a4 1 0x0 0 0x443c05a8>;
	};
	/omit-if-no-ref/ iomuxc_sd2_data3_flexio2_4_2_flexio6_flexio2_4_2_flexio6: IOMUXC_SD2_DATA3_FLEXIO2_4_2_FLEXIO6_FLEXIO2_4_2_FLEXIO6 {
		pinmux = <0x443c02a8 4 0x0 0 0x443c05ac>;
	};
	/omit-if-no-ref/ iomuxc_sd2_data3_netc_pinmux_eth_txd_netc_pinmux_eth4_txd3: IOMUXC_SD2_DATA3_NETC_PINMUX_ETH_TXD_NETC_PINMUX_ETH4_TXD3 {
		pinmux = <0x443c02a8 1 0x0 0 0x443c05ac>;
	};
	/omit-if-no-ref/ iomuxc_sd2_gpio0_flexio2_4_2_flexio8_flexio2_4_2_flexio8: IOMUXC_SD2_GPIO0_FLEXIO2_4_2_FLEXIO8_FLEXIO2_4_2_FLEXIO8 {
		pinmux = <0x443c02b0 4 0x0 0 0x443c05b4>;
	};
	/omit-if-no-ref/ iomuxc_sd2_gpio0_netc_pinmux_eth_rxd_netc_pinmux_eth4_rxd1: IOMUXC_SD2_GPIO0_NETC_PINMUX_ETH_RXD_NETC_PINMUX_ETH4_RXD1 {
		pinmux = <0x443c02b0 1 0x443c063c 1 0x443c05b4>;
	};
	/omit-if-no-ref/ iomuxc_sd2_gpio1_flexio2_4_2_flexio9_flexio2_4_2_flexio9: IOMUXC_SD2_GPIO1_FLEXIO2_4_2_FLEXIO9_FLEXIO2_4_2_FLEXIO9 {
		pinmux = <0x443c02b4 4 0x0 0 0x443c05b8>;
	};
	/omit-if-no-ref/ iomuxc_sd2_gpio1_netc_pinmux_eth_rxd_netc_pinmux_eth4_rxd2: IOMUXC_SD2_GPIO1_NETC_PINMUX_ETH_RXD_NETC_PINMUX_ETH4_RXD2 {
		pinmux = <0x443c02b4 1 0x443c0640 1 0x443c05b8>;
	};
	/omit-if-no-ref/ iomuxc_sd2_gpio2_flexio2_4_2_flexio10_flexio2_4_2_flexio10: IOMUXC_SD2_GPIO2_FLEXIO2_4_2_FLEXIO10_FLEXIO2_4_2_FLEXIO10 {
		pinmux = <0x443c02b8 4 0x0 0 0x443c05bc>;
	};
	/omit-if-no-ref/ iomuxc_sd2_gpio2_netc_pinmux_eth_rxd_netc_pinmux_eth4_rxd3: IOMUXC_SD2_GPIO2_NETC_PINMUX_ETH_RXD_NETC_PINMUX_ETH4_RXD3 {
		pinmux = <0x443c02b8 1 0x443c0644 1 0x443c05bc>;
	};
	/omit-if-no-ref/ iomuxc_sd2_gpio3_flexio2_4_2_flexio11_flexio2_4_2_flexio11: IOMUXC_SD2_GPIO3_FLEXIO2_4_2_FLEXIO11_FLEXIO2_4_2_FLEXIO11 {
		pinmux = <0x443c02bc 4 0x0 0 0x443c05c0>;
	};
	/omit-if-no-ref/ iomuxc_sd2_gpio3_netc_pinmux_eth_rx_clk_netc_pinmux_eth4_rx_clk: IOMUXC_SD2_GPIO3_NETC_PINMUX_ETH_RX_CLK_NETC_PINMUX_ETH4_RX_CLK {
		pinmux = <0x443c02bc 1 0x443c0630 1 0x443c05c0>;
	};
	/omit-if-no-ref/ iomuxc_sd2_reset_b_flexio2_4_2_flexio7_flexio2_4_2_flexio7: IOMUXC_SD2_RESET_B_FLEXIO2_4_2_FLEXIO7_FLEXIO2_4_2_FLEXIO7 {
		pinmux = <0x443c02ac 4 0x0 0 0x443c05b0>;
	};
	/omit-if-no-ref/ iomuxc_sd2_reset_b_netc_pinmux_eth_rxd_netc_pinmux_eth4_rxd0: IOMUXC_SD2_RESET_B_NETC_PINMUX_ETH_RXD_NETC_PINMUX_ETH4_RXD0 {
		pinmux = <0x443c02ac 1 0x443c0638 1 0x443c05b0>;
	};
	/omit-if-no-ref/ iomuxc_sd2_vselect_flexio2_4_1_flexio11_flexio2_4_1_flexio11: IOMUXC_SD2_VSELECT_FLEXIO2_4_1_FLEXIO11_FLEXIO2_4_1_FLEXIO11 {
		pinmux = <0x443c025c 4 0x443c0694 1 0x443c0560>;
	};
	/omit-if-no-ref/ iomuxc_xspi1_data0_flexio1_3_3_flexio0_flexio1_3_3_flexio0: IOMUXC_XSPI1_DATA0_FLEXIO1_3_3_FLEXIO0_FLEXIO1_3_3_FLEXIO0 {
		pinmux = <0x443c0260 4 0x0 0 0x443c0564>;
	};
	/omit-if-no-ref/ iomuxc_xspi1_data0_xspi_slv_data_xspi_slv_data0: IOMUXC_XSPI1_DATA0_XSPI_SLV_DATA_XSPI_SLV_DATA0 {
		pinmux = <0x443c0260 3 0x443c0908 1 0x443c0564>;
	};
	/omit-if-no-ref/ iomuxc_xspi1_data1_flexio1_3_3_flexio1_flexio1_3_3_flexio1: IOMUXC_XSPI1_DATA1_FLEXIO1_3_3_FLEXIO1_FLEXIO1_3_3_FLEXIO1 {
		pinmux = <0x443c0264 4 0x0 0 0x443c0568>;
	};
	/omit-if-no-ref/ iomuxc_xspi1_data1_xspi_slv_data_xspi_slv_data1: IOMUXC_XSPI1_DATA1_XSPI_SLV_DATA_XSPI_SLV_DATA1 {
		pinmux = <0x443c0264 3 0x443c090c 1 0x443c0568>;
	};
	/omit-if-no-ref/ iomuxc_xspi1_data2_flexio1_3_3_flexio2_flexio1_3_3_flexio2: IOMUXC_XSPI1_DATA2_FLEXIO1_3_3_FLEXIO2_FLEXIO1_3_3_FLEXIO2 {
		pinmux = <0x443c0268 4 0x0 0 0x443c056c>;
	};
	/omit-if-no-ref/ iomuxc_xspi1_data2_xspi_slv_data_xspi_slv_data2: IOMUXC_XSPI1_DATA2_XSPI_SLV_DATA_XSPI_SLV_DATA2 {
		pinmux = <0x443c0268 3 0x443c0910 1 0x443c056c>;
	};
	/omit-if-no-ref/ iomuxc_xspi1_data3_flexio1_3_3_flexio3_flexio1_3_3_flexio3: IOMUXC_XSPI1_DATA3_FLEXIO1_3_3_FLEXIO3_FLEXIO1_3_3_FLEXIO3 {
		pinmux = <0x443c026c 4 0x0 0 0x443c0570>;
	};
	/omit-if-no-ref/ iomuxc_xspi1_data3_xspi_slv_data_xspi_slv_data3: IOMUXC_XSPI1_DATA3_XSPI_SLV_DATA_XSPI_SLV_DATA3 {
		pinmux = <0x443c026c 3 0x443c0914 1 0x443c0570>;
	};
	/omit-if-no-ref/ iomuxc_xspi1_data4_flexio1_3_3_flexio4_flexio1_3_3_flexio4: IOMUXC_XSPI1_DATA4_FLEXIO1_3_3_FLEXIO4_FLEXIO1_3_3_FLEXIO4 {
		pinmux = <0x443c0270 4 0x0 0 0x443c0574>;
	};
	/omit-if-no-ref/ iomuxc_xspi1_data4_xspi_slv_data_xspi_slv_data4: IOMUXC_XSPI1_DATA4_XSPI_SLV_DATA_XSPI_SLV_DATA4 {
		pinmux = <0x443c0270 3 0x443c0918 1 0x443c0574>;
	};
	/omit-if-no-ref/ iomuxc_xspi1_data5_flexio1_3_3_flexio5_flexio1_3_3_flexio5: IOMUXC_XSPI1_DATA5_FLEXIO1_3_3_FLEXIO5_FLEXIO1_3_3_FLEXIO5 {
		pinmux = <0x443c0274 4 0x0 0 0x443c0578>;
	};
	/omit-if-no-ref/ iomuxc_xspi1_data5_xspi_slv_data_xspi_slv_data5: IOMUXC_XSPI1_DATA5_XSPI_SLV_DATA_XSPI_SLV_DATA5 {
		pinmux = <0x443c0274 3 0x443c091c 1 0x443c0578>;
	};
	/omit-if-no-ref/ iomuxc_xspi1_data6_flexio1_3_3_flexio6_flexio1_3_3_flexio6: IOMUXC_XSPI1_DATA6_FLEXIO1_3_3_FLEXIO6_FLEXIO1_3_3_FLEXIO6 {
		pinmux = <0x443c0278 4 0x0 0 0x443c057c>;
	};
	/omit-if-no-ref/ iomuxc_xspi1_data6_xspi_slv_data_xspi_slv_data6: IOMUXC_XSPI1_DATA6_XSPI_SLV_DATA_XSPI_SLV_DATA6 {
		pinmux = <0x443c0278 3 0x443c0920 1 0x443c057c>;
	};
	/omit-if-no-ref/ iomuxc_xspi1_data7_flexio1_3_3_flexio7_flexio1_3_3_flexio7: IOMUXC_XSPI1_DATA7_FLEXIO1_3_3_FLEXIO7_FLEXIO1_3_3_FLEXIO7 {
		pinmux = <0x443c027c 4 0x0 0 0x443c0580>;
	};
	/omit-if-no-ref/ iomuxc_xspi1_data7_xspi_slv_data_xspi_slv_data7: IOMUXC_XSPI1_DATA7_XSPI_SLV_DATA_XSPI_SLV_DATA7 {
		pinmux = <0x443c027c 3 0x443c0924 1 0x443c0580>;
	};
	/omit-if-no-ref/ iomuxc_xspi1_dqs_flexio1_3_3_flexio8_flexio1_3_3_flexio8: IOMUXC_XSPI1_DQS_FLEXIO1_3_3_FLEXIO8_FLEXIO1_3_3_FLEXIO8 {
		pinmux = <0x443c0280 4 0x0 0 0x443c0584>;
	};
	/omit-if-no-ref/ iomuxc_xspi1_sclk_flexio1_3_3_flexio9_flexio1_3_3_flexio9: IOMUXC_XSPI1_SCLK_FLEXIO1_3_3_FLEXIO9_FLEXIO1_3_3_FLEXIO9 {
		pinmux = <0x443c0284 4 0x0 0 0x443c0588>;
	};
	/omit-if-no-ref/ iomuxc_xspi1_ss0_b_flexio1_3_3_flexio10_flexio1_3_3_flexio10: IOMUXC_XSPI1_SS0_B_FLEXIO1_3_3_FLEXIO10_FLEXIO1_3_3_FLEXIO10 {
		pinmux = <0x443c0288 4 0x0 0 0x443c058c>;
	};
	/omit-if-no-ref/ iomuxc_xspi1_ss1_b_flexio1_3_3_flexio11_flexio1_3_3_flexio11: IOMUXC_XSPI1_SS1_B_FLEXIO1_3_3_FLEXIO11_FLEXIO1_3_3_FLEXIO11 {
		pinmux = <0x443c028c 4 0x0 0 0x443c0590>;
	};
};
