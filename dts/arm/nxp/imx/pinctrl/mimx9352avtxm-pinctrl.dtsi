/*
 * Copyright 2024, NXP
 * SPDX-License-Identifier: Apache-2.0
 *
 * Note: File generated by gen_soc_headers.py
 * from configuration data for MIMX9352AVTXM
 */

/*
 * Delta-deduplicated by dedup_pinctrl.py:
 * based on mimx9352cvuxk-pinctrl.dtsi with this part's differences applied
 * below (6 removed, 0 changed,
 * 1 added). Regenerate with dedup_pinctrl.py;
 * do not edit by hand.
 * target-hash: b66a4e2d2a62f881
 */

#include "mimx9352cvuxk-pinctrl.dtsi"

/delete-node/ &iomuxc1_enet1_rd3_flexspi_tester_trigger_flexspi1_tester_trigger;
/delete-node/ &iomuxc1_sd1_data1_ccmsrcgpcmix_int_boot_ccmsrcgpcmix_int_boot;
/delete-node/ &iomuxc1_sd1_data2_ccmsrcgpcmix_pmic_ready_ccmsrcgpcmix_pmic_ready;
/delete-node/ &iomuxc1_sd2_data1_ccmsrcgpcmix_wait_ccmsrcgpcmix_wait;
/delete-node/ &iomuxc1_sd2_data2_ccmsrcgpcmix_stop_ccmsrcgpcmix_stop;
/delete-node/ &iomuxc1_sd2_data3_ccmsrcgpcmix_early_reset_ccmsrcgpcmix_early_reset;

&iomuxc {
	/omit-if-no-ref/ iomuxc1_pdm_bit_stream1_nmi_glue_nmi_nmi_glue_nmi: IOMUXC1_PDM_BIT_STREAM1_NMI_GLUE_NMI_NMI_GLUE_NMI {
		pinmux = <0x443c0198 1 0x0 0 0x443c0348>;
	};
};
