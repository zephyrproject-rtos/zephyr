/*
 * Copyright (c) 2022, NXP
 * SPDX-License-Identifier: Apache-2.0
 *
 * Note: File generated by imx_cfg_utils.py
 * from configuration data for MIMX8MM6DVTLZ
 */

/*
 * Content deduplicated by dedup_pinctrl.py:
 * the pin mux data of this part is identical to mimx8mm6cvtkz-pinctrl.dtsi.
 * Do not edit; edit the canonical file instead.
 * target-hash: 14c663c9995133cb
 */

#include "mimx8mm6cvtkz-pinctrl.dtsi"
