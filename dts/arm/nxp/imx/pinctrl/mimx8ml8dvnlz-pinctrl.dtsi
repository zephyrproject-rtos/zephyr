/*
 * Copyright (c) 2022, NXP
 * SPDX-License-Identifier: Apache-2.0
 *
 * Note: File generated by imx_cfg_utils.py
 * from configuration data for MIMX8ML8DVNLZ
 */

/*
 * Content deduplicated by dedup_pinctrl.py:
 * the pin mux data of this part is identical to mimx8ml8cvnkz-pinctrl.dtsi.
 * Do not edit; edit the canonical file instead.
 * target-hash: 27e0912da0cd22ba
 */

#include "mimx8ml8cvnkz-pinctrl.dtsi"
