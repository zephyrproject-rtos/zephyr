/*
 * Copyright 2024, NXP
 * SPDX-License-Identifier: Apache-2.0
 *
 * Note: File generated by gen_soc_headers.py
 * from configuration data for MIMX9352DVVXM
 */

/*
 * Content deduplicated by dedup_pinctrl.py:
 * the pin mux data of this part is identical to mimx9352avtxm-pinctrl.dtsi.
 * Do not edit; edit the canonical file instead.
 * target-hash: 553111bb3e9760e3
 */

#include "mimx9352avtxm-pinctrl.dtsi"
