/*
 * Copyright 2024, NXP
 * SPDX-License-Identifier: Apache-2.0
 *
 * Note: File generated by gen_soc_headers.py
 * from configuration data for MIMX8MD7CVAHZ
 */

/*
 * SOC level pinctrl defintions
 * These definitions define SOC level defaults for each pin,
 * and select the pinmux for the pin. Pinmux entries are a tuple of:
 * <mux_register mux_mode input_register input_daisy config_register>
 * the mux_register and input_daisy reside in the IOMUXC peripheral, and
 * the pinctrl driver will write the mux_mode and input_daisy values into
 * each register, respectively. The config_register is used to configure
 * the pin based on the devicetree properties set
 */

&iomuxc {
	/omit-if-no-ref/ iomuxc_boot_mode0_src_boot_mode_src_boot_mode0: IOMUXC_BOOT_MODE0_SRC_BOOT_MODE_SRC_BOOT_MODE0 {
		pinmux = <0x0 0 0x0 0 0x30330258>;
	};
	/omit-if-no-ref/ iomuxc_boot_mode1_src_boot_mode_src_boot_mode1: IOMUXC_BOOT_MODE1_SRC_BOOT_MODE_SRC_BOOT_MODE1 {
		pinmux = <0x0 0 0x0 0 0x3033025c>;
	};
	/omit-if-no-ref/ iomuxc_ecspi1_miso_ecspi_miso_ecspi1_miso: IOMUXC_ECSPI1_MISO_ECSPI_MISO_ECSPI1_MISO {
		pinmux = <0x303301fc 0 0x0 0 0x30330464>;
	};
	/omit-if-no-ref/ iomuxc_ecspi1_miso_gpio_io_gpio5_io08: IOMUXC_ECSPI1_MISO_GPIO_IO_GPIO5_IO08 {
		pinmux = <0x303301fc 5 0x0 0 0x30330464>;
	};
	/omit-if-no-ref/ iomuxc_ecspi1_miso_uart_cts_b_uart3_cts_b: IOMUXC_ECSPI1_MISO_UART_CTS_B_UART3_CTS_B {
		pinmux = <0x303301fc 1 0x0 0 0x30330464>;
	};
	/omit-if-no-ref/ iomuxc_ecspi1_miso_uart_rts_b_uart3_cts_b: IOMUXC_ECSPI1_MISO_UART_RTS_B_UART3_CTS_B {
		pinmux = <0x303301fc 1 0x30330500 0 0x30330464>;
	};
	/omit-if-no-ref/ iomuxc_ecspi1_mosi_ecspi_mosi_ecspi1_mosi: IOMUXC_ECSPI1_MOSI_ECSPI_MOSI_ECSPI1_MOSI {
		pinmux = <0x303301f8 0 0x0 0 0x30330460>;
	};
	/omit-if-no-ref/ iomuxc_ecspi1_mosi_gpio_io_gpio5_io07: IOMUXC_ECSPI1_MOSI_GPIO_IO_GPIO5_IO07 {
		pinmux = <0x303301f8 5 0x0 0 0x30330460>;
	};
	/omit-if-no-ref/ iomuxc_ecspi1_mosi_uart_rx_uart3_tx: IOMUXC_ECSPI1_MOSI_UART_RX_UART3_TX {
		pinmux = <0x303301f8 1 0x30330504 1 0x30330460>;
	};
	/omit-if-no-ref/ iomuxc_ecspi1_mosi_uart_tx_uart3_tx: IOMUXC_ECSPI1_MOSI_UART_TX_UART3_TX {
		pinmux = <0x303301f8 1 0x0 0 0x30330460>;
	};
	/omit-if-no-ref/ iomuxc_ecspi1_sclk_ecspi_sclk_ecspi1_sclk: IOMUXC_ECSPI1_SCLK_ECSPI_SCLK_ECSPI1_SCLK {
		pinmux = <0x303301f4 0 0x0 0 0x3033045c>;
	};
	/omit-if-no-ref/ iomuxc_ecspi1_sclk_gpio_io_gpio5_io06: IOMUXC_ECSPI1_SCLK_GPIO_IO_GPIO5_IO06 {
		pinmux = <0x303301f4 5 0x0 0 0x3033045c>;
	};
	/omit-if-no-ref/ iomuxc_ecspi1_sclk_uart_rx_uart3_rx: IOMUXC_ECSPI1_SCLK_UART_RX_UART3_RX {
		pinmux = <0x303301f4 1 0x30330504 0 0x3033045c>;
	};
	/omit-if-no-ref/ iomuxc_ecspi1_sclk_uart_tx_uart3_rx: IOMUXC_ECSPI1_SCLK_UART_TX_UART3_RX {
		pinmux = <0x303301f4 1 0x0 0 0x3033045c>;
	};
	/omit-if-no-ref/ iomuxc_ecspi1_ss0_ecspi_ss_ecspi1_ss0: IOMUXC_ECSPI1_SS0_ECSPI_SS_ECSPI1_SS0 {
		pinmux = <0x30330200 0 0x0 0 0x30330468>;
	};
	/omit-if-no-ref/ iomuxc_ecspi1_ss0_gpio_io_gpio5_io09: IOMUXC_ECSPI1_SS0_GPIO_IO_GPIO5_IO09 {
		pinmux = <0x30330200 5 0x0 0 0x30330468>;
	};
	/omit-if-no-ref/ iomuxc_ecspi1_ss0_uart_cts_b_uart3_rts_b: IOMUXC_ECSPI1_SS0_UART_CTS_B_UART3_RTS_B {
		pinmux = <0x30330200 1 0x0 0 0x30330468>;
	};
	/omit-if-no-ref/ iomuxc_ecspi1_ss0_uart_rts_b_uart3_rts_b: IOMUXC_ECSPI1_SS0_UART_RTS_B_UART3_RTS_B {
		pinmux = <0x30330200 1 0x30330500 1 0x30330468>;
	};
	/omit-if-no-ref/ iomuxc_ecspi2_miso_ecspi_miso_ecspi2_miso: IOMUXC_ECSPI2_MISO_ECSPI_MISO_ECSPI2_MISO {
		pinmux = <0x3033020c 0 0x0 0 0x30330474>;
	};
	/omit-if-no-ref/ iomuxc_ecspi2_miso_gpio_io_gpio5_io12: IOMUXC_ECSPI2_MISO_GPIO_IO_GPIO5_IO12 {
		pinmux = <0x3033020c 5 0x0 0 0x30330474>;
	};
	/omit-if-no-ref/ iomuxc_ecspi2_miso_uart_cts_b_uart4_cts_b: IOMUXC_ECSPI2_MISO_UART_CTS_B_UART4_CTS_B {
		pinmux = <0x3033020c 1 0x0 0 0x30330474>;
	};
	/omit-if-no-ref/ iomuxc_ecspi2_miso_uart_rts_b_uart4_cts_b: IOMUXC_ECSPI2_MISO_UART_RTS_B_UART4_CTS_B {
		pinmux = <0x3033020c 1 0x30330508 0 0x30330474>;
	};
	/omit-if-no-ref/ iomuxc_ecspi2_mosi_ecspi_mosi_ecspi2_mosi: IOMUXC_ECSPI2_MOSI_ECSPI_MOSI_ECSPI2_MOSI {
		pinmux = <0x30330208 0 0x0 0 0x30330470>;
	};
	/omit-if-no-ref/ iomuxc_ecspi2_mosi_gpio_io_gpio5_io11: IOMUXC_ECSPI2_MOSI_GPIO_IO_GPIO5_IO11 {
		pinmux = <0x30330208 5 0x0 0 0x30330470>;
	};
	/omit-if-no-ref/ iomuxc_ecspi2_mosi_uart_rx_uart4_tx: IOMUXC_ECSPI2_MOSI_UART_RX_UART4_TX {
		pinmux = <0x30330208 1 0x3033050c 1 0x30330470>;
	};
	/omit-if-no-ref/ iomuxc_ecspi2_mosi_uart_tx_uart4_tx: IOMUXC_ECSPI2_MOSI_UART_TX_UART4_TX {
		pinmux = <0x30330208 1 0x0 0 0x30330470>;
	};
	/omit-if-no-ref/ iomuxc_ecspi2_sclk_ecspi_sclk_ecspi2_sclk: IOMUXC_ECSPI2_SCLK_ECSPI_SCLK_ECSPI2_SCLK {
		pinmux = <0x30330204 0 0x0 0 0x3033046c>;
	};
	/omit-if-no-ref/ iomuxc_ecspi2_sclk_gpio_io_gpio5_io10: IOMUXC_ECSPI2_SCLK_GPIO_IO_GPIO5_IO10 {
		pinmux = <0x30330204 5 0x0 0 0x3033046c>;
	};
	/omit-if-no-ref/ iomuxc_ecspi2_sclk_uart_rx_uart4_rx: IOMUXC_ECSPI2_SCLK_UART_RX_UART4_RX {
		pinmux = <0x30330204 1 0x3033050c 0 0x3033046c>;
	};
	/omit-if-no-ref/ iomuxc_ecspi2_sclk_uart_tx_uart4_rx: IOMUXC_ECSPI2_SCLK_UART_TX_UART4_RX {
		pinmux = <0x30330204 1 0x0 0 0x3033046c>;
	};
	/omit-if-no-ref/ iomuxc_ecspi2_ss0_ecspi_ss_ecspi2_ss0: IOMUXC_ECSPI2_SS0_ECSPI_SS_ECSPI2_SS0 {
		pinmux = <0x30330210 0 0x0 0 0x30330478>;
	};
	/omit-if-no-ref/ iomuxc_ecspi2_ss0_gpio_io_gpio5_io13: IOMUXC_ECSPI2_SS0_GPIO_IO_GPIO5_IO13 {
		pinmux = <0x30330210 5 0x0 0 0x30330478>;
	};
	/omit-if-no-ref/ iomuxc_ecspi2_ss0_uart_cts_b_uart4_rts_b: IOMUXC_ECSPI2_SS0_UART_CTS_B_UART4_RTS_B {
		pinmux = <0x30330210 1 0x0 0 0x30330478>;
	};
	/omit-if-no-ref/ iomuxc_ecspi2_ss0_uart_rts_b_uart4_rts_b: IOMUXC_ECSPI2_SS0_UART_RTS_B_UART4_RTS_B {
		pinmux = <0x30330210 1 0x30330508 1 0x30330478>;
	};
	/omit-if-no-ref/ iomuxc_enet_mdc_enet_mdc_enet1_mdc: IOMUXC_ENET_MDC_ENET_MDC_ENET1_MDC {
		pinmux = <0x30330068 0 0x0 0 0x303302d0>;
	};
	/omit-if-no-ref/ iomuxc_enet_mdc_gpio_io_gpio1_io16: IOMUXC_ENET_MDC_GPIO_IO_GPIO1_IO16 {
		pinmux = <0x30330068 5 0x0 0 0x303302d0>;
	};
	/omit-if-no-ref/ iomuxc_enet_mdio_enet_mdio_enet1_mdio: IOMUXC_ENET_MDIO_ENET_MDIO_ENET1_MDIO {
		pinmux = <0x3033006c 0 0x303304c0 1 0x303302d4>;
	};
	/omit-if-no-ref/ iomuxc_enet_mdio_gpio_io_gpio1_io17: IOMUXC_ENET_MDIO_GPIO_IO_GPIO1_IO17 {
		pinmux = <0x3033006c 5 0x0 0 0x303302d4>;
	};
	/omit-if-no-ref/ iomuxc_enet_rd0_enet_rgmii_rd_enet1_rgmii_rd0: IOMUXC_ENET_RD0_ENET_RGMII_RD_ENET1_RGMII_RD0 {
		pinmux = <0x30330090 0 0x0 0 0x303302f8>;
	};
	/omit-if-no-ref/ iomuxc_enet_rd0_gpio_io_gpio1_io26: IOMUXC_ENET_RD0_GPIO_IO_GPIO1_IO26 {
		pinmux = <0x30330090 5 0x0 0 0x303302f8>;
	};
	/omit-if-no-ref/ iomuxc_enet_rd1_enet_rgmii_rd_enet1_rgmii_rd1: IOMUXC_ENET_RD1_ENET_RGMII_RD_ENET1_RGMII_RD1 {
		pinmux = <0x30330094 0 0x0 0 0x303302fc>;
	};
	/omit-if-no-ref/ iomuxc_enet_rd1_gpio_io_gpio1_io27: IOMUXC_ENET_RD1_GPIO_IO_GPIO1_IO27 {
		pinmux = <0x30330094 5 0x0 0 0x303302fc>;
	};
	/omit-if-no-ref/ iomuxc_enet_rd2_enet_rgmii_rd_enet1_rgmii_rd2: IOMUXC_ENET_RD2_ENET_RGMII_RD_ENET1_RGMII_RD2 {
		pinmux = <0x30330098 0 0x0 0 0x30330300>;
	};
	/omit-if-no-ref/ iomuxc_enet_rd2_gpio_io_gpio1_io28: IOMUXC_ENET_RD2_GPIO_IO_GPIO1_IO28 {
		pinmux = <0x30330098 5 0x0 0 0x30330300>;
	};
	/omit-if-no-ref/ iomuxc_enet_rd3_enet_rgmii_rd_enet1_rgmii_rd3: IOMUXC_ENET_RD3_ENET_RGMII_RD_ENET1_RGMII_RD3 {
		pinmux = <0x3033009c 0 0x0 0 0x30330304>;
	};
	/omit-if-no-ref/ iomuxc_enet_rd3_gpio_io_gpio1_io29: IOMUXC_ENET_RD3_GPIO_IO_GPIO1_IO29 {
		pinmux = <0x3033009c 5 0x0 0 0x30330304>;
	};
	/omit-if-no-ref/ iomuxc_enet_rxc_enet_rgmii_rxc_enet1_rgmii_rxc: IOMUXC_ENET_RXC_ENET_RGMII_RXC_ENET1_RGMII_RXC {
		pinmux = <0x3033008c 0 0x0 0 0x303302f4>;
	};
	/omit-if-no-ref/ iomuxc_enet_rxc_enet_rx_er_enet1_rx_er: IOMUXC_ENET_RXC_ENET_RX_ER_ENET1_RX_ER {
		pinmux = <0x3033008c 1 0x0 0 0x303302f4>;
	};
	/omit-if-no-ref/ iomuxc_enet_rxc_gpio_io_gpio1_io25: IOMUXC_ENET_RXC_GPIO_IO_GPIO1_IO25 {
		pinmux = <0x3033008c 5 0x0 0 0x303302f4>;
	};
	/omit-if-no-ref/ iomuxc_enet_rx_ctl_enet_rgmii_rx_ctl_enet1_rgmii_rx_ctl: IOMUXC_ENET_RX_CTL_ENET_RGMII_RX_CTL_ENET1_RGMII_RX_CTL {
		pinmux = <0x30330088 0 0x0 0 0x303302f0>;
	};
	/omit-if-no-ref/ iomuxc_enet_rx_ctl_gpio_io_gpio1_io24: IOMUXC_ENET_RX_CTL_GPIO_IO_GPIO1_IO24 {
		pinmux = <0x30330088 5 0x0 0 0x303302f0>;
	};
	/omit-if-no-ref/ iomuxc_enet_td0_enet_rgmii_td_enet1_rgmii_td0: IOMUXC_ENET_TD0_ENET_RGMII_TD_ENET1_RGMII_TD0 {
		pinmux = <0x3033007c 0 0x0 0 0x303302e4>;
	};
	/omit-if-no-ref/ iomuxc_enet_td0_gpio_io_gpio1_io21: IOMUXC_ENET_TD0_GPIO_IO_GPIO1_IO21 {
		pinmux = <0x3033007c 5 0x0 0 0x303302e4>;
	};
	/omit-if-no-ref/ iomuxc_enet_td1_enet_rgmii_td_enet1_rgmii_td1: IOMUXC_ENET_TD1_ENET_RGMII_TD_ENET1_RGMII_TD1 {
		pinmux = <0x30330078 0 0x0 0 0x303302e0>;
	};
	/omit-if-no-ref/ iomuxc_enet_td1_gpio_io_gpio1_io20: IOMUXC_ENET_TD1_GPIO_IO_GPIO1_IO20 {
		pinmux = <0x30330078 5 0x0 0 0x303302e0>;
	};
	/omit-if-no-ref/ iomuxc_enet_td2_ccm_enet_ref_clk_root_ccm_enet_ref_clk_root: IOMUXC_ENET_TD2_CCM_ENET_REF_CLK_ROOT_CCM_ENET_REF_CLK_ROOT {
		pinmux = <0x30330074 1 0x0 0 0x303302dc>;
	};
	/omit-if-no-ref/ iomuxc_enet_td2_enet_rgmii_td_enet1_rgmii_td2: IOMUXC_ENET_TD2_ENET_RGMII_TD_ENET1_RGMII_TD2 {
		pinmux = <0x30330074 0 0x0 0 0x303302dc>;
	};
	/omit-if-no-ref/ iomuxc_enet_td2_enet_tx_clk_enet1_tx_clk: IOMUXC_ENET_TD2_ENET_TX_CLK_ENET1_TX_CLK {
		pinmux = <0x30330074 1 0x0 0 0x303302dc>;
	};
	/omit-if-no-ref/ iomuxc_enet_td2_gpio_io_gpio1_io19: IOMUXC_ENET_TD2_GPIO_IO_GPIO1_IO19 {
		pinmux = <0x30330074 5 0x0 0 0x303302dc>;
	};
	/omit-if-no-ref/ iomuxc_enet_td3_enet_rgmii_td_enet1_rgmii_td3: IOMUXC_ENET_TD3_ENET_RGMII_TD_ENET1_RGMII_TD3 {
		pinmux = <0x30330070 0 0x0 0 0x303302d8>;
	};
	/omit-if-no-ref/ iomuxc_enet_td3_gpio_io_gpio1_io18: IOMUXC_ENET_TD3_GPIO_IO_GPIO1_IO18 {
		pinmux = <0x30330070 5 0x0 0 0x303302d8>;
	};
	/omit-if-no-ref/ iomuxc_enet_txc_enet_rgmii_txc_enet1_rgmii_txc: IOMUXC_ENET_TXC_ENET_RGMII_TXC_ENET1_RGMII_TXC {
		pinmux = <0x30330084 0 0x0 0 0x303302ec>;
	};
	/omit-if-no-ref/ iomuxc_enet_txc_enet_tx_er_enet1_tx_er: IOMUXC_ENET_TXC_ENET_TX_ER_ENET1_TX_ER {
		pinmux = <0x30330084 1 0x0 0 0x303302ec>;
	};
	/omit-if-no-ref/ iomuxc_enet_txc_gpio_io_gpio1_io23: IOMUXC_ENET_TXC_GPIO_IO_GPIO1_IO23 {
		pinmux = <0x30330084 5 0x0 0 0x303302ec>;
	};
	/omit-if-no-ref/ iomuxc_enet_tx_ctl_enet_rgmii_tx_ctl_enet1_rgmii_tx_ctl: IOMUXC_ENET_TX_CTL_ENET_RGMII_TX_CTL_ENET1_RGMII_TX_CTL {
		pinmux = <0x30330080 0 0x0 0 0x303302e8>;
	};
	/omit-if-no-ref/ iomuxc_enet_tx_ctl_gpio_io_gpio1_io22: IOMUXC_ENET_TX_CTL_GPIO_IO_GPIO1_IO22 {
		pinmux = <0x30330080 5 0x0 0 0x303302e8>;
	};
	/omit-if-no-ref/ iomuxc_gpio1_io00_ccm_enet_phy_ref_clk_root_ccm_enet_phy_ref_clk_root: IOMUXC_GPIO1_IO00_CCM_ENET_PHY_REF_CLK_ROOT_CCM_ENET_PHY_REF_CLK_ROOT {
		pinmux = <0x30330028 1 0x0 0 0x30330290>;
	};
	/omit-if-no-ref/ iomuxc_gpio1_io00_ccm_ext_clk_ccm_ext_clk1: IOMUXC_GPIO1_IO00_CCM_EXT_CLK_CCM_EXT_CLK1 {
		pinmux = <0x30330028 6 0x0 0 0x30330290>;
	};
	/omit-if-no-ref/ iomuxc_gpio1_io00_gpio_io_gpio1_io00: IOMUXC_GPIO1_IO00_GPIO_IO_GPIO1_IO00 {
		pinmux = <0x30330028 0 0x0 0 0x30330290>;
	};
	/omit-if-no-ref/ iomuxc_gpio1_io00_xtalosc_ref_clk_32k_xtalosc_ref_clk_32k: IOMUXC_GPIO1_IO00_XTALOSC_REF_CLK_32K_XTALOSC_REF_CLK_32K {
		pinmux = <0x30330028 5 0x0 0 0x30330290>;
	};
	/omit-if-no-ref/ iomuxc_gpio1_io01_ccm_ext_clk_ccm_ext_clk2: IOMUXC_GPIO1_IO01_CCM_EXT_CLK_CCM_EXT_CLK2 {
		pinmux = <0x3033002c 6 0x0 0 0x30330294>;
	};
	/omit-if-no-ref/ iomuxc_gpio1_io01_gpio_io_gpio1_io01: IOMUXC_GPIO1_IO01_GPIO_IO_GPIO1_IO01 {
		pinmux = <0x3033002c 0 0x0 0 0x30330294>;
	};
	/omit-if-no-ref/ iomuxc_gpio1_io01_pwm_out_pwm1_out: IOMUXC_GPIO1_IO01_PWM_OUT_PWM1_OUT {
		pinmux = <0x3033002c 1 0x0 0 0x30330294>;
	};
	/omit-if-no-ref/ iomuxc_gpio1_io01_xtalosc_ref_clk_24m_xtalosc_ref_clk_24m: IOMUXC_GPIO1_IO01_XTALOSC_REF_CLK_24M_XTALOSC_REF_CLK_24M {
		pinmux = <0x3033002c 5 0x0 0 0x30330294>;
	};
	/omit-if-no-ref/ iomuxc_gpio1_io02_gpio_io_gpio1_io02: IOMUXC_GPIO1_IO02_GPIO_IO_GPIO1_IO02 {
		pinmux = <0x30330030 0 0x0 0 0x30330298>;
	};
	/omit-if-no-ref/ iomuxc_gpio1_io02_wdog_wdog_any_wdog1_wdog_any: IOMUXC_GPIO1_IO02_WDOG_WDOG_ANY_WDOG1_WDOG_ANY {
		pinmux = <0x30330030 5 0x0 0 0x30330298>;
	};
	/omit-if-no-ref/ iomuxc_gpio1_io02_wdog_wdog_b_wdog1_wdog_b: IOMUXC_GPIO1_IO02_WDOG_WDOG_B_WDOG1_WDOG_B {
		pinmux = <0x30330030 1 0x0 0 0x30330298>;
	};
	/omit-if-no-ref/ iomuxc_gpio1_io03_gpio_io_gpio1_io03: IOMUXC_GPIO1_IO03_GPIO_IO_GPIO1_IO03 {
		pinmux = <0x30330034 0 0x0 0 0x3033029c>;
	};
	/omit-if-no-ref/ iomuxc_gpio1_io03_sdma_ext_event_sdma1_ext_event0: IOMUXC_GPIO1_IO03_SDMA_EXT_EVENT_SDMA1_EXT_EVENT0 {
		pinmux = <0x30330034 5 0x0 0 0x3033029c>;
	};
	/omit-if-no-ref/ iomuxc_gpio1_io03_usdhc_vselect_usdhc1_vselect: IOMUXC_GPIO1_IO03_USDHC_VSELECT_USDHC1_VSELECT {
		pinmux = <0x30330034 1 0x0 0 0x3033029c>;
	};
	/omit-if-no-ref/ iomuxc_gpio1_io04_gpio_io_gpio1_io04: IOMUXC_GPIO1_IO04_GPIO_IO_GPIO1_IO04 {
		pinmux = <0x30330038 0 0x0 0 0x303302a0>;
	};
	/omit-if-no-ref/ iomuxc_gpio1_io04_sdma_ext_event_sdma1_ext_event1: IOMUXC_GPIO1_IO04_SDMA_EXT_EVENT_SDMA1_EXT_EVENT1 {
		pinmux = <0x30330038 5 0x0 0 0x303302a0>;
	};
	/omit-if-no-ref/ iomuxc_gpio1_io04_usdhc_vselect_usdhc2_vselect: IOMUXC_GPIO1_IO04_USDHC_VSELECT_USDHC2_VSELECT {
		pinmux = <0x30330038 1 0x0 0 0x303302a0>;
	};
	/omit-if-no-ref/ iomuxc_gpio1_io05_ccm_pmic_ready_ccm_pmic_ready: IOMUXC_GPIO1_IO05_CCM_PMIC_READY_CCM_PMIC_READY {
		pinmux = <0x3033003c 5 0x303304bc 0 0x303302a4>;
	};
	/omit-if-no-ref/ iomuxc_gpio1_io05_gpio_io_gpio1_io05: IOMUXC_GPIO1_IO05_GPIO_IO_GPIO1_IO05 {
		pinmux = <0x3033003c 0 0x0 0 0x303302a4>;
	};
	/omit-if-no-ref/ iomuxc_gpio1_io05_m4_nmi_m4_nmi: IOMUXC_GPIO1_IO05_M4_NMI_M4_NMI {
		pinmux = <0x3033003c 1 0x0 0 0x303302a4>;
	};
	/omit-if-no-ref/ iomuxc_gpio1_io06_ccm_ext_clk_ccm_ext_clk3: IOMUXC_GPIO1_IO06_CCM_EXT_CLK_CCM_EXT_CLK3 {
		pinmux = <0x30330040 6 0x0 0 0x303302a8>;
	};
	/omit-if-no-ref/ iomuxc_gpio1_io06_enet_mdc_enet1_mdc: IOMUXC_GPIO1_IO06_ENET_MDC_ENET1_MDC {
		pinmux = <0x30330040 1 0x0 0 0x303302a8>;
	};
	/omit-if-no-ref/ iomuxc_gpio1_io06_gpio_io_gpio1_io06: IOMUXC_GPIO1_IO06_GPIO_IO_GPIO1_IO06 {
		pinmux = <0x30330040 0 0x0 0 0x303302a8>;
	};
	/omit-if-no-ref/ iomuxc_gpio1_io06_usdhc_cd_b_usdhc1_cd_b: IOMUXC_GPIO1_IO06_USDHC_CD_B_USDHC1_CD_B {
		pinmux = <0x30330040 5 0x0 0 0x303302a8>;
	};
	/omit-if-no-ref/ iomuxc_gpio1_io07_ccm_ext_clk_ccm_ext_clk4: IOMUXC_GPIO1_IO07_CCM_EXT_CLK_CCM_EXT_CLK4 {
		pinmux = <0x30330044 6 0x0 0 0x303302ac>;
	};
	/omit-if-no-ref/ iomuxc_gpio1_io07_enet_mdio_enet1_mdio: IOMUXC_GPIO1_IO07_ENET_MDIO_ENET1_MDIO {
		pinmux = <0x30330044 1 0x303304c0 0 0x303302ac>;
	};
	/omit-if-no-ref/ iomuxc_gpio1_io07_gpio_io_gpio1_io07: IOMUXC_GPIO1_IO07_GPIO_IO_GPIO1_IO07 {
		pinmux = <0x30330044 0 0x0 0 0x303302ac>;
	};
	/omit-if-no-ref/ iomuxc_gpio1_io07_usdhc_wp_usdhc1_wp: IOMUXC_GPIO1_IO07_USDHC_WP_USDHC1_WP {
		pinmux = <0x30330044 5 0x0 0 0x303302ac>;
	};
	/omit-if-no-ref/ iomuxc_gpio1_io08_enet_1588_event0_in_enet1_1588_event0_in: IOMUXC_GPIO1_IO08_ENET_1588_EVENT0_IN_ENET1_1588_EVENT0_IN {
		pinmux = <0x30330048 1 0x0 0 0x303302b0>;
	};
	/omit-if-no-ref/ iomuxc_gpio1_io08_gpio_io_gpio1_io08: IOMUXC_GPIO1_IO08_GPIO_IO_GPIO1_IO08 {
		pinmux = <0x30330048 0 0x0 0 0x303302b0>;
	};
	/omit-if-no-ref/ iomuxc_gpio1_io08_usdhc_reset_b_usdhc2_reset_b: IOMUXC_GPIO1_IO08_USDHC_RESET_B_USDHC2_RESET_B {
		pinmux = <0x30330048 5 0x0 0 0x303302b0>;
	};
	/omit-if-no-ref/ iomuxc_gpio1_io09_enet_1588_event0_out_enet1_1588_event0_out: IOMUXC_GPIO1_IO09_ENET_1588_EVENT0_OUT_ENET1_1588_EVENT0_OUT {
		pinmux = <0x3033004c 1 0x0 0 0x303302b4>;
	};
	/omit-if-no-ref/ iomuxc_gpio1_io09_gpio_io_gpio1_io09: IOMUXC_GPIO1_IO09_GPIO_IO_GPIO1_IO09 {
		pinmux = <0x3033004c 0 0x0 0 0x303302b4>;
	};
	/omit-if-no-ref/ iomuxc_gpio1_io09_sdma_ext_event_sdma2_ext_event0: IOMUXC_GPIO1_IO09_SDMA_EXT_EVENT_SDMA2_EXT_EVENT0 {
		pinmux = <0x3033004c 5 0x0 0 0x303302b4>;
	};
	/omit-if-no-ref/ iomuxc_gpio1_io10_gpio_io_gpio1_io10: IOMUXC_GPIO1_IO10_GPIO_IO_GPIO1_IO10 {
		pinmux = <0x30330050 0 0x0 0 0x303302b8>;
	};
	/omit-if-no-ref/ iomuxc_gpio1_io10_usb_otg_id_usb1_otg_id: IOMUXC_GPIO1_IO10_USB_OTG_ID_USB1_OTG_ID {
		pinmux = <0x30330050 1 0x0 0 0x303302b8>;
	};
	/omit-if-no-ref/ iomuxc_gpio1_io11_ccm_pmic_ready_ccm_pmic_ready: IOMUXC_GPIO1_IO11_CCM_PMIC_READY_CCM_PMIC_READY {
		pinmux = <0x30330054 5 0x303304bc 1 0x303302bc>;
	};
	/omit-if-no-ref/ iomuxc_gpio1_io11_gpio_io_gpio1_io11: IOMUXC_GPIO1_IO11_GPIO_IO_GPIO1_IO11 {
		pinmux = <0x30330054 0 0x0 0 0x303302bc>;
	};
	/omit-if-no-ref/ iomuxc_gpio1_io11_usb_otg_id_usb2_otg_id: IOMUXC_GPIO1_IO11_USB_OTG_ID_USB2_OTG_ID {
		pinmux = <0x30330054 1 0x0 0 0x303302bc>;
	};
	/omit-if-no-ref/ iomuxc_gpio1_io12_gpio_io_gpio1_io12: IOMUXC_GPIO1_IO12_GPIO_IO_GPIO1_IO12 {
		pinmux = <0x30330058 0 0x0 0 0x303302c0>;
	};
	/omit-if-no-ref/ iomuxc_gpio1_io12_sdma_ext_event_sdma2_ext_event1: IOMUXC_GPIO1_IO12_SDMA_EXT_EVENT_SDMA2_EXT_EVENT1 {
		pinmux = <0x30330058 5 0x0 0 0x303302c0>;
	};
	/omit-if-no-ref/ iomuxc_gpio1_io12_usb_otg_pwr_usb1_otg_pwr: IOMUXC_GPIO1_IO12_USB_OTG_PWR_USB1_OTG_PWR {
		pinmux = <0x30330058 1 0x0 0 0x303302c0>;
	};
	/omit-if-no-ref/ iomuxc_gpio1_io13_gpio_io_gpio1_io13: IOMUXC_GPIO1_IO13_GPIO_IO_GPIO1_IO13 {
		pinmux = <0x3033005c 0 0x0 0 0x303302c4>;
	};
	/omit-if-no-ref/ iomuxc_gpio1_io13_pwm_out_pwm2_out: IOMUXC_GPIO1_IO13_PWM_OUT_PWM2_OUT {
		pinmux = <0x3033005c 5 0x0 0 0x303302c4>;
	};
	/omit-if-no-ref/ iomuxc_gpio1_io13_usb_otg_oc_usb1_otg_oc: IOMUXC_GPIO1_IO13_USB_OTG_OC_USB1_OTG_OC {
		pinmux = <0x3033005c 1 0x0 0 0x303302c4>;
	};
	/omit-if-no-ref/ iomuxc_gpio1_io14_ccm_clko_ccm_clko1: IOMUXC_GPIO1_IO14_CCM_CLKO_CCM_CLKO1 {
		pinmux = <0x30330060 6 0x0 0 0x303302c8>;
	};
	/omit-if-no-ref/ iomuxc_gpio1_io14_gpio_io_gpio1_io14: IOMUXC_GPIO1_IO14_GPIO_IO_GPIO1_IO14 {
		pinmux = <0x30330060 0 0x0 0 0x303302c8>;
	};
	/omit-if-no-ref/ iomuxc_gpio1_io14_pwm_out_pwm3_out: IOMUXC_GPIO1_IO14_PWM_OUT_PWM3_OUT {
		pinmux = <0x30330060 5 0x0 0 0x303302c8>;
	};
	/omit-if-no-ref/ iomuxc_gpio1_io14_usb_otg_pwr_usb2_otg_pwr: IOMUXC_GPIO1_IO14_USB_OTG_PWR_USB2_OTG_PWR {
		pinmux = <0x30330060 1 0x0 0 0x303302c8>;
	};
	/omit-if-no-ref/ iomuxc_gpio1_io15_ccm_clko_ccm_clko2: IOMUXC_GPIO1_IO15_CCM_CLKO_CCM_CLKO2 {
		pinmux = <0x30330064 6 0x0 0 0x303302cc>;
	};
	/omit-if-no-ref/ iomuxc_gpio1_io15_gpio_io_gpio1_io15: IOMUXC_GPIO1_IO15_GPIO_IO_GPIO1_IO15 {
		pinmux = <0x30330064 0 0x0 0 0x303302cc>;
	};
	/omit-if-no-ref/ iomuxc_gpio1_io15_pwm_out_pwm4_out: IOMUXC_GPIO1_IO15_PWM_OUT_PWM4_OUT {
		pinmux = <0x30330064 5 0x0 0 0x303302cc>;
	};
	/omit-if-no-ref/ iomuxc_gpio1_io15_usb_otg_oc_usb2_otg_oc: IOMUXC_GPIO1_IO15_USB_OTG_OC_USB2_OTG_OC {
		pinmux = <0x30330064 1 0x0 0 0x303302cc>;
	};
	/omit-if-no-ref/ iomuxc_i2c1_scl_enet_mdc_enet1_mdc: IOMUXC_I2C1_SCL_ENET_MDC_ENET1_MDC {
		pinmux = <0x30330214 1 0x0 0 0x3033047c>;
	};
	/omit-if-no-ref/ iomuxc_i2c1_scl_gpio_io_gpio5_io14: IOMUXC_I2C1_SCL_GPIO_IO_GPIO5_IO14 {
		pinmux = <0x30330214 5 0x0 0 0x3033047c>;
	};
	/omit-if-no-ref/ iomuxc_i2c1_scl_i2c_scl_i2c1_scl: IOMUXC_I2C1_SCL_I2C_SCL_I2C1_SCL {
		pinmux = <0x30330214 0 0x0 0 0x3033047c>;
	};
	/omit-if-no-ref/ iomuxc_i2c1_sda_enet_mdio_enet1_mdio: IOMUXC_I2C1_SDA_ENET_MDIO_ENET1_MDIO {
		pinmux = <0x30330218 1 0x303304c0 2 0x30330480>;
	};
	/omit-if-no-ref/ iomuxc_i2c1_sda_gpio_io_gpio5_io15: IOMUXC_I2C1_SDA_GPIO_IO_GPIO5_IO15 {
		pinmux = <0x30330218 5 0x0 0 0x30330480>;
	};
	/omit-if-no-ref/ iomuxc_i2c1_sda_i2c_sda_i2c1_sda: IOMUXC_I2C1_SDA_I2C_SDA_I2C1_SDA {
		pinmux = <0x30330218 0 0x0 0 0x30330480>;
	};
	/omit-if-no-ref/ iomuxc_i2c2_scl_enet_1588_event1_in_enet1_1588_event1_in: IOMUXC_I2C2_SCL_ENET_1588_EVENT1_IN_ENET1_1588_EVENT1_IN {
		pinmux = <0x3033021c 1 0x0 0 0x30330484>;
	};
	/omit-if-no-ref/ iomuxc_i2c2_scl_gpio_io_gpio5_io16: IOMUXC_I2C2_SCL_GPIO_IO_GPIO5_IO16 {
		pinmux = <0x3033021c 5 0x0 0 0x30330484>;
	};
	/omit-if-no-ref/ iomuxc_i2c2_scl_i2c_scl_i2c2_scl: IOMUXC_I2C2_SCL_I2C_SCL_I2C2_SCL {
		pinmux = <0x3033021c 0 0x0 0 0x30330484>;
	};
	/omit-if-no-ref/ iomuxc_i2c2_sda_enet_1588_event1_out_enet1_1588_event1_out: IOMUXC_I2C2_SDA_ENET_1588_EVENT1_OUT_ENET1_1588_EVENT1_OUT {
		pinmux = <0x30330220 1 0x0 0 0x30330488>;
	};
	/omit-if-no-ref/ iomuxc_i2c2_sda_gpio_io_gpio5_io17: IOMUXC_I2C2_SDA_GPIO_IO_GPIO5_IO17 {
		pinmux = <0x30330220 5 0x0 0 0x30330488>;
	};
	/omit-if-no-ref/ iomuxc_i2c2_sda_i2c_sda_i2c2_sda: IOMUXC_I2C2_SDA_I2C_SDA_I2C2_SDA {
		pinmux = <0x30330220 0 0x0 0 0x30330488>;
	};
	/omit-if-no-ref/ iomuxc_i2c3_scl_gpio_io_gpio5_io18: IOMUXC_I2C3_SCL_GPIO_IO_GPIO5_IO18 {
		pinmux = <0x30330224 5 0x0 0 0x3033048c>;
	};
	/omit-if-no-ref/ iomuxc_i2c3_scl_gpt_clk_gpt2_clk: IOMUXC_I2C3_SCL_GPT_CLK_GPT2_CLK {
		pinmux = <0x30330224 2 0x0 0 0x3033048c>;
	};
	/omit-if-no-ref/ iomuxc_i2c3_scl_i2c_scl_i2c3_scl: IOMUXC_I2C3_SCL_I2C_SCL_I2C3_SCL {
		pinmux = <0x30330224 0 0x0 0 0x3033048c>;
	};
	/omit-if-no-ref/ iomuxc_i2c3_scl_pwm_out_pwm4_out: IOMUXC_I2C3_SCL_PWM_OUT_PWM4_OUT {
		pinmux = <0x30330224 1 0x0 0 0x3033048c>;
	};
	/omit-if-no-ref/ iomuxc_i2c3_sda_gpio_io_gpio5_io19: IOMUXC_I2C3_SDA_GPIO_IO_GPIO5_IO19 {
		pinmux = <0x30330228 5 0x0 0 0x30330490>;
	};
	/omit-if-no-ref/ iomuxc_i2c3_sda_gpt_clk_gpt3_clk: IOMUXC_I2C3_SDA_GPT_CLK_GPT3_CLK {
		pinmux = <0x30330228 2 0x0 0 0x30330490>;
	};
	/omit-if-no-ref/ iomuxc_i2c3_sda_i2c_sda_i2c3_sda: IOMUXC_I2C3_SDA_I2C_SDA_I2C3_SDA {
		pinmux = <0x30330228 0 0x0 0 0x30330490>;
	};
	/omit-if-no-ref/ iomuxc_i2c3_sda_pwm_out_pwm3_out: IOMUXC_I2C3_SDA_PWM_OUT_PWM3_OUT {
		pinmux = <0x30330228 1 0x0 0 0x30330490>;
	};
	/omit-if-no-ref/ iomuxc_i2c4_scl_gpio_io_gpio5_io20: IOMUXC_I2C4_SCL_GPIO_IO_GPIO5_IO20 {
		pinmux = <0x3033022c 5 0x0 0 0x30330494>;
	};
	/omit-if-no-ref/ iomuxc_i2c4_scl_i2c_scl_i2c4_scl: IOMUXC_I2C4_SCL_I2C_SCL_I2C4_SCL {
		pinmux = <0x3033022c 0 0x0 0 0x30330494>;
	};
	/omit-if-no-ref/ iomuxc_i2c4_scl_pcie_clkreq_b_pcie1_clkreq_b: IOMUXC_I2C4_SCL_PCIE_CLKREQ_B_PCIE1_CLKREQ_B {
		pinmux = <0x3033022c 2 0x30330524 0 0x30330494>;
	};
	/omit-if-no-ref/ iomuxc_i2c4_scl_pwm_out_pwm2_out: IOMUXC_I2C4_SCL_PWM_OUT_PWM2_OUT {
		pinmux = <0x3033022c 1 0x0 0 0x30330494>;
	};
	/omit-if-no-ref/ iomuxc_i2c4_sda_gpio_io_gpio5_io21: IOMUXC_I2C4_SDA_GPIO_IO_GPIO5_IO21 {
		pinmux = <0x30330230 5 0x0 0 0x30330498>;
	};
	/omit-if-no-ref/ iomuxc_i2c4_sda_i2c_sda_i2c4_sda: IOMUXC_I2C4_SDA_I2C_SDA_I2C4_SDA {
		pinmux = <0x30330230 0 0x0 0 0x30330498>;
	};
	/omit-if-no-ref/ iomuxc_i2c4_sda_pcie_clkreq_b_pcie2_clkreq_b: IOMUXC_I2C4_SDA_PCIE_CLKREQ_B_PCIE2_CLKREQ_B {
		pinmux = <0x30330230 2 0x30330528 0 0x30330498>;
	};
	/omit-if-no-ref/ iomuxc_i2c4_sda_pwm_out_pwm1_out: IOMUXC_I2C4_SDA_PWM_OUT_PWM1_OUT {
		pinmux = <0x30330230 1 0x0 0 0x30330498>;
	};
	/omit-if-no-ref/ iomuxc_jtag_mod_jtag_mode_jtag_mode: IOMUXC_JTAG_MOD_JTAG_MODE_JTAG_MODE {
		pinmux = <0x0 0 0x0 0 0x30330260>;
	};
	/omit-if-no-ref/ iomuxc_jtag_tck_jtag_tck_jtag_tck: IOMUXC_JTAG_TCK_JTAG_TCK_JTAG_TCK {
		pinmux = <0x0 0 0x0 0 0x30330270>;
	};
	/omit-if-no-ref/ iomuxc_jtag_tdi_jtag_tdi_jtag_tdi: IOMUXC_JTAG_TDI_JTAG_TDI_JTAG_TDI {
		pinmux = <0x0 0 0x0 0 0x30330268>;
	};
	/omit-if-no-ref/ iomuxc_jtag_tdo_jtag_tdo_jtag_tdo: IOMUXC_JTAG_TDO_JTAG_TDO_JTAG_TDO {
		pinmux = <0x0 0 0x0 0 0x30330274>;
	};
	/omit-if-no-ref/ iomuxc_jtag_tms_jtag_tms_jtag_tms: IOMUXC_JTAG_TMS_JTAG_TMS_JTAG_TMS {
		pinmux = <0x0 0 0x0 0 0x3033026c>;
	};
	/omit-if-no-ref/ iomuxc_jtag_trst_b_jtag_trst_b_jtag_trst_b: IOMUXC_JTAG_TRST_B_JTAG_TRST_B_JTAG_TRST_B {
		pinmux = <0x0 0 0x0 0 0x30330264>;
	};
	/omit-if-no-ref/ iomuxc_nand_ale_gpio_io_gpio3_io00: IOMUXC_NAND_ALE_GPIO_IO_GPIO3_IO00 {
		pinmux = <0x303300f4 5 0x0 0 0x3033035c>;
	};
	/omit-if-no-ref/ iomuxc_nand_ale_nand_ale_nand_ale: IOMUXC_NAND_ALE_NAND_ALE_NAND_ALE {
		pinmux = <0x303300f4 0 0x0 0 0x3033035c>;
	};
	/omit-if-no-ref/ iomuxc_nand_ale_qspi_a_sclk_qspi_a_sclk: IOMUXC_NAND_ALE_QSPI_A_SCLK_QSPI_A_SCLK {
		pinmux = <0x303300f4 1 0x0 0 0x3033035c>;
	};
	/omit-if-no-ref/ iomuxc_nand_ce0_b_gpio_io_gpio3_io01: IOMUXC_NAND_CE0_B_GPIO_IO_GPIO3_IO01 {
		pinmux = <0x303300f8 5 0x0 0 0x30330360>;
	};
	/omit-if-no-ref/ iomuxc_nand_ce0_b_nand_ce0_b_nand_ce0_b: IOMUXC_NAND_CE0_B_NAND_CE0_B_NAND_CE0_B {
		pinmux = <0x303300f8 0 0x0 0 0x30330360>;
	};
	/omit-if-no-ref/ iomuxc_nand_ce0_b_qspi_a_ss0_b_qspi_a_ss0_b: IOMUXC_NAND_CE0_B_QSPI_A_SS0_B_QSPI_A_SS0_B {
		pinmux = <0x303300f8 1 0x0 0 0x30330360>;
	};
	/omit-if-no-ref/ iomuxc_nand_ce1_b_gpio_io_gpio3_io02: IOMUXC_NAND_CE1_B_GPIO_IO_GPIO3_IO02 {
		pinmux = <0x303300fc 5 0x0 0 0x30330364>;
	};
	/omit-if-no-ref/ iomuxc_nand_ce1_b_nand_ce1_b_nand_ce1_b: IOMUXC_NAND_CE1_B_NAND_CE1_B_NAND_CE1_B {
		pinmux = <0x303300fc 0 0x0 0 0x30330364>;
	};
	/omit-if-no-ref/ iomuxc_nand_ce1_b_qspi_a_ss1_b_qspi_a_ss1_b: IOMUXC_NAND_CE1_B_QSPI_A_SS1_B_QSPI_A_SS1_B {
		pinmux = <0x303300fc 1 0x0 0 0x30330364>;
	};
	/omit-if-no-ref/ iomuxc_nand_ce2_b_gpio_io_gpio3_io03: IOMUXC_NAND_CE2_B_GPIO_IO_GPIO3_IO03 {
		pinmux = <0x30330100 5 0x0 0 0x30330368>;
	};
	/omit-if-no-ref/ iomuxc_nand_ce2_b_nand_ce2_b_nand_ce2_b: IOMUXC_NAND_CE2_B_NAND_CE2_B_NAND_CE2_B {
		pinmux = <0x30330100 0 0x0 0 0x30330368>;
	};
	/omit-if-no-ref/ iomuxc_nand_ce2_b_qspi_b_ss0_b_qspi_b_ss0_b: IOMUXC_NAND_CE2_B_QSPI_B_SS0_B_QSPI_B_SS0_B {
		pinmux = <0x30330100 1 0x0 0 0x30330368>;
	};
	/omit-if-no-ref/ iomuxc_nand_ce3_b_gpio_io_gpio3_io04: IOMUXC_NAND_CE3_B_GPIO_IO_GPIO3_IO04 {
		pinmux = <0x30330104 5 0x0 0 0x3033036c>;
	};
	/omit-if-no-ref/ iomuxc_nand_ce3_b_nand_ce3_b_nand_ce3_b: IOMUXC_NAND_CE3_B_NAND_CE3_B_NAND_CE3_B {
		pinmux = <0x30330104 0 0x0 0 0x3033036c>;
	};
	/omit-if-no-ref/ iomuxc_nand_ce3_b_qspi_b_ss1_b_qspi_b_ss1_b: IOMUXC_NAND_CE3_B_QSPI_B_SS1_B_QSPI_B_SS1_B {
		pinmux = <0x30330104 1 0x0 0 0x3033036c>;
	};
	/omit-if-no-ref/ iomuxc_nand_cle_gpio_io_gpio3_io05: IOMUXC_NAND_CLE_GPIO_IO_GPIO3_IO05 {
		pinmux = <0x30330108 5 0x0 0 0x30330370>;
	};
	/omit-if-no-ref/ iomuxc_nand_cle_nand_cle_nand_cle: IOMUXC_NAND_CLE_NAND_CLE_NAND_CLE {
		pinmux = <0x30330108 0 0x0 0 0x30330370>;
	};
	/omit-if-no-ref/ iomuxc_nand_cle_qspi_b_sclk_qspi_b_sclk: IOMUXC_NAND_CLE_QSPI_B_SCLK_QSPI_B_SCLK {
		pinmux = <0x30330108 1 0x0 0 0x30330370>;
	};
	/omit-if-no-ref/ iomuxc_nand_data00_gpio_io_gpio3_io06: IOMUXC_NAND_DATA00_GPIO_IO_GPIO3_IO06 {
		pinmux = <0x3033010c 5 0x0 0 0x30330374>;
	};
	/omit-if-no-ref/ iomuxc_nand_data00_nand_data_nand_data00: IOMUXC_NAND_DATA00_NAND_DATA_NAND_DATA00 {
		pinmux = <0x3033010c 0 0x0 0 0x30330374>;
	};
	/omit-if-no-ref/ iomuxc_nand_data00_qspi_a_data_qspi_a_data0: IOMUXC_NAND_DATA00_QSPI_A_DATA_QSPI_A_DATA0 {
		pinmux = <0x3033010c 1 0x0 0 0x30330374>;
	};
	/omit-if-no-ref/ iomuxc_nand_data01_gpio_io_gpio3_io07: IOMUXC_NAND_DATA01_GPIO_IO_GPIO3_IO07 {
		pinmux = <0x30330110 5 0x0 0 0x30330378>;
	};
	/omit-if-no-ref/ iomuxc_nand_data01_nand_data_nand_data01: IOMUXC_NAND_DATA01_NAND_DATA_NAND_DATA01 {
		pinmux = <0x30330110 0 0x0 0 0x30330378>;
	};
	/omit-if-no-ref/ iomuxc_nand_data01_qspi_a_data_qspi_a_data1: IOMUXC_NAND_DATA01_QSPI_A_DATA_QSPI_A_DATA1 {
		pinmux = <0x30330110 1 0x0 0 0x30330378>;
	};
	/omit-if-no-ref/ iomuxc_nand_data02_gpio_io_gpio3_io08: IOMUXC_NAND_DATA02_GPIO_IO_GPIO3_IO08 {
		pinmux = <0x30330114 5 0x0 0 0x3033037c>;
	};
	/omit-if-no-ref/ iomuxc_nand_data02_nand_data_nand_data02: IOMUXC_NAND_DATA02_NAND_DATA_NAND_DATA02 {
		pinmux = <0x30330114 0 0x0 0 0x3033037c>;
	};
	/omit-if-no-ref/ iomuxc_nand_data02_qspi_a_data_qspi_a_data2: IOMUXC_NAND_DATA02_QSPI_A_DATA_QSPI_A_DATA2 {
		pinmux = <0x30330114 1 0x0 0 0x3033037c>;
	};
	/omit-if-no-ref/ iomuxc_nand_data03_gpio_io_gpio3_io09: IOMUXC_NAND_DATA03_GPIO_IO_GPIO3_IO09 {
		pinmux = <0x30330118 5 0x0 0 0x30330380>;
	};
	/omit-if-no-ref/ iomuxc_nand_data03_nand_data_nand_data03: IOMUXC_NAND_DATA03_NAND_DATA_NAND_DATA03 {
		pinmux = <0x30330118 0 0x0 0 0x30330380>;
	};
	/omit-if-no-ref/ iomuxc_nand_data03_qspi_a_data_qspi_a_data3: IOMUXC_NAND_DATA03_QSPI_A_DATA_QSPI_A_DATA3 {
		pinmux = <0x30330118 1 0x0 0 0x30330380>;
	};
	/omit-if-no-ref/ iomuxc_nand_data04_gpio_io_gpio3_io10: IOMUXC_NAND_DATA04_GPIO_IO_GPIO3_IO10 {
		pinmux = <0x3033011c 5 0x0 0 0x30330384>;
	};
	/omit-if-no-ref/ iomuxc_nand_data04_nand_data_nand_data04: IOMUXC_NAND_DATA04_NAND_DATA_NAND_DATA04 {
		pinmux = <0x3033011c 0 0x0 0 0x30330384>;
	};
	/omit-if-no-ref/ iomuxc_nand_data04_qspi_b_data_qspi_b_data0: IOMUXC_NAND_DATA04_QSPI_B_DATA_QSPI_B_DATA0 {
		pinmux = <0x3033011c 1 0x0 0 0x30330384>;
	};
	/omit-if-no-ref/ iomuxc_nand_data05_gpio_io_gpio3_io11: IOMUXC_NAND_DATA05_GPIO_IO_GPIO3_IO11 {
		pinmux = <0x30330120 5 0x0 0 0x30330388>;
	};
	/omit-if-no-ref/ iomuxc_nand_data05_nand_data_nand_data05: IOMUXC_NAND_DATA05_NAND_DATA_NAND_DATA05 {
		pinmux = <0x30330120 0 0x0 0 0x30330388>;
	};
	/omit-if-no-ref/ iomuxc_nand_data05_qspi_b_data_qspi_b_data1: IOMUXC_NAND_DATA05_QSPI_B_DATA_QSPI_B_DATA1 {
		pinmux = <0x30330120 1 0x0 0 0x30330388>;
	};
	/omit-if-no-ref/ iomuxc_nand_data06_gpio_io_gpio3_io12: IOMUXC_NAND_DATA06_GPIO_IO_GPIO3_IO12 {
		pinmux = <0x30330124 5 0x0 0 0x3033038c>;
	};
	/omit-if-no-ref/ iomuxc_nand_data06_nand_data_nand_data06: IOMUXC_NAND_DATA06_NAND_DATA_NAND_DATA06 {
		pinmux = <0x30330124 0 0x0 0 0x3033038c>;
	};
	/omit-if-no-ref/ iomuxc_nand_data06_qspi_b_data_qspi_b_data2: IOMUXC_NAND_DATA06_QSPI_B_DATA_QSPI_B_DATA2 {
		pinmux = <0x30330124 1 0x0 0 0x3033038c>;
	};
	/omit-if-no-ref/ iomuxc_nand_data07_gpio_io_gpio3_io13: IOMUXC_NAND_DATA07_GPIO_IO_GPIO3_IO13 {
		pinmux = <0x30330128 5 0x0 0 0x30330390>;
	};
	/omit-if-no-ref/ iomuxc_nand_data07_nand_data_nand_data07: IOMUXC_NAND_DATA07_NAND_DATA_NAND_DATA07 {
		pinmux = <0x30330128 0 0x0 0 0x30330390>;
	};
	/omit-if-no-ref/ iomuxc_nand_data07_qspi_b_data_qspi_b_data3: IOMUXC_NAND_DATA07_QSPI_B_DATA_QSPI_B_DATA3 {
		pinmux = <0x30330128 1 0x0 0 0x30330390>;
	};
	/omit-if-no-ref/ iomuxc_nand_dqs_gpio_io_gpio3_io14: IOMUXC_NAND_DQS_GPIO_IO_GPIO3_IO14 {
		pinmux = <0x3033012c 5 0x0 0 0x30330394>;
	};
	/omit-if-no-ref/ iomuxc_nand_dqs_nand_dqs_nand_dqs: IOMUXC_NAND_DQS_NAND_DQS_NAND_DQS {
		pinmux = <0x3033012c 0 0x0 0 0x30330394>;
	};
	/omit-if-no-ref/ iomuxc_nand_dqs_qspi_a_dqs_qspi_a_dqs: IOMUXC_NAND_DQS_QSPI_A_DQS_QSPI_A_DQS {
		pinmux = <0x3033012c 1 0x0 0 0x30330394>;
	};
	/omit-if-no-ref/ iomuxc_nand_ready_b_gpio_io_gpio3_io16: IOMUXC_NAND_READY_B_GPIO_IO_GPIO3_IO16 {
		pinmux = <0x30330134 5 0x0 0 0x3033039c>;
	};
	/omit-if-no-ref/ iomuxc_nand_ready_b_nand_ready_b_nand_ready_b: IOMUXC_NAND_READY_B_NAND_READY_B_NAND_READY_B {
		pinmux = <0x30330134 0 0x0 0 0x3033039c>;
	};
	/omit-if-no-ref/ iomuxc_nand_re_b_gpio_io_gpio3_io15: IOMUXC_NAND_RE_B_GPIO_IO_GPIO3_IO15 {
		pinmux = <0x30330130 5 0x0 0 0x30330398>;
	};
	/omit-if-no-ref/ iomuxc_nand_re_b_nand_re_b_nand_re_b: IOMUXC_NAND_RE_B_NAND_RE_B_NAND_RE_B {
		pinmux = <0x30330130 0 0x0 0 0x30330398>;
	};
	/omit-if-no-ref/ iomuxc_nand_re_b_qspi_b_dqs_qspi_b_dqs: IOMUXC_NAND_RE_B_QSPI_B_DQS_QSPI_B_DQS {
		pinmux = <0x30330130 1 0x0 0 0x30330398>;
	};
	/omit-if-no-ref/ iomuxc_nand_we_b_gpio_io_gpio3_io17: IOMUXC_NAND_WE_B_GPIO_IO_GPIO3_IO17 {
		pinmux = <0x30330138 5 0x0 0 0x303303a0>;
	};
	/omit-if-no-ref/ iomuxc_nand_we_b_nand_we_b_nand_we_b: IOMUXC_NAND_WE_B_NAND_WE_B_NAND_WE_B {
		pinmux = <0x30330138 0 0x0 0 0x303303a0>;
	};
	/omit-if-no-ref/ iomuxc_nand_wp_b_gpio_io_gpio3_io18: IOMUXC_NAND_WP_B_GPIO_IO_GPIO3_IO18 {
		pinmux = <0x3033013c 5 0x0 0 0x303303a4>;
	};
	/omit-if-no-ref/ iomuxc_nand_wp_b_nand_wp_b_nand_wp_b: IOMUXC_NAND_WP_B_NAND_WP_B_NAND_WP_B {
		pinmux = <0x3033013c 0 0x0 0 0x303303a4>;
	};
	/omit-if-no-ref/ iomuxc_onoff_snvs_onoff_snvs_onoff: IOMUXC_ONOFF_SNVS_ONOFF_SNVS_ONOFF {
		pinmux = <0x0 0 0x0 0 0x30330284>;
	};
	/omit-if-no-ref/ iomuxc_pmic_on_req_snvs_pmic_on_req_snvs_pmic_on_req: IOMUXC_PMIC_ON_REQ_SNVS_PMIC_ON_REQ_SNVS_PMIC_ON_REQ {
		pinmux = <0x0 0 0x0 0 0x30330280>;
	};
	/omit-if-no-ref/ iomuxc_pmic_stby_req_ccm_pmic_stby_req_ccm_pmic_stby_req: IOMUXC_PMIC_STBY_REQ_CCM_PMIC_STBY_REQ_CCM_PMIC_STBY_REQ {
		pinmux = <0x0 0 0x0 0 0x3033027c>;
	};
	/omit-if-no-ref/ iomuxc_por_b_snvs_por_b_snvs_por_b: IOMUXC_POR_B_SNVS_POR_B_SNVS_POR_B {
		pinmux = <0x0 0 0x0 0 0x30330288>;
	};
	/omit-if-no-ref/ iomuxc_rtc_snvs_rtc_snvs_rtc: IOMUXC_RTC_SNVS_RTC_SNVS_RTC {
		pinmux = <0x0 0 0x0 0 0x30330278>;
	};
	/omit-if-no-ref/ iomuxc_rtc_reset_b_snvs_rtc_reset_b_snvs_rtc_reset_b: IOMUXC_RTC_RESET_B_SNVS_RTC_RESET_B_SNVS_RTC_RESET_B {
		pinmux = <0x0 0 0x0 0 0x3033028c>;
	};
	/omit-if-no-ref/ iomuxc_sai1_mclk_gpio_io_gpio4_io20: IOMUXC_SAI1_MCLK_GPIO_IO_GPIO4_IO20 {
		pinmux = <0x303301ac 5 0x0 0 0x30330414>;
	};
	/omit-if-no-ref/ iomuxc_sai1_mclk_sai_mclk_sai1_mclk: IOMUXC_SAI1_MCLK_SAI_MCLK_SAI1_MCLK {
		pinmux = <0x303301ac 0 0x0 0 0x30330414>;
	};
	/omit-if-no-ref/ iomuxc_sai1_mclk_sai_mclk_sai5_mclk: IOMUXC_SAI1_MCLK_SAI_MCLK_SAI5_MCLK {
		pinmux = <0x303301ac 1 0x3033052c 1 0x30330414>;
	};
	/omit-if-no-ref/ iomuxc_sai1_mclk_sai_tx_bclk_sai1_tx_bclk: IOMUXC_SAI1_MCLK_SAI_TX_BCLK_SAI1_TX_BCLK {
		pinmux = <0x303301ac 2 0x303304c8 2 0x30330414>;
	};
	/omit-if-no-ref/ iomuxc_sai1_rxc_arm_platform_trace_ctl_arm_platform_trace_ctl: IOMUXC_SAI1_RXC_ARM_PLATFORM_TRACE_CTL_ARM_PLATFORM_TRACE_CTL {
		pinmux = <0x30330160 4 0x0 0 0x303303c8>;
	};
	/omit-if-no-ref/ iomuxc_sai1_rxc_gpio_io_gpio4_io01: IOMUXC_SAI1_RXC_GPIO_IO_GPIO4_IO01 {
		pinmux = <0x30330160 5 0x0 0 0x303303c8>;
	};
	/omit-if-no-ref/ iomuxc_sai1_rxc_sai_rx_bclk_sai1_rx_bclk: IOMUXC_SAI1_RXC_SAI_RX_BCLK_SAI1_RX_BCLK {
		pinmux = <0x30330160 0 0x0 0 0x303303c8>;
	};
	/omit-if-no-ref/ iomuxc_sai1_rxc_sai_rx_bclk_sai5_rx_bclk: IOMUXC_SAI1_RXC_SAI_RX_BCLK_SAI5_RX_BCLK {
		pinmux = <0x30330160 1 0x303304d0 1 0x303303c8>;
	};
	/omit-if-no-ref/ iomuxc_sai1_rxd0_arm_platform_trace_arm_platform_trace0: IOMUXC_SAI1_RXD0_ARM_PLATFORM_TRACE_ARM_PLATFORM_TRACE0 {
		pinmux = <0x30330164 4 0x0 0 0x303303cc>;
	};
	/omit-if-no-ref/ iomuxc_sai1_rxd0_gpio_io_gpio4_io02: IOMUXC_SAI1_RXD0_GPIO_IO_GPIO4_IO02 {
		pinmux = <0x30330164 5 0x0 0 0x303303cc>;
	};
	/omit-if-no-ref/ iomuxc_sai1_rxd0_sai_rx_data_sai1_rx_data0: IOMUXC_SAI1_RXD0_SAI_RX_DATA_SAI1_RX_DATA0 {
		pinmux = <0x30330164 0 0x0 0 0x303303cc>;
	};
	/omit-if-no-ref/ iomuxc_sai1_rxd0_sai_rx_data_sai5_rx_data0: IOMUXC_SAI1_RXD0_SAI_RX_DATA_SAI5_RX_DATA0 {
		pinmux = <0x30330164 1 0x303304d4 1 0x303303cc>;
	};
	/omit-if-no-ref/ iomuxc_sai1_rxd0_src_boot_cfg_src_boot_cfg0: IOMUXC_SAI1_RXD0_SRC_BOOT_CFG_SRC_BOOT_CFG0 {
		pinmux = <0x30330164 6 0x0 0 0x303303cc>;
	};
	/omit-if-no-ref/ iomuxc_sai1_rxd1_arm_platform_trace_arm_platform_trace1: IOMUXC_SAI1_RXD1_ARM_PLATFORM_TRACE_ARM_PLATFORM_TRACE1 {
		pinmux = <0x30330168 4 0x0 0 0x303303d0>;
	};
	/omit-if-no-ref/ iomuxc_sai1_rxd1_gpio_io_gpio4_io03: IOMUXC_SAI1_RXD1_GPIO_IO_GPIO4_IO03 {
		pinmux = <0x30330168 5 0x0 0 0x303303d0>;
	};
	/omit-if-no-ref/ iomuxc_sai1_rxd1_sai_rx_data_sai1_rx_data1: IOMUXC_SAI1_RXD1_SAI_RX_DATA_SAI1_RX_DATA1 {
		pinmux = <0x30330168 0 0x0 0 0x303303d0>;
	};
	/omit-if-no-ref/ iomuxc_sai1_rxd1_sai_rx_data_sai5_rx_data1: IOMUXC_SAI1_RXD1_SAI_RX_DATA_SAI5_RX_DATA1 {
		pinmux = <0x30330168 1 0x303304d8 1 0x303303d0>;
	};
	/omit-if-no-ref/ iomuxc_sai1_rxd1_src_boot_cfg_src_boot_cfg1: IOMUXC_SAI1_RXD1_SRC_BOOT_CFG_SRC_BOOT_CFG1 {
		pinmux = <0x30330168 6 0x0 0 0x303303d0>;
	};
	/omit-if-no-ref/ iomuxc_sai1_rxd2_arm_platform_trace_arm_platform_trace2: IOMUXC_SAI1_RXD2_ARM_PLATFORM_TRACE_ARM_PLATFORM_TRACE2 {
		pinmux = <0x3033016c 4 0x0 0 0x303303d4>;
	};
	/omit-if-no-ref/ iomuxc_sai1_rxd2_gpio_io_gpio4_io04: IOMUXC_SAI1_RXD2_GPIO_IO_GPIO4_IO04 {
		pinmux = <0x3033016c 5 0x0 0 0x303303d4>;
	};
	/omit-if-no-ref/ iomuxc_sai1_rxd2_sai_rx_data_sai1_rx_data2: IOMUXC_SAI1_RXD2_SAI_RX_DATA_SAI1_RX_DATA2 {
		pinmux = <0x3033016c 0 0x0 0 0x303303d4>;
	};
	/omit-if-no-ref/ iomuxc_sai1_rxd2_sai_rx_data_sai5_rx_data2: IOMUXC_SAI1_RXD2_SAI_RX_DATA_SAI5_RX_DATA2 {
		pinmux = <0x3033016c 1 0x303304dc 1 0x303303d4>;
	};
	/omit-if-no-ref/ iomuxc_sai1_rxd2_src_boot_cfg_src_boot_cfg2: IOMUXC_SAI1_RXD2_SRC_BOOT_CFG_SRC_BOOT_CFG2 {
		pinmux = <0x3033016c 6 0x0 0 0x303303d4>;
	};
	/omit-if-no-ref/ iomuxc_sai1_rxd3_arm_platform_trace_arm_platform_trace3: IOMUXC_SAI1_RXD3_ARM_PLATFORM_TRACE_ARM_PLATFORM_TRACE3 {
		pinmux = <0x30330170 4 0x0 0 0x303303d8>;
	};
	/omit-if-no-ref/ iomuxc_sai1_rxd3_gpio_io_gpio4_io05: IOMUXC_SAI1_RXD3_GPIO_IO_GPIO4_IO05 {
		pinmux = <0x30330170 5 0x0 0 0x303303d8>;
	};
	/omit-if-no-ref/ iomuxc_sai1_rxd3_sai_rx_data_sai1_rx_data3: IOMUXC_SAI1_RXD3_SAI_RX_DATA_SAI1_RX_DATA3 {
		pinmux = <0x30330170 0 0x0 0 0x303303d8>;
	};
	/omit-if-no-ref/ iomuxc_sai1_rxd3_sai_rx_data_sai5_rx_data3: IOMUXC_SAI1_RXD3_SAI_RX_DATA_SAI5_RX_DATA3 {
		pinmux = <0x30330170 1 0x303304e0 1 0x303303d8>;
	};
	/omit-if-no-ref/ iomuxc_sai1_rxd3_src_boot_cfg_src_boot_cfg3: IOMUXC_SAI1_RXD3_SRC_BOOT_CFG_SRC_BOOT_CFG3 {
		pinmux = <0x30330170 6 0x0 0 0x303303d8>;
	};
	/omit-if-no-ref/ iomuxc_sai1_rxd4_arm_platform_trace_arm_platform_trace4: IOMUXC_SAI1_RXD4_ARM_PLATFORM_TRACE_ARM_PLATFORM_TRACE4 {
		pinmux = <0x30330174 4 0x0 0 0x303303dc>;
	};
	/omit-if-no-ref/ iomuxc_sai1_rxd4_gpio_io_gpio4_io06: IOMUXC_SAI1_RXD4_GPIO_IO_GPIO4_IO06 {
		pinmux = <0x30330174 5 0x0 0 0x303303dc>;
	};
	/omit-if-no-ref/ iomuxc_sai1_rxd4_sai_rx_bclk_sai6_rx_bclk: IOMUXC_SAI1_RXD4_SAI_RX_BCLK_SAI6_RX_BCLK {
		pinmux = <0x30330174 2 0x30330510 0 0x303303dc>;
	};
	/omit-if-no-ref/ iomuxc_sai1_rxd4_sai_rx_data_sai1_rx_data4: IOMUXC_SAI1_RXD4_SAI_RX_DATA_SAI1_RX_DATA4 {
		pinmux = <0x30330174 0 0x0 0 0x303303dc>;
	};
	/omit-if-no-ref/ iomuxc_sai1_rxd4_sai_tx_bclk_sai6_tx_bclk: IOMUXC_SAI1_RXD4_SAI_TX_BCLK_SAI6_TX_BCLK {
		pinmux = <0x30330174 1 0x3033051c 0 0x303303dc>;
	};
	/omit-if-no-ref/ iomuxc_sai1_rxd4_src_boot_cfg_src_boot_cfg4: IOMUXC_SAI1_RXD4_SRC_BOOT_CFG_SRC_BOOT_CFG4 {
		pinmux = <0x30330174 6 0x0 0 0x303303dc>;
	};
	/omit-if-no-ref/ iomuxc_sai1_rxd5_arm_platform_trace_arm_platform_trace5: IOMUXC_SAI1_RXD5_ARM_PLATFORM_TRACE_ARM_PLATFORM_TRACE5 {
		pinmux = <0x30330178 4 0x0 0 0x303303e0>;
	};
	/omit-if-no-ref/ iomuxc_sai1_rxd5_gpio_io_gpio4_io07: IOMUXC_SAI1_RXD5_GPIO_IO_GPIO4_IO07 {
		pinmux = <0x30330178 5 0x0 0 0x303303e0>;
	};
	/omit-if-no-ref/ iomuxc_sai1_rxd5_sai_rx_data_sai1_rx_data5: IOMUXC_SAI1_RXD5_SAI_RX_DATA_SAI1_RX_DATA5 {
		pinmux = <0x30330178 0 0x0 0 0x303303e0>;
	};
	/omit-if-no-ref/ iomuxc_sai1_rxd5_sai_rx_data_sai6_rx_data0: IOMUXC_SAI1_RXD5_SAI_RX_DATA_SAI6_RX_DATA0 {
		pinmux = <0x30330178 2 0x30330514 0 0x303303e0>;
	};
	/omit-if-no-ref/ iomuxc_sai1_rxd5_sai_rx_sync_sai1_rx_sync: IOMUXC_SAI1_RXD5_SAI_RX_SYNC_SAI1_RX_SYNC {
		pinmux = <0x30330178 3 0x303304c4 1 0x303303e0>;
	};
	/omit-if-no-ref/ iomuxc_sai1_rxd5_sai_tx_data_sai6_tx_data0: IOMUXC_SAI1_RXD5_SAI_TX_DATA_SAI6_TX_DATA0 {
		pinmux = <0x30330178 1 0x0 0 0x303303e0>;
	};
	/omit-if-no-ref/ iomuxc_sai1_rxd5_src_boot_cfg_src_boot_cfg5: IOMUXC_SAI1_RXD5_SRC_BOOT_CFG_SRC_BOOT_CFG5 {
		pinmux = <0x30330178 6 0x0 0 0x303303e0>;
	};
	/omit-if-no-ref/ iomuxc_sai1_rxd6_arm_platform_trace_arm_platform_trace6: IOMUXC_SAI1_RXD6_ARM_PLATFORM_TRACE_ARM_PLATFORM_TRACE6 {
		pinmux = <0x3033017c 4 0x0 0 0x303303e4>;
	};
	/omit-if-no-ref/ iomuxc_sai1_rxd6_gpio_io_gpio4_io08: IOMUXC_SAI1_RXD6_GPIO_IO_GPIO4_IO08 {
		pinmux = <0x3033017c 5 0x0 0 0x303303e4>;
	};
	/omit-if-no-ref/ iomuxc_sai1_rxd6_sai_rx_data_sai1_rx_data6: IOMUXC_SAI1_RXD6_SAI_RX_DATA_SAI1_RX_DATA6 {
		pinmux = <0x3033017c 0 0x0 0 0x303303e4>;
	};
	/omit-if-no-ref/ iomuxc_sai1_rxd6_sai_rx_sync_sai6_rx_sync: IOMUXC_SAI1_RXD6_SAI_RX_SYNC_SAI6_RX_SYNC {
		pinmux = <0x3033017c 2 0x30330518 0 0x303303e4>;
	};
	/omit-if-no-ref/ iomuxc_sai1_rxd6_sai_tx_sync_sai6_tx_sync: IOMUXC_SAI1_RXD6_SAI_TX_SYNC_SAI6_TX_SYNC {
		pinmux = <0x3033017c 1 0x30330520 0 0x303303e4>;
	};
	/omit-if-no-ref/ iomuxc_sai1_rxd6_src_boot_cfg_src_boot_cfg6: IOMUXC_SAI1_RXD6_SRC_BOOT_CFG_SRC_BOOT_CFG6 {
		pinmux = <0x3033017c 6 0x0 0 0x303303e4>;
	};
	/omit-if-no-ref/ iomuxc_sai1_rxd7_arm_platform_trace_arm_platform_trace7: IOMUXC_SAI1_RXD7_ARM_PLATFORM_TRACE_ARM_PLATFORM_TRACE7 {
		pinmux = <0x30330180 4 0x0 0 0x303303e8>;
	};
	/omit-if-no-ref/ iomuxc_sai1_rxd7_gpio_io_gpio4_io09: IOMUXC_SAI1_RXD7_GPIO_IO_GPIO4_IO09 {
		pinmux = <0x30330180 5 0x0 0 0x303303e8>;
	};
	/omit-if-no-ref/ iomuxc_sai1_rxd7_sai_mclk_sai6_mclk: IOMUXC_SAI1_RXD7_SAI_MCLK_SAI6_MCLK {
		pinmux = <0x30330180 1 0x30330530 0 0x303303e8>;
	};
	/omit-if-no-ref/ iomuxc_sai1_rxd7_sai_rx_data_sai1_rx_data7: IOMUXC_SAI1_RXD7_SAI_RX_DATA_SAI1_RX_DATA7 {
		pinmux = <0x30330180 0 0x0 0 0x303303e8>;
	};
	/omit-if-no-ref/ iomuxc_sai1_rxd7_sai_tx_data_sai1_tx_data4: IOMUXC_SAI1_RXD7_SAI_TX_DATA_SAI1_TX_DATA4 {
		pinmux = <0x30330180 3 0x0 0 0x303303e8>;
	};
	/omit-if-no-ref/ iomuxc_sai1_rxd7_sai_tx_sync_sai1_tx_sync: IOMUXC_SAI1_RXD7_SAI_TX_SYNC_SAI1_TX_SYNC {
		pinmux = <0x30330180 2 0x303304cc 4 0x303303e8>;
	};
	/omit-if-no-ref/ iomuxc_sai1_rxd7_src_boot_cfg_src_boot_cfg7: IOMUXC_SAI1_RXD7_SRC_BOOT_CFG_SRC_BOOT_CFG7 {
		pinmux = <0x30330180 6 0x0 0 0x303303e8>;
	};
	/omit-if-no-ref/ iomuxc_sai1_rxfs_arm_platform_trace_clk_arm_platform_trace_clk: IOMUXC_SAI1_RXFS_ARM_PLATFORM_TRACE_CLK_ARM_PLATFORM_TRACE_CLK {
		pinmux = <0x3033015c 4 0x0 0 0x303303c4>;
	};
	/omit-if-no-ref/ iomuxc_sai1_rxfs_gpio_io_gpio4_io00: IOMUXC_SAI1_RXFS_GPIO_IO_GPIO4_IO00 {
		pinmux = <0x3033015c 5 0x0 0 0x303303c4>;
	};
	/omit-if-no-ref/ iomuxc_sai1_rxfs_sai_rx_sync_sai1_rx_sync: IOMUXC_SAI1_RXFS_SAI_RX_SYNC_SAI1_RX_SYNC {
		pinmux = <0x3033015c 0 0x303304c4 0 0x303303c4>;
	};
	/omit-if-no-ref/ iomuxc_sai1_rxfs_sai_rx_sync_sai5_rx_sync: IOMUXC_SAI1_RXFS_SAI_RX_SYNC_SAI5_RX_SYNC {
		pinmux = <0x3033015c 1 0x303304e4 1 0x303303c4>;
	};
	/omit-if-no-ref/ iomuxc_sai1_txc_arm_platform_eventi_arm_platform_eventi: IOMUXC_SAI1_TXC_ARM_PLATFORM_EVENTI_ARM_PLATFORM_EVENTI {
		pinmux = <0x30330188 4 0x0 0 0x303303f0>;
	};
	/omit-if-no-ref/ iomuxc_sai1_txc_gpio_io_gpio4_io11: IOMUXC_SAI1_TXC_GPIO_IO_GPIO4_IO11 {
		pinmux = <0x30330188 5 0x0 0 0x303303f0>;
	};
	/omit-if-no-ref/ iomuxc_sai1_txc_sai_tx_bclk_sai1_tx_bclk: IOMUXC_SAI1_TXC_SAI_TX_BCLK_SAI1_TX_BCLK {
		pinmux = <0x30330188 0 0x303304c8 1 0x303303f0>;
	};
	/omit-if-no-ref/ iomuxc_sai1_txc_sai_tx_bclk_sai5_tx_bclk: IOMUXC_SAI1_TXC_SAI_TX_BCLK_SAI5_TX_BCLK {
		pinmux = <0x30330188 1 0x303304e8 1 0x303303f0>;
	};
	/omit-if-no-ref/ iomuxc_sai1_txd0_arm_platform_trace_arm_platform_trace8: IOMUXC_SAI1_TXD0_ARM_PLATFORM_TRACE_ARM_PLATFORM_TRACE8 {
		pinmux = <0x3033018c 4 0x0 0 0x303303f4>;
	};
	/omit-if-no-ref/ iomuxc_sai1_txd0_gpio_io_gpio4_io12: IOMUXC_SAI1_TXD0_GPIO_IO_GPIO4_IO12 {
		pinmux = <0x3033018c 5 0x0 0 0x303303f4>;
	};
	/omit-if-no-ref/ iomuxc_sai1_txd0_sai_tx_data_sai1_tx_data0: IOMUXC_SAI1_TXD0_SAI_TX_DATA_SAI1_TX_DATA0 {
		pinmux = <0x3033018c 0 0x0 0 0x303303f4>;
	};
	/omit-if-no-ref/ iomuxc_sai1_txd0_sai_tx_data_sai5_tx_data0: IOMUXC_SAI1_TXD0_SAI_TX_DATA_SAI5_TX_DATA0 {
		pinmux = <0x3033018c 1 0x0 0 0x303303f4>;
	};
	/omit-if-no-ref/ iomuxc_sai1_txd0_src_boot_cfg_src_boot_cfg8: IOMUXC_SAI1_TXD0_SRC_BOOT_CFG_SRC_BOOT_CFG8 {
		pinmux = <0x3033018c 6 0x0 0 0x303303f4>;
	};
	/omit-if-no-ref/ iomuxc_sai1_txd1_arm_platform_trace_arm_platform_trace9: IOMUXC_SAI1_TXD1_ARM_PLATFORM_TRACE_ARM_PLATFORM_TRACE9 {
		pinmux = <0x30330190 4 0x0 0 0x303303f8>;
	};
	/omit-if-no-ref/ iomuxc_sai1_txd1_gpio_io_gpio4_io13: IOMUXC_SAI1_TXD1_GPIO_IO_GPIO4_IO13 {
		pinmux = <0x30330190 5 0x0 0 0x303303f8>;
	};
	/omit-if-no-ref/ iomuxc_sai1_txd1_sai_tx_data_sai1_tx_data1: IOMUXC_SAI1_TXD1_SAI_TX_DATA_SAI1_TX_DATA1 {
		pinmux = <0x30330190 0 0x0 0 0x303303f8>;
	};
	/omit-if-no-ref/ iomuxc_sai1_txd1_sai_tx_data_sai5_tx_data1: IOMUXC_SAI1_TXD1_SAI_TX_DATA_SAI5_TX_DATA1 {
		pinmux = <0x30330190 1 0x0 0 0x303303f8>;
	};
	/omit-if-no-ref/ iomuxc_sai1_txd1_src_boot_cfg_src_boot_cfg9: IOMUXC_SAI1_TXD1_SRC_BOOT_CFG_SRC_BOOT_CFG9 {
		pinmux = <0x30330190 6 0x0 0 0x303303f8>;
	};
	/omit-if-no-ref/ iomuxc_sai1_txd2_arm_platform_trace_arm_platform_trace10: IOMUXC_SAI1_TXD2_ARM_PLATFORM_TRACE_ARM_PLATFORM_TRACE10 {
		pinmux = <0x30330194 4 0x0 0 0x303303fc>;
	};
	/omit-if-no-ref/ iomuxc_sai1_txd2_gpio_io_gpio4_io14: IOMUXC_SAI1_TXD2_GPIO_IO_GPIO4_IO14 {
		pinmux = <0x30330194 5 0x0 0 0x303303fc>;
	};
	/omit-if-no-ref/ iomuxc_sai1_txd2_sai_tx_data_sai1_tx_data2: IOMUXC_SAI1_TXD2_SAI_TX_DATA_SAI1_TX_DATA2 {
		pinmux = <0x30330194 0 0x0 0 0x303303fc>;
	};
	/omit-if-no-ref/ iomuxc_sai1_txd2_sai_tx_data_sai5_tx_data2: IOMUXC_SAI1_TXD2_SAI_TX_DATA_SAI5_TX_DATA2 {
		pinmux = <0x30330194 1 0x0 0 0x303303fc>;
	};
	/omit-if-no-ref/ iomuxc_sai1_txd2_src_boot_cfg_src_boot_cfg10: IOMUXC_SAI1_TXD2_SRC_BOOT_CFG_SRC_BOOT_CFG10 {
		pinmux = <0x30330194 6 0x0 0 0x303303fc>;
	};
	/omit-if-no-ref/ iomuxc_sai1_txd3_arm_platform_trace_arm_platform_trace11: IOMUXC_SAI1_TXD3_ARM_PLATFORM_TRACE_ARM_PLATFORM_TRACE11 {
		pinmux = <0x30330198 4 0x0 0 0x30330400>;
	};
	/omit-if-no-ref/ iomuxc_sai1_txd3_gpio_io_gpio4_io15: IOMUXC_SAI1_TXD3_GPIO_IO_GPIO4_IO15 {
		pinmux = <0x30330198 5 0x0 0 0x30330400>;
	};
	/omit-if-no-ref/ iomuxc_sai1_txd3_sai_tx_data_sai1_tx_data3: IOMUXC_SAI1_TXD3_SAI_TX_DATA_SAI1_TX_DATA3 {
		pinmux = <0x30330198 0 0x0 0 0x30330400>;
	};
	/omit-if-no-ref/ iomuxc_sai1_txd3_sai_tx_data_sai5_tx_data3: IOMUXC_SAI1_TXD3_SAI_TX_DATA_SAI5_TX_DATA3 {
		pinmux = <0x30330198 1 0x0 0 0x30330400>;
	};
	/omit-if-no-ref/ iomuxc_sai1_txd3_src_boot_cfg_src_boot_cfg11: IOMUXC_SAI1_TXD3_SRC_BOOT_CFG_SRC_BOOT_CFG11 {
		pinmux = <0x30330198 6 0x0 0 0x30330400>;
	};
	/omit-if-no-ref/ iomuxc_sai1_txd4_arm_platform_trace_arm_platform_trace12: IOMUXC_SAI1_TXD4_ARM_PLATFORM_TRACE_ARM_PLATFORM_TRACE12 {
		pinmux = <0x3033019c 4 0x0 0 0x30330404>;
	};
	/omit-if-no-ref/ iomuxc_sai1_txd4_gpio_io_gpio4_io16: IOMUXC_SAI1_TXD4_GPIO_IO_GPIO4_IO16 {
		pinmux = <0x3033019c 5 0x0 0 0x30330404>;
	};
	/omit-if-no-ref/ iomuxc_sai1_txd4_sai_rx_bclk_sai6_rx_bclk: IOMUXC_SAI1_TXD4_SAI_RX_BCLK_SAI6_RX_BCLK {
		pinmux = <0x3033019c 1 0x30330510 1 0x30330404>;
	};
	/omit-if-no-ref/ iomuxc_sai1_txd4_sai_tx_bclk_sai6_tx_bclk: IOMUXC_SAI1_TXD4_SAI_TX_BCLK_SAI6_TX_BCLK {
		pinmux = <0x3033019c 2 0x3033051c 1 0x30330404>;
	};
	/omit-if-no-ref/ iomuxc_sai1_txd4_sai_tx_data_sai1_tx_data4: IOMUXC_SAI1_TXD4_SAI_TX_DATA_SAI1_TX_DATA4 {
		pinmux = <0x3033019c 0 0x0 0 0x30330404>;
	};
	/omit-if-no-ref/ iomuxc_sai1_txd4_src_boot_cfg_src_boot_cfg12: IOMUXC_SAI1_TXD4_SRC_BOOT_CFG_SRC_BOOT_CFG12 {
		pinmux = <0x3033019c 6 0x0 0 0x30330404>;
	};
	/omit-if-no-ref/ iomuxc_sai1_txd5_arm_platform_trace_arm_platform_trace13: IOMUXC_SAI1_TXD5_ARM_PLATFORM_TRACE_ARM_PLATFORM_TRACE13 {
		pinmux = <0x303301a0 4 0x0 0 0x30330408>;
	};
	/omit-if-no-ref/ iomuxc_sai1_txd5_gpio_io_gpio4_io17: IOMUXC_SAI1_TXD5_GPIO_IO_GPIO4_IO17 {
		pinmux = <0x303301a0 5 0x0 0 0x30330408>;
	};
	/omit-if-no-ref/ iomuxc_sai1_txd5_sai_rx_data_sai6_rx_data0: IOMUXC_SAI1_TXD5_SAI_RX_DATA_SAI6_RX_DATA0 {
		pinmux = <0x303301a0 1 0x30330514 1 0x30330408>;
	};
	/omit-if-no-ref/ iomuxc_sai1_txd5_sai_tx_data_sai1_tx_data5: IOMUXC_SAI1_TXD5_SAI_TX_DATA_SAI1_TX_DATA5 {
		pinmux = <0x303301a0 0 0x0 0 0x30330408>;
	};
	/omit-if-no-ref/ iomuxc_sai1_txd5_sai_tx_data_sai6_tx_data0: IOMUXC_SAI1_TXD5_SAI_TX_DATA_SAI6_TX_DATA0 {
		pinmux = <0x303301a0 2 0x0 0 0x30330408>;
	};
	/omit-if-no-ref/ iomuxc_sai1_txd5_src_boot_cfg_src_boot_cfg13: IOMUXC_SAI1_TXD5_SRC_BOOT_CFG_SRC_BOOT_CFG13 {
		pinmux = <0x303301a0 6 0x0 0 0x30330408>;
	};
	/omit-if-no-ref/ iomuxc_sai1_txd6_arm_platform_trace_arm_platform_trace14: IOMUXC_SAI1_TXD6_ARM_PLATFORM_TRACE_ARM_PLATFORM_TRACE14 {
		pinmux = <0x303301a4 4 0x0 0 0x3033040c>;
	};
	/omit-if-no-ref/ iomuxc_sai1_txd6_gpio_io_gpio4_io18: IOMUXC_SAI1_TXD6_GPIO_IO_GPIO4_IO18 {
		pinmux = <0x303301a4 5 0x0 0 0x3033040c>;
	};
	/omit-if-no-ref/ iomuxc_sai1_txd6_sai_rx_sync_sai6_rx_sync: IOMUXC_SAI1_TXD6_SAI_RX_SYNC_SAI6_RX_SYNC {
		pinmux = <0x303301a4 1 0x30330518 1 0x3033040c>;
	};
	/omit-if-no-ref/ iomuxc_sai1_txd6_sai_tx_data_sai1_tx_data6: IOMUXC_SAI1_TXD6_SAI_TX_DATA_SAI1_TX_DATA6 {
		pinmux = <0x303301a4 0 0x0 0 0x3033040c>;
	};
	/omit-if-no-ref/ iomuxc_sai1_txd6_sai_tx_sync_sai6_tx_sync: IOMUXC_SAI1_TXD6_SAI_TX_SYNC_SAI6_TX_SYNC {
		pinmux = <0x303301a4 2 0x30330520 1 0x3033040c>;
	};
	/omit-if-no-ref/ iomuxc_sai1_txd6_src_boot_cfg_src_boot_cfg14: IOMUXC_SAI1_TXD6_SRC_BOOT_CFG_SRC_BOOT_CFG14 {
		pinmux = <0x303301a4 6 0x0 0 0x3033040c>;
	};
	/omit-if-no-ref/ iomuxc_sai1_txd7_arm_platform_trace_arm_platform_trace15: IOMUXC_SAI1_TXD7_ARM_PLATFORM_TRACE_ARM_PLATFORM_TRACE15 {
		pinmux = <0x303301a8 4 0x0 0 0x30330410>;
	};
	/omit-if-no-ref/ iomuxc_sai1_txd7_gpio_io_gpio4_io19: IOMUXC_SAI1_TXD7_GPIO_IO_GPIO4_IO19 {
		pinmux = <0x303301a8 5 0x0 0 0x30330410>;
	};
	/omit-if-no-ref/ iomuxc_sai1_txd7_sai_mclk_sai6_mclk: IOMUXC_SAI1_TXD7_SAI_MCLK_SAI6_MCLK {
		pinmux = <0x303301a8 1 0x30330530 1 0x30330410>;
	};
	/omit-if-no-ref/ iomuxc_sai1_txd7_sai_tx_data_sai1_tx_data7: IOMUXC_SAI1_TXD7_SAI_TX_DATA_SAI1_TX_DATA7 {
		pinmux = <0x303301a8 0 0x0 0 0x30330410>;
	};
	/omit-if-no-ref/ iomuxc_sai1_txd7_src_boot_cfg_src_boot_cfg15: IOMUXC_SAI1_TXD7_SRC_BOOT_CFG_SRC_BOOT_CFG15 {
		pinmux = <0x303301a8 6 0x0 0 0x30330410>;
	};
	/omit-if-no-ref/ iomuxc_sai1_txfs_arm_platform_evento_arm_platform_evento: IOMUXC_SAI1_TXFS_ARM_PLATFORM_EVENTO_ARM_PLATFORM_EVENTO {
		pinmux = <0x30330184 4 0x0 0 0x303303ec>;
	};
	/omit-if-no-ref/ iomuxc_sai1_txfs_gpio_io_gpio4_io10: IOMUXC_SAI1_TXFS_GPIO_IO_GPIO4_IO10 {
		pinmux = <0x30330184 5 0x0 0 0x303303ec>;
	};
	/omit-if-no-ref/ iomuxc_sai1_txfs_sai_tx_sync_sai1_tx_sync: IOMUXC_SAI1_TXFS_SAI_TX_SYNC_SAI1_TX_SYNC {
		pinmux = <0x30330184 0 0x303304cc 3 0x303303ec>;
	};
	/omit-if-no-ref/ iomuxc_sai1_txfs_sai_tx_sync_sai5_tx_sync: IOMUXC_SAI1_TXFS_SAI_TX_SYNC_SAI5_TX_SYNC {
		pinmux = <0x30330184 1 0x303304ec 1 0x303303ec>;
	};
	/omit-if-no-ref/ iomuxc_sai2_mclk_gpio_io_gpio4_io27: IOMUXC_SAI2_MCLK_GPIO_IO_GPIO4_IO27 {
		pinmux = <0x303301c8 5 0x0 0 0x30330430>;
	};
	/omit-if-no-ref/ iomuxc_sai2_mclk_sai_mclk_sai2_mclk: IOMUXC_SAI2_MCLK_SAI_MCLK_SAI2_MCLK {
		pinmux = <0x303301c8 0 0x0 0 0x30330430>;
	};
	/omit-if-no-ref/ iomuxc_sai2_mclk_sai_mclk_sai5_mclk: IOMUXC_SAI2_MCLK_SAI_MCLK_SAI5_MCLK {
		pinmux = <0x303301c8 1 0x3033052c 2 0x30330430>;
	};
	/omit-if-no-ref/ iomuxc_sai2_rxc_gpio_io_gpio4_io22: IOMUXC_SAI2_RXC_GPIO_IO_GPIO4_IO22 {
		pinmux = <0x303301b4 5 0x0 0 0x3033041c>;
	};
	/omit-if-no-ref/ iomuxc_sai2_rxc_sai_rx_bclk_sai2_rx_bclk: IOMUXC_SAI2_RXC_SAI_RX_BCLK_SAI2_RX_BCLK {
		pinmux = <0x303301b4 0 0x0 0 0x3033041c>;
	};
	/omit-if-no-ref/ iomuxc_sai2_rxc_sai_tx_bclk_sai5_tx_bclk: IOMUXC_SAI2_RXC_SAI_TX_BCLK_SAI5_TX_BCLK {
		pinmux = <0x303301b4 1 0x303304e8 2 0x3033041c>;
	};
	/omit-if-no-ref/ iomuxc_sai2_rxd0_gpio_io_gpio4_io23: IOMUXC_SAI2_RXD0_GPIO_IO_GPIO4_IO23 {
		pinmux = <0x303301b8 5 0x0 0 0x30330420>;
	};
	/omit-if-no-ref/ iomuxc_sai2_rxd0_sai_rx_data_sai2_rx_data0: IOMUXC_SAI2_RXD0_SAI_RX_DATA_SAI2_RX_DATA0 {
		pinmux = <0x303301b8 0 0x0 0 0x30330420>;
	};
	/omit-if-no-ref/ iomuxc_sai2_rxd0_sai_tx_data_sai5_tx_data0: IOMUXC_SAI2_RXD0_SAI_TX_DATA_SAI5_TX_DATA0 {
		pinmux = <0x303301b8 1 0x0 0 0x30330420>;
	};
	/omit-if-no-ref/ iomuxc_sai2_rxfs_gpio_io_gpio4_io21: IOMUXC_SAI2_RXFS_GPIO_IO_GPIO4_IO21 {
		pinmux = <0x303301b0 5 0x0 0 0x30330418>;
	};
	/omit-if-no-ref/ iomuxc_sai2_rxfs_sai_rx_sync_sai2_rx_sync: IOMUXC_SAI2_RXFS_SAI_RX_SYNC_SAI2_RX_SYNC {
		pinmux = <0x303301b0 0 0x0 0 0x30330418>;
	};
	/omit-if-no-ref/ iomuxc_sai2_rxfs_sai_tx_sync_sai5_tx_sync: IOMUXC_SAI2_RXFS_SAI_TX_SYNC_SAI5_TX_SYNC {
		pinmux = <0x303301b0 1 0x303304ec 2 0x30330418>;
	};
	/omit-if-no-ref/ iomuxc_sai2_txc_gpio_io_gpio4_io25: IOMUXC_SAI2_TXC_GPIO_IO_GPIO4_IO25 {
		pinmux = <0x303301c0 5 0x0 0 0x30330428>;
	};
	/omit-if-no-ref/ iomuxc_sai2_txc_sai_tx_bclk_sai2_tx_bclk: IOMUXC_SAI2_TXC_SAI_TX_BCLK_SAI2_TX_BCLK {
		pinmux = <0x303301c0 0 0x0 0 0x30330428>;
	};
	/omit-if-no-ref/ iomuxc_sai2_txc_sai_tx_data_sai5_tx_data2: IOMUXC_SAI2_TXC_SAI_TX_DATA_SAI5_TX_DATA2 {
		pinmux = <0x303301c0 1 0x0 0 0x30330428>;
	};
	/omit-if-no-ref/ iomuxc_sai2_txd0_gpio_io_gpio4_io26: IOMUXC_SAI2_TXD0_GPIO_IO_GPIO4_IO26 {
		pinmux = <0x303301c4 5 0x0 0 0x3033042c>;
	};
	/omit-if-no-ref/ iomuxc_sai2_txd0_sai_tx_data_sai2_tx_data0: IOMUXC_SAI2_TXD0_SAI_TX_DATA_SAI2_TX_DATA0 {
		pinmux = <0x303301c4 0 0x0 0 0x3033042c>;
	};
	/omit-if-no-ref/ iomuxc_sai2_txd0_sai_tx_data_sai5_tx_data3: IOMUXC_SAI2_TXD0_SAI_TX_DATA_SAI5_TX_DATA3 {
		pinmux = <0x303301c4 1 0x0 0 0x3033042c>;
	};
	/omit-if-no-ref/ iomuxc_sai2_txfs_gpio_io_gpio4_io24: IOMUXC_SAI2_TXFS_GPIO_IO_GPIO4_IO24 {
		pinmux = <0x303301bc 5 0x0 0 0x30330424>;
	};
	/omit-if-no-ref/ iomuxc_sai2_txfs_sai_tx_data_sai5_tx_data1: IOMUXC_SAI2_TXFS_SAI_TX_DATA_SAI5_TX_DATA1 {
		pinmux = <0x303301bc 1 0x0 0 0x30330424>;
	};
	/omit-if-no-ref/ iomuxc_sai2_txfs_sai_tx_sync_sai2_tx_sync: IOMUXC_SAI2_TXFS_SAI_TX_SYNC_SAI2_TX_SYNC {
		pinmux = <0x303301bc 0 0x0 0 0x30330424>;
	};
	/omit-if-no-ref/ iomuxc_sai3_mclk_gpio_io_gpio5_io02: IOMUXC_SAI3_MCLK_GPIO_IO_GPIO5_IO02 {
		pinmux = <0x303301e4 5 0x0 0 0x3033044c>;
	};
	/omit-if-no-ref/ iomuxc_sai3_mclk_pwm_out_pwm4_out: IOMUXC_SAI3_MCLK_PWM_OUT_PWM4_OUT {
		pinmux = <0x303301e4 1 0x0 0 0x3033044c>;
	};
	/omit-if-no-ref/ iomuxc_sai3_mclk_sai_mclk_sai3_mclk: IOMUXC_SAI3_MCLK_SAI_MCLK_SAI3_MCLK {
		pinmux = <0x303301e4 0 0x0 0 0x3033044c>;
	};
	/omit-if-no-ref/ iomuxc_sai3_mclk_sai_mclk_sai5_mclk: IOMUXC_SAI3_MCLK_SAI_MCLK_SAI5_MCLK {
		pinmux = <0x303301e4 2 0x3033052c 3 0x3033044c>;
	};
	/omit-if-no-ref/ iomuxc_sai3_rxc_gpio_io_gpio4_io29: IOMUXC_SAI3_RXC_GPIO_IO_GPIO4_IO29 {
		pinmux = <0x303301d0 5 0x0 0 0x30330438>;
	};
	/omit-if-no-ref/ iomuxc_sai3_rxc_gpt_capture_gpt1_capture2: IOMUXC_SAI3_RXC_GPT_CAPTURE_GPT1_CAPTURE2 {
		pinmux = <0x303301d0 1 0x0 0 0x30330438>;
	};
	/omit-if-no-ref/ iomuxc_sai3_rxc_sai_rx_bclk_sai3_rx_bclk: IOMUXC_SAI3_RXC_SAI_RX_BCLK_SAI3_RX_BCLK {
		pinmux = <0x303301d0 0 0x0 0 0x30330438>;
	};
	/omit-if-no-ref/ iomuxc_sai3_rxc_sai_rx_bclk_sai5_rx_bclk: IOMUXC_SAI3_RXC_SAI_RX_BCLK_SAI5_RX_BCLK {
		pinmux = <0x303301d0 2 0x303304d0 2 0x30330438>;
	};
	/omit-if-no-ref/ iomuxc_sai3_rxd_gpio_io_gpio4_io30: IOMUXC_SAI3_RXD_GPIO_IO_GPIO4_IO30 {
		pinmux = <0x303301d4 5 0x0 0 0x3033043c>;
	};
	/omit-if-no-ref/ iomuxc_sai3_rxd_gpt_compare_gpt1_compare1: IOMUXC_SAI3_RXD_GPT_COMPARE_GPT1_COMPARE1 {
		pinmux = <0x303301d4 1 0x0 0 0x3033043c>;
	};
	/omit-if-no-ref/ iomuxc_sai3_rxd_sai_rx_data_sai3_rx_data0: IOMUXC_SAI3_RXD_SAI_RX_DATA_SAI3_RX_DATA0 {
		pinmux = <0x303301d4 0 0x0 0 0x3033043c>;
	};
	/omit-if-no-ref/ iomuxc_sai3_rxd_sai_rx_data_sai5_rx_data0: IOMUXC_SAI3_RXD_SAI_RX_DATA_SAI5_RX_DATA0 {
		pinmux = <0x303301d4 2 0x303304d4 2 0x3033043c>;
	};
	/omit-if-no-ref/ iomuxc_sai3_rxfs_gpio_io_gpio4_io28: IOMUXC_SAI3_RXFS_GPIO_IO_GPIO4_IO28 {
		pinmux = <0x303301cc 5 0x0 0 0x30330434>;
	};
	/omit-if-no-ref/ iomuxc_sai3_rxfs_gpt_capture_gpt1_capture1: IOMUXC_SAI3_RXFS_GPT_CAPTURE_GPT1_CAPTURE1 {
		pinmux = <0x303301cc 1 0x0 0 0x30330434>;
	};
	/omit-if-no-ref/ iomuxc_sai3_rxfs_sai_rx_sync_sai3_rx_sync: IOMUXC_SAI3_RXFS_SAI_RX_SYNC_SAI3_RX_SYNC {
		pinmux = <0x303301cc 0 0x0 0 0x30330434>;
	};
	/omit-if-no-ref/ iomuxc_sai3_rxfs_sai_rx_sync_sai5_rx_sync: IOMUXC_SAI3_RXFS_SAI_RX_SYNC_SAI5_RX_SYNC {
		pinmux = <0x303301cc 2 0x303304e4 2 0x30330434>;
	};
	/omit-if-no-ref/ iomuxc_sai3_txc_gpio_io_gpio5_io00: IOMUXC_SAI3_TXC_GPIO_IO_GPIO5_IO00 {
		pinmux = <0x303301dc 5 0x0 0 0x30330444>;
	};
	/omit-if-no-ref/ iomuxc_sai3_txc_gpt_compare_gpt1_compare2: IOMUXC_SAI3_TXC_GPT_COMPARE_GPT1_COMPARE2 {
		pinmux = <0x303301dc 1 0x0 0 0x30330444>;
	};
	/omit-if-no-ref/ iomuxc_sai3_txc_sai_rx_data_sai5_rx_data2: IOMUXC_SAI3_TXC_SAI_RX_DATA_SAI5_RX_DATA2 {
		pinmux = <0x303301dc 2 0x303304dc 2 0x30330444>;
	};
	/omit-if-no-ref/ iomuxc_sai3_txc_sai_tx_bclk_sai3_tx_bclk: IOMUXC_SAI3_TXC_SAI_TX_BCLK_SAI3_TX_BCLK {
		pinmux = <0x303301dc 0 0x0 0 0x30330444>;
	};
	/omit-if-no-ref/ iomuxc_sai3_txd_gpio_io_gpio5_io01: IOMUXC_SAI3_TXD_GPIO_IO_GPIO5_IO01 {
		pinmux = <0x303301e0 5 0x0 0 0x30330448>;
	};
	/omit-if-no-ref/ iomuxc_sai3_txd_gpt_compare_gpt1_compare3: IOMUXC_SAI3_TXD_GPT_COMPARE_GPT1_COMPARE3 {
		pinmux = <0x303301e0 1 0x0 0 0x30330448>;
	};
	/omit-if-no-ref/ iomuxc_sai3_txd_sai_rx_data_sai5_rx_data3: IOMUXC_SAI3_TXD_SAI_RX_DATA_SAI5_RX_DATA3 {
		pinmux = <0x303301e0 2 0x303304e0 2 0x30330448>;
	};
	/omit-if-no-ref/ iomuxc_sai3_txd_sai_tx_data_sai3_tx_data0: IOMUXC_SAI3_TXD_SAI_TX_DATA_SAI3_TX_DATA0 {
		pinmux = <0x303301e0 0 0x0 0 0x30330448>;
	};
	/omit-if-no-ref/ iomuxc_sai3_txfs_gpio_io_gpio4_io31: IOMUXC_SAI3_TXFS_GPIO_IO_GPIO4_IO31 {
		pinmux = <0x303301d8 5 0x0 0 0x30330440>;
	};
	/omit-if-no-ref/ iomuxc_sai3_txfs_gpt_clk_gpt1_clk: IOMUXC_SAI3_TXFS_GPT_CLK_GPT1_CLK {
		pinmux = <0x303301d8 1 0x0 0 0x30330440>;
	};
	/omit-if-no-ref/ iomuxc_sai3_txfs_sai_rx_data_sai5_rx_data1: IOMUXC_SAI3_TXFS_SAI_RX_DATA_SAI5_RX_DATA1 {
		pinmux = <0x303301d8 2 0x303304d8 2 0x30330440>;
	};
	/omit-if-no-ref/ iomuxc_sai3_txfs_sai_tx_sync_sai3_tx_sync: IOMUXC_SAI3_TXFS_SAI_TX_SYNC_SAI3_TX_SYNC {
		pinmux = <0x303301d8 0 0x0 0 0x30330440>;
	};
	/omit-if-no-ref/ iomuxc_sai5_mclk_gpio_io_gpio3_io25: IOMUXC_SAI5_MCLK_GPIO_IO_GPIO3_IO25 {
		pinmux = <0x30330158 5 0x0 0 0x303303c0>;
	};
	/omit-if-no-ref/ iomuxc_sai5_mclk_sai_mclk_sai4_mclk: IOMUXC_SAI5_MCLK_SAI_MCLK_SAI4_MCLK {
		pinmux = <0x30330158 2 0x0 0 0x303303c0>;
	};
	/omit-if-no-ref/ iomuxc_sai5_mclk_sai_mclk_sai5_mclk: IOMUXC_SAI5_MCLK_SAI_MCLK_SAI5_MCLK {
		pinmux = <0x30330158 0 0x3033052c 0 0x303303c0>;
	};
	/omit-if-no-ref/ iomuxc_sai5_mclk_sai_tx_bclk_sai1_tx_bclk: IOMUXC_SAI5_MCLK_SAI_TX_BCLK_SAI1_TX_BCLK {
		pinmux = <0x30330158 1 0x303304c8 0 0x303303c0>;
	};
	/omit-if-no-ref/ iomuxc_sai5_rxc_gpio_io_gpio3_io20: IOMUXC_SAI5_RXC_GPIO_IO_GPIO3_IO20 {
		pinmux = <0x30330144 5 0x0 0 0x303303ac>;
	};
	/omit-if-no-ref/ iomuxc_sai5_rxc_sai_rx_bclk_sai5_rx_bclk: IOMUXC_SAI5_RXC_SAI_RX_BCLK_SAI5_RX_BCLK {
		pinmux = <0x30330144 0 0x303304d0 0 0x303303ac>;
	};
	/omit-if-no-ref/ iomuxc_sai5_rxc_sai_tx_data_sai1_tx_data1: IOMUXC_SAI5_RXC_SAI_TX_DATA_SAI1_TX_DATA1 {
		pinmux = <0x30330144 1 0x0 0 0x303303ac>;
	};
	/omit-if-no-ref/ iomuxc_sai5_rxd0_gpio_io_gpio3_io21: IOMUXC_SAI5_RXD0_GPIO_IO_GPIO3_IO21 {
		pinmux = <0x30330148 5 0x0 0 0x303303b0>;
	};
	/omit-if-no-ref/ iomuxc_sai5_rxd0_sai_rx_data_sai5_rx_data0: IOMUXC_SAI5_RXD0_SAI_RX_DATA_SAI5_RX_DATA0 {
		pinmux = <0x30330148 0 0x303304d4 0 0x303303b0>;
	};
	/omit-if-no-ref/ iomuxc_sai5_rxd0_sai_tx_data_sai1_tx_data2: IOMUXC_SAI5_RXD0_SAI_TX_DATA_SAI1_TX_DATA2 {
		pinmux = <0x30330148 1 0x0 0 0x303303b0>;
	};
	/omit-if-no-ref/ iomuxc_sai5_rxd1_gpio_io_gpio3_io22: IOMUXC_SAI5_RXD1_GPIO_IO_GPIO3_IO22 {
		pinmux = <0x3033014c 5 0x0 0 0x303303b4>;
	};
	/omit-if-no-ref/ iomuxc_sai5_rxd1_sai_rx_data_sai5_rx_data1: IOMUXC_SAI5_RXD1_SAI_RX_DATA_SAI5_RX_DATA1 {
		pinmux = <0x3033014c 0 0x303304d8 0 0x303303b4>;
	};
	/omit-if-no-ref/ iomuxc_sai5_rxd1_sai_tx_data_sai1_tx_data3: IOMUXC_SAI5_RXD1_SAI_TX_DATA_SAI1_TX_DATA3 {
		pinmux = <0x3033014c 1 0x0 0 0x303303b4>;
	};
	/omit-if-no-ref/ iomuxc_sai5_rxd1_sai_tx_sync_sai1_tx_sync: IOMUXC_SAI5_RXD1_SAI_TX_SYNC_SAI1_TX_SYNC {
		pinmux = <0x3033014c 2 0x303304cc 0 0x303303b4>;
	};
	/omit-if-no-ref/ iomuxc_sai5_rxd1_sai_tx_sync_sai5_tx_sync: IOMUXC_SAI5_RXD1_SAI_TX_SYNC_SAI5_TX_SYNC {
		pinmux = <0x3033014c 3 0x303304ec 0 0x303303b4>;
	};
	/omit-if-no-ref/ iomuxc_sai5_rxd2_gpio_io_gpio3_io23: IOMUXC_SAI5_RXD2_GPIO_IO_GPIO3_IO23 {
		pinmux = <0x30330150 5 0x0 0 0x303303b8>;
	};
	/omit-if-no-ref/ iomuxc_sai5_rxd2_sai_rx_data_sai5_rx_data2: IOMUXC_SAI5_RXD2_SAI_RX_DATA_SAI5_RX_DATA2 {
		pinmux = <0x30330150 0 0x303304dc 0 0x303303b8>;
	};
	/omit-if-no-ref/ iomuxc_sai5_rxd2_sai_tx_bclk_sai5_tx_bclk: IOMUXC_SAI5_RXD2_SAI_TX_BCLK_SAI5_TX_BCLK {
		pinmux = <0x30330150 3 0x303304e8 0 0x303303b8>;
	};
	/omit-if-no-ref/ iomuxc_sai5_rxd2_sai_tx_data_sai1_tx_data4: IOMUXC_SAI5_RXD2_SAI_TX_DATA_SAI1_TX_DATA4 {
		pinmux = <0x30330150 1 0x0 0 0x303303b8>;
	};
	/omit-if-no-ref/ iomuxc_sai5_rxd2_sai_tx_sync_sai1_tx_sync: IOMUXC_SAI5_RXD2_SAI_TX_SYNC_SAI1_TX_SYNC {
		pinmux = <0x30330150 2 0x303304cc 1 0x303303b8>;
	};
	/omit-if-no-ref/ iomuxc_sai5_rxd3_gpio_io_gpio3_io24: IOMUXC_SAI5_RXD3_GPIO_IO_GPIO3_IO24 {
		pinmux = <0x30330154 5 0x0 0 0x303303bc>;
	};
	/omit-if-no-ref/ iomuxc_sai5_rxd3_sai_rx_data_sai5_rx_data3: IOMUXC_SAI5_RXD3_SAI_RX_DATA_SAI5_RX_DATA3 {
		pinmux = <0x30330154 0 0x303304e0 0 0x303303bc>;
	};
	/omit-if-no-ref/ iomuxc_sai5_rxd3_sai_tx_data_sai1_tx_data5: IOMUXC_SAI5_RXD3_SAI_TX_DATA_SAI1_TX_DATA5 {
		pinmux = <0x30330154 1 0x0 0 0x303303bc>;
	};
	/omit-if-no-ref/ iomuxc_sai5_rxd3_sai_tx_data_sai5_tx_data0: IOMUXC_SAI5_RXD3_SAI_TX_DATA_SAI5_TX_DATA0 {
		pinmux = <0x30330154 3 0x0 0 0x303303bc>;
	};
	/omit-if-no-ref/ iomuxc_sai5_rxd3_sai_tx_sync_sai1_tx_sync: IOMUXC_SAI5_RXD3_SAI_TX_SYNC_SAI1_TX_SYNC {
		pinmux = <0x30330154 2 0x303304cc 2 0x303303bc>;
	};
	/omit-if-no-ref/ iomuxc_sai5_rxfs_gpio_io_gpio3_io19: IOMUXC_SAI5_RXFS_GPIO_IO_GPIO3_IO19 {
		pinmux = <0x30330140 5 0x0 0 0x303303a8>;
	};
	/omit-if-no-ref/ iomuxc_sai5_rxfs_sai_rx_sync_sai5_rx_sync: IOMUXC_SAI5_RXFS_SAI_RX_SYNC_SAI5_RX_SYNC {
		pinmux = <0x30330140 0 0x303304e4 0 0x303303a8>;
	};
	/omit-if-no-ref/ iomuxc_sai5_rxfs_sai_tx_data_sai1_tx_data0: IOMUXC_SAI5_RXFS_SAI_TX_DATA_SAI1_TX_DATA0 {
		pinmux = <0x30330140 1 0x0 0 0x303303a8>;
	};
	/omit-if-no-ref/ iomuxc_sd1_clk_gpio_io_gpio2_io00: IOMUXC_SD1_CLK_GPIO_IO_GPIO2_IO00 {
		pinmux = <0x303300a0 5 0x0 0 0x30330308>;
	};
	/omit-if-no-ref/ iomuxc_sd1_clk_usdhc_clk_usdhc1_clk: IOMUXC_SD1_CLK_USDHC_CLK_USDHC1_CLK {
		pinmux = <0x303300a0 0 0x0 0 0x30330308>;
	};
	/omit-if-no-ref/ iomuxc_sd1_cmd_gpio_io_gpio2_io01: IOMUXC_SD1_CMD_GPIO_IO_GPIO2_IO01 {
		pinmux = <0x303300a4 5 0x0 0 0x3033030c>;
	};
	/omit-if-no-ref/ iomuxc_sd1_cmd_usdhc_cmd_usdhc1_cmd: IOMUXC_SD1_CMD_USDHC_CMD_USDHC1_CMD {
		pinmux = <0x303300a4 0 0x0 0 0x3033030c>;
	};
	/omit-if-no-ref/ iomuxc_sd1_data0_gpio_io_gpio2_io02: IOMUXC_SD1_DATA0_GPIO_IO_GPIO2_IO02 {
		pinmux = <0x303300a8 5 0x0 0 0x30330310>;
	};
	/omit-if-no-ref/ iomuxc_sd1_data0_usdhc_data_usdhc1_data0: IOMUXC_SD1_DATA0_USDHC_DATA_USDHC1_DATA0 {
		pinmux = <0x303300a8 0 0x0 0 0x30330310>;
	};
	/omit-if-no-ref/ iomuxc_sd1_data1_gpio_io_gpio2_io03: IOMUXC_SD1_DATA1_GPIO_IO_GPIO2_IO03 {
		pinmux = <0x303300ac 5 0x0 0 0x30330314>;
	};
	/omit-if-no-ref/ iomuxc_sd1_data1_usdhc_data_usdhc1_data1: IOMUXC_SD1_DATA1_USDHC_DATA_USDHC1_DATA1 {
		pinmux = <0x303300ac 0 0x0 0 0x30330314>;
	};
	/omit-if-no-ref/ iomuxc_sd1_data2_gpio_io_gpio2_io04: IOMUXC_SD1_DATA2_GPIO_IO_GPIO2_IO04 {
		pinmux = <0x303300b0 5 0x0 0 0x30330318>;
	};
	/omit-if-no-ref/ iomuxc_sd1_data2_usdhc_data_usdhc1_data2: IOMUXC_SD1_DATA2_USDHC_DATA_USDHC1_DATA2 {
		pinmux = <0x303300b0 0 0x0 0 0x30330318>;
	};
	/omit-if-no-ref/ iomuxc_sd1_data3_gpio_io_gpio2_io05: IOMUXC_SD1_DATA3_GPIO_IO_GPIO2_IO05 {
		pinmux = <0x303300b4 5 0x0 0 0x3033031c>;
	};
	/omit-if-no-ref/ iomuxc_sd1_data3_usdhc_data_usdhc1_data3: IOMUXC_SD1_DATA3_USDHC_DATA_USDHC1_DATA3 {
		pinmux = <0x303300b4 0 0x0 0 0x3033031c>;
	};
	/omit-if-no-ref/ iomuxc_sd1_data4_gpio_io_gpio2_io06: IOMUXC_SD1_DATA4_GPIO_IO_GPIO2_IO06 {
		pinmux = <0x303300b8 5 0x0 0 0x30330320>;
	};
	/omit-if-no-ref/ iomuxc_sd1_data4_usdhc_data_usdhc1_data4: IOMUXC_SD1_DATA4_USDHC_DATA_USDHC1_DATA4 {
		pinmux = <0x303300b8 0 0x0 0 0x30330320>;
	};
	/omit-if-no-ref/ iomuxc_sd1_data5_gpio_io_gpio2_io07: IOMUXC_SD1_DATA5_GPIO_IO_GPIO2_IO07 {
		pinmux = <0x303300bc 5 0x0 0 0x30330324>;
	};
	/omit-if-no-ref/ iomuxc_sd1_data5_usdhc_data_usdhc1_data5: IOMUXC_SD1_DATA5_USDHC_DATA_USDHC1_DATA5 {
		pinmux = <0x303300bc 0 0x0 0 0x30330324>;
	};
	/omit-if-no-ref/ iomuxc_sd1_data6_gpio_io_gpio2_io08: IOMUXC_SD1_DATA6_GPIO_IO_GPIO2_IO08 {
		pinmux = <0x303300c0 5 0x0 0 0x30330328>;
	};
	/omit-if-no-ref/ iomuxc_sd1_data6_usdhc_data_usdhc1_data6: IOMUXC_SD1_DATA6_USDHC_DATA_USDHC1_DATA6 {
		pinmux = <0x303300c0 0 0x0 0 0x30330328>;
	};
	/omit-if-no-ref/ iomuxc_sd1_data7_gpio_io_gpio2_io09: IOMUXC_SD1_DATA7_GPIO_IO_GPIO2_IO09 {
		pinmux = <0x303300c4 5 0x0 0 0x3033032c>;
	};
	/omit-if-no-ref/ iomuxc_sd1_data7_usdhc_data_usdhc1_data7: IOMUXC_SD1_DATA7_USDHC_DATA_USDHC1_DATA7 {
		pinmux = <0x303300c4 0 0x0 0 0x3033032c>;
	};
	/omit-if-no-ref/ iomuxc_sd1_reset_b_gpio_io_gpio2_io10: IOMUXC_SD1_RESET_B_GPIO_IO_GPIO2_IO10 {
		pinmux = <0x303300c8 5 0x0 0 0x30330330>;
	};
	/omit-if-no-ref/ iomuxc_sd1_reset_b_usdhc_reset_b_usdhc1_reset_b: IOMUXC_SD1_RESET_B_USDHC_RESET_B_USDHC1_RESET_B {
		pinmux = <0x303300c8 0 0x0 0 0x30330330>;
	};
	/omit-if-no-ref/ iomuxc_sd1_strobe_gpio_io_gpio2_io11: IOMUXC_SD1_STROBE_GPIO_IO_GPIO2_IO11 {
		pinmux = <0x303300cc 5 0x0 0 0x30330334>;
	};
	/omit-if-no-ref/ iomuxc_sd1_strobe_usdhc_strobe_usdhc1_strobe: IOMUXC_SD1_STROBE_USDHC_STROBE_USDHC1_STROBE {
		pinmux = <0x303300cc 0 0x0 0 0x30330334>;
	};
	/omit-if-no-ref/ iomuxc_sd2_cd_b_gpio_io_gpio2_io12: IOMUXC_SD2_CD_B_GPIO_IO_GPIO2_IO12 {
		pinmux = <0x303300d0 5 0x0 0 0x30330338>;
	};
	/omit-if-no-ref/ iomuxc_sd2_cd_b_usdhc_cd_b_usdhc2_cd_b: IOMUXC_SD2_CD_B_USDHC_CD_B_USDHC2_CD_B {
		pinmux = <0x303300d0 0 0x0 0 0x30330338>;
	};
	/omit-if-no-ref/ iomuxc_sd2_clk_gpio_io_gpio2_io13: IOMUXC_SD2_CLK_GPIO_IO_GPIO2_IO13 {
		pinmux = <0x303300d4 5 0x0 0 0x3033033c>;
	};
	/omit-if-no-ref/ iomuxc_sd2_clk_usdhc_clk_usdhc2_clk: IOMUXC_SD2_CLK_USDHC_CLK_USDHC2_CLK {
		pinmux = <0x303300d4 0 0x0 0 0x3033033c>;
	};
	/omit-if-no-ref/ iomuxc_sd2_cmd_gpio_io_gpio2_io14: IOMUXC_SD2_CMD_GPIO_IO_GPIO2_IO14 {
		pinmux = <0x303300d8 5 0x0 0 0x30330340>;
	};
	/omit-if-no-ref/ iomuxc_sd2_cmd_usdhc_cmd_usdhc2_cmd: IOMUXC_SD2_CMD_USDHC_CMD_USDHC2_CMD {
		pinmux = <0x303300d8 0 0x0 0 0x30330340>;
	};
	/omit-if-no-ref/ iomuxc_sd2_data0_gpio_io_gpio2_io15: IOMUXC_SD2_DATA0_GPIO_IO_GPIO2_IO15 {
		pinmux = <0x303300dc 5 0x0 0 0x30330344>;
	};
	/omit-if-no-ref/ iomuxc_sd2_data0_usdhc_data_usdhc2_data0: IOMUXC_SD2_DATA0_USDHC_DATA_USDHC2_DATA0 {
		pinmux = <0x303300dc 0 0x0 0 0x30330344>;
	};
	/omit-if-no-ref/ iomuxc_sd2_data1_gpio_io_gpio2_io16: IOMUXC_SD2_DATA1_GPIO_IO_GPIO2_IO16 {
		pinmux = <0x303300e0 5 0x0 0 0x30330348>;
	};
	/omit-if-no-ref/ iomuxc_sd2_data1_usdhc_data_usdhc2_data1: IOMUXC_SD2_DATA1_USDHC_DATA_USDHC2_DATA1 {
		pinmux = <0x303300e0 0 0x0 0 0x30330348>;
	};
	/omit-if-no-ref/ iomuxc_sd2_data2_gpio_io_gpio2_io17: IOMUXC_SD2_DATA2_GPIO_IO_GPIO2_IO17 {
		pinmux = <0x303300e4 5 0x0 0 0x3033034c>;
	};
	/omit-if-no-ref/ iomuxc_sd2_data2_usdhc_data_usdhc2_data2: IOMUXC_SD2_DATA2_USDHC_DATA_USDHC2_DATA2 {
		pinmux = <0x303300e4 0 0x0 0 0x3033034c>;
	};
	/omit-if-no-ref/ iomuxc_sd2_data3_gpio_io_gpio2_io18: IOMUXC_SD2_DATA3_GPIO_IO_GPIO2_IO18 {
		pinmux = <0x303300e8 5 0x0 0 0x30330350>;
	};
	/omit-if-no-ref/ iomuxc_sd2_data3_usdhc_data_usdhc2_data3: IOMUXC_SD2_DATA3_USDHC_DATA_USDHC2_DATA3 {
		pinmux = <0x303300e8 0 0x0 0 0x30330350>;
	};
	/omit-if-no-ref/ iomuxc_sd2_reset_b_gpio_io_gpio2_io19: IOMUXC_SD2_RESET_B_GPIO_IO_GPIO2_IO19 {
		pinmux = <0x303300ec 5 0x0 0 0x30330354>;
	};
	/omit-if-no-ref/ iomuxc_sd2_reset_b_usdhc_reset_b_usdhc2_reset_b: IOMUXC_SD2_RESET_B_USDHC_RESET_B_USDHC2_RESET_B {
		pinmux = <0x303300ec 0 0x0 0 0x30330354>;
	};
	/omit-if-no-ref/ iomuxc_sd2_wp_gpio_io_gpio2_io20: IOMUXC_SD2_WP_GPIO_IO_GPIO2_IO20 {
		pinmux = <0x303300f0 5 0x0 0 0x30330358>;
	};
	/omit-if-no-ref/ iomuxc_sd2_wp_usdhc_wp_usdhc2_wp: IOMUXC_SD2_WP_USDHC_WP_USDHC2_WP {
		pinmux = <0x303300f0 0 0x0 0 0x30330358>;
	};
	/omit-if-no-ref/ iomuxc_spdif_ext_clk_gpio_io_gpio5_io05: IOMUXC_SPDIF_EXT_CLK_GPIO_IO_GPIO5_IO05 {
		pinmux = <0x303301f0 5 0x0 0 0x30330458>;
	};
	/omit-if-no-ref/ iomuxc_spdif_ext_clk_pwm_out_pwm1_out: IOMUXC_SPDIF_EXT_CLK_PWM_OUT_PWM1_OUT {
		pinmux = <0x303301f0 1 0x0 0 0x30330458>;
	};
	/omit-if-no-ref/ iomuxc_spdif_ext_clk_spdif_ext_clk_spdif_ext_clk: IOMUXC_SPDIF_EXT_CLK_SPDIF_EXT_CLK_SPDIF_EXT_CLK {
		pinmux = <0x303301f0 0 0x0 0 0x30330458>;
	};
	/omit-if-no-ref/ iomuxc_spdif_rx_gpio_io_gpio5_io04: IOMUXC_SPDIF_RX_GPIO_IO_GPIO5_IO04 {
		pinmux = <0x303301ec 5 0x0 0 0x30330454>;
	};
	/omit-if-no-ref/ iomuxc_spdif_rx_pwm_out_pwm2_out: IOMUXC_SPDIF_RX_PWM_OUT_PWM2_OUT {
		pinmux = <0x303301ec 1 0x0 0 0x30330454>;
	};
	/omit-if-no-ref/ iomuxc_spdif_rx_spdif_in_spdif_in: IOMUXC_SPDIF_RX_SPDIF_IN_SPDIF_IN {
		pinmux = <0x303301ec 0 0x0 0 0x30330454>;
	};
	/omit-if-no-ref/ iomuxc_spdif_tx_gpio_io_gpio5_io03: IOMUXC_SPDIF_TX_GPIO_IO_GPIO5_IO03 {
		pinmux = <0x303301e8 5 0x0 0 0x30330450>;
	};
	/omit-if-no-ref/ iomuxc_spdif_tx_pwm_out_pwm3_out: IOMUXC_SPDIF_TX_PWM_OUT_PWM3_OUT {
		pinmux = <0x303301e8 1 0x0 0 0x30330450>;
	};
	/omit-if-no-ref/ iomuxc_spdif_tx_spdif_out_spdif_out: IOMUXC_SPDIF_TX_SPDIF_OUT_SPDIF_OUT {
		pinmux = <0x303301e8 0 0x0 0 0x30330450>;
	};
	/omit-if-no-ref/ iomuxc_test_mode_tcu_test_mode_tcu_test_mode: IOMUXC_TEST_MODE_TCU_TEST_MODE_TCU_TEST_MODE {
		pinmux = <0x0 0 0x0 0 0x30330254>;
	};
	/omit-if-no-ref/ iomuxc_uart1_rxd_ecspi_sclk_ecspi3_sclk: IOMUXC_UART1_RXD_ECSPI_SCLK_ECSPI3_SCLK {
		pinmux = <0x30330234 1 0x0 0 0x3033049c>;
	};
	/omit-if-no-ref/ iomuxc_uart1_rxd_gpio_io_gpio5_io22: IOMUXC_UART1_RXD_GPIO_IO_GPIO5_IO22 {
		pinmux = <0x30330234 5 0x0 0 0x3033049c>;
	};
	/omit-if-no-ref/ iomuxc_uart1_rxd_uart_rx_uart1_rx: IOMUXC_UART1_RXD_UART_RX_UART1_RX {
		pinmux = <0x30330234 0 0x303304f4 0 0x3033049c>;
	};
	/omit-if-no-ref/ iomuxc_uart1_rxd_uart_tx_uart1_rx: IOMUXC_UART1_RXD_UART_TX_UART1_RX {
		pinmux = <0x30330234 0 0x0 0 0x3033049c>;
	};
	/omit-if-no-ref/ iomuxc_uart1_txd_ecspi_mosi_ecspi3_mosi: IOMUXC_UART1_TXD_ECSPI_MOSI_ECSPI3_MOSI {
		pinmux = <0x30330238 1 0x0 0 0x303304a0>;
	};
	/omit-if-no-ref/ iomuxc_uart1_txd_gpio_io_gpio5_io23: IOMUXC_UART1_TXD_GPIO_IO_GPIO5_IO23 {
		pinmux = <0x30330238 5 0x0 0 0x303304a0>;
	};
	/omit-if-no-ref/ iomuxc_uart1_txd_uart_rx_uart1_tx: IOMUXC_UART1_TXD_UART_RX_UART1_TX {
		pinmux = <0x30330238 0 0x303304f4 1 0x303304a0>;
	};
	/omit-if-no-ref/ iomuxc_uart1_txd_uart_tx_uart1_tx: IOMUXC_UART1_TXD_UART_TX_UART1_TX {
		pinmux = <0x30330238 0 0x0 0 0x303304a0>;
	};
	/omit-if-no-ref/ iomuxc_uart2_rxd_ecspi_miso_ecspi3_miso: IOMUXC_UART2_RXD_ECSPI_MISO_ECSPI3_MISO {
		pinmux = <0x3033023c 1 0x0 0 0x303304a4>;
	};
	/omit-if-no-ref/ iomuxc_uart2_rxd_gpio_io_gpio5_io24: IOMUXC_UART2_RXD_GPIO_IO_GPIO5_IO24 {
		pinmux = <0x3033023c 5 0x0 0 0x303304a4>;
	};
	/omit-if-no-ref/ iomuxc_uart2_rxd_uart_rx_uart2_rx: IOMUXC_UART2_RXD_UART_RX_UART2_RX {
		pinmux = <0x3033023c 0 0x303304fc 0 0x303304a4>;
	};
	/omit-if-no-ref/ iomuxc_uart2_rxd_uart_tx_uart2_rx: IOMUXC_UART2_RXD_UART_TX_UART2_RX {
		pinmux = <0x3033023c 0 0x0 0 0x303304a4>;
	};
	/omit-if-no-ref/ iomuxc_uart2_txd_ecspi_ss_ecspi3_ss0: IOMUXC_UART2_TXD_ECSPI_SS_ECSPI3_SS0 {
		pinmux = <0x30330240 1 0x0 0 0x303304a8>;
	};
	/omit-if-no-ref/ iomuxc_uart2_txd_gpio_io_gpio5_io25: IOMUXC_UART2_TXD_GPIO_IO_GPIO5_IO25 {
		pinmux = <0x30330240 5 0x0 0 0x303304a8>;
	};
	/omit-if-no-ref/ iomuxc_uart2_txd_uart_rx_uart2_tx: IOMUXC_UART2_TXD_UART_RX_UART2_TX {
		pinmux = <0x30330240 0 0x303304fc 1 0x303304a8>;
	};
	/omit-if-no-ref/ iomuxc_uart2_txd_uart_tx_uart2_tx: IOMUXC_UART2_TXD_UART_TX_UART2_TX {
		pinmux = <0x30330240 0 0x0 0 0x303304a8>;
	};
	/omit-if-no-ref/ iomuxc_uart3_rxd_gpio_io_gpio5_io26: IOMUXC_UART3_RXD_GPIO_IO_GPIO5_IO26 {
		pinmux = <0x30330244 5 0x0 0 0x303304ac>;
	};
	/omit-if-no-ref/ iomuxc_uart3_rxd_uart_cts_b_uart1_cts_b: IOMUXC_UART3_RXD_UART_CTS_B_UART1_CTS_B {
		pinmux = <0x30330244 1 0x0 0 0x303304ac>;
	};
	/omit-if-no-ref/ iomuxc_uart3_rxd_uart_rts_b_uart1_cts_b: IOMUXC_UART3_RXD_UART_RTS_B_UART1_CTS_B {
		pinmux = <0x30330244 1 0x303304f0 0 0x303304ac>;
	};
	/omit-if-no-ref/ iomuxc_uart3_rxd_uart_rx_uart3_rx: IOMUXC_UART3_RXD_UART_RX_UART3_RX {
		pinmux = <0x30330244 0 0x30330504 2 0x303304ac>;
	};
	/omit-if-no-ref/ iomuxc_uart3_rxd_uart_tx_uart3_rx: IOMUXC_UART3_RXD_UART_TX_UART3_RX {
		pinmux = <0x30330244 0 0x0 0 0x303304ac>;
	};
	/omit-if-no-ref/ iomuxc_uart3_txd_gpio_io_gpio5_io27: IOMUXC_UART3_TXD_GPIO_IO_GPIO5_IO27 {
		pinmux = <0x30330248 5 0x0 0 0x303304b0>;
	};
	/omit-if-no-ref/ iomuxc_uart3_txd_uart_cts_b_uart1_rts_b: IOMUXC_UART3_TXD_UART_CTS_B_UART1_RTS_B {
		pinmux = <0x30330248 1 0x0 0 0x303304b0>;
	};
	/omit-if-no-ref/ iomuxc_uart3_txd_uart_rts_b_uart1_rts_b: IOMUXC_UART3_TXD_UART_RTS_B_UART1_RTS_B {
		pinmux = <0x30330248 1 0x303304f0 1 0x303304b0>;
	};
	/omit-if-no-ref/ iomuxc_uart3_txd_uart_rx_uart3_tx: IOMUXC_UART3_TXD_UART_RX_UART3_TX {
		pinmux = <0x30330248 0 0x30330504 3 0x303304b0>;
	};
	/omit-if-no-ref/ iomuxc_uart3_txd_uart_tx_uart3_tx: IOMUXC_UART3_TXD_UART_TX_UART3_TX {
		pinmux = <0x30330248 0 0x0 0 0x303304b0>;
	};
	/omit-if-no-ref/ iomuxc_uart4_rxd_gpio_io_gpio5_io28: IOMUXC_UART4_RXD_GPIO_IO_GPIO5_IO28 {
		pinmux = <0x3033024c 5 0x0 0 0x303304b4>;
	};
	/omit-if-no-ref/ iomuxc_uart4_rxd_pcie_clkreq_b_pcie1_clkreq_b: IOMUXC_UART4_RXD_PCIE_CLKREQ_B_PCIE1_CLKREQ_B {
		pinmux = <0x3033024c 2 0x30330524 1 0x303304b4>;
	};
	/omit-if-no-ref/ iomuxc_uart4_rxd_uart_cts_b_uart2_cts_b: IOMUXC_UART4_RXD_UART_CTS_B_UART2_CTS_B {
		pinmux = <0x3033024c 1 0x0 0 0x303304b4>;
	};
	/omit-if-no-ref/ iomuxc_uart4_rxd_uart_rts_b_uart2_cts_b: IOMUXC_UART4_RXD_UART_RTS_B_UART2_CTS_B {
		pinmux = <0x3033024c 1 0x303304f8 0 0x303304b4>;
	};
	/omit-if-no-ref/ iomuxc_uart4_rxd_uart_rx_uart4_rx: IOMUXC_UART4_RXD_UART_RX_UART4_RX {
		pinmux = <0x3033024c 0 0x3033050c 2 0x303304b4>;
	};
	/omit-if-no-ref/ iomuxc_uart4_rxd_uart_tx_uart4_rx: IOMUXC_UART4_RXD_UART_TX_UART4_RX {
		pinmux = <0x3033024c 0 0x0 0 0x303304b4>;
	};
	/omit-if-no-ref/ iomuxc_uart4_txd_gpio_io_gpio5_io29: IOMUXC_UART4_TXD_GPIO_IO_GPIO5_IO29 {
		pinmux = <0x30330250 5 0x0 0 0x303304b8>;
	};
	/omit-if-no-ref/ iomuxc_uart4_txd_pcie_clkreq_b_pcie2_clkreq_b: IOMUXC_UART4_TXD_PCIE_CLKREQ_B_PCIE2_CLKREQ_B {
		pinmux = <0x30330250 2 0x30330528 1 0x303304b8>;
	};
	/omit-if-no-ref/ iomuxc_uart4_txd_uart_cts_b_uart2_rts_b: IOMUXC_UART4_TXD_UART_CTS_B_UART2_RTS_B {
		pinmux = <0x30330250 1 0x0 0 0x303304b8>;
	};
	/omit-if-no-ref/ iomuxc_uart4_txd_uart_rts_b_uart2_rts_b: IOMUXC_UART4_TXD_UART_RTS_B_UART2_RTS_B {
		pinmux = <0x30330250 1 0x303304f8 1 0x303304b8>;
	};
	/omit-if-no-ref/ iomuxc_uart4_txd_uart_rx_uart4_tx: IOMUXC_UART4_TXD_UART_RX_UART4_TX {
		pinmux = <0x30330250 0 0x3033050c 3 0x303304b8>;
	};
	/omit-if-no-ref/ iomuxc_uart4_txd_uart_tx_uart4_tx: IOMUXC_UART4_TXD_UART_TX_UART4_TX {
		pinmux = <0x30330250 0 0x0 0 0x303304b8>;
	};
};
