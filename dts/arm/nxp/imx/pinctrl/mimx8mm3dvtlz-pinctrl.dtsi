/*
 * Copyright 2024, NXP
 * SPDX-License-Identifier: Apache-2.0
 *
 * Note: File generated by gen_soc_headers.py
 * from configuration data for MIMX8MM3DVTLZ
 */

/*
 * Content deduplicated by dedup_pinctrl.py:
 * the pin mux data of this part is identical to mimx8mm6cvtkz-pinctrl.dtsi.
 * Do not edit; edit the canonical file instead.
 * target-hash: b0759339f104cd1e
 */

#include "mimx8mm6cvtkz-pinctrl.dtsi"
