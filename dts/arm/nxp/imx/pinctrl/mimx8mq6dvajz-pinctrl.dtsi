/*
 * Copyright (c) 2022, NXP
 * SPDX-License-Identifier: Apache-2.0
 *
 * Note: File generated by imx_cfg_utils.py
 * from configuration data for MIMX8MQ6DVAJZ
 */

/*
 * Delta-deduplicated by dedup_pinctrl.py:
 * based on mimx8md7cvahz-pinctrl.dtsi with this part's differences applied
 * below (0 removed, 0 changed,
 * 2 added). Regenerate with dedup_pinctrl.py;
 * do not edit by hand.
 * target-hash: 2756143bb0fd5b26
 */

#include "mimx8md7cvahz-pinctrl.dtsi"

&iomuxc {
	/omit-if-no-ref/ iomuxc_sd2_data3_src_early_reset_src_early_reset: IOMUXC_SD2_DATA3_SRC_EARLY_RESET_SRC_EARLY_RESET {
		pinmux = <0x303300e8 6 0x0 0 0x30330350>;
	};
	/omit-if-no-ref/ iomuxc_sd2_reset_b_src_system_reset_src_system_reset: IOMUXC_SD2_RESET_B_SRC_SYSTEM_RESET_SRC_SYSTEM_RESET {
		pinmux = <0x303300ec 6 0x0 0 0x30330354>;
	};
};
