/*
 * Copyright 2024, NXP
 * SPDX-License-Identifier: Apache-2.0
 *
 * Note: File generated by gen_soc_headers.py
 * from configuration data for MIMX8MQ7CVAHZ
 */

/*
 * Content deduplicated by dedup_pinctrl.py:
 * the pin mux data of this part is identical to mimx8md7cvahz-pinctrl.dtsi.
 * Do not edit; edit the canonical file instead.
 * target-hash: 2756143bb0fd5b26
 */

#include "mimx8md7cvahz-pinctrl.dtsi"
