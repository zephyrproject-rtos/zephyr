/*
 * Copyright 2024, NXP
 * SPDX-License-Identifier: Apache-2.0
 *
 * Note: File generated by gen_soc_headers.py
 * from configuration data for MIMX8ML6CVNKZ
 */

/*
 * Content deduplicated by dedup_pinctrl.py:
 * the pin mux data of this part is identical to mimx8ml8cvnkz-pinctrl.dtsi.
 * Do not edit; edit the canonical file instead.
 * target-hash: 7bcf1123b53b36c0
 */

#include "mimx8ml8cvnkz-pinctrl.dtsi"
