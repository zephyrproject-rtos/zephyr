/*
 * Copyright 2024-2025 NXP
 * SPDX-License-Identifier: Apache-2.0
 *
 * Note: File generated by gen_soc_headers.py
 * from configuration data for MIMX9596CVTXN
 */

/*
 * Delta-deduplicated by dedup_pinctrl.py:
 * based on mimx9596avzxn-pinctrl.dtsi with this part's differences applied
 * below (10 removed, 0 changed,
 * 0 added). Regenerate with dedup_pinctrl.py;
 * do not edit by hand.
 * target-hash: 01b4bc8d8e6e81f7
 */

#include "mimx9596avzxn-pinctrl.dtsi"

/delete-node/ &iomuxc_gpio_io35_gpio_io_bit_gpio5_io_bit15;
/delete-node/ &iomuxc_gpio_io35_lpspi_sin_lpspi4_sin;
/delete-node/ &iomuxc_gpio_io35_lpuart_rts_b_lpuart6_rts_b;
/delete-node/ &iomuxc_gpio_io35_pcie_clkreq_b_pcie2_clkreq_b;
/delete-node/ &iomuxc_gpio_io36_gpio_io_bit_gpio5_io_bit16;
/delete-node/ &iomuxc_gpio_io36_lpspi_sout_lpspi4_sout;
/delete-node/ &iomuxc_gpio_io36_lpuart_tx_lpuart7_tx;
/delete-node/ &iomuxc_gpio_io37_gpio_io_bit_gpio5_io_bit17;
/delete-node/ &iomuxc_gpio_io37_lpspi_sck_lpspi4_sck;
/delete-node/ &iomuxc_gpio_io37_lpuart_rx_lpuart7_rx;
