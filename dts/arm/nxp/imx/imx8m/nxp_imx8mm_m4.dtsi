/*
 * Copyright (c) 2019, Manivannan Sadhasivam
 *
 * SPDX-License-Identifier: Apache-2.0
 */

#include <nxp/imx/imx8m/nxp_imx8m_m4.dtsi>

&pinctrl {
	status = "okay";
	compatible = "nxp,imx8mp-pinctrl";
};
