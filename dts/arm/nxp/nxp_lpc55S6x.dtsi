/*
 * Copyright (c) 2019,2023 NXP
 *
 * SPDX-License-Identifier: Apache-2.0
 */


/* Include the base devicetree */
#include "nxp_lpc55S6x_ns.dtsi"

&sram {
	/* Moves all child addresses from 0x4000000-0x40104000 by 0x10000000 */
	ranges = <0x4000000 0x14000000 DT_SIZE_K(984080)>;

};


&peripheral {
	/* Moves all child addresses from 0x40000000-0x50000000 by 0x10000000 */
	ranges = <0x40000000 0x50000000 DT_SIZE_K(262144)>;

	flash: flash@40034000 {
		/* Move flash to secure region */
		ranges = <0 0x10000000 DT_SIZE_K(630)>;
	};

};
