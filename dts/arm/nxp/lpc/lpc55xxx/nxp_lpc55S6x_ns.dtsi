/*
 * Copyright (c) 2019, NXP
 *
 * SPDX-License-Identifier: Apache-2.0
 */

/ {
	soc {
		sram: sram@4000000 {
			ranges = <0x4000000 0x4000000 0x20000000>;
		};

		peripheral: peripheral@40000000 {
			/*
			 * Map the IAP flash window to the non-secure flash alias at 0x0.
			 * This only translates addresses; TrustZone attribution is unchanged.
			 */
			ranges = <0x0 0x40000000 0x10000000>,
				 <0x10000000 0x0 0x3020000>;
		};
	};
};

#include "nxp_lpc55S6x_common.dtsi"
