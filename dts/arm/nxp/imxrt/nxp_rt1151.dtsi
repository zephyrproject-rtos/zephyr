/*
 * SPDX-FileCopyrightText: Copyright 2026 NXP
 *
 * SPDX-License-Identifier: Apache-2.0
 */

/* SOC DTS for the single Cortex-M7 core i.MX RT1151 */

/* Include the shared RT11xx series devicetree for the Cortex-M7 core */
#include <nxp/imxrt/nxp_rt11xx_cm7.dtsi>

/* Includes the specifics for the RT1150 family */
#include <nxp/imxrt/nxp_rt115x.dtsi>

/*
 * The RT1151 additionally has no parallel camera interface (CSI),
 * eLCDIF display controller, or PXP pixel pipeline compared to the RT1152.
 */
/delete-node/ &csi;
/delete-node/ &lcdif;
/delete-node/ &pxp;
