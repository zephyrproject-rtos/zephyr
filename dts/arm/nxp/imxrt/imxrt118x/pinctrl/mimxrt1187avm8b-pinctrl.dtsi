/*
 * Copyright 2025, NXP
 * SPDX-License-Identifier: Apache-2.0
 *
 * Note: File generated by gen_soc_headers.py
 * from configuration data for MIMXRT1187AVM8B
 */

/*
 * Delta-deduplicated by dedup_pinctrl.py:
 * based on mimxrt1189cvm8b-pinctrl.dtsi with this part's differences applied
 * below (84 removed, 0 changed,
 * 0 added). Regenerate with dedup_pinctrl.py;
 * do not edit by hand.
 * target-hash: 94eb1e46fe89fe37
 */

#include "mimxrt1189cvm8b-pinctrl.dtsi"

/delete-node/ &iomuxc_aon_gpio_aon_02_clkout25m;
/delete-node/ &iomuxc_aon_gpio_aon_03_ecat_led_state_run;
/delete-node/ &iomuxc_aon_gpio_aon_04_ecat_led_run;
/delete-node/ &iomuxc_aon_gpio_aon_05_ecat_led_err;
/delete-node/ &iomuxc_aon_gpio_aon_06_ecat_sda;
/delete-node/ &iomuxc_aon_gpio_aon_07_ecat_scl;
/delete-node/ &iomuxc_aon_gpio_aon_08_ecat_link_act_0;
/delete-node/ &iomuxc_aon_gpio_aon_09_ecat_link_act_1;
/delete-node/ &iomuxc_gpio_ad_15_clkout25m;
/delete-node/ &iomuxc_gpio_ad_16_ecat_link_mii_0;
/delete-node/ &iomuxc_gpio_ad_17_ecat_link_mii_1;
/delete-node/ &iomuxc_gpio_ad_18_ecat_scl;
/delete-node/ &iomuxc_gpio_ad_19_ecat_sda;
/delete-node/ &iomuxc_gpio_ad_21_ecat_led_run;
/delete-node/ &iomuxc_gpio_ad_22_ecat_led_err;
/delete-node/ &iomuxc_gpio_ad_23_ecat_led_state_run;
/delete-node/ &iomuxc_gpio_ad_24_ecat_link_act_0;
/delete-node/ &iomuxc_gpio_ad_25_ecat_link_act_1;
/delete-node/ &iomuxc_gpio_ad_30_ecat_mdc;
/delete-node/ &iomuxc_gpio_ad_31_ecat_mdio;
/delete-node/ &iomuxc_gpio_b2_00_clkout25m;
/delete-node/ &iomuxc_gpio_b2_01_ecat_pt1_rx_er;
/delete-node/ &iomuxc_gpio_b2_02_ecat_pt1_rxd_2;
/delete-node/ &iomuxc_gpio_b2_03_ecat_pt1_rxd_3;
/delete-node/ &iomuxc_gpio_b2_04_ecat_pt1_txd_2;
/delete-node/ &iomuxc_gpio_b2_05_ecat_pt1_txd_3;
/delete-node/ &iomuxc_gpio_b2_06_ecat_pt1_txd_0;
/delete-node/ &iomuxc_gpio_b2_07_ecat_pt1_txd_1;
/delete-node/ &iomuxc_gpio_b2_08_ecat_pt1_tx_en;
/delete-node/ &iomuxc_gpio_b2_09_ecat_pt1_tx_clk;
/delete-node/ &iomuxc_gpio_b2_10_ecat_pt1_rxd_0;
/delete-node/ &iomuxc_gpio_b2_11_ecat_pt1_rxd_1;
/delete-node/ &iomuxc_gpio_b2_12_ecat_pt1_rx_dv;
/delete-node/ &iomuxc_gpio_b2_13_ecat_pt1_rx_clk;
/delete-node/ &iomuxc_gpio_emc_b1_00_ecat_pt0_txd_3;
/delete-node/ &iomuxc_gpio_emc_b1_01_ecat_pt0_txd_2;
/delete-node/ &iomuxc_gpio_emc_b1_02_ecat_pt0_rx_clk;
/delete-node/ &iomuxc_gpio_emc_b1_03_ecat_pt0_rxd_3;
/delete-node/ &iomuxc_gpio_emc_b1_04_ecat_pt0_rxd_2;
/delete-node/ &iomuxc_gpio_emc_b1_05_ecat_pt0_txd_0;
/delete-node/ &iomuxc_gpio_emc_b1_06_ecat_pt0_txd_1;
/delete-node/ &iomuxc_gpio_emc_b1_07_ecat_pt0_tx_en;
/delete-node/ &iomuxc_gpio_emc_b1_08_ecat_pt0_tx_clk;
/delete-node/ &iomuxc_gpio_emc_b1_09_ecat_pt0_rxd_0;
/delete-node/ &iomuxc_gpio_emc_b1_10_ecat_pt0_rxd_1;
/delete-node/ &iomuxc_gpio_emc_b1_11_ecat_pt0_rx_dv;
/delete-node/ &iomuxc_gpio_emc_b1_12_ecat_pt0_rx_er;
/delete-node/ &iomuxc_gpio_emc_b1_26_ecat_pt1_txd_1;
/delete-node/ &iomuxc_gpio_emc_b1_27_ecat_pt1_txd_0;
/delete-node/ &iomuxc_gpio_emc_b1_28_ecat_pt1_tx_en;
/delete-node/ &iomuxc_gpio_emc_b1_29_ecat_pt1_tx_clk;
/delete-node/ &iomuxc_gpio_emc_b1_30_ecat_pt1_rxd_0;
/delete-node/ &iomuxc_gpio_emc_b1_31_ecat_pt1_rxd_1;
/delete-node/ &iomuxc_gpio_emc_b1_32_ecat_pt1_rx_dv;
/delete-node/ &iomuxc_gpio_emc_b1_33_ecat_pt1_rx_er;
/delete-node/ &iomuxc_gpio_emc_b1_34_ecat_pt1_rxd_2;
/delete-node/ &iomuxc_gpio_emc_b1_35_ecat_pt1_rxd_3;
/delete-node/ &iomuxc_gpio_emc_b1_36_ecat_pt1_txd_3;
/delete-node/ &iomuxc_gpio_emc_b1_37_ecat_pt1_txd_2;
/delete-node/ &iomuxc_gpio_emc_b1_38_ecat_pt1_rx_clk;
/delete-node/ &iomuxc_gpio_emc_b2_00_ecat_pt0_rx_clk;
/delete-node/ &iomuxc_gpio_emc_b2_01_ecat_pt0_rxd_2;
/delete-node/ &iomuxc_gpio_emc_b2_02_ecat_pt0_rxd_3;
/delete-node/ &iomuxc_gpio_emc_b2_03_ecat_pt0_txd_2;
/delete-node/ &iomuxc_gpio_emc_b2_04_ecat_pt0_txd_3;
/delete-node/ &iomuxc_gpio_emc_b2_05_ecat_pt0_txd_0;
/delete-node/ &iomuxc_gpio_emc_b2_06_ecat_pt0_txd_1;
/delete-node/ &iomuxc_gpio_emc_b2_07_ecat_pt0_tx_en;
/delete-node/ &iomuxc_gpio_emc_b2_08_ecat_pt0_tx_clk;
/delete-node/ &iomuxc_gpio_emc_b2_09_ecat_pt0_rxd_0;
/delete-node/ &iomuxc_gpio_emc_b2_10_ecat_pt0_rxd_1;
/delete-node/ &iomuxc_gpio_emc_b2_11_ecat_pt0_rx_dv;
/delete-node/ &iomuxc_gpio_emc_b2_12_ecat_pt0_rx_er;
/delete-node/ &iomuxc_gpio_emc_b2_13_ecat_pt1_txd_0;
/delete-node/ &iomuxc_gpio_emc_b2_14_ecat_pt1_txd_1;
/delete-node/ &iomuxc_gpio_emc_b2_15_ecat_pt1_tx_en;
/delete-node/ &iomuxc_gpio_emc_b2_16_ecat_pt1_tx_clk;
/delete-node/ &iomuxc_gpio_emc_b2_17_ecat_pt1_rxd_0;
/delete-node/ &iomuxc_gpio_emc_b2_18_ecat_pt1_rxd_1;
/delete-node/ &iomuxc_gpio_emc_b2_19_ecat_pt1_rx_dv;
/delete-node/ &iomuxc_gpio_emc_b2_20_ecat_pt1_rx_er;
/delete-node/ &iomuxc_gpio_sd_b1_02_ecat_reset_out;
/delete-node/ &iomuxc_gpio_sd_b2_10_ecat_mdio;
/delete-node/ &iomuxc_gpio_sd_b2_11_ecat_mdc;
