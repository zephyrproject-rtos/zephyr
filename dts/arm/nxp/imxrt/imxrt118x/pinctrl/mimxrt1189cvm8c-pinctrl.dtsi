/*
 * Copyright 2025, NXP
 * SPDX-License-Identifier: Apache-2.0
 *
 * Note: File generated by gen_soc_headers.py
 * from configuration data for MIMXRT1189CVM8C
 */

/*
 * Content deduplicated by dedup_pinctrl.py:
 * the pin mux data of this part is identical to mimxrt1189cvm8b-pinctrl.dtsi.
 * Do not edit; edit the canonical file instead.
 * target-hash: 94eb1e46fe89fe37
 */

#include "mimxrt1189cvm8b-pinctrl.dtsi"
