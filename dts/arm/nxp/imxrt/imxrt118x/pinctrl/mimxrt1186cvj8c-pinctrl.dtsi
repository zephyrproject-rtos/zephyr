/*
 * Copyright 2026 NXP
 * SPDX-License-Identifier: Apache-2.0
 *
 * Note: File generated by gen_soc_headers.py
 * from configuration data for MIMXRT1186CVJ8C
 */

/*
 * Delta-deduplicated by dedup_pinctrl.py:
 * based on mimxrt1189cvm8b-pinctrl.dtsi with this part's differences applied
 * below (492 removed, 0 changed,
 * 0 added). Regenerate with dedup_pinctrl.py;
 * do not edit by hand.
 * target-hash: 94eb1e46fe89fe37
 */

#include "mimxrt1189cvm8b-pinctrl.dtsi"

/delete-node/ &iomuxc_aon_gpio_aon_02_flexcan3_tx;
/delete-node/ &iomuxc_aon_gpio_aon_03_flexcan3_rx;
/delete-node/ &iomuxc_aon_gpio_aon_08_seco_tx;
/delete-node/ &iomuxc_aon_gpio_aon_09_seco_rx;
/delete-node/ &iomuxc_aon_gpio_aon_13_lpuart12_cts_b;
/delete-node/ &iomuxc_aon_gpio_aon_14_lpuart12_rts_b;
/delete-node/ &iomuxc_aon_gpio_aon_15_lpuart12_txd;
/delete-node/ &iomuxc_aon_gpio_aon_16_lpuart12_rxd;
/delete-node/ &iomuxc_aon_gpio_aon_18_flexcan3_tx;
/delete-node/ &iomuxc_aon_gpio_aon_19_flexcan3_rx;
/delete-node/ &iomuxc_aon_gpio_aon_19_lpuart12_txd;
/delete-node/ &iomuxc_aon_gpio_aon_20_lpuart12_rxd;
/delete-node/ &iomuxc_aon_gpio_aon_22_lpuart12_cts_b;
/delete-node/ &iomuxc_aon_gpio_aon_23_lpuart12_rts_b;
/delete-node/ &iomuxc_gpio_ad_00_acmp1_in1;
/delete-node/ &iomuxc_gpio_ad_00_flexcan2_tx;
/delete-node/ &iomuxc_gpio_ad_00_flexio2_d00;
/delete-node/ &iomuxc_gpio_ad_00_flexpwm1_pwm0_a;
/delete-node/ &iomuxc_gpio_ad_00_gpio4_io00;
/delete-node/ &iomuxc_gpio_ad_00_gpt2_capture1;
/delete-node/ &iomuxc_gpio_ad_00_mic_clk;
/delete-node/ &iomuxc_gpio_ad_00_qtimer4_timer0;
/delete-node/ &iomuxc_gpio_ad_00_sinc1_mod_clk0;
/delete-node/ &iomuxc_gpio_ad_01_acmp1_in2;
/delete-node/ &iomuxc_gpio_ad_01_flexcan2_rx;
/delete-node/ &iomuxc_gpio_ad_01_flexio2_d01;
/delete-node/ &iomuxc_gpio_ad_01_flexpwm1_pwm0_b;
/delete-node/ &iomuxc_gpio_ad_01_gpio4_io01;
/delete-node/ &iomuxc_gpio_ad_01_gpt2_capture2;
/delete-node/ &iomuxc_gpio_ad_01_mic_bitstream0;
/delete-node/ &iomuxc_gpio_ad_01_qtimer4_timer1;
/delete-node/ &iomuxc_gpio_ad_01_sinc1_mod_clk1;
/delete-node/ &iomuxc_gpio_ad_02_acmp1_in3;
/delete-node/ &iomuxc_gpio_ad_02_adc1_ch7a;
/delete-node/ &iomuxc_gpio_ad_02_flexio2_d02;
/delete-node/ &iomuxc_gpio_ad_02_flexpwm1_pwm1_a;
/delete-node/ &iomuxc_gpio_ad_02_gpio4_io02;
/delete-node/ &iomuxc_gpio_ad_02_gpt2_compare1;
/delete-node/ &iomuxc_gpio_ad_02_mic_bitstream1;
/delete-node/ &iomuxc_gpio_ad_02_qtimer4_timer2;
/delete-node/ &iomuxc_gpio_ad_02_sinc1_mod_clk2;
/delete-node/ &iomuxc_gpio_ad_03_acmp1_in4;
/delete-node/ &iomuxc_gpio_ad_03_adc1_ch7b;
/delete-node/ &iomuxc_gpio_ad_03_flexio2_d03;
/delete-node/ &iomuxc_gpio_ad_03_flexpwm1_pwm1_b;
/delete-node/ &iomuxc_gpio_ad_03_gpio4_io03;
/delete-node/ &iomuxc_gpio_ad_03_gpt2_compare2;
/delete-node/ &iomuxc_gpio_ad_03_mic_bitstream2;
/delete-node/ &iomuxc_gpio_ad_03_qtimer4_timer3;
/delete-node/ &iomuxc_gpio_ad_03_sinc1_emclk0;
/delete-node/ &iomuxc_gpio_ad_04_acmp2_in1;
/delete-node/ &iomuxc_gpio_ad_04_adc1_ch6a;
/delete-node/ &iomuxc_gpio_ad_04_flexio2_d04;
/delete-node/ &iomuxc_gpio_ad_04_flexpwm1_pwm2_b;
/delete-node/ &iomuxc_gpio_ad_04_gpio4_io04;
/delete-node/ &iomuxc_gpio_ad_04_gpt2_compare3;
/delete-node/ &iomuxc_gpio_ad_04_mic_bitstream3;
/delete-node/ &iomuxc_gpio_ad_04_qtimer5_timer0;
/delete-node/ &iomuxc_gpio_ad_04_sinc1_embit0;
/delete-node/ &iomuxc_gpio_ad_05_acmp2_in2;
/delete-node/ &iomuxc_gpio_ad_05_adc1_ch6b;
/delete-node/ &iomuxc_gpio_ad_05_ccm_enet_ref_clk_25m;
/delete-node/ &iomuxc_gpio_ad_05_flexio2_d05;
/delete-node/ &iomuxc_gpio_ad_05_flexpwm1_pwm2_a;
/delete-node/ &iomuxc_gpio_ad_05_gpio4_io05;
/delete-node/ &iomuxc_gpio_ad_05_gpt2_clk;
/delete-node/ &iomuxc_gpio_ad_05_qtimer5_timer1;
/delete-node/ &iomuxc_gpio_ad_05_sinc1_emclk1;
/delete-node/ &iomuxc_gpio_ad_06_adc1_ch5a;
/delete-node/ &iomuxc_gpio_ad_06_flexcan3_tx;
/delete-node/ &iomuxc_gpio_ad_06_flexio2_d06;
/delete-node/ &iomuxc_gpio_ad_06_flexpwm1_pwm0_x;
/delete-node/ &iomuxc_gpio_ad_06_gpio4_io06;
/delete-node/ &iomuxc_gpio_ad_06_qtimer5_timer2;
/delete-node/ &iomuxc_gpio_ad_06_sinc1_embit1;
/delete-node/ &iomuxc_gpio_ad_06_usb_otg2_oc;
/delete-node/ &iomuxc_gpio_ad_07_adc1_ch5b;
/delete-node/ &iomuxc_gpio_ad_07_flexcan3_rx;
/delete-node/ &iomuxc_gpio_ad_07_flexio2_d07;
/delete-node/ &iomuxc_gpio_ad_07_flexpwm1_pwm1_x;
/delete-node/ &iomuxc_gpio_ad_07_gpio4_io07;
/delete-node/ &iomuxc_gpio_ad_07_qtimer5_timer3;
/delete-node/ &iomuxc_gpio_ad_07_sinc1_emclk2;
/delete-node/ &iomuxc_gpio_ad_07_usb_otg2_pwr;
/delete-node/ &iomuxc_gpio_ad_08_adc1_ch4a;
/delete-node/ &iomuxc_gpio_ad_08_flexio2_d08;
/delete-node/ &iomuxc_gpio_ad_08_flexpwm1_pwm2_x;
/delete-node/ &iomuxc_gpio_ad_08_gpio4_io08;
/delete-node/ &iomuxc_gpio_ad_08_lpi2c5_scl;
/delete-node/ &iomuxc_gpio_ad_08_qtimer6_timer0;
/delete-node/ &iomuxc_gpio_ad_08_sinc1_embit2;
/delete-node/ &iomuxc_gpio_ad_08_usb_otg2_id;
/delete-node/ &iomuxc_gpio_ad_09_adc1_ch4b;
/delete-node/ &iomuxc_gpio_ad_09_flexio2_d09;
/delete-node/ &iomuxc_gpio_ad_09_flexpwm1_pwm3_x;
/delete-node/ &iomuxc_gpio_ad_09_gpio4_io09;
/delete-node/ &iomuxc_gpio_ad_09_lpi2c5_sda;
/delete-node/ &iomuxc_gpio_ad_09_qtimer6_timer1;
/delete-node/ &iomuxc_gpio_ad_09_sinc1_emclk3;
/delete-node/ &iomuxc_gpio_ad_09_usb_otg1_id;
/delete-node/ &iomuxc_gpio_ad_10_adc1_ch3a;
/delete-node/ &iomuxc_gpio_ad_10_flexio2_d10;
/delete-node/ &iomuxc_gpio_ad_10_flexpwm2_pwm0_x;
/delete-node/ &iomuxc_gpio_ad_10_gpio4_io10;
/delete-node/ &iomuxc_gpio_ad_10_qtimer6_timer2;
/delete-node/ &iomuxc_gpio_ad_10_sinc1_embit3;
/delete-node/ &iomuxc_gpio_ad_10_usb_otg1_pwr;
/delete-node/ &iomuxc_gpio_ad_11_adc1_ch3b;
/delete-node/ &iomuxc_gpio_ad_11_flexio2_d11;
/delete-node/ &iomuxc_gpio_ad_11_flexpwm2_pwm1_x;
/delete-node/ &iomuxc_gpio_ad_11_gpio4_io11;
/delete-node/ &iomuxc_gpio_ad_11_qtimer6_timer3;
/delete-node/ &iomuxc_gpio_ad_11_sinc1_break;
/delete-node/ &iomuxc_gpio_ad_11_usb_otg1_oc;
/delete-node/ &iomuxc_gpio_ad_12_lpi2c5_scls;
/delete-node/ &iomuxc_gpio_ad_13_lpi2c5_sdas;
/delete-node/ &iomuxc_gpio_ad_14_lpi2c5_hreq;
/delete-node/ &iomuxc_gpio_ad_15_lpuart10_txd;
/delete-node/ &iomuxc_gpio_ad_16_lpuart10_rxd;
/delete-node/ &iomuxc_gpio_ad_17_acmp1_out;
/delete-node/ &iomuxc_gpio_ad_18_acmp2_out;
/delete-node/ &iomuxc_gpio_ad_20_acmp4_out;
/delete-node/ &iomuxc_gpio_ad_20_adc2_ch1a;
/delete-node/ &iomuxc_gpio_ad_20_flexio2_d20;
/delete-node/ &iomuxc_gpio_ad_20_flexpwm4_pwm2_x;
/delete-node/ &iomuxc_gpio_ad_20_gpio4_io20;
/delete-node/ &iomuxc_gpio_ad_20_lpit2_trigger0;
/delete-node/ &iomuxc_gpio_ad_20_netc_1588_clk;
/delete-node/ &iomuxc_gpio_ad_20_netc_tmr_trig1;
/delete-node/ &iomuxc_gpio_ad_20_sai4_rx_data0;
/delete-node/ &iomuxc_gpio_ad_20_sinc1_emclk0;
/delete-node/ &iomuxc_gpio_ad_21_adc2_ch1b;
/delete-node/ &iomuxc_gpio_ad_21_ecat_led_run;
/delete-node/ &iomuxc_gpio_ad_21_flexio2_d21;
/delete-node/ &iomuxc_gpio_ad_21_flexpwm4_pwm3_x;
/delete-node/ &iomuxc_gpio_ad_21_gpio4_io21;
/delete-node/ &iomuxc_gpio_ad_21_lpit2_trigger1;
/delete-node/ &iomuxc_gpio_ad_21_netc_tmr_gclk;
/delete-node/ &iomuxc_gpio_ad_21_netc_tmr_trig2;
/delete-node/ &iomuxc_gpio_ad_21_sai4_tx_data0;
/delete-node/ &iomuxc_gpio_ad_21_sinc1_embit0;
/delete-node/ &iomuxc_gpio_ad_22_adc2_ch2a;
/delete-node/ &iomuxc_gpio_ad_22_ecat_led_err;
/delete-node/ &iomuxc_gpio_ad_22_flexio2_d22;
/delete-node/ &iomuxc_gpio_ad_22_gpio4_io22;
/delete-node/ &iomuxc_gpio_ad_22_lpit2_trigger2;
/delete-node/ &iomuxc_gpio_ad_22_netc_tmr_alarm1;
/delete-node/ &iomuxc_gpio_ad_22_sai4_tx_bclk;
/delete-node/ &iomuxc_gpio_ad_22_sinc1_emclk1;
/delete-node/ &iomuxc_gpio_ad_23_adc2_ch2b;
/delete-node/ &iomuxc_gpio_ad_23_ecat_led_state_run;
/delete-node/ &iomuxc_gpio_ad_23_flexio2_d23;
/delete-node/ &iomuxc_gpio_ad_23_gpio4_io23;
/delete-node/ &iomuxc_gpio_ad_23_lpit2_trigger3;
/delete-node/ &iomuxc_gpio_ad_23_netc_tmr_alarm2;
/delete-node/ &iomuxc_gpio_ad_23_sai4_tx_sync;
/delete-node/ &iomuxc_gpio_ad_23_sinc1_embit1;
/delete-node/ &iomuxc_gpio_ad_24_adc2_ch3a;
/delete-node/ &iomuxc_gpio_ad_24_ecat_link_act_0;
/delete-node/ &iomuxc_gpio_ad_24_flexio2_d24;
/delete-node/ &iomuxc_gpio_ad_24_flexpwm2_pwm0_a;
/delete-node/ &iomuxc_gpio_ad_24_gpio4_io24;
/delete-node/ &iomuxc_gpio_ad_24_lpi2c4_scl;
/delete-node/ &iomuxc_gpio_ad_24_lpuart6_txd;
/delete-node/ &iomuxc_gpio_ad_24_netc_tmr_trig1;
/delete-node/ &iomuxc_gpio_ad_24_sinc2_mod_clk1;
/delete-node/ &iomuxc_gpio_ad_25_adc2_ch3b;
/delete-node/ &iomuxc_gpio_ad_25_ecat_link_act_1;
/delete-node/ &iomuxc_gpio_ad_25_flexio2_d25;
/delete-node/ &iomuxc_gpio_ad_25_flexpwm2_pwm0_b;
/delete-node/ &iomuxc_gpio_ad_25_gpio4_io25;
/delete-node/ &iomuxc_gpio_ad_25_lpi2c4_sda;
/delete-node/ &iomuxc_gpio_ad_25_lpspi5_pcs3;
/delete-node/ &iomuxc_gpio_ad_25_lpuart6_rxd;
/delete-node/ &iomuxc_gpio_ad_25_netc_tmr_trig2;
/delete-node/ &iomuxc_gpio_ad_25_sinc2_mod_clk2;
/delete-node/ &iomuxc_gpio_ad_26_acmp2_in3;
/delete-node/ &iomuxc_gpio_ad_26_adc2_ch4a;
/delete-node/ &iomuxc_gpio_ad_26_flexio2_d26;
/delete-node/ &iomuxc_gpio_ad_26_flexpwm2_pwm1_a;
/delete-node/ &iomuxc_gpio_ad_26_gpio4_io26;
/delete-node/ &iomuxc_gpio_ad_26_kpp_row0;
/delete-node/ &iomuxc_gpio_ad_26_lpspi5_pcs2;
/delete-node/ &iomuxc_gpio_ad_26_lpuart5_txd;
/delete-node/ &iomuxc_gpio_ad_26_lpuart6_cts_b;
/delete-node/ &iomuxc_gpio_ad_26_mic_bitstream2;
/delete-node/ &iomuxc_gpio_ad_26_netc_tmr_pp1;
/delete-node/ &iomuxc_gpio_ad_26_sinc2_emclk0;
/delete-node/ &iomuxc_gpio_ad_26_usdhc2_cd_b;
/delete-node/ &iomuxc_gpio_ad_27_acmp2_in4;
/delete-node/ &iomuxc_gpio_ad_27_adc2_ch4b;
/delete-node/ &iomuxc_gpio_ad_27_flexio2_d27;
/delete-node/ &iomuxc_gpio_ad_27_flexpwm2_pwm1_b;
/delete-node/ &iomuxc_gpio_ad_27_gpio4_io27;
/delete-node/ &iomuxc_gpio_ad_27_kpp_col0;
/delete-node/ &iomuxc_gpio_ad_27_lpspi5_pcs1;
/delete-node/ &iomuxc_gpio_ad_27_lpuart5_rxd;
/delete-node/ &iomuxc_gpio_ad_27_lpuart6_rts_b;
/delete-node/ &iomuxc_gpio_ad_27_mic_clk;
/delete-node/ &iomuxc_gpio_ad_27_netc_tmr_pp2;
/delete-node/ &iomuxc_gpio_ad_27_sinc2_embit0;
/delete-node/ &iomuxc_gpio_ad_27_usdhc2_wp;
/delete-node/ &iomuxc_gpio_ad_28_acmp3_in1;
/delete-node/ &iomuxc_gpio_ad_28_adc2_ch5a;
/delete-node/ &iomuxc_gpio_ad_28_flexio2_d28;
/delete-node/ &iomuxc_gpio_ad_28_flexpwm2_pwm2_b;
/delete-node/ &iomuxc_gpio_ad_28_gpio4_io28;
/delete-node/ &iomuxc_gpio_ad_28_i3c1_pur;
/delete-node/ &iomuxc_gpio_ad_28_kpp_row3;
/delete-node/ &iomuxc_gpio_ad_28_lpspi5_sck;
/delete-node/ &iomuxc_gpio_ad_28_mic_bitstream0;
/delete-node/ &iomuxc_gpio_ad_28_netc_tmr_pp3;
/delete-node/ &iomuxc_gpio_ad_28_sinc2_emclk1;
/delete-node/ &iomuxc_gpio_ad_28_usdhc2_reset_b;
/delete-node/ &iomuxc_gpio_ad_30_usb_otg2_oc;
/delete-node/ &iomuxc_gpio_ad_31_usb_otg2_pwr;
/delete-node/ &iomuxc_gpio_ad_32_acmp4_in1;
/delete-node/ &iomuxc_gpio_ad_32_gpio5_io00;
/delete-node/ &iomuxc_gpio_ad_32_kpp_row1;
/delete-node/ &iomuxc_gpio_ad_32_lpi2c5_scl;
/delete-node/ &iomuxc_gpio_ad_32_lpuart10_txd;
/delete-node/ &iomuxc_gpio_ad_32_mic_bitstream3;
/delete-node/ &iomuxc_gpio_ad_32_netc_tmr_trig1;
/delete-node/ &iomuxc_gpio_ad_32_pmic_ready;
/delete-node/ &iomuxc_gpio_ad_32_sinc2_emclk3;
/delete-node/ &iomuxc_gpio_ad_32_usb_otg2_id;
/delete-node/ &iomuxc_gpio_ad_32_usdhc1_cd_b;
/delete-node/ &iomuxc_gpio_ad_33_acmp4_in2;
/delete-node/ &iomuxc_gpio_ad_33_gpio5_io01;
/delete-node/ &iomuxc_gpio_ad_33_kpp_col1;
/delete-node/ &iomuxc_gpio_ad_33_lpi2c5_sda;
/delete-node/ &iomuxc_gpio_ad_33_lpuart10_rxd;
/delete-node/ &iomuxc_gpio_ad_33_netc_tmr_trig2;
/delete-node/ &iomuxc_gpio_ad_33_sinc2_embit3;
/delete-node/ &iomuxc_gpio_ad_33_usb_otg1_id;
/delete-node/ &iomuxc_gpio_ad_33_usdhc1_wp;
/delete-node/ &iomuxc_gpio_ad_33_xbar_inout17;
/delete-node/ &iomuxc_gpio_ad_34_acmp4_in3;
/delete-node/ &iomuxc_gpio_ad_34_gpio5_io02;
/delete-node/ &iomuxc_gpio_ad_34_i3c2_scl;
/delete-node/ &iomuxc_gpio_ad_34_lpuart10_cts_b;
/delete-node/ &iomuxc_gpio_ad_34_netc_tmr_alarm1;
/delete-node/ &iomuxc_gpio_ad_34_sinc2_break;
/delete-node/ &iomuxc_gpio_ad_34_usb_otg1_pwr;
/delete-node/ &iomuxc_gpio_ad_34_usdhc1_vselect;
/delete-node/ &iomuxc_gpio_ad_34_xbar_inout18;
/delete-node/ &iomuxc_gpio_ad_35_acmp4_in4;
/delete-node/ &iomuxc_gpio_ad_35_gpio5_io03;
/delete-node/ &iomuxc_gpio_ad_35_i3c2_sda;
/delete-node/ &iomuxc_gpio_ad_35_lpuart10_rts_b;
/delete-node/ &iomuxc_gpio_ad_35_netc_tmr_alarm2;
/delete-node/ &iomuxc_gpio_ad_35_sinc2_mod_clk0;
/delete-node/ &iomuxc_gpio_ad_35_usb_otg1_oc;
/delete-node/ &iomuxc_gpio_ad_35_usdhc1_reset_b;
/delete-node/ &iomuxc_gpio_ad_35_xbar_inout19;
/delete-node/ &iomuxc_gpio_b1_00_eth1_tx_data0;
/delete-node/ &iomuxc_gpio_b1_00_eth4_tx_data0;
/delete-node/ &iomuxc_gpio_b1_00_gpio6_io00;
/delete-node/ &iomuxc_gpio_b1_00_qtimer1_timer0;
/delete-node/ &iomuxc_gpio_b1_00_semc_csx1;
/delete-node/ &iomuxc_gpio_b1_00_tpm5_ch0;
/delete-node/ &iomuxc_gpio_b1_00_xbar_inout26;
/delete-node/ &iomuxc_gpio_b1_01_eth1_tx_data1;
/delete-node/ &iomuxc_gpio_b1_01_eth4_tx_data1;
/delete-node/ &iomuxc_gpio_b1_01_gpio6_io01;
/delete-node/ &iomuxc_gpio_b1_01_qtimer1_timer1;
/delete-node/ &iomuxc_gpio_b1_01_sai4_rx_data0;
/delete-node/ &iomuxc_gpio_b1_01_semc_csx2;
/delete-node/ &iomuxc_gpio_b1_01_tpm5_ch1;
/delete-node/ &iomuxc_gpio_b1_01_xbar_inout27;
/delete-node/ &iomuxc_gpio_b1_02_eth1_tx_en;
/delete-node/ &iomuxc_gpio_b1_02_eth4_tx_en;
/delete-node/ &iomuxc_gpio_b1_02_flexspi1_b_ss1_b;
/delete-node/ &iomuxc_gpio_b1_02_gpio6_io02;
/delete-node/ &iomuxc_gpio_b1_02_lpi2c6_scl;
/delete-node/ &iomuxc_gpio_b1_02_lpuart11_txd;
/delete-node/ &iomuxc_gpio_b1_02_qtimer1_timer2;
/delete-node/ &iomuxc_gpio_b1_02_sai4_rx_data1;
/delete-node/ &iomuxc_gpio_b1_02_tpm5_ch2;
/delete-node/ &iomuxc_gpio_b1_02_xbar_inout28;
/delete-node/ &iomuxc_gpio_b1_03_eth1_tx_clk;
/delete-node/ &iomuxc_gpio_b1_03_eth4_tx_clk;
/delete-node/ &iomuxc_gpio_b1_03_flexspi1_b_dqs;
/delete-node/ &iomuxc_gpio_b1_03_gpio6_io03;
/delete-node/ &iomuxc_gpio_b1_03_lpi2c6_sda;
/delete-node/ &iomuxc_gpio_b1_03_lpuart11_rxd;
/delete-node/ &iomuxc_gpio_b1_03_qtimer2_timer0;
/delete-node/ &iomuxc_gpio_b1_03_sai4_rx_data2;
/delete-node/ &iomuxc_gpio_b1_03_tpm5_ch3;
/delete-node/ &iomuxc_gpio_b1_03_xbar_inout29;
/delete-node/ &iomuxc_gpio_b1_04_eth1_rx_data0;
/delete-node/ &iomuxc_gpio_b1_04_eth4_rx_data0;
/delete-node/ &iomuxc_gpio_b1_04_flexspi1_b_ss0_b;
/delete-node/ &iomuxc_gpio_b1_04_gpio6_io04;
/delete-node/ &iomuxc_gpio_b1_04_lpuart9_rxd;
/delete-node/ &iomuxc_gpio_b1_04_qtimer2_timer1;
/delete-node/ &iomuxc_gpio_b1_04_sai4_rx_data3;
/delete-node/ &iomuxc_gpio_b1_04_tpm5_extclk;
/delete-node/ &iomuxc_gpio_b1_04_xbar_inout30;
/delete-node/ &iomuxc_gpio_b1_05_eth1_rx_data1;
/delete-node/ &iomuxc_gpio_b1_05_eth4_rx_data1;
/delete-node/ &iomuxc_gpio_b1_05_flexspi1_b_sclk;
/delete-node/ &iomuxc_gpio_b1_05_gpio6_io05;
/delete-node/ &iomuxc_gpio_b1_05_lpuart9_cts_b;
/delete-node/ &iomuxc_gpio_b1_05_qtimer2_timer2;
/delete-node/ &iomuxc_gpio_b1_05_sai4_mclk;
/delete-node/ &iomuxc_gpio_b1_05_tpm6_extclk;
/delete-node/ &iomuxc_gpio_b1_05_xbar_inout31;
/delete-node/ &iomuxc_gpio_b1_06_eth1_rx_en;
/delete-node/ &iomuxc_gpio_b1_06_eth4_rx_en;
/delete-node/ &iomuxc_gpio_b1_06_flexspi1_b_data7;
/delete-node/ &iomuxc_gpio_b1_06_gpio6_io06;
/delete-node/ &iomuxc_gpio_b1_06_lpuart9_txd;
/delete-node/ &iomuxc_gpio_b1_06_qtimer3_timer0;
/delete-node/ &iomuxc_gpio_b1_06_sai4_rx_bclk;
/delete-node/ &iomuxc_gpio_b1_06_tpm6_ch0;
/delete-node/ &iomuxc_gpio_b1_06_xbar_inout32;
/delete-node/ &iomuxc_gpio_b1_07_eth1_tx_data2;
/delete-node/ &iomuxc_gpio_b1_07_eth4_tx_data2;
/delete-node/ &iomuxc_gpio_b1_07_flexspi1_b_data6;
/delete-node/ &iomuxc_gpio_b1_07_gpio6_io07;
/delete-node/ &iomuxc_gpio_b1_07_lpspi6_sin;
/delete-node/ &iomuxc_gpio_b1_07_lpuart9_rts_b;
/delete-node/ &iomuxc_gpio_b1_07_qtimer3_timer1;
/delete-node/ &iomuxc_gpio_b1_07_sai4_rx_sync;
/delete-node/ &iomuxc_gpio_b1_07_tpm6_ch1;
/delete-node/ &iomuxc_gpio_b1_07_xbar_inout33;
/delete-node/ &iomuxc_gpio_b1_08_eth1_tx_data3;
/delete-node/ &iomuxc_gpio_b1_08_eth4_tx_data3;
/delete-node/ &iomuxc_gpio_b1_08_flexspi1_b_data5;
/delete-node/ &iomuxc_gpio_b1_08_gpio6_io08;
/delete-node/ &iomuxc_gpio_b1_08_lpspi6_sout;
/delete-node/ &iomuxc_gpio_b1_08_qtimer3_timer2;
/delete-node/ &iomuxc_gpio_b1_08_sai4_tx_bclk;
/delete-node/ &iomuxc_gpio_b1_08_tpm6_ch2;
/delete-node/ &iomuxc_gpio_b1_08_usdhc1_cd_b;
/delete-node/ &iomuxc_gpio_b1_08_xbar_inout36;
/delete-node/ &iomuxc_gpio_b1_09_eth1_rx_data2;
/delete-node/ &iomuxc_gpio_b1_09_eth4_rx_data2;
/delete-node/ &iomuxc_gpio_b1_09_flexspi1_b_data4;
/delete-node/ &iomuxc_gpio_b1_09_gpio6_io09;
/delete-node/ &iomuxc_gpio_b1_09_lpspi6_pcs1;
/delete-node/ &iomuxc_gpio_b1_09_qtimer4_timer0;
/delete-node/ &iomuxc_gpio_b1_09_sai4_tx_sync;
/delete-node/ &iomuxc_gpio_b1_09_tpm6_ch3;
/delete-node/ &iomuxc_gpio_b1_09_usdhc1_wp;
/delete-node/ &iomuxc_gpio_b1_09_xbar_inout37;
/delete-node/ &iomuxc_gpio_b1_10_eth1_rx_data3;
/delete-node/ &iomuxc_gpio_b1_10_eth4_rx_data3;
/delete-node/ &iomuxc_gpio_b1_10_flexspi1_b_data3;
/delete-node/ &iomuxc_gpio_b1_10_gpio6_io10;
/delete-node/ &iomuxc_gpio_b1_10_lpspi6_pcs2;
/delete-node/ &iomuxc_gpio_b1_10_qtimer4_timer1;
/delete-node/ &iomuxc_gpio_b1_10_sai4_tx_data0;
/delete-node/ &iomuxc_gpio_b1_10_usdhc1_reset_b;
/delete-node/ &iomuxc_gpio_b1_10_xbar_inout34;
/delete-node/ &iomuxc_gpio_b1_11_eth1_rx_clk;
/delete-node/ &iomuxc_gpio_b1_11_eth4_rx_clk;
/delete-node/ &iomuxc_gpio_b1_11_flexspi1_b_data2;
/delete-node/ &iomuxc_gpio_b1_11_gpio6_io11;
/delete-node/ &iomuxc_gpio_b1_11_lpspi6_pcs3;
/delete-node/ &iomuxc_gpio_b1_11_qtimer4_timer2;
/delete-node/ &iomuxc_gpio_b1_11_sai4_tx_data1;
/delete-node/ &iomuxc_gpio_b1_11_xbar_inout35;
/delete-node/ &iomuxc_gpio_b1_12_eth1_rx_er;
/delete-node/ &iomuxc_gpio_b1_12_eth4_rx_er;
/delete-node/ &iomuxc_gpio_b1_12_flexspi1_b_data1;
/delete-node/ &iomuxc_gpio_b1_12_gpio6_io12;
/delete-node/ &iomuxc_gpio_b1_12_lpspi6_pcs0;
/delete-node/ &iomuxc_gpio_b1_12_netc_emdio;
/delete-node/ &iomuxc_gpio_b1_12_sai4_tx_data2;
/delete-node/ &iomuxc_gpio_b1_13_ccm_enet_ref_clk_25m;
/delete-node/ &iomuxc_gpio_b1_13_eth1_tx_er;
/delete-node/ &iomuxc_gpio_b1_13_eth4_tx_er;
/delete-node/ &iomuxc_gpio_b1_13_flexspi1_b_data0;
/delete-node/ &iomuxc_gpio_b1_13_gpio6_io13;
/delete-node/ &iomuxc_gpio_b1_13_lpspi6_sck;
/delete-node/ &iomuxc_gpio_b1_13_netc_emdc;
/delete-node/ &iomuxc_gpio_b1_13_sai4_tx_data3;
/delete-node/ &iomuxc_gpio_b1_13_usdhc1_vselect;
/delete-node/ &iomuxc_gpio_b2_06_lpuart11_txd;
/delete-node/ &iomuxc_gpio_b2_07_lpuart11_rxd;
/delete-node/ &iomuxc_gpio_b2_10_flexcan3_tx;
/delete-node/ &iomuxc_gpio_b2_10_lpi2c4_scl;
/delete-node/ &iomuxc_gpio_b2_11_flexcan3_rx;
/delete-node/ &iomuxc_gpio_b2_11_lpi2c4_sda;
/delete-node/ &iomuxc_gpio_b2_12_flexcan3_tx;
/delete-node/ &iomuxc_gpio_b2_13_flexcan3_rx;
/delete-node/ &iomuxc_gpio_emc_b1_16_lpuart9_txd;
/delete-node/ &iomuxc_gpio_emc_b1_17_lpuart9_rxd;
/delete-node/ &iomuxc_gpio_emc_b2_11_sai3_rx_sync;
/delete-node/ &iomuxc_gpio_emc_b2_12_sai3_rx_bclk;
/delete-node/ &iomuxc_gpio_emc_b2_13_ecat_pt1_txd_0;
/delete-node/ &iomuxc_gpio_emc_b2_13_eth0_tx_data3;
/delete-node/ &iomuxc_gpio_emc_b2_13_eth3_tx_data3;
/delete-node/ &iomuxc_gpio_emc_b2_13_eth4_tx_data0;
/delete-node/ &iomuxc_gpio_emc_b2_13_gpio3_io23;
/delete-node/ &iomuxc_gpio_emc_b2_13_lpspi5_pcs1;
/delete-node/ &iomuxc_gpio_emc_b2_13_lpuart11_txd;
/delete-node/ &iomuxc_gpio_emc_b2_13_qtimer2_timer0;
/delete-node/ &iomuxc_gpio_emc_b2_13_sai3_rx_data;
/delete-node/ &iomuxc_gpio_emc_b2_13_semc_data28;
/delete-node/ &iomuxc_gpio_emc_b2_13_xbar_inout33;
/delete-node/ &iomuxc_gpio_emc_b2_14_ecat_pt1_txd_1;
/delete-node/ &iomuxc_gpio_emc_b2_14_eth0_tx_data2;
/delete-node/ &iomuxc_gpio_emc_b2_14_eth3_tx_data2;
/delete-node/ &iomuxc_gpio_emc_b2_14_eth4_tx_data1;
/delete-node/ &iomuxc_gpio_emc_b2_14_gpio3_io24;
/delete-node/ &iomuxc_gpio_emc_b2_14_lpuart11_rxd;
/delete-node/ &iomuxc_gpio_emc_b2_14_lpuart5_dsr_b;
/delete-node/ &iomuxc_gpio_emc_b2_14_qtimer2_timer1;
/delete-node/ &iomuxc_gpio_emc_b2_14_sai3_tx_data;
/delete-node/ &iomuxc_gpio_emc_b2_14_semc_data29;
/delete-node/ &iomuxc_gpio_emc_b2_14_xbar_inout34;
/delete-node/ &iomuxc_gpio_emc_b2_15_ecat_pt1_tx_en;
/delete-node/ &iomuxc_gpio_emc_b2_15_eth0_rx_clk;
/delete-node/ &iomuxc_gpio_emc_b2_15_eth3_rx_clk;
/delete-node/ &iomuxc_gpio_emc_b2_15_eth4_tx_en;
/delete-node/ &iomuxc_gpio_emc_b2_15_gpio3_io25;
/delete-node/ &iomuxc_gpio_emc_b2_15_lpuart11_cts_b;
/delete-node/ &iomuxc_gpio_emc_b2_15_lpuart5_dcd_b;
/delete-node/ &iomuxc_gpio_emc_b2_15_qtimer2_timer2;
/delete-node/ &iomuxc_gpio_emc_b2_15_sai3_tx_bclk;
/delete-node/ &iomuxc_gpio_emc_b2_15_semc_data30;
/delete-node/ &iomuxc_gpio_emc_b2_15_xbar_inout35;
/delete-node/ &iomuxc_gpio_emc_b2_16_ecat_pt1_tx_clk;
/delete-node/ &iomuxc_gpio_emc_b2_16_eth0_rx_data2;
/delete-node/ &iomuxc_gpio_emc_b2_16_eth3_rx_data2;
/delete-node/ &iomuxc_gpio_emc_b2_16_eth4_tx_clk;
/delete-node/ &iomuxc_gpio_emc_b2_16_gpio3_io26;
/delete-node/ &iomuxc_gpio_emc_b2_16_lpuart11_rts_b;
/delete-node/ &iomuxc_gpio_emc_b2_16_lpuart5_dtr_b;
/delete-node/ &iomuxc_gpio_emc_b2_16_qtimer2_timer3;
/delete-node/ &iomuxc_gpio_emc_b2_16_sai3_tx_sync;
/delete-node/ &iomuxc_gpio_emc_b2_16_semc_data31;
/delete-node/ &iomuxc_gpio_emc_b2_16_xbar_inout14;
/delete-node/ &iomuxc_gpio_emc_b2_17_ecat_pt1_rxd_0;
/delete-node/ &iomuxc_gpio_emc_b2_17_eth0_rx_data3;
/delete-node/ &iomuxc_gpio_emc_b2_17_eth3_rx_data3;
/delete-node/ &iomuxc_gpio_emc_b2_17_eth4_rx_data0;
/delete-node/ &iomuxc_gpio_emc_b2_17_gpio3_io27;
/delete-node/ &iomuxc_gpio_emc_b2_17_lpuart5_txd;
/delete-node/ &iomuxc_gpio_emc_b2_17_qtimer3_timer0;
/delete-node/ &iomuxc_gpio_emc_b2_17_sai3_mclk;
/delete-node/ &iomuxc_gpio_emc_b2_17_semc_dm3;
/delete-node/ &iomuxc_gpio_emc_b2_17_xbar_inout15;
/delete-node/ &iomuxc_gpio_emc_b2_18_ecat_pt1_rxd_1;
/delete-node/ &iomuxc_gpio_emc_b2_18_eth0_tx_er;
/delete-node/ &iomuxc_gpio_emc_b2_18_eth3_tx_er;
/delete-node/ &iomuxc_gpio_emc_b2_18_eth4_rx_data1;
/delete-node/ &iomuxc_gpio_emc_b2_18_ewm_out_b;
/delete-node/ &iomuxc_gpio_emc_b2_18_gpio3_io28;
/delete-node/ &iomuxc_gpio_emc_b2_18_lpuart5_rxd;
/delete-node/ &iomuxc_gpio_emc_b2_18_qtimer3_timer1;
/delete-node/ &iomuxc_gpio_emc_b2_18_semc_dqs4;
/delete-node/ &iomuxc_gpio_emc_b2_18_xbar_inout16;
/delete-node/ &iomuxc_gpio_sd_b1_00_ccm_clko1;
/delete-node/ &iomuxc_gpio_sd_b1_00_gpio5_io04;
/delete-node/ &iomuxc_gpio_sd_b1_00_kpp_row7;
/delete-node/ &iomuxc_gpio_sd_b1_00_lpspi3_pcs0;
/delete-node/ &iomuxc_gpio_sd_b1_00_lptmr2_alt1;
/delete-node/ &iomuxc_gpio_sd_b1_00_sinc1_emclk2;
/delete-node/ &iomuxc_gpio_sd_b1_00_usdhc1_cmd;
/delete-node/ &iomuxc_gpio_sd_b1_00_xbar_inout20;
/delete-node/ &iomuxc_gpio_sd_b1_00_xspi_slv_cs;
/delete-node/ &iomuxc_gpio_sd_b1_01_ccm_clko2;
/delete-node/ &iomuxc_gpio_sd_b1_01_gpio5_io05;
/delete-node/ &iomuxc_gpio_sd_b1_01_kpp_col7;
/delete-node/ &iomuxc_gpio_sd_b1_01_lpspi3_sck;
/delete-node/ &iomuxc_gpio_sd_b1_01_lptmr2_alt2;
/delete-node/ &iomuxc_gpio_sd_b1_01_sinc1_embit2;
/delete-node/ &iomuxc_gpio_sd_b1_01_usdhc1_clk;
/delete-node/ &iomuxc_gpio_sd_b1_01_xbar_inout21;
/delete-node/ &iomuxc_gpio_sd_b1_01_xspi_slv_clk;
/delete-node/ &iomuxc_gpio_sd_b1_02_usdhc1_data0;
/delete-node/ &iomuxc_gpio_sd_b1_03_usdhc1_data1;
/delete-node/ &iomuxc_gpio_sd_b1_04_flexspi1_a_ss1_b;
/delete-node/ &iomuxc_gpio_sd_b1_04_flexspi1_b_ss0_b;
/delete-node/ &iomuxc_gpio_sd_b1_04_gpio5_io08;
/delete-node/ &iomuxc_gpio_sd_b1_04_lpspi3_pcs1;
/delete-node/ &iomuxc_gpio_sd_b1_04_lptmr3_alt2;
/delete-node/ &iomuxc_gpio_sd_b1_04_sinc1_break;
/delete-node/ &iomuxc_gpio_sd_b1_04_sinc2_emclk2;
/delete-node/ &iomuxc_gpio_sd_b1_04_usdhc1_data2;
/delete-node/ &iomuxc_gpio_sd_b1_04_xspi_slv_data6;
/delete-node/ &iomuxc_gpio_sd_b1_05_flexspi1_b_ss0_b;
/delete-node/ &iomuxc_gpio_sd_b1_05_gpio5_io09;
/delete-node/ &iomuxc_gpio_sd_b1_05_lpspi3_pcs2;
/delete-node/ &iomuxc_gpio_sd_b1_05_lptmr3_alt3;
/delete-node/ &iomuxc_gpio_sd_b1_05_sinc2_embit2;
/delete-node/ &iomuxc_gpio_sd_b1_05_usdhc1_data3;
/delete-node/ &iomuxc_gpio_sd_b1_05_xspi_slv_data7;
