/*
 * Copyright 2025, NXP
 * SPDX-License-Identifier: Apache-2.0
 *
 * Note: File generated by gen_soc_headers.py
 * from configuration data for MIMXRT1181XVP2B
 */

/*
 * Content deduplicated by dedup_pinctrl.py:
 * the pin mux data of this part is identical to mimxrt1181cvp2b-pinctrl.dtsi.
 * Do not edit; edit the canonical file instead.
 * target-hash: a2ce477e1887786f
 */

#include "mimxrt1181cvp2b-pinctrl.dtsi"
