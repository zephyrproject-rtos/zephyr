/*
 * Copyright 2026 NXP
 * SPDX-License-Identifier: Apache-2.0
 *
 * Note: File generated by gen_soc_headers.py
 * from configuration data for MIMXRT1186XVJ8C
 */

/*
 * Content deduplicated by dedup_pinctrl.py:
 * the pin mux data of this part is identical to mimxrt1186cvj8c-pinctrl.dtsi.
 * Do not edit; edit the canonical file instead.
 * target-hash: 3fac7fef6e6d3eab
 */

#include "mimxrt1186cvj8c-pinctrl.dtsi"
