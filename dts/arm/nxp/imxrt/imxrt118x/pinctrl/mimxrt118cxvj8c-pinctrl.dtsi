/*
 * Copyright 2026, NXP
 * SPDX-License-Identifier: Apache-2.0
 *
 * Note: File generated by gen_soc_headers.py
 * from configuration data for MIMXRT118CXVJ8C
 */

/*
 * Content deduplicated by dedup_pinctrl.py:
 * the pin mux data of this part is identical to mimxrt118ccvj8c-pinctrl.dtsi.
 * Do not edit; edit the canonical file instead.
 * target-hash: e8ae11ba9a8b3829
 */

#include "mimxrt118ccvj8c-pinctrl.dtsi"
