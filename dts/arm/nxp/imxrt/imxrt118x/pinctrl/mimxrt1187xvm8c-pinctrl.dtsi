/*
 * Copyright 2025, NXP
 * SPDX-License-Identifier: Apache-2.0
 *
 * Note: File generated by gen_soc_headers.py
 * from configuration data for MIMXRT1187XVM8C
 */

/*
 * Content deduplicated by dedup_pinctrl.py:
 * the pin mux data of this part is identical to mimxrt1187avm8b-pinctrl.dtsi.
 * Do not edit; edit the canonical file instead.
 * target-hash: 586f0b7be420ea39
 */

#include "mimxrt1187avm8b-pinctrl.dtsi"
