/*
 * SPDX-FileCopyrightText: Copyright 2026 NXP
 *
 * SPDX-License-Identifier: Apache-2.0
 *
 * Note: File generated by gen_soc_headers.py
 * from configuration data for MIMXRT2663XVV8A
 */

/*
 * Content deduplicated by dedup_pinctrl.py:
 * the pin mux data of this part is identical to mimxrt2663ahp8a-pinctrl.dtsi.
 * Do not edit; edit the canonical file instead.
 * target-hash: 705873e6456a164f
 */

#include "mimxrt2663ahp8a-pinctrl.dtsi"
