/*
 * Copyright 2026, NXP
 * SPDX-License-Identifier: Apache-2.0
 *
 * Note: File generated by gen_soc_headers.py
 * from configuration data for MIMXRT1151XHM8B
 */

/*
 * Content deduplicated by dedup_pinctrl.py:
 * the pin mux data of this part is identical to mimxrt1151dhm8b-pinctrl.dtsi.
 * Do not edit; edit the canonical file instead.
 * target-hash: 15a688f51c8cfea3
 */

#include "mimxrt1151dhm8b-pinctrl.dtsi"
