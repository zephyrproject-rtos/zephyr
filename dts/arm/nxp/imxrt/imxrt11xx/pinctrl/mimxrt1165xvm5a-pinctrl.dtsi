/*
 * Copyright 2024, NXP
 * SPDX-License-Identifier: Apache-2.0
 *
 * Note: File generated by gen_soc_headers.py
 * from configuration data for MIMXRT1165XVM5A
 */

/*
 * Content deduplicated by dedup_pinctrl.py:
 * the pin mux data of this part is identical to mimxrt1165dvm6a-pinctrl.dtsi.
 * Do not edit; edit the canonical file instead.
 * target-hash: 97b4b220aae99b0a
 */

#include "mimxrt1165dvm6a-pinctrl.dtsi"
