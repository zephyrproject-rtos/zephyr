/*
 * Copyright 2026, NXP
 * SPDX-License-Identifier: Apache-2.0
 *
 * Note: File generated by gen_soc_headers.py
 * from configuration data for MIMXRT1151DHM8B
 */

/*
 * Delta-deduplicated by dedup_pinctrl.py:
 * based on mimxrt1176avm8a-pinctrl.dtsi with this part's differences applied
 * below (398 removed, 2 changed,
 * 1 added). Regenerate with dedup_pinctrl.py;
 * do not edit by hand.
 * target-hash: d0dcf505715381c8
 */

#include "mimxrt1176avm8a-pinctrl.dtsi"

/delete-node/ &iomuxc_gpio_ad_00_sim1_trxd;
/delete-node/ &iomuxc_gpio_ad_01_sim1_clk;
/delete-node/ &iomuxc_gpio_ad_02_sim1_rst_b;
/delete-node/ &iomuxc_gpio_ad_03_sim1_sven;
/delete-node/ &iomuxc_gpio_ad_04_sim1_pd;
/delete-node/ &iomuxc_gpio_ad_05_sim1_power_fail;
/delete-node/ &iomuxc_gpio_ad_06_enet_1588_event1_in;
/delete-node/ &iomuxc_gpio_ad_06_sim2_trxd;
/delete-node/ &iomuxc_gpio_ad_06_video_mux_csi_data15;
/delete-node/ &iomuxc_gpio_ad_07_enet_1588_event1_out;
/delete-node/ &iomuxc_gpio_ad_07_sim2_clk;
/delete-node/ &iomuxc_gpio_ad_07_video_mux_csi_data14;
/delete-node/ &iomuxc_gpio_ad_08_enet_1588_event2_in;
/delete-node/ &iomuxc_gpio_ad_08_sim2_rst_b;
/delete-node/ &iomuxc_gpio_ad_08_video_mux_csi_data13;
/delete-node/ &iomuxc_gpio_ad_09_enet_1588_event2_out;
/delete-node/ &iomuxc_gpio_ad_09_sim2_sven;
/delete-node/ &iomuxc_gpio_ad_09_video_mux_csi_data12;
/delete-node/ &iomuxc_gpio_ad_10_enet_1588_event3_in;
/delete-node/ &iomuxc_gpio_ad_10_sim2_pd;
/delete-node/ &iomuxc_gpio_ad_10_video_mux_csi_data11;
/delete-node/ &iomuxc_gpio_ad_11_enet_1588_event3_out;
/delete-node/ &iomuxc_gpio_ad_11_sim2_power_fail;
/delete-node/ &iomuxc_gpio_ad_11_video_mux_csi_data10;
/delete-node/ &iomuxc_gpio_ad_12_enet_tdata03;
/delete-node/ &iomuxc_gpio_ad_12_video_mux_csi_pixclk;
/delete-node/ &iomuxc_gpio_ad_13_enet_tdata02;
/delete-node/ &iomuxc_gpio_ad_13_video_mux_csi_mclk;
/delete-node/ &iomuxc_gpio_ad_14_enet_rx_clk;
/delete-node/ &iomuxc_gpio_ad_14_video_mux_csi_vsync;
/delete-node/ &iomuxc_gpio_ad_15_adc1_ch4b;
/delete-node/ &iomuxc_gpio_ad_15_adc2_ch4b;
/delete-node/ &iomuxc_gpio_ad_15_enet_tx_er;
/delete-node/ &iomuxc_gpio_ad_15_flexio2_flexio15;
/delete-node/ &iomuxc_gpio_ad_15_flexpwm3_pwm1_x;
/delete-node/ &iomuxc_gpio_ad_15_flexspi1_b_data00;
/delete-node/ &iomuxc_gpio_ad_15_gpio9_io14;
/delete-node/ &iomuxc_gpio_ad_15_gpio_mux3_io14;
/delete-node/ &iomuxc_gpio_ad_15_gpio_mux3_io14_cm7;
/delete-node/ &iomuxc_gpio_ad_15_gpt1_compare2;
/delete-node/ &iomuxc_gpio_ad_15_lpuart10_tx;
/delete-node/ &iomuxc_gpio_ad_15_spdif_in;
/delete-node/ &iomuxc_gpio_ad_15_video_mux_csi_hsync;
/delete-node/ &iomuxc_gpio_ad_16_adc1_ch5a;
/delete-node/ &iomuxc_gpio_ad_16_adc2_ch5a;
/delete-node/ &iomuxc_gpio_ad_16_enet_1g_mdc;
/delete-node/ &iomuxc_gpio_ad_16_enet_rdata03;
/delete-node/ &iomuxc_gpio_ad_16_flexio2_flexio16;
/delete-node/ &iomuxc_gpio_ad_16_flexpwm3_pwm2_x;
/delete-node/ &iomuxc_gpio_ad_16_flexspi1_b_sclk;
/delete-node/ &iomuxc_gpio_ad_16_gpio9_io15;
/delete-node/ &iomuxc_gpio_ad_16_gpio_mux3_io15;
/delete-node/ &iomuxc_gpio_ad_16_gpio_mux3_io15_cm7;
/delete-node/ &iomuxc_gpio_ad_16_gpt1_compare3;
/delete-node/ &iomuxc_gpio_ad_16_lpuart10_rx;
/delete-node/ &iomuxc_gpio_ad_16_spdif_out;
/delete-node/ &iomuxc_gpio_ad_16_video_mux_csi_data09;
/delete-node/ &iomuxc_gpio_ad_17_acmp1_cmpo;
/delete-node/ &iomuxc_gpio_ad_17_adc1_ch5b;
/delete-node/ &iomuxc_gpio_ad_17_adc2_ch5b;
/delete-node/ &iomuxc_gpio_ad_17_enet_1g_mdio;
/delete-node/ &iomuxc_gpio_ad_17_enet_rdata02;
/delete-node/ &iomuxc_gpio_ad_17_flexio2_flexio17;
/delete-node/ &iomuxc_gpio_ad_17_flexpwm3_pwm3_x;
/delete-node/ &iomuxc_gpio_ad_17_flexspi1_a_dqs;
/delete-node/ &iomuxc_gpio_ad_17_gpio9_io16;
/delete-node/ &iomuxc_gpio_ad_17_gpio_mux3_io16;
/delete-node/ &iomuxc_gpio_ad_17_gpio_mux3_io16_cm7;
/delete-node/ &iomuxc_gpio_ad_17_gpt1_clk;
/delete-node/ &iomuxc_gpio_ad_17_sai1_mclk;
/delete-node/ &iomuxc_gpio_ad_17_video_mux_csi_data08;
/delete-node/ &iomuxc_gpio_ad_18_acmp2_cmpo;
/delete-node/ &iomuxc_gpio_ad_18_adc2_ch0a;
/delete-node/ &iomuxc_gpio_ad_18_enet_crs;
/delete-node/ &iomuxc_gpio_ad_18_flexio2_flexio18;
/delete-node/ &iomuxc_gpio_ad_18_flexpwm4_pwm0_x;
/delete-node/ &iomuxc_gpio_ad_18_flexspi1_a_ss0_b;
/delete-node/ &iomuxc_gpio_ad_18_gpio9_io17;
/delete-node/ &iomuxc_gpio_ad_18_gpio_mux3_io17;
/delete-node/ &iomuxc_gpio_ad_18_gpio_mux3_io17_cm7;
/delete-node/ &iomuxc_gpio_ad_18_lpi2c2_scl;
/delete-node/ &iomuxc_gpio_ad_18_lpspi1_pcs1;
/delete-node/ &iomuxc_gpio_ad_18_sai1_rx_sync;
/delete-node/ &iomuxc_gpio_ad_18_video_mux_csi_data07;
/delete-node/ &iomuxc_gpio_ad_19_acmp3_cmpo;
/delete-node/ &iomuxc_gpio_ad_19_adc2_ch0b;
/delete-node/ &iomuxc_gpio_ad_19_enet_col;
/delete-node/ &iomuxc_gpio_ad_19_flexio2_flexio19;
/delete-node/ &iomuxc_gpio_ad_19_flexpwm4_pwm1_x;
/delete-node/ &iomuxc_gpio_ad_19_flexspi1_a_sclk;
/delete-node/ &iomuxc_gpio_ad_19_gpio9_io18;
/delete-node/ &iomuxc_gpio_ad_19_gpio_mux3_io18;
/delete-node/ &iomuxc_gpio_ad_19_gpio_mux3_io18_cm7;
/delete-node/ &iomuxc_gpio_ad_19_lpi2c2_sda;
/delete-node/ &iomuxc_gpio_ad_19_lpspi1_pcs2;
/delete-node/ &iomuxc_gpio_ad_19_sai1_rx_bclk;
/delete-node/ &iomuxc_gpio_ad_19_video_mux_csi_data06;
/delete-node/ &iomuxc_gpio_ad_20_acmp4_cmpo;
/delete-node/ &iomuxc_gpio_ad_20_adc2_ch1a;
/delete-node/ &iomuxc_gpio_ad_20_enet_qos_1588_event2_out;
/delete-node/ &iomuxc_gpio_ad_20_flexio2_flexio20;
/delete-node/ &iomuxc_gpio_ad_20_flexpwm4_pwm2_x;
/delete-node/ &iomuxc_gpio_ad_20_flexspi1_a_data00;
/delete-node/ &iomuxc_gpio_ad_20_gpio9_io19;
/delete-node/ &iomuxc_gpio_ad_20_gpio_mux3_io19;
/delete-node/ &iomuxc_gpio_ad_20_gpio_mux3_io19_cm7;
/delete-node/ &iomuxc_gpio_ad_20_kpp_row07;
/delete-node/ &iomuxc_gpio_ad_20_lpspi1_pcs3;
/delete-node/ &iomuxc_gpio_ad_20_sai1_rx_data00;
/delete-node/ &iomuxc_gpio_ad_20_video_mux_csi_data05;
/delete-node/ &iomuxc_gpio_ad_21_adc2_ch1b;
/delete-node/ &iomuxc_gpio_ad_21_enet_qos_1588_event2_in;
/delete-node/ &iomuxc_gpio_ad_21_flexio2_flexio21;
/delete-node/ &iomuxc_gpio_ad_21_flexpwm4_pwm3_x;
/delete-node/ &iomuxc_gpio_ad_21_flexspi1_a_data01;
/delete-node/ &iomuxc_gpio_ad_21_gpio9_io20;
/delete-node/ &iomuxc_gpio_ad_21_gpio_mux3_io20;
/delete-node/ &iomuxc_gpio_ad_21_gpio_mux3_io20_cm7;
/delete-node/ &iomuxc_gpio_ad_21_kpp_col07;
/delete-node/ &iomuxc_gpio_ad_21_lpspi2_pcs1;
/delete-node/ &iomuxc_gpio_ad_21_sai1_tx_data00;
/delete-node/ &iomuxc_gpio_ad_21_video_mux_csi_data04;
/delete-node/ &iomuxc_gpio_ad_22_adc2_ch2a;
/delete-node/ &iomuxc_gpio_ad_22_enet_qos_1588_event3_out;
/delete-node/ &iomuxc_gpio_ad_22_flexio2_flexio22;
/delete-node/ &iomuxc_gpio_ad_22_flexspi1_a_data02;
/delete-node/ &iomuxc_gpio_ad_22_gpio9_io21;
/delete-node/ &iomuxc_gpio_ad_22_gpio_mux3_io21;
/delete-node/ &iomuxc_gpio_ad_22_gpio_mux3_io21_cm7;
/delete-node/ &iomuxc_gpio_ad_22_kpp_row06;
/delete-node/ &iomuxc_gpio_ad_22_lpspi2_pcs2;
/delete-node/ &iomuxc_gpio_ad_22_sai1_tx_bclk;
/delete-node/ &iomuxc_gpio_ad_22_video_mux_csi_data03;
/delete-node/ &iomuxc_gpio_ad_23_adc2_ch2b;
/delete-node/ &iomuxc_gpio_ad_23_enet_qos_1588_event3_in;
/delete-node/ &iomuxc_gpio_ad_23_flexio2_flexio23;
/delete-node/ &iomuxc_gpio_ad_23_flexspi1_a_data03;
/delete-node/ &iomuxc_gpio_ad_23_gpio9_io22;
/delete-node/ &iomuxc_gpio_ad_23_gpio_mux3_io22;
/delete-node/ &iomuxc_gpio_ad_23_gpio_mux3_io22_cm7;
/delete-node/ &iomuxc_gpio_ad_23_kpp_col06;
/delete-node/ &iomuxc_gpio_ad_23_lpspi2_pcs3;
/delete-node/ &iomuxc_gpio_ad_23_sai1_tx_sync;
/delete-node/ &iomuxc_gpio_ad_23_video_mux_csi_data02;
/delete-node/ &iomuxc_gpio_ad_24_enet_rx_en;
/delete-node/ &iomuxc_gpio_ad_24_video_mux_csi_data00;
/delete-node/ &iomuxc_gpio_ad_25_enet_rx_er;
/delete-node/ &iomuxc_gpio_ad_25_video_mux_csi_data01;
/delete-node/ &iomuxc_gpio_ad_26_acmp2_in3;
/delete-node/ &iomuxc_gpio_ad_26_enet_qos_mdc;
/delete-node/ &iomuxc_gpio_ad_26_enet_rdata00;
/delete-node/ &iomuxc_gpio_ad_26_flexio2_flexio26;
/delete-node/ &iomuxc_gpio_ad_26_flexpwm2_pwm1_a;
/delete-node/ &iomuxc_gpio_ad_26_gpio9_io25;
/delete-node/ &iomuxc_gpio_ad_26_gpio_mux3_io25;
/delete-node/ &iomuxc_gpio_ad_26_gpio_mux3_io25_cm7;
/delete-node/ &iomuxc_gpio_ad_26_kpp_row04;
/delete-node/ &iomuxc_gpio_ad_26_lpspi2_sdo;
/delete-node/ &iomuxc_gpio_ad_26_lpuart1_cts_b;
/delete-node/ &iomuxc_gpio_ad_26_semc_csx01;
/delete-node/ &iomuxc_gpio_ad_26_usdhc2_cd_b;
/delete-node/ &iomuxc_gpio_ad_27_enet_rdata01;
/delete-node/ &iomuxc_gpio_ad_28_enet_tx_en;
/delete-node/ &iomuxc_gpio_ad_29_enet_ref_clk;
/delete-node/ &iomuxc_gpio_ad_29_enet_tx_clk;
/delete-node/ &iomuxc_gpio_ad_30_enet_tdata00;
/delete-node/ &iomuxc_gpio_ad_31_enet_tdata01;
/delete-node/ &iomuxc_gpio_ad_32_acmp4_in1;
/delete-node/ &iomuxc_gpio_ad_32_enet_1g_mdc;
/delete-node/ &iomuxc_gpio_ad_32_enet_mdc;
/delete-node/ &iomuxc_gpio_ad_32_gpio9_io31;
/delete-node/ &iomuxc_gpio_ad_32_gpio_mux3_io31;
/delete-node/ &iomuxc_gpio_ad_32_gpio_mux3_io31_cm7;
/delete-node/ &iomuxc_gpio_ad_32_kpp_row01;
/delete-node/ &iomuxc_gpio_ad_32_lpi2c1_scl;
/delete-node/ &iomuxc_gpio_ad_32_lpuart10_tx;
/delete-node/ &iomuxc_gpio_ad_32_pgmc_pmic_ready;
/delete-node/ &iomuxc_gpio_ad_32_usbphy2_otg_id;
/delete-node/ &iomuxc_gpio_ad_32_usdhc1_cd_b;
/delete-node/ &iomuxc_gpio_ad_33_enet_mdio;
/delete-node/ &iomuxc_gpio_ad_33_lpuart10_rx;
/delete-node/ &iomuxc_gpio_ad_34_enet_1588_event0_in;
/delete-node/ &iomuxc_gpio_ad_34_lpuart10_cts_b;
/delete-node/ &iomuxc_gpio_ad_35_enet_1588_event0_out;
/delete-node/ &iomuxc_gpio_ad_35_lpuart10_rts_b;
/delete-node/ &iomuxc_gpio_disp_b1_00_enet_1g_rx_en;
/delete-node/ &iomuxc_gpio_disp_b1_00_enet_qos_rx_en;
/delete-node/ &iomuxc_gpio_disp_b1_00_gpio10_io21;
/delete-node/ &iomuxc_gpio_disp_b1_00_gpio_mux4_io21;
/delete-node/ &iomuxc_gpio_disp_b1_00_qtimer1_timer0;
/delete-node/ &iomuxc_gpio_disp_b1_00_video_mux_lcdif_clk;
/delete-node/ &iomuxc_gpio_disp_b1_00_xbar1_xbar_in26;
/delete-node/ &iomuxc_gpio_disp_b1_00_xbar1_xbar_inout26;
/delete-node/ &iomuxc_gpio_disp_b1_01_enet_1g_rx_clk;
/delete-node/ &iomuxc_gpio_disp_b1_01_enet_1g_rx_er;
/delete-node/ &iomuxc_gpio_disp_b1_01_enet_qos_rx_clk;
/delete-node/ &iomuxc_gpio_disp_b1_01_enet_qos_rx_er;
/delete-node/ &iomuxc_gpio_disp_b1_01_gpio10_io22;
/delete-node/ &iomuxc_gpio_disp_b1_01_gpio_mux4_io22;
/delete-node/ &iomuxc_gpio_disp_b1_01_qtimer1_timer1;
/delete-node/ &iomuxc_gpio_disp_b1_01_video_mux_lcdif_enable;
/delete-node/ &iomuxc_gpio_disp_b1_01_xbar1_xbar_in27;
/delete-node/ &iomuxc_gpio_disp_b1_01_xbar1_xbar_inout27;
/delete-node/ &iomuxc_gpio_disp_b1_02_enet_1g_rdata00;
/delete-node/ &iomuxc_gpio_disp_b1_02_enet_qos_rdata00;
/delete-node/ &iomuxc_gpio_disp_b1_02_gpio10_io23;
/delete-node/ &iomuxc_gpio_disp_b1_02_gpio_mux4_io23;
/delete-node/ &iomuxc_gpio_disp_b1_02_lpi2c3_scl;
/delete-node/ &iomuxc_gpio_disp_b1_02_lpuart1_tx;
/delete-node/ &iomuxc_gpio_disp_b1_02_qtimer1_timer2;
/delete-node/ &iomuxc_gpio_disp_b1_02_video_mux_lcdif_hsync;
/delete-node/ &iomuxc_gpio_disp_b1_02_xbar1_xbar_in28;
/delete-node/ &iomuxc_gpio_disp_b1_02_xbar1_xbar_inout28;
/delete-node/ &iomuxc_gpio_disp_b1_03_enet_1g_rdata01;
/delete-node/ &iomuxc_gpio_disp_b1_03_enet_qos_rdata01;
/delete-node/ &iomuxc_gpio_disp_b1_03_gpio10_io24;
/delete-node/ &iomuxc_gpio_disp_b1_03_gpio_mux4_io24;
/delete-node/ &iomuxc_gpio_disp_b1_03_lpi2c3_sda;
/delete-node/ &iomuxc_gpio_disp_b1_03_lpuart1_rx;
/delete-node/ &iomuxc_gpio_disp_b1_03_qtimer2_timer0;
/delete-node/ &iomuxc_gpio_disp_b1_03_video_mux_lcdif_vsync;
/delete-node/ &iomuxc_gpio_disp_b1_03_xbar1_xbar_in29;
/delete-node/ &iomuxc_gpio_disp_b1_03_xbar1_xbar_inout29;
/delete-node/ &iomuxc_gpio_disp_b1_04_enet_1g_rdata02;
/delete-node/ &iomuxc_gpio_disp_b1_04_enet_qos_rdata02;
/delete-node/ &iomuxc_gpio_disp_b1_04_gpio10_io25;
/delete-node/ &iomuxc_gpio_disp_b1_04_gpio_mux4_io25;
/delete-node/ &iomuxc_gpio_disp_b1_04_lpspi3_sck;
/delete-node/ &iomuxc_gpio_disp_b1_04_lpuart4_rx;
/delete-node/ &iomuxc_gpio_disp_b1_04_qtimer2_timer1;
/delete-node/ &iomuxc_gpio_disp_b1_04_video_mux_lcdif_data00;
/delete-node/ &iomuxc_gpio_disp_b1_04_xbar1_xbar_in30;
/delete-node/ &iomuxc_gpio_disp_b1_04_xbar1_xbar_inout30;
/delete-node/ &iomuxc_gpio_disp_b1_05_enet_1g_rdata03;
/delete-node/ &iomuxc_gpio_disp_b1_05_enet_qos_rdata03;
/delete-node/ &iomuxc_gpio_disp_b1_05_gpio10_io26;
/delete-node/ &iomuxc_gpio_disp_b1_05_gpio_mux4_io26;
/delete-node/ &iomuxc_gpio_disp_b1_05_lpspi3_sdi;
/delete-node/ &iomuxc_gpio_disp_b1_05_lpuart4_cts_b;
/delete-node/ &iomuxc_gpio_disp_b1_05_qtimer2_timer2;
/delete-node/ &iomuxc_gpio_disp_b1_05_video_mux_lcdif_data01;
/delete-node/ &iomuxc_gpio_disp_b1_05_xbar1_xbar_in31;
/delete-node/ &iomuxc_gpio_disp_b1_05_xbar1_xbar_inout31;
/delete-node/ &iomuxc_gpio_disp_b1_06_lpuart4_tx;
/delete-node/ &iomuxc_gpio_disp_b1_06_video_mux_lcdif_data02;
/delete-node/ &iomuxc_gpio_disp_b1_07_lpuart4_rts_b;
/delete-node/ &iomuxc_gpio_disp_b1_07_video_mux_lcdif_data03;
/delete-node/ &iomuxc_gpio_disp_b1_08_video_mux_lcdif_data04;
/delete-node/ &iomuxc_gpio_disp_b1_09_video_mux_lcdif_data05;
/delete-node/ &iomuxc_gpio_disp_b1_10_video_mux_lcdif_data06;
/delete-node/ &iomuxc_gpio_disp_b1_11_video_mux_lcdif_data07;
/delete-node/ &iomuxc_gpio_disp_b2_00_video_mux_lcdif_data08;
/delete-node/ &iomuxc_gpio_disp_b2_01_video_mux_lcdif_data09;
/delete-node/ &iomuxc_gpio_disp_b2_02_enet_tdata00;
/delete-node/ &iomuxc_gpio_disp_b2_02_video_mux_lcdif_data10;
/delete-node/ &iomuxc_gpio_disp_b2_03_enet_tdata01;
/delete-node/ &iomuxc_gpio_disp_b2_03_video_mux_lcdif_data11;
/delete-node/ &iomuxc_gpio_disp_b2_04_enet_tx_en;
/delete-node/ &iomuxc_gpio_disp_b2_04_video_mux_lcdif_data12;
/delete-node/ &iomuxc_gpio_disp_b2_05_enet_ref_clk;
/delete-node/ &iomuxc_gpio_disp_b2_05_enet_tx_clk;
/delete-node/ &iomuxc_gpio_disp_b2_05_video_mux_lcdif_data13;
/delete-node/ &iomuxc_gpio_disp_b2_06_enet_rdata00;
/delete-node/ &iomuxc_gpio_disp_b2_06_video_mux_lcdif_data14;
/delete-node/ &iomuxc_gpio_disp_b2_07_enet_rdata01;
/delete-node/ &iomuxc_gpio_disp_b2_07_video_mux_lcdif_data15;
/delete-node/ &iomuxc_gpio_disp_b2_08_enet_rx_en;
/delete-node/ &iomuxc_gpio_disp_b2_08_video_mux_lcdif_data16;
/delete-node/ &iomuxc_gpio_disp_b2_09_enet_rx_er;
/delete-node/ &iomuxc_gpio_disp_b2_09_video_mux_lcdif_data17;
/delete-node/ &iomuxc_gpio_disp_b2_10_sim2_trxd;
/delete-node/ &iomuxc_gpio_disp_b2_10_video_mux_lcdif_data18;
/delete-node/ &iomuxc_gpio_disp_b2_11_sim2_clk;
/delete-node/ &iomuxc_gpio_disp_b2_11_video_mux_lcdif_data19;
/delete-node/ &iomuxc_gpio_disp_b2_12_sim2_rst_b;
/delete-node/ &iomuxc_gpio_disp_b2_12_video_mux_lcdif_data20;
/delete-node/ &iomuxc_gpio_disp_b2_13_enet_ref_clk;
/delete-node/ &iomuxc_gpio_disp_b2_13_sim2_sven;
/delete-node/ &iomuxc_gpio_disp_b2_13_video_mux_lcdif_data21;
/delete-node/ &iomuxc_gpio_disp_b2_14_sim2_pd;
/delete-node/ &iomuxc_gpio_disp_b2_14_video_mux_lcdif_data22;
/delete-node/ &iomuxc_gpio_disp_b2_15_sim2_power_fail;
/delete-node/ &iomuxc_gpio_disp_b2_15_video_mux_lcdif_data23;
/delete-node/ &iomuxc_gpio_emc_b2_02_video_mux_csi_data23;
/delete-node/ &iomuxc_gpio_emc_b2_03_video_mux_csi_data22;
/delete-node/ &iomuxc_gpio_emc_b2_04_video_mux_csi_data21;
/delete-node/ &iomuxc_gpio_emc_b2_05_video_mux_csi_data20;
/delete-node/ &iomuxc_gpio_emc_b2_06_video_mux_csi_data19;
/delete-node/ &iomuxc_gpio_emc_b2_07_video_mux_csi_data18;
/delete-node/ &iomuxc_gpio_emc_b2_08_video_mux_csi_data17;
/delete-node/ &iomuxc_gpio_emc_b2_09_video_mux_csi_data16;
/delete-node/ &iomuxc_gpio_emc_b2_10_video_mux_csi_field;
/delete-node/ &iomuxc_gpio_emc_b2_11_sim1_trxd;
/delete-node/ &iomuxc_gpio_emc_b2_12_sim1_clk;
/delete-node/ &iomuxc_gpio_emc_b2_13_sim1_rst_b;
/delete-node/ &iomuxc_gpio_emc_b2_14_sim1_sven;
/delete-node/ &iomuxc_gpio_emc_b2_15_sim1_pd;
/delete-node/ &iomuxc_gpio_emc_b2_16_sim1_power_fail;
/delete-node/ &iomuxc_gpio_emc_b2_19_enet_mdc;
/delete-node/ &iomuxc_gpio_emc_b2_20_enet_mdio;
/delete-node/ &iomuxc_gpio_sd_b2_07_enet_tx_er;
/delete-node/ &iomuxc_lpsr_gpio_lpsr_00_can3_tx;
/delete-node/ &iomuxc_lpsr_gpio_lpsr_00_cm4_imxrt_txev;
/delete-node/ &iomuxc_lpsr_gpio_lpsr_00_gpio12_io00;
/delete-node/ &iomuxc_lpsr_gpio_lpsr_00_gpio_mux6_io00;
/delete-node/ &iomuxc_lpsr_gpio_lpsr_00_lpuart12_tx;
/delete-node/ &iomuxc_lpsr_gpio_lpsr_00_mic_clk;
/delete-node/ &iomuxc_lpsr_gpio_lpsr_00_mqs_right;
/delete-node/ &iomuxc_lpsr_gpio_lpsr_00_sai4_mclk;
/delete-node/ &iomuxc_lpsr_gpio_lpsr_01_can3_rx;
/delete-node/ &iomuxc_lpsr_gpio_lpsr_01_cm4_imxrt_rxev;
/delete-node/ &iomuxc_lpsr_gpio_lpsr_01_gpio12_io01;
/delete-node/ &iomuxc_lpsr_gpio_lpsr_01_gpio_mux6_io01;
/delete-node/ &iomuxc_lpsr_gpio_lpsr_01_lpuart12_rx;
/delete-node/ &iomuxc_lpsr_gpio_lpsr_01_mic_bitstream00;
/delete-node/ &iomuxc_lpsr_gpio_lpsr_01_mqs_left;
/delete-node/ &iomuxc_lpsr_gpio_lpsr_02_sai4_tx_data;
/delete-node/ &iomuxc_lpsr_gpio_lpsr_03_sai4_tx_sync;
/delete-node/ &iomuxc_lpsr_gpio_lpsr_04_lpi2c5_sda;
/delete-node/ &iomuxc_lpsr_gpio_lpsr_04_lpuart11_tx;
/delete-node/ &iomuxc_lpsr_gpio_lpsr_04_sai4_tx_bclk;
/delete-node/ &iomuxc_lpsr_gpio_lpsr_05_gpio12_io05;
/delete-node/ &iomuxc_lpsr_gpio_lpsr_05_gpio_mux6_io05;
/delete-node/ &iomuxc_lpsr_gpio_lpsr_05_lpi2c5_scl;
/delete-node/ &iomuxc_lpsr_gpio_lpsr_05_lpspi5_sdi;
/delete-node/ &iomuxc_lpsr_gpio_lpsr_05_lpuart11_rx;
/delete-node/ &iomuxc_lpsr_gpio_lpsr_05_lpuart12_cts_b;
/delete-node/ &iomuxc_lpsr_gpio_lpsr_05_sai4_mclk;
/delete-node/ &iomuxc_lpsr_gpio_lpsr_06_can3_tx;
/delete-node/ &iomuxc_lpsr_gpio_lpsr_06_gpio12_io06;
/delete-node/ &iomuxc_lpsr_gpio_lpsr_06_gpio_mux6_io06;
/delete-node/ &iomuxc_lpsr_gpio_lpsr_06_lpi2c6_sda;
/delete-node/ &iomuxc_lpsr_gpio_lpsr_06_lpspi5_pcs1;
/delete-node/ &iomuxc_lpsr_gpio_lpsr_06_lpspi6_pcs3;
/delete-node/ &iomuxc_lpsr_gpio_lpsr_06_lpuart12_tx;
/delete-node/ &iomuxc_lpsr_gpio_lpsr_06_pit2_trigger03;
/delete-node/ &iomuxc_lpsr_gpio_lpsr_06_sai4_rx_data;
/delete-node/ &iomuxc_lpsr_gpio_lpsr_07_can3_rx;
/delete-node/ &iomuxc_lpsr_gpio_lpsr_07_gpio12_io07;
/delete-node/ &iomuxc_lpsr_gpio_lpsr_07_gpio_mux6_io07;
/delete-node/ &iomuxc_lpsr_gpio_lpsr_07_lpi2c6_scl;
/delete-node/ &iomuxc_lpsr_gpio_lpsr_07_lpspi5_pcs2;
/delete-node/ &iomuxc_lpsr_gpio_lpsr_07_lpspi6_pcs2;
/delete-node/ &iomuxc_lpsr_gpio_lpsr_07_lpuart12_rx;
/delete-node/ &iomuxc_lpsr_gpio_lpsr_07_pit2_trigger02;
/delete-node/ &iomuxc_lpsr_gpio_lpsr_07_sai4_rx_bclk;
/delete-node/ &iomuxc_lpsr_gpio_lpsr_08_can3_tx;
/delete-node/ &iomuxc_lpsr_gpio_lpsr_08_gpio12_io08;
/delete-node/ &iomuxc_lpsr_gpio_lpsr_08_gpio_mux6_io08;
/delete-node/ &iomuxc_lpsr_gpio_lpsr_08_lpi2c5_sda;
/delete-node/ &iomuxc_lpsr_gpio_lpsr_08_lpspi5_pcs3;
/delete-node/ &iomuxc_lpsr_gpio_lpsr_08_lpspi6_pcs1;
/delete-node/ &iomuxc_lpsr_gpio_lpsr_08_lpuart11_tx;
/delete-node/ &iomuxc_lpsr_gpio_lpsr_08_mic_clk;
/delete-node/ &iomuxc_lpsr_gpio_lpsr_08_pit2_trigger01;
/delete-node/ &iomuxc_lpsr_gpio_lpsr_08_sai4_rx_sync;
/delete-node/ &iomuxc_lpsr_gpio_lpsr_09_can3_rx;
/delete-node/ &iomuxc_lpsr_gpio_lpsr_09_gpio12_io09;
/delete-node/ &iomuxc_lpsr_gpio_lpsr_09_gpio_mux6_io09;
/delete-node/ &iomuxc_lpsr_gpio_lpsr_09_lpi2c5_scl;
/delete-node/ &iomuxc_lpsr_gpio_lpsr_09_lpspi6_pcs0;
/delete-node/ &iomuxc_lpsr_gpio_lpsr_09_lpuart11_rx;
/delete-node/ &iomuxc_lpsr_gpio_lpsr_09_mic_bitstream00;
/delete-node/ &iomuxc_lpsr_gpio_lpsr_09_pit2_trigger00;
/delete-node/ &iomuxc_lpsr_gpio_lpsr_09_sai4_tx_data;
/delete-node/ &iomuxc_lpsr_gpio_lpsr_10_lpi2c5_scls;
/delete-node/ &iomuxc_lpsr_gpio_lpsr_10_lpspi6_sck;
/delete-node/ &iomuxc_lpsr_gpio_lpsr_10_lpuart11_cts_b;
/delete-node/ &iomuxc_lpsr_gpio_lpsr_10_sai4_tx_sync;
/delete-node/ &iomuxc_lpsr_gpio_lpsr_11_lpi2c5_sdas;
/delete-node/ &iomuxc_lpsr_gpio_lpsr_11_lpspi6_sdo;
/delete-node/ &iomuxc_lpsr_gpio_lpsr_11_lpuart11_rts_b;
/delete-node/ &iomuxc_lpsr_gpio_lpsr_12_lpi2c5_hreq;
/delete-node/ &iomuxc_lpsr_gpio_lpsr_12_lpspi6_sdi;
/delete-node/ &iomuxc_lpsr_gpio_lpsr_12_sai4_tx_bclk;
/delete-node/ &iomuxc_lpsr_gpio_lpsr_13_sai4_rx_data;
/delete-node/ &iomuxc_lpsr_gpio_lpsr_14_sai4_rx_bclk;
/delete-node/ &iomuxc_lpsr_gpio_lpsr_15_sai4_rx_sync;
/delete-node/ &iomuxc_snvs_gpio_snvs_00_dig_gpio13_io03;
/delete-node/ &iomuxc_snvs_gpio_snvs_00_dig_snvs_lp_tamper00;
/delete-node/ &iomuxc_snvs_gpio_snvs_01_dig_gpio13_io04;
/delete-node/ &iomuxc_snvs_gpio_snvs_01_dig_snvs_lp_tamper01;
/delete-node/ &iomuxc_snvs_gpio_snvs_02_dig_gpio13_io05;
/delete-node/ &iomuxc_snvs_gpio_snvs_02_dig_snvs_lp_tamper02;
/delete-node/ &iomuxc_snvs_gpio_snvs_03_dig_gpio13_io06;
/delete-node/ &iomuxc_snvs_gpio_snvs_03_dig_snvs_lp_tamper03;
/delete-node/ &iomuxc_snvs_gpio_snvs_04_dig_gpio13_io07;
/delete-node/ &iomuxc_snvs_gpio_snvs_04_dig_snvs_lp_tamper04;
/delete-node/ &iomuxc_snvs_gpio_snvs_05_dig_gpio13_io08;
/delete-node/ &iomuxc_snvs_gpio_snvs_05_dig_snvs_lp_tamper05;
/delete-node/ &iomuxc_snvs_gpio_snvs_06_dig_gpio13_io09;
/delete-node/ &iomuxc_snvs_gpio_snvs_06_dig_snvs_lp_tamper06;
/delete-node/ &iomuxc_snvs_gpio_snvs_07_dig_gpio13_io10;
/delete-node/ &iomuxc_snvs_gpio_snvs_07_dig_snvs_lp_tamper07;
/delete-node/ &iomuxc_snvs_gpio_snvs_08_dig_gpio13_io11;
/delete-node/ &iomuxc_snvs_gpio_snvs_08_dig_snvs_lp_tamper08;
/delete-node/ &iomuxc_snvs_gpio_snvs_09_dig_gpio13_io12;
/delete-node/ &iomuxc_snvs_gpio_snvs_09_dig_snvs_lp_tamper09;
/delete-node/ &iomuxc_snvs_por_b_dig_src_por_b;
/delete-node/ &iomuxc_snvs_test_mode_dig_test_mode;

&iomuxc {
	/omit-if-no-ref/ iomuxc_snvs_por_b_dig_src_por_b: IOMUXC_SNVS_POR_B_DIG_SRC_POR_B {
		pinmux = <0x0 0 0x0 0 0x40c9403c>;
		pin-pue;
	};
	/omit-if-no-ref/ iomuxc_snvs_test_mode_dig_test_mode: IOMUXC_SNVS_TEST_MODE_DIG_TEST_MODE {
		pinmux = <0x0 0 0x0 0 0x40c9403c>;
		pin-pue;
	};
	/omit-if-no-ref/ iomuxc_snvs_wakeup_dig_nmi_glue_nmi: IOMUXC_SNVS_WAKEUP_DIG_NMI_GLUE_NMI {
		pinmux = <0x40c94000 7 0x40c080c4 1 0x40c94040>;
		pin-snvs;
	};
};
