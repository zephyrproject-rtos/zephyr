/*
 * Copyright 2024, NXP
 * SPDX-License-Identifier: Apache-2.0
 *
 * Note: File generated by gen_soc_headers.py
 * from configuration data for MIMXRT1165DVM6A
 */

/*
 * Delta-deduplicated by dedup_pinctrl.py:
 * based on mimxrt1176avm8a-pinctrl.dtsi with this part's differences applied
 * below (101 removed, 0 changed,
 * 0 added). Regenerate with dedup_pinctrl.py;
 * do not edit by hand.
 * target-hash: d0dcf505715381c8
 */

#include "mimxrt1176avm8a-pinctrl.dtsi"

/delete-node/ &iomuxc_gpio_ad_06_video_mux_csi_data15;
/delete-node/ &iomuxc_gpio_ad_07_video_mux_csi_data14;
/delete-node/ &iomuxc_gpio_ad_08_video_mux_csi_data13;
/delete-node/ &iomuxc_gpio_ad_09_video_mux_csi_data12;
/delete-node/ &iomuxc_gpio_ad_10_video_mux_csi_data11;
/delete-node/ &iomuxc_gpio_ad_11_video_mux_csi_data10;
/delete-node/ &iomuxc_gpio_ad_12_video_mux_csi_pixclk;
/delete-node/ &iomuxc_gpio_ad_13_video_mux_csi_mclk;
/delete-node/ &iomuxc_gpio_ad_14_video_mux_csi_vsync;
/delete-node/ &iomuxc_gpio_ad_15_video_mux_csi_hsync;
/delete-node/ &iomuxc_gpio_ad_16_video_mux_csi_data09;
/delete-node/ &iomuxc_gpio_ad_17_video_mux_csi_data08;
/delete-node/ &iomuxc_gpio_ad_18_video_mux_csi_data07;
/delete-node/ &iomuxc_gpio_ad_19_video_mux_csi_data06;
/delete-node/ &iomuxc_gpio_ad_20_enet_qos_1588_event2_out;
/delete-node/ &iomuxc_gpio_ad_20_video_mux_csi_data05;
/delete-node/ &iomuxc_gpio_ad_21_enet_qos_1588_event2_in;
/delete-node/ &iomuxc_gpio_ad_21_video_mux_csi_data04;
/delete-node/ &iomuxc_gpio_ad_22_enet_qos_1588_event3_out;
/delete-node/ &iomuxc_gpio_ad_22_video_mux_csi_data03;
/delete-node/ &iomuxc_gpio_ad_23_enet_qos_1588_event3_in;
/delete-node/ &iomuxc_gpio_ad_23_video_mux_csi_data02;
/delete-node/ &iomuxc_gpio_ad_24_video_mux_csi_data00;
/delete-node/ &iomuxc_gpio_ad_25_video_mux_csi_data01;
/delete-node/ &iomuxc_gpio_ad_26_enet_qos_mdc;
/delete-node/ &iomuxc_gpio_ad_27_enet_qos_mdio;
/delete-node/ &iomuxc_gpio_disp_b1_00_enet_qos_rx_en;
/delete-node/ &iomuxc_gpio_disp_b1_00_video_mux_lcdif_clk;
/delete-node/ &iomuxc_gpio_disp_b1_01_enet_qos_rx_clk;
/delete-node/ &iomuxc_gpio_disp_b1_01_enet_qos_rx_er;
/delete-node/ &iomuxc_gpio_disp_b1_01_video_mux_lcdif_enable;
/delete-node/ &iomuxc_gpio_disp_b1_02_enet_qos_rdata00;
/delete-node/ &iomuxc_gpio_disp_b1_02_video_mux_lcdif_hsync;
/delete-node/ &iomuxc_gpio_disp_b1_03_enet_qos_rdata01;
/delete-node/ &iomuxc_gpio_disp_b1_03_video_mux_lcdif_vsync;
/delete-node/ &iomuxc_gpio_disp_b1_04_enet_qos_rdata02;
/delete-node/ &iomuxc_gpio_disp_b1_04_video_mux_lcdif_data00;
/delete-node/ &iomuxc_gpio_disp_b1_05_enet_qos_rdata03;
/delete-node/ &iomuxc_gpio_disp_b1_05_video_mux_lcdif_data01;
/delete-node/ &iomuxc_gpio_disp_b1_06_enet_qos_tdata03;
/delete-node/ &iomuxc_gpio_disp_b1_06_video_mux_lcdif_data02;
/delete-node/ &iomuxc_gpio_disp_b1_07_enet_qos_tdata02;
/delete-node/ &iomuxc_gpio_disp_b1_07_video_mux_lcdif_data03;
/delete-node/ &iomuxc_gpio_disp_b1_08_enet_qos_tdata01;
/delete-node/ &iomuxc_gpio_disp_b1_08_video_mux_lcdif_data04;
/delete-node/ &iomuxc_gpio_disp_b1_09_enet_qos_tdata00;
/delete-node/ &iomuxc_gpio_disp_b1_09_video_mux_lcdif_data05;
/delete-node/ &iomuxc_gpio_disp_b1_10_enet_qos_tx_en;
/delete-node/ &iomuxc_gpio_disp_b1_10_video_mux_lcdif_data06;
/delete-node/ &iomuxc_gpio_disp_b1_11_enet_qos_ref_clk1;
/delete-node/ &iomuxc_gpio_disp_b1_11_enet_qos_tx_clk;
/delete-node/ &iomuxc_gpio_disp_b1_11_video_mux_lcdif_data07;
/delete-node/ &iomuxc_gpio_disp_b2_00_enet_qos_tx_er;
/delete-node/ &iomuxc_gpio_disp_b2_00_video_mux_lcdif_data08;
/delete-node/ &iomuxc_gpio_disp_b2_01_video_mux_lcdif_data09;
/delete-node/ &iomuxc_gpio_disp_b2_02_enet_qos_tdata00;
/delete-node/ &iomuxc_gpio_disp_b2_02_video_mux_lcdif_data10;
/delete-node/ &iomuxc_gpio_disp_b2_03_enet_qos_tdata01;
/delete-node/ &iomuxc_gpio_disp_b2_03_video_mux_lcdif_data11;
/delete-node/ &iomuxc_gpio_disp_b2_04_enet_qos_tx_en;
/delete-node/ &iomuxc_gpio_disp_b2_04_video_mux_lcdif_data12;
/delete-node/ &iomuxc_gpio_disp_b2_05_enet_qos_tx_clk;
/delete-node/ &iomuxc_gpio_disp_b2_05_video_mux_lcdif_data13;
/delete-node/ &iomuxc_gpio_disp_b2_06_enet_qos_rdata00;
/delete-node/ &iomuxc_gpio_disp_b2_06_video_mux_lcdif_data14;
/delete-node/ &iomuxc_gpio_disp_b2_07_enet_qos_rdata01;
/delete-node/ &iomuxc_gpio_disp_b2_07_video_mux_lcdif_data15;
/delete-node/ &iomuxc_gpio_disp_b2_08_enet_qos_rx_en;
/delete-node/ &iomuxc_gpio_disp_b2_08_video_mux_lcdif_data16;
/delete-node/ &iomuxc_gpio_disp_b2_09_enet_qos_rx_er;
/delete-node/ &iomuxc_gpio_disp_b2_09_video_mux_lcdif_data17;
/delete-node/ &iomuxc_gpio_disp_b2_10_enet_qos_rx_er;
/delete-node/ &iomuxc_gpio_disp_b2_10_video_mux_lcdif_data18;
/delete-node/ &iomuxc_gpio_disp_b2_11_enet_qos_crs;
/delete-node/ &iomuxc_gpio_disp_b2_11_video_mux_lcdif_data19;
/delete-node/ &iomuxc_gpio_disp_b2_12_enet_qos_col;
/delete-node/ &iomuxc_gpio_disp_b2_12_video_mux_lcdif_data20;
/delete-node/ &iomuxc_gpio_disp_b2_13_enet_qos_1588_event0_out;
/delete-node/ &iomuxc_gpio_disp_b2_13_video_mux_lcdif_data21;
/delete-node/ &iomuxc_gpio_disp_b2_14_enet_qos_1588_event0_in;
/delete-node/ &iomuxc_gpio_disp_b2_14_video_mux_lcdif_data22;
/delete-node/ &iomuxc_gpio_disp_b2_15_enet_qos_1588_event0_aux_in;
/delete-node/ &iomuxc_gpio_disp_b2_15_video_mux_lcdif_data23;
/delete-node/ &iomuxc_gpio_emc_b2_00_enet_qos_1588_event1_out;
/delete-node/ &iomuxc_gpio_emc_b2_01_enet_qos_1588_event1_in;
/delete-node/ &iomuxc_gpio_emc_b2_02_enet_qos_1588_event1_aux_in;
/delete-node/ &iomuxc_gpio_emc_b2_02_video_mux_csi_data23;
/delete-node/ &iomuxc_gpio_emc_b2_03_video_mux_csi_data22;
/delete-node/ &iomuxc_gpio_emc_b2_04_video_mux_csi_data21;
/delete-node/ &iomuxc_gpio_emc_b2_05_video_mux_csi_data20;
/delete-node/ &iomuxc_gpio_emc_b2_06_video_mux_csi_data19;
/delete-node/ &iomuxc_gpio_emc_b2_07_video_mux_csi_data18;
/delete-node/ &iomuxc_gpio_emc_b2_08_video_mux_csi_data17;
/delete-node/ &iomuxc_gpio_emc_b2_09_video_mux_csi_data16;
/delete-node/ &iomuxc_gpio_emc_b2_10_video_mux_csi_field;
/delete-node/ &iomuxc_gpio_emc_b2_19_enet_qos_mdc;
/delete-node/ &iomuxc_gpio_emc_b2_20_enet_qos_mdio;
/delete-node/ &iomuxc_gpio_emc_b2_20_enet_qos_ref_clk1;
/delete-node/ &iomuxc_gpio_sd_b1_04_enet_qos_1588_event2_aux_in;
/delete-node/ &iomuxc_gpio_sd_b1_05_enet_qos_1588_event3_aux_in;
/delete-node/ &iomuxc_gpio_sd_b2_07_enet_qos_ref_clk1;
