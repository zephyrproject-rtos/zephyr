/*
 * Copyright 2023, NXP
 * SPDX-License-Identifier: Apache-2.0
 *
 * Note: File generated by imx_cfg_utils.py
 * from configuration data for MIMXRT1176DVMAA
 */

/*
 * Content deduplicated by dedup_pinctrl.py:
 * the pin mux data of this part is identical to mimxrt1176avm8a-pinctrl.dtsi.
 * Do not edit; edit the canonical file instead.
 * target-hash: d0dcf505715381c8
 */

#include "mimxrt1176avm8a-pinctrl.dtsi"
