/*
 * Copyright 2026, NXP
 * SPDX-License-Identifier: Apache-2.0
 *
 * Note: File generated by gen_soc_headers.py
 * from configuration data for MIMXRT1152AVM6B
 */

/*
 * Content deduplicated by dedup_pinctrl.py:
 * the pin mux data of this part is identical to mimxrt1152dvm8b-pinctrl.dtsi.
 * Do not edit; edit the canonical file instead.
 * target-hash: b4a4b009623a86f1
 */

#include "mimxrt1152dvm8b-pinctrl.dtsi"
