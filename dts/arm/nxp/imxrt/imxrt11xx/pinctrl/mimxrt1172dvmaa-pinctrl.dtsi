/*
 * Copyright 2024, NXP
 * SPDX-License-Identifier: Apache-2.0
 *
 * Note: File generated by gen_soc_headers.py
 * from configuration data for MIMXRT1172DVMAA
 */

/*
 * Content deduplicated by dedup_pinctrl.py:
 * the pin mux data of this part is identical to mimxrt1173cvm8a-pinctrl.dtsi.
 * Do not edit; edit the canonical file instead.
 * target-hash: 274cb89d8218d5de
 */

#include "mimxrt1173cvm8a-pinctrl.dtsi"
