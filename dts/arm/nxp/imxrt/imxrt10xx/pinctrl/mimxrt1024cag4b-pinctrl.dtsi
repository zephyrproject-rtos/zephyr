/*
 * Copyright 2024, NXP
 * SPDX-License-Identifier: Apache-2.0
 *
 * Note: File generated by gen_soc_headers.py
 * from configuration data for MIMXRT1024CAG4B
 */

/*
 * Content deduplicated by dedup_pinctrl.py:
 * the pin mux data of this part is identical to mimxrt1024dag5b-pinctrl.dtsi.
 * Do not edit; edit the canonical file instead.
 * target-hash: 0a5a77bdb0ada393
 */

#include "mimxrt1024dag5b-pinctrl.dtsi"
