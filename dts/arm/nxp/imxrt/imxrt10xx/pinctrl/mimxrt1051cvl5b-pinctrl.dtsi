/*
 * Copyright (c) 2023, Centralp
 * SPDX-License-Identifier: Apache-2.0
 *
 * Note: File generated by imx_cfg_utils.py
 * from configuration data for MIMXRT1051CVL5B
 */

/*
 * Content deduplicated by dedup_pinctrl.py:
 * the pin mux data of this part is identical to mimxrt1051dvj6b-pinctrl.dtsi.
 * Do not edit; edit the canonical file instead.
 * target-hash: 3b8a3f50adae7e35
 */

#include "mimxrt1051dvj6b-pinctrl.dtsi"
