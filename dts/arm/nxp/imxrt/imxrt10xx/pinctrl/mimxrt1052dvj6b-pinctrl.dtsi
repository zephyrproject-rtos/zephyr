/*
 * Copyright (c) 2022, NXP
 * SPDX-License-Identifier: Apache-2.0
 *
 * Note: File generated by rt_cfg_utils.py
 * from configuration data for MIMXRT1052DVJ6B
 */

/*
 * Delta-deduplicated by dedup_pinctrl.py:
 * based on mimxrt1064dvj6a-pinctrl.dtsi with this part's differences applied
 * below (241 removed, 137 changed,
 * 2 added). Regenerate with dedup_pinctrl.py;
 * do not edit by hand.
 * target-hash: 304d2df1a5f7ddd6
 */

#include "mimxrt1064dvj6a-pinctrl.dtsi"

/delete-node/ &iomuxc_gpio_ad_b0_00_gpio6_io00;
/delete-node/ &iomuxc_gpio_ad_b0_01_gpio6_io01;
/delete-node/ &iomuxc_gpio_ad_b0_02_gpio6_io02;
/delete-node/ &iomuxc_gpio_ad_b0_03_gpio6_io03;
/delete-node/ &iomuxc_gpio_ad_b0_04_gpio6_io04;
/delete-node/ &iomuxc_gpio_ad_b0_05_gpio6_io05;
/delete-node/ &iomuxc_gpio_ad_b0_06_gpio6_io06;
/delete-node/ &iomuxc_gpio_ad_b0_07_gpio6_io07;
/delete-node/ &iomuxc_gpio_ad_b0_08_gpio6_io08;
/delete-node/ &iomuxc_gpio_ad_b0_09_gpio6_io09;
/delete-node/ &iomuxc_gpio_ad_b0_09_semc_dqs4;
/delete-node/ &iomuxc_gpio_ad_b0_10_arm_trace_swo;
/delete-node/ &iomuxc_gpio_ad_b0_10_flexcan3_tx;
/delete-node/ &iomuxc_gpio_ad_b0_10_gpio6_io10;
/delete-node/ &iomuxc_gpio_ad_b0_11_flexcan3_rx;
/delete-node/ &iomuxc_gpio_ad_b0_11_gpio6_io11;
/delete-node/ &iomuxc_gpio_ad_b0_11_semc_clk6;
/delete-node/ &iomuxc_gpio_ad_b0_12_gpio6_io12;
/delete-node/ &iomuxc_gpio_ad_b0_13_gpio6_io13;
/delete-node/ &iomuxc_gpio_ad_b0_14_flexcan3_tx;
/delete-node/ &iomuxc_gpio_ad_b0_14_gpio6_io14;
/delete-node/ &iomuxc_gpio_ad_b0_15_flexcan3_rx;
/delete-node/ &iomuxc_gpio_ad_b0_15_gpio6_io15;
/delete-node/ &iomuxc_gpio_ad_b1_00_enet2_1588_event0_out;
/delete-node/ &iomuxc_gpio_ad_b1_00_flexio3_flexio00;
/delete-node/ &iomuxc_gpio_ad_b1_00_gpio6_io16;
/delete-node/ &iomuxc_gpio_ad_b1_01_enet2_1588_event0_in;
/delete-node/ &iomuxc_gpio_ad_b1_01_flexio3_flexio01;
/delete-node/ &iomuxc_gpio_ad_b1_01_gpio6_io17;
/delete-node/ &iomuxc_gpio_ad_b1_02_flexio3_flexio02;
/delete-node/ &iomuxc_gpio_ad_b1_02_gpio6_io18;
/delete-node/ &iomuxc_gpio_ad_b1_02_gpt2_clk;
/delete-node/ &iomuxc_gpio_ad_b1_03_flexio3_flexio03;
/delete-node/ &iomuxc_gpio_ad_b1_03_gpio6_io19;
/delete-node/ &iomuxc_gpio_ad_b1_03_gpt2_capture1;
/delete-node/ &iomuxc_gpio_ad_b1_04_flexio3_flexio04;
/delete-node/ &iomuxc_gpio_ad_b1_04_gpio6_io20;
/delete-node/ &iomuxc_gpio_ad_b1_04_gpt2_capture2;
/delete-node/ &iomuxc_gpio_ad_b1_05_flexio3_flexio05;
/delete-node/ &iomuxc_gpio_ad_b1_05_gpio6_io21;
/delete-node/ &iomuxc_gpio_ad_b1_05_gpt2_compare1;
/delete-node/ &iomuxc_gpio_ad_b1_06_flexio3_flexio06;
/delete-node/ &iomuxc_gpio_ad_b1_06_gpio6_io22;
/delete-node/ &iomuxc_gpio_ad_b1_06_gpt2_compare2;
/delete-node/ &iomuxc_gpio_ad_b1_07_flexio3_flexio07;
/delete-node/ &iomuxc_gpio_ad_b1_07_gpio6_io23;
/delete-node/ &iomuxc_gpio_ad_b1_07_gpt2_compare3;
/delete-node/ &iomuxc_gpio_ad_b1_08_flexio3_flexio08;
/delete-node/ &iomuxc_gpio_ad_b1_08_gpio6_io24;
/delete-node/ &iomuxc_gpio_ad_b1_09_flexio3_flexio09;
/delete-node/ &iomuxc_gpio_ad_b1_09_gpio6_io25;
/delete-node/ &iomuxc_gpio_ad_b1_10_enet2_1588_event1_out;
/delete-node/ &iomuxc_gpio_ad_b1_10_flexio3_flexio10;
/delete-node/ &iomuxc_gpio_ad_b1_10_gpio6_io26;
/delete-node/ &iomuxc_gpio_ad_b1_11_enet2_1588_event1_in;
/delete-node/ &iomuxc_gpio_ad_b1_11_flexio3_flexio11;
/delete-node/ &iomuxc_gpio_ad_b1_11_gpio6_io27;
/delete-node/ &iomuxc_gpio_ad_b1_12_enet2_1588_event2_out;
/delete-node/ &iomuxc_gpio_ad_b1_12_flexio3_flexio12;
/delete-node/ &iomuxc_gpio_ad_b1_12_gpio6_io28;
/delete-node/ &iomuxc_gpio_ad_b1_13_enet2_1588_event2_in;
/delete-node/ &iomuxc_gpio_ad_b1_13_flexio3_flexio13;
/delete-node/ &iomuxc_gpio_ad_b1_13_gpio6_io29;
/delete-node/ &iomuxc_gpio_ad_b1_14_enet2_1588_event3_out;
/delete-node/ &iomuxc_gpio_ad_b1_14_flexio3_flexio14;
/delete-node/ &iomuxc_gpio_ad_b1_14_gpio6_io30;
/delete-node/ &iomuxc_gpio_ad_b1_15_enet2_1588_event3_in;
/delete-node/ &iomuxc_gpio_ad_b1_15_flexio3_flexio15;
/delete-node/ &iomuxc_gpio_ad_b1_15_gpio6_io31;
/delete-node/ &iomuxc_gpio_b0_00_enet2_mdc;
/delete-node/ &iomuxc_gpio_b0_00_gpio7_io00;
/delete-node/ &iomuxc_gpio_b0_01_enet2_mdio;
/delete-node/ &iomuxc_gpio_b0_01_gpio7_io01;
/delete-node/ &iomuxc_gpio_b0_02_enet2_1588_event0_out;
/delete-node/ &iomuxc_gpio_b0_02_gpio7_io02;
/delete-node/ &iomuxc_gpio_b0_03_enet2_1588_event0_in;
/delete-node/ &iomuxc_gpio_b0_03_gpio7_io03;
/delete-node/ &iomuxc_gpio_b0_04_enet2_tx_data3;
/delete-node/ &iomuxc_gpio_b0_04_gpio7_io04;
/delete-node/ &iomuxc_gpio_b0_05_enet2_tx_data2;
/delete-node/ &iomuxc_gpio_b0_05_gpio7_io05;
/delete-node/ &iomuxc_gpio_b0_06_enet2_rx_clk;
/delete-node/ &iomuxc_gpio_b0_06_gpio7_io06;
/delete-node/ &iomuxc_gpio_b0_07_enet2_tx_er;
/delete-node/ &iomuxc_gpio_b0_07_gpio7_io07;
/delete-node/ &iomuxc_gpio_b0_08_enet2_rx_data3;
/delete-node/ &iomuxc_gpio_b0_08_gpio7_io08;
/delete-node/ &iomuxc_gpio_b0_09_enet2_rx_data2;
/delete-node/ &iomuxc_gpio_b0_09_gpio7_io09;
/delete-node/ &iomuxc_gpio_b0_10_enet2_crs;
/delete-node/ &iomuxc_gpio_b0_10_gpio7_io10;
/delete-node/ &iomuxc_gpio_b0_11_enet2_col;
/delete-node/ &iomuxc_gpio_b0_11_gpio7_io11;
/delete-node/ &iomuxc_gpio_b0_12_enet2_tx_data0;
/delete-node/ &iomuxc_gpio_b0_12_gpio7_io12;
/delete-node/ &iomuxc_gpio_b0_13_enet2_tx_data1;
/delete-node/ &iomuxc_gpio_b0_13_gpio7_io13;
/delete-node/ &iomuxc_gpio_b0_14_arm_txev;
/delete-node/ &iomuxc_gpio_b0_14_enet2_tx_en;
/delete-node/ &iomuxc_gpio_b0_14_gpio7_io14;
/delete-node/ &iomuxc_gpio_b0_15_arm_rxev;
/delete-node/ &iomuxc_gpio_b0_15_enet2_ref_clk2;
/delete-node/ &iomuxc_gpio_b0_15_enet2_tx_clk;
/delete-node/ &iomuxc_gpio_b0_15_gpio7_io15;
/delete-node/ &iomuxc_gpio_b1_00_enet2_rx_er;
/delete-node/ &iomuxc_gpio_b1_00_flexio3_flexio16;
/delete-node/ &iomuxc_gpio_b1_00_gpio7_io16;
/delete-node/ &iomuxc_gpio_b1_01_enet2_rx_data0;
/delete-node/ &iomuxc_gpio_b1_01_flexio3_flexio17;
/delete-node/ &iomuxc_gpio_b1_01_gpio7_io17;
/delete-node/ &iomuxc_gpio_b1_02_enet2_rx_data1;
/delete-node/ &iomuxc_gpio_b1_02_flexio3_flexio18;
/delete-node/ &iomuxc_gpio_b1_02_gpio7_io18;
/delete-node/ &iomuxc_gpio_b1_03_enet2_rx_en;
/delete-node/ &iomuxc_gpio_b1_03_flexio3_flexio19;
/delete-node/ &iomuxc_gpio_b1_03_gpio7_io19;
/delete-node/ &iomuxc_gpio_b1_04_flexio3_flexio20;
/delete-node/ &iomuxc_gpio_b1_04_gpio7_io20;
/delete-node/ &iomuxc_gpio_b1_04_gpt1_clk;
/delete-node/ &iomuxc_gpio_b1_05_flexio3_flexio21;
/delete-node/ &iomuxc_gpio_b1_05_gpio7_io21;
/delete-node/ &iomuxc_gpio_b1_05_gpt1_capture1;
/delete-node/ &iomuxc_gpio_b1_06_flexio3_flexio22;
/delete-node/ &iomuxc_gpio_b1_06_gpio7_io22;
/delete-node/ &iomuxc_gpio_b1_06_gpt1_capture2;
/delete-node/ &iomuxc_gpio_b1_07_flexio3_flexio23;
/delete-node/ &iomuxc_gpio_b1_07_gpio7_io23;
/delete-node/ &iomuxc_gpio_b1_07_gpt1_compare1;
/delete-node/ &iomuxc_gpio_b1_08_flexio3_flexio24;
/delete-node/ &iomuxc_gpio_b1_08_gpio7_io24;
/delete-node/ &iomuxc_gpio_b1_08_gpt1_compare2;
/delete-node/ &iomuxc_gpio_b1_09_flexio3_flexio25;
/delete-node/ &iomuxc_gpio_b1_09_gpio7_io25;
/delete-node/ &iomuxc_gpio_b1_09_gpt1_compare3;
/delete-node/ &iomuxc_gpio_b1_10_flexio3_flexio26;
/delete-node/ &iomuxc_gpio_b1_10_gpio7_io26;
/delete-node/ &iomuxc_gpio_b1_11_flexio3_flexio27;
/delete-node/ &iomuxc_gpio_b1_11_gpio7_io27;
/delete-node/ &iomuxc_gpio_b1_12_flexio3_flexio28;
/delete-node/ &iomuxc_gpio_b1_12_gpio7_io28;
/delete-node/ &iomuxc_gpio_b1_13_flexio3_flexio29;
/delete-node/ &iomuxc_gpio_b1_13_gpio7_io29;
/delete-node/ &iomuxc_gpio_b1_13_semc_dqs4;
/delete-node/ &iomuxc_gpio_b1_14_enet2_tx_data0;
/delete-node/ &iomuxc_gpio_b1_14_flexio3_flexio30;
/delete-node/ &iomuxc_gpio_b1_14_gpio7_io30;
/delete-node/ &iomuxc_gpio_b1_15_enet2_tx_data1;
/delete-node/ &iomuxc_gpio_b1_15_flexio3_flexio31;
/delete-node/ &iomuxc_gpio_b1_15_gpio7_io31;
/delete-node/ &iomuxc_gpio_emc_00_gpio9_io00;
/delete-node/ &iomuxc_gpio_emc_01_gpio9_io01;
/delete-node/ &iomuxc_gpio_emc_02_gpio9_io02;
/delete-node/ &iomuxc_gpio_emc_03_gpio9_io03;
/delete-node/ &iomuxc_gpio_emc_04_gpio9_io04;
/delete-node/ &iomuxc_gpio_emc_05_gpio9_io05;
/delete-node/ &iomuxc_gpio_emc_06_gpio9_io06;
/delete-node/ &iomuxc_gpio_emc_07_gpio9_io07;
/delete-node/ &iomuxc_gpio_emc_08_gpio9_io08;
/delete-node/ &iomuxc_gpio_emc_09_gpio9_io09;
/delete-node/ &iomuxc_gpio_emc_10_gpio9_io10;
/delete-node/ &iomuxc_gpio_emc_11_gpio9_io11;
/delete-node/ &iomuxc_gpio_emc_12_gpio9_io12;
/delete-node/ &iomuxc_gpio_emc_13_gpio9_io13;
/delete-node/ &iomuxc_gpio_emc_14_gpio9_io14;
/delete-node/ &iomuxc_gpio_emc_15_gpio9_io15;
/delete-node/ &iomuxc_gpio_emc_16_gpio9_io16;
/delete-node/ &iomuxc_gpio_emc_17_gpio9_io17;
/delete-node/ &iomuxc_gpio_emc_18_gpio9_io18;
/delete-node/ &iomuxc_gpio_emc_19_gpio9_io19;
/delete-node/ &iomuxc_gpio_emc_20_gpio9_io20;
/delete-node/ &iomuxc_gpio_emc_21_gpio9_io21;
/delete-node/ &iomuxc_gpio_emc_22_gpio9_io22;
/delete-node/ &iomuxc_gpio_emc_23_gpio9_io23;
/delete-node/ &iomuxc_gpio_emc_24_gpio9_io24;
/delete-node/ &iomuxc_gpio_emc_25_gpio9_io25;
/delete-node/ &iomuxc_gpio_emc_26_gpio9_io26;
/delete-node/ &iomuxc_gpio_emc_27_gpio9_io27;
/delete-node/ &iomuxc_gpio_emc_28_gpio9_io28;
/delete-node/ &iomuxc_gpio_emc_29_gpio9_io29;
/delete-node/ &iomuxc_gpio_emc_30_enet2_tx_data0;
/delete-node/ &iomuxc_gpio_emc_30_gpio9_io30;
/delete-node/ &iomuxc_gpio_emc_31_enet2_tx_data1;
/delete-node/ &iomuxc_gpio_emc_31_gpio9_io31;
/delete-node/ &iomuxc_gpio_emc_32_enet2_tx_en;
/delete-node/ &iomuxc_gpio_emc_32_gpio8_io18;
/delete-node/ &iomuxc_gpio_emc_33_enet2_ref_clk2;
/delete-node/ &iomuxc_gpio_emc_33_enet2_tx_clk;
/delete-node/ &iomuxc_gpio_emc_33_gpio8_io19;
/delete-node/ &iomuxc_gpio_emc_34_enet2_rx_er;
/delete-node/ &iomuxc_gpio_emc_34_gpio8_io20;
/delete-node/ &iomuxc_gpio_emc_35_enet2_rx_data0;
/delete-node/ &iomuxc_gpio_emc_35_gpio8_io21;
/delete-node/ &iomuxc_gpio_emc_36_enet2_rx_data1;
/delete-node/ &iomuxc_gpio_emc_36_flexcan3_tx;
/delete-node/ &iomuxc_gpio_emc_36_gpio8_io22;
/delete-node/ &iomuxc_gpio_emc_37_enet2_rx_en;
/delete-node/ &iomuxc_gpio_emc_37_flexcan3_rx;
/delete-node/ &iomuxc_gpio_emc_37_gpio8_io23;
/delete-node/ &iomuxc_gpio_emc_38_enet2_mdc;
/delete-node/ &iomuxc_gpio_emc_38_gpio8_io24;
/delete-node/ &iomuxc_gpio_emc_39_enet2_mdio;
/delete-node/ &iomuxc_gpio_emc_39_gpio8_io25;
/delete-node/ &iomuxc_gpio_emc_39_semc_dqs4;
/delete-node/ &iomuxc_gpio_emc_40_gpio8_io26;
/delete-node/ &iomuxc_gpio_emc_40_semc_clk5;
/delete-node/ &iomuxc_gpio_emc_41_gpio8_io27;
/delete-node/ &iomuxc_gpio_sd_b0_00_enet2_tx_en;
/delete-node/ &iomuxc_gpio_sd_b0_00_gpio8_io12;
/delete-node/ &iomuxc_gpio_sd_b0_00_semc_dqs4;
/delete-node/ &iomuxc_gpio_sd_b0_01_enet2_ref_clk2;
/delete-node/ &iomuxc_gpio_sd_b0_01_enet2_tx_clk;
/delete-node/ &iomuxc_gpio_sd_b0_01_gpio8_io13;
/delete-node/ &iomuxc_gpio_sd_b0_02_enet2_rx_er;
/delete-node/ &iomuxc_gpio_sd_b0_02_gpio8_io14;
/delete-node/ &iomuxc_gpio_sd_b0_02_semc_clk5;
/delete-node/ &iomuxc_gpio_sd_b0_03_enet2_rx_data0;
/delete-node/ &iomuxc_gpio_sd_b0_03_gpio8_io15;
/delete-node/ &iomuxc_gpio_sd_b0_03_semc_clk6;
/delete-node/ &iomuxc_gpio_sd_b0_04_enet2_rx_data1;
/delete-node/ &iomuxc_gpio_sd_b0_04_gpio8_io16;
/delete-node/ &iomuxc_gpio_sd_b0_05_enet2_rx_en;
/delete-node/ &iomuxc_gpio_sd_b0_05_gpio8_io17;
/delete-node/ &iomuxc_gpio_sd_b1_00_gpio8_io00;
/delete-node/ &iomuxc_gpio_sd_b1_00_sai3_rx_data;
/delete-node/ &iomuxc_gpio_sd_b1_01_gpio8_io01;
/delete-node/ &iomuxc_gpio_sd_b1_01_sai3_tx_data;
/delete-node/ &iomuxc_gpio_sd_b1_02_gpio8_io02;
/delete-node/ &iomuxc_gpio_sd_b1_02_sai3_tx_sync;
/delete-node/ &iomuxc_gpio_sd_b1_03_gpio8_io03;
/delete-node/ &iomuxc_gpio_sd_b1_03_sai3_tx_bclk;
/delete-node/ &iomuxc_gpio_sd_b1_04_gpio8_io04;
/delete-node/ &iomuxc_gpio_sd_b1_04_sai3_mclk;
/delete-node/ &iomuxc_gpio_sd_b1_05_gpio8_io05;
/delete-node/ &iomuxc_gpio_sd_b1_05_sai3_rx_sync;
/delete-node/ &iomuxc_gpio_sd_b1_06_gpio8_io06;
/delete-node/ &iomuxc_gpio_sd_b1_06_sai3_rx_bclk;
/delete-node/ &iomuxc_gpio_sd_b1_07_gpio8_io07;
/delete-node/ &iomuxc_gpio_sd_b1_08_gpio8_io08;
/delete-node/ &iomuxc_gpio_sd_b1_09_gpio8_io09;
/delete-node/ &iomuxc_gpio_sd_b1_10_gpio8_io10;
/delete-node/ &iomuxc_gpio_sd_b1_11_gpio8_io11;
/delete-node/ &iomuxc_gpio_ad_b0_00_gpio1_io00;
/delete-node/ &iomuxc_gpio_ad_b0_01_gpio1_io01;
/delete-node/ &iomuxc_gpio_ad_b0_02_gpio1_io02;
/delete-node/ &iomuxc_gpio_ad_b0_03_gpio1_io03;
/delete-node/ &iomuxc_gpio_ad_b0_04_gpio1_io04;
/delete-node/ &iomuxc_gpio_ad_b0_05_gpio1_io05;
/delete-node/ &iomuxc_gpio_ad_b0_06_gpio1_io06;
/delete-node/ &iomuxc_gpio_ad_b0_07_gpio1_io07;
/delete-node/ &iomuxc_gpio_ad_b0_08_gpio1_io08;
/delete-node/ &iomuxc_gpio_ad_b0_09_gpio1_io09;
/delete-node/ &iomuxc_gpio_ad_b0_09_gpt2_clk;
/delete-node/ &iomuxc_gpio_ad_b0_10_gpio1_io10;
/delete-node/ &iomuxc_gpio_ad_b0_11_gpio1_io11;
/delete-node/ &iomuxc_gpio_ad_b0_12_gpio1_io12;
/delete-node/ &iomuxc_gpio_ad_b0_13_gpio1_io13;
/delete-node/ &iomuxc_gpio_ad_b0_13_gpt1_clk;
/delete-node/ &iomuxc_gpio_ad_b0_14_gpio1_io14;
/delete-node/ &iomuxc_gpio_ad_b0_15_gpio1_io15;
/delete-node/ &iomuxc_gpio_ad_b1_00_gpio1_io16;
/delete-node/ &iomuxc_gpio_ad_b1_01_gpio1_io17;
/delete-node/ &iomuxc_gpio_ad_b1_02_gpio1_io18;
/delete-node/ &iomuxc_gpio_ad_b1_03_gpio1_io19;
/delete-node/ &iomuxc_gpio_ad_b1_04_gpio1_io20;
/delete-node/ &iomuxc_gpio_ad_b1_05_gpio1_io21;
/delete-node/ &iomuxc_gpio_ad_b1_06_gpio1_io22;
/delete-node/ &iomuxc_gpio_ad_b1_07_gpio1_io23;
/delete-node/ &iomuxc_gpio_ad_b1_08_gpio1_io24;
/delete-node/ &iomuxc_gpio_ad_b1_09_gpio1_io25;
/delete-node/ &iomuxc_gpio_ad_b1_10_gpio1_io26;
/delete-node/ &iomuxc_gpio_ad_b1_11_gpio1_io27;
/delete-node/ &iomuxc_gpio_ad_b1_12_gpio1_io28;
/delete-node/ &iomuxc_gpio_ad_b1_13_gpio1_io29;
/delete-node/ &iomuxc_gpio_ad_b1_14_gpio1_io30;
/delete-node/ &iomuxc_gpio_ad_b1_15_gpio1_io31;
/delete-node/ &iomuxc_gpio_ad_b1_15_lpspi3_sck;
/delete-node/ &iomuxc_gpio_b0_00_gpio2_io00;
/delete-node/ &iomuxc_gpio_b0_01_gpio2_io01;
/delete-node/ &iomuxc_gpio_b0_02_gpio2_io02;
/delete-node/ &iomuxc_gpio_b0_03_gpio2_io03;
/delete-node/ &iomuxc_gpio_b0_04_gpio2_io04;
/delete-node/ &iomuxc_gpio_b0_05_gpio2_io05;
/delete-node/ &iomuxc_gpio_b0_06_gpio2_io06;
/delete-node/ &iomuxc_gpio_b0_07_gpio2_io07;
/delete-node/ &iomuxc_gpio_b0_08_gpio2_io08;
/delete-node/ &iomuxc_gpio_b0_09_gpio2_io09;
/delete-node/ &iomuxc_gpio_b0_10_gpio2_io10;
/delete-node/ &iomuxc_gpio_b0_11_gpio2_io11;
/delete-node/ &iomuxc_gpio_b0_12_gpio2_io12;
/delete-node/ &iomuxc_gpio_b0_13_gpio2_io13;
/delete-node/ &iomuxc_gpio_b0_14_gpio2_io14;
/delete-node/ &iomuxc_gpio_b0_15_gpio2_io15;
/delete-node/ &iomuxc_gpio_b1_00_gpio2_io16;
/delete-node/ &iomuxc_gpio_b1_01_gpio2_io17;
/delete-node/ &iomuxc_gpio_b1_02_gpio2_io18;
/delete-node/ &iomuxc_gpio_b1_03_gpio2_io19;
/delete-node/ &iomuxc_gpio_b1_04_gpio2_io20;
/delete-node/ &iomuxc_gpio_b1_05_gpio2_io21;
/delete-node/ &iomuxc_gpio_b1_06_gpio2_io22;
/delete-node/ &iomuxc_gpio_b1_07_gpio2_io23;
/delete-node/ &iomuxc_gpio_b1_08_gpio2_io24;
/delete-node/ &iomuxc_gpio_b1_09_gpio2_io25;
/delete-node/ &iomuxc_gpio_b1_10_gpio2_io26;
/delete-node/ &iomuxc_gpio_b1_11_gpio2_io27;
/delete-node/ &iomuxc_gpio_b1_12_gpio2_io28;
/delete-node/ &iomuxc_gpio_b1_13_gpio2_io29;
/delete-node/ &iomuxc_gpio_b1_14_gpio2_io30;
/delete-node/ &iomuxc_gpio_b1_15_gpio2_io31;
/delete-node/ &iomuxc_gpio_emc_00_gpio4_io00;
/delete-node/ &iomuxc_gpio_emc_01_gpio4_io01;
/delete-node/ &iomuxc_gpio_emc_02_gpio4_io02;
/delete-node/ &iomuxc_gpio_emc_03_gpio4_io03;
/delete-node/ &iomuxc_gpio_emc_04_gpio4_io04;
/delete-node/ &iomuxc_gpio_emc_05_gpio4_io05;
/delete-node/ &iomuxc_gpio_emc_06_gpio4_io06;
/delete-node/ &iomuxc_gpio_emc_07_gpio4_io07;
/delete-node/ &iomuxc_gpio_emc_08_gpio4_io08;
/delete-node/ &iomuxc_gpio_emc_09_gpio4_io09;
/delete-node/ &iomuxc_gpio_emc_10_gpio4_io10;
/delete-node/ &iomuxc_gpio_emc_11_gpio4_io11;
/delete-node/ &iomuxc_gpio_emc_12_gpio4_io12;
/delete-node/ &iomuxc_gpio_emc_13_gpio4_io13;
/delete-node/ &iomuxc_gpio_emc_14_gpio4_io14;
/delete-node/ &iomuxc_gpio_emc_15_gpio4_io15;
/delete-node/ &iomuxc_gpio_emc_16_gpio4_io16;
/delete-node/ &iomuxc_gpio_emc_17_gpio4_io17;
/delete-node/ &iomuxc_gpio_emc_18_gpio4_io18;
/delete-node/ &iomuxc_gpio_emc_19_gpio4_io19;
/delete-node/ &iomuxc_gpio_emc_20_gpio4_io20;
/delete-node/ &iomuxc_gpio_emc_21_gpio4_io21;
/delete-node/ &iomuxc_gpio_emc_22_gpio4_io22;
/delete-node/ &iomuxc_gpio_emc_23_gpio4_io23;
/delete-node/ &iomuxc_gpio_emc_23_gpt1_capture2;
/delete-node/ &iomuxc_gpio_emc_24_gpio4_io24;
/delete-node/ &iomuxc_gpio_emc_24_gpt1_capture1;
/delete-node/ &iomuxc_gpio_emc_25_gpio4_io25;
/delete-node/ &iomuxc_gpio_emc_26_gpio4_io26;
/delete-node/ &iomuxc_gpio_emc_27_gpio4_io27;
/delete-node/ &iomuxc_gpio_emc_28_gpio4_io28;
/delete-node/ &iomuxc_gpio_emc_29_gpio4_io29;
/delete-node/ &iomuxc_gpio_emc_30_gpio4_io30;
/delete-node/ &iomuxc_gpio_emc_31_gpio4_io31;
/delete-node/ &iomuxc_gpio_emc_32_gpio3_io18;
/delete-node/ &iomuxc_gpio_emc_33_gpio3_io19;
/delete-node/ &iomuxc_gpio_emc_33_sai3_rx_data;
/delete-node/ &iomuxc_gpio_emc_34_gpio3_io20;
/delete-node/ &iomuxc_gpio_emc_34_sai3_rx_sync;
/delete-node/ &iomuxc_gpio_emc_35_gpio3_io21;
/delete-node/ &iomuxc_gpio_emc_35_sai3_rx_bclk;
/delete-node/ &iomuxc_gpio_emc_36_gpio3_io22;
/delete-node/ &iomuxc_gpio_emc_37_gpio3_io23;
/delete-node/ &iomuxc_gpio_emc_37_sai3_mclk;
/delete-node/ &iomuxc_gpio_emc_38_gpio3_io24;
/delete-node/ &iomuxc_gpio_emc_38_sai3_tx_bclk;
/delete-node/ &iomuxc_gpio_emc_39_gpio3_io25;
/delete-node/ &iomuxc_gpio_emc_39_sai3_tx_sync;
/delete-node/ &iomuxc_gpio_emc_40_gpio3_io26;
/delete-node/ &iomuxc_gpio_emc_40_gpt2_capture2;
/delete-node/ &iomuxc_gpio_emc_41_gpio3_io27;
/delete-node/ &iomuxc_gpio_emc_41_gpt2_capture1;
/delete-node/ &iomuxc_gpio_sd_b0_00_gpio3_io12;
/delete-node/ &iomuxc_gpio_sd_b0_01_gpio3_io13;
/delete-node/ &iomuxc_gpio_sd_b0_02_gpio3_io14;
/delete-node/ &iomuxc_gpio_sd_b0_03_gpio3_io15;
/delete-node/ &iomuxc_gpio_sd_b0_04_gpio3_io16;
/delete-node/ &iomuxc_gpio_sd_b0_05_gpio3_io17;
/delete-node/ &iomuxc_gpio_sd_b1_00_gpio3_io00;
/delete-node/ &iomuxc_gpio_sd_b1_01_gpio3_io01;
/delete-node/ &iomuxc_gpio_sd_b1_02_gpio3_io02;
/delete-node/ &iomuxc_gpio_sd_b1_03_gpio3_io03;
/delete-node/ &iomuxc_gpio_sd_b1_04_gpio3_io04;
/delete-node/ &iomuxc_gpio_sd_b1_05_gpio3_io05;
/delete-node/ &iomuxc_gpio_sd_b1_06_gpio3_io06;
/delete-node/ &iomuxc_gpio_sd_b1_07_gpio3_io07;
/delete-node/ &iomuxc_gpio_sd_b1_08_gpio3_io08;
/delete-node/ &iomuxc_gpio_sd_b1_09_gpio3_io09;
/delete-node/ &iomuxc_gpio_sd_b1_10_gpio3_io10;
/delete-node/ &iomuxc_gpio_sd_b1_11_gpio3_io11;

&iomuxc {
	/omit-if-no-ref/ iomuxc_gpio_ad_b0_00_gpio1_io00: IOMUXC_GPIO_AD_B0_00_GPIO1_IO00 {
		pinmux = <0x401f80bc 5 0x0 0 0x401f82ac>;
	};
	/omit-if-no-ref/ iomuxc_gpio_ad_b0_01_gpio1_io01: IOMUXC_GPIO_AD_B0_01_GPIO1_IO01 {
		pinmux = <0x401f80c0 5 0x0 0 0x401f82b0>;
	};
	/omit-if-no-ref/ iomuxc_gpio_ad_b0_02_gpio1_io02: IOMUXC_GPIO_AD_B0_02_GPIO1_IO02 {
		pinmux = <0x401f80c4 5 0x0 0 0x401f82b4>;
	};
	/omit-if-no-ref/ iomuxc_gpio_ad_b0_03_gpio1_io03: IOMUXC_GPIO_AD_B0_03_GPIO1_IO03 {
		pinmux = <0x401f80c8 5 0x0 0 0x401f82b8>;
	};
	/omit-if-no-ref/ iomuxc_gpio_ad_b0_04_gpio1_io04: IOMUXC_GPIO_AD_B0_04_GPIO1_IO04 {
		pinmux = <0x401f80cc 5 0x0 0 0x401f82bc>;
	};
	/omit-if-no-ref/ iomuxc_gpio_ad_b0_05_gpio1_io05: IOMUXC_GPIO_AD_B0_05_GPIO1_IO05 {
		pinmux = <0x401f80d0 5 0x0 0 0x401f82c0>;
	};
	/omit-if-no-ref/ iomuxc_gpio_ad_b0_06_gpio1_io06: IOMUXC_GPIO_AD_B0_06_GPIO1_IO06 {
		pinmux = <0x401f80d4 5 0x0 0 0x401f82c4>;
	};
	/omit-if-no-ref/ iomuxc_gpio_ad_b0_07_gpio1_io07: IOMUXC_GPIO_AD_B0_07_GPIO1_IO07 {
		pinmux = <0x401f80d8 5 0x0 0 0x401f82c8>;
	};
	/omit-if-no-ref/ iomuxc_gpio_ad_b0_08_gpio1_io08: IOMUXC_GPIO_AD_B0_08_GPIO1_IO08 {
		pinmux = <0x401f80dc 5 0x0 0 0x401f82cc>;
	};
	/omit-if-no-ref/ iomuxc_gpio_ad_b0_09_gpio1_io09: IOMUXC_GPIO_AD_B0_09_GPIO1_IO09 {
		pinmux = <0x401f80e0 5 0x0 0 0x401f82d0>;
	};
	/omit-if-no-ref/ iomuxc_gpio_ad_b0_09_gpt2_clk: IOMUXC_GPIO_AD_B0_09_GPT2_CLK {
		pinmux = <0x401f80e0 7 0x0 0 0x401f82d0>;
	};
	/omit-if-no-ref/ iomuxc_gpio_ad_b0_10_gpio1_io10: IOMUXC_GPIO_AD_B0_10_GPIO1_IO10 {
		pinmux = <0x401f80e4 5 0x0 0 0x401f82d4>;
	};
	/omit-if-no-ref/ iomuxc_gpio_ad_b0_11_gpio1_io11: IOMUXC_GPIO_AD_B0_11_GPIO1_IO11 {
		pinmux = <0x401f80e8 5 0x0 0 0x401f82d8>;
	};
	/omit-if-no-ref/ iomuxc_gpio_ad_b0_12_gpio1_io12: IOMUXC_GPIO_AD_B0_12_GPIO1_IO12 {
		pinmux = <0x401f80ec 5 0x0 0 0x401f82dc>;
	};
	/omit-if-no-ref/ iomuxc_gpio_ad_b0_13_gpio1_io13: IOMUXC_GPIO_AD_B0_13_GPIO1_IO13 {
		pinmux = <0x401f80f0 5 0x0 0 0x401f82e0>;
	};
	/omit-if-no-ref/ iomuxc_gpio_ad_b0_13_gpt1_clk: IOMUXC_GPIO_AD_B0_13_GPT1_CLK {
		pinmux = <0x401f80f0 1 0x0 0 0x401f82e0>;
	};
	/omit-if-no-ref/ iomuxc_gpio_ad_b0_14_gpio1_io14: IOMUXC_GPIO_AD_B0_14_GPIO1_IO14 {
		pinmux = <0x401f80f4 5 0x0 0 0x401f82e4>;
	};
	/omit-if-no-ref/ iomuxc_gpio_ad_b0_15_gpio1_io15: IOMUXC_GPIO_AD_B0_15_GPIO1_IO15 {
		pinmux = <0x401f80f8 5 0x0 0 0x401f82e8>;
	};
	/omit-if-no-ref/ iomuxc_gpio_ad_b1_00_gpio1_io16: IOMUXC_GPIO_AD_B1_00_GPIO1_IO16 {
		pinmux = <0x401f80fc 5 0x0 0 0x401f82ec>;
	};
	/omit-if-no-ref/ iomuxc_gpio_ad_b1_01_gpio1_io17: IOMUXC_GPIO_AD_B1_01_GPIO1_IO17 {
		pinmux = <0x401f8100 5 0x0 0 0x401f82f0>;
	};
	/omit-if-no-ref/ iomuxc_gpio_ad_b1_02_gpio1_io18: IOMUXC_GPIO_AD_B1_02_GPIO1_IO18 {
		pinmux = <0x401f8104 5 0x0 0 0x401f82f4>;
	};
	/omit-if-no-ref/ iomuxc_gpio_ad_b1_03_gpio1_io19: IOMUXC_GPIO_AD_B1_03_GPIO1_IO19 {
		pinmux = <0x401f8108 5 0x0 0 0x401f82f8>;
	};
	/omit-if-no-ref/ iomuxc_gpio_ad_b1_04_gpio1_io20: IOMUXC_GPIO_AD_B1_04_GPIO1_IO20 {
		pinmux = <0x401f810c 5 0x0 0 0x401f82fc>;
	};
	/omit-if-no-ref/ iomuxc_gpio_ad_b1_05_gpio1_io21: IOMUXC_GPIO_AD_B1_05_GPIO1_IO21 {
		pinmux = <0x401f8110 5 0x0 0 0x401f8300>;
	};
	/omit-if-no-ref/ iomuxc_gpio_ad_b1_06_gpio1_io22: IOMUXC_GPIO_AD_B1_06_GPIO1_IO22 {
		pinmux = <0x401f8114 5 0x0 0 0x401f8304>;
	};
	/omit-if-no-ref/ iomuxc_gpio_ad_b1_07_gpio1_io23: IOMUXC_GPIO_AD_B1_07_GPIO1_IO23 {
		pinmux = <0x401f8118 5 0x0 0 0x401f8308>;
	};
	/omit-if-no-ref/ iomuxc_gpio_ad_b1_08_gpio1_io24: IOMUXC_GPIO_AD_B1_08_GPIO1_IO24 {
		pinmux = <0x401f811c 5 0x0 0 0x401f830c>;
	};
	/omit-if-no-ref/ iomuxc_gpio_ad_b1_09_gpio1_io25: IOMUXC_GPIO_AD_B1_09_GPIO1_IO25 {
		pinmux = <0x401f8120 5 0x0 0 0x401f8310>;
	};
	/omit-if-no-ref/ iomuxc_gpio_ad_b1_10_gpio1_io26: IOMUXC_GPIO_AD_B1_10_GPIO1_IO26 {
		pinmux = <0x401f8124 5 0x0 0 0x401f8314>;
	};
	/omit-if-no-ref/ iomuxc_gpio_ad_b1_11_gpio1_io27: IOMUXC_GPIO_AD_B1_11_GPIO1_IO27 {
		pinmux = <0x401f8128 5 0x0 0 0x401f8318>;
	};
	/omit-if-no-ref/ iomuxc_gpio_ad_b1_12_gpio1_io28: IOMUXC_GPIO_AD_B1_12_GPIO1_IO28 {
		pinmux = <0x401f812c 5 0x0 0 0x401f831c>;
	};
	/omit-if-no-ref/ iomuxc_gpio_ad_b1_13_gpio1_io29: IOMUXC_GPIO_AD_B1_13_GPIO1_IO29 {
		pinmux = <0x401f8130 5 0x0 0 0x401f8320>;
	};
	/omit-if-no-ref/ iomuxc_gpio_ad_b1_14_gpio1_io30: IOMUXC_GPIO_AD_B1_14_GPIO1_IO30 {
		pinmux = <0x401f8134 5 0x0 0 0x401f8324>;
	};
	/omit-if-no-ref/ iomuxc_gpio_ad_b1_15_gpio1_io31: IOMUXC_GPIO_AD_B1_15_GPIO1_IO31 {
		pinmux = <0x401f8138 5 0x0 0 0x401f8328>;
	};
	/omit-if-no-ref/ iomuxc_gpio_ad_b1_15_lpspi3_sck: IOMUXC_GPIO_AD_B1_15_LPSPI3_SCK {
		pinmux = <0x401f8138 2 0x0 0 0x401f8328>;
	};
	/omit-if-no-ref/ iomuxc_gpio_b0_00_gpio2_io00: IOMUXC_GPIO_B0_00_GPIO2_IO00 {
		pinmux = <0x401f813c 5 0x0 0 0x401f832c>;
	};
	/omit-if-no-ref/ iomuxc_gpio_b0_01_gpio2_io01: IOMUXC_GPIO_B0_01_GPIO2_IO01 {
		pinmux = <0x401f8140 5 0x0 0 0x401f8330>;
	};
	/omit-if-no-ref/ iomuxc_gpio_b0_02_gpio2_io02: IOMUXC_GPIO_B0_02_GPIO2_IO02 {
		pinmux = <0x401f8144 5 0x0 0 0x401f8334>;
	};
	/omit-if-no-ref/ iomuxc_gpio_b0_03_gpio2_io03: IOMUXC_GPIO_B0_03_GPIO2_IO03 {
		pinmux = <0x401f8148 5 0x0 0 0x401f8338>;
	};
	/omit-if-no-ref/ iomuxc_gpio_b0_04_gpio2_io04: IOMUXC_GPIO_B0_04_GPIO2_IO04 {
		pinmux = <0x401f814c 5 0x0 0 0x401f833c>;
	};
	/omit-if-no-ref/ iomuxc_gpio_b0_05_gpio2_io05: IOMUXC_GPIO_B0_05_GPIO2_IO05 {
		pinmux = <0x401f8150 5 0x0 0 0x401f8340>;
	};
	/omit-if-no-ref/ iomuxc_gpio_b0_06_gpio2_io06: IOMUXC_GPIO_B0_06_GPIO2_IO06 {
		pinmux = <0x401f8154 5 0x0 0 0x401f8344>;
	};
	/omit-if-no-ref/ iomuxc_gpio_b0_07_gpio2_io07: IOMUXC_GPIO_B0_07_GPIO2_IO07 {
		pinmux = <0x401f8158 5 0x0 0 0x401f8348>;
	};
	/omit-if-no-ref/ iomuxc_gpio_b0_08_gpio2_io08: IOMUXC_GPIO_B0_08_GPIO2_IO08 {
		pinmux = <0x401f815c 5 0x0 0 0x401f834c>;
	};
	/omit-if-no-ref/ iomuxc_gpio_b0_09_gpio2_io09: IOMUXC_GPIO_B0_09_GPIO2_IO09 {
		pinmux = <0x401f8160 5 0x0 0 0x401f8350>;
	};
	/omit-if-no-ref/ iomuxc_gpio_b0_10_gpio2_io10: IOMUXC_GPIO_B0_10_GPIO2_IO10 {
		pinmux = <0x401f8164 5 0x0 0 0x401f8354>;
	};
	/omit-if-no-ref/ iomuxc_gpio_b0_11_gpio2_io11: IOMUXC_GPIO_B0_11_GPIO2_IO11 {
		pinmux = <0x401f8168 5 0x0 0 0x401f8358>;
	};
	/omit-if-no-ref/ iomuxc_gpio_b0_12_gpio2_io12: IOMUXC_GPIO_B0_12_GPIO2_IO12 {
		pinmux = <0x401f816c 5 0x0 0 0x401f835c>;
	};
	/omit-if-no-ref/ iomuxc_gpio_b0_13_gpio2_io13: IOMUXC_GPIO_B0_13_GPIO2_IO13 {
		pinmux = <0x401f8170 5 0x0 0 0x401f8360>;
	};
	/omit-if-no-ref/ iomuxc_gpio_b0_14_gpio2_io14: IOMUXC_GPIO_B0_14_GPIO2_IO14 {
		pinmux = <0x401f8174 5 0x0 0 0x401f8364>;
	};
	/omit-if-no-ref/ iomuxc_gpio_b0_15_gpio2_io15: IOMUXC_GPIO_B0_15_GPIO2_IO15 {
		pinmux = <0x401f8178 5 0x0 0 0x401f8368>;
	};
	/omit-if-no-ref/ iomuxc_gpio_b1_00_gpio2_io16: IOMUXC_GPIO_B1_00_GPIO2_IO16 {
		pinmux = <0x401f817c 5 0x0 0 0x401f836c>;
	};
	/omit-if-no-ref/ iomuxc_gpio_b1_01_gpio2_io17: IOMUXC_GPIO_B1_01_GPIO2_IO17 {
		pinmux = <0x401f8180 5 0x0 0 0x401f8370>;
	};
	/omit-if-no-ref/ iomuxc_gpio_b1_02_gpio2_io18: IOMUXC_GPIO_B1_02_GPIO2_IO18 {
		pinmux = <0x401f8184 5 0x0 0 0x401f8374>;
	};
	/omit-if-no-ref/ iomuxc_gpio_b1_03_gpio2_io19: IOMUXC_GPIO_B1_03_GPIO2_IO19 {
		pinmux = <0x401f8188 5 0x0 0 0x401f8378>;
	};
	/omit-if-no-ref/ iomuxc_gpio_b1_04_gpio2_io20: IOMUXC_GPIO_B1_04_GPIO2_IO20 {
		pinmux = <0x401f818c 5 0x0 0 0x401f837c>;
	};
	/omit-if-no-ref/ iomuxc_gpio_b1_05_gpio2_io21: IOMUXC_GPIO_B1_05_GPIO2_IO21 {
		pinmux = <0x401f8190 5 0x0 0 0x401f8380>;
	};
	/omit-if-no-ref/ iomuxc_gpio_b1_06_gpio2_io22: IOMUXC_GPIO_B1_06_GPIO2_IO22 {
		pinmux = <0x401f8194 5 0x0 0 0x401f8384>;
	};
	/omit-if-no-ref/ iomuxc_gpio_b1_07_gpio2_io23: IOMUXC_GPIO_B1_07_GPIO2_IO23 {
		pinmux = <0x401f8198 5 0x0 0 0x401f8388>;
	};
	/omit-if-no-ref/ iomuxc_gpio_b1_08_gpio2_io24: IOMUXC_GPIO_B1_08_GPIO2_IO24 {
		pinmux = <0x401f819c 5 0x0 0 0x401f838c>;
	};
	/omit-if-no-ref/ iomuxc_gpio_b1_09_gpio2_io25: IOMUXC_GPIO_B1_09_GPIO2_IO25 {
		pinmux = <0x401f81a0 5 0x0 0 0x401f8390>;
	};
	/omit-if-no-ref/ iomuxc_gpio_b1_10_gpio2_io26: IOMUXC_GPIO_B1_10_GPIO2_IO26 {
		pinmux = <0x401f81a4 5 0x0 0 0x401f8394>;
	};
	/omit-if-no-ref/ iomuxc_gpio_b1_11_gpio2_io27: IOMUXC_GPIO_B1_11_GPIO2_IO27 {
		pinmux = <0x401f81a8 5 0x0 0 0x401f8398>;
	};
	/omit-if-no-ref/ iomuxc_gpio_b1_12_gpio2_io28: IOMUXC_GPIO_B1_12_GPIO2_IO28 {
		pinmux = <0x401f81ac 5 0x0 0 0x401f839c>;
	};
	/omit-if-no-ref/ iomuxc_gpio_b1_13_gpio2_io29: IOMUXC_GPIO_B1_13_GPIO2_IO29 {
		pinmux = <0x401f81b0 5 0x0 0 0x401f83a0>;
	};
	/omit-if-no-ref/ iomuxc_gpio_b1_14_gpio2_io30: IOMUXC_GPIO_B1_14_GPIO2_IO30 {
		pinmux = <0x401f81b4 5 0x0 0 0x401f83a4>;
	};
	/omit-if-no-ref/ iomuxc_gpio_b1_15_gpio2_io31: IOMUXC_GPIO_B1_15_GPIO2_IO31 {
		pinmux = <0x401f81b8 5 0x0 0 0x401f83a8>;
	};
	/omit-if-no-ref/ iomuxc_gpio_emc_00_gpio4_io00: IOMUXC_GPIO_EMC_00_GPIO4_IO00 {
		pinmux = <0x401f8014 5 0x0 0 0x401f8204>;
	};
	/omit-if-no-ref/ iomuxc_gpio_emc_01_gpio4_io01: IOMUXC_GPIO_EMC_01_GPIO4_IO01 {
		pinmux = <0x401f8018 5 0x0 0 0x401f8208>;
	};
	/omit-if-no-ref/ iomuxc_gpio_emc_02_gpio4_io02: IOMUXC_GPIO_EMC_02_GPIO4_IO02 {
		pinmux = <0x401f801c 5 0x0 0 0x401f820c>;
	};
	/omit-if-no-ref/ iomuxc_gpio_emc_03_gpio4_io03: IOMUXC_GPIO_EMC_03_GPIO4_IO03 {
		pinmux = <0x401f8020 5 0x0 0 0x401f8210>;
	};
	/omit-if-no-ref/ iomuxc_gpio_emc_04_gpio4_io04: IOMUXC_GPIO_EMC_04_GPIO4_IO04 {
		pinmux = <0x401f8024 5 0x0 0 0x401f8214>;
	};
	/omit-if-no-ref/ iomuxc_gpio_emc_05_gpio4_io05: IOMUXC_GPIO_EMC_05_GPIO4_IO05 {
		pinmux = <0x401f8028 5 0x0 0 0x401f8218>;
	};
	/omit-if-no-ref/ iomuxc_gpio_emc_06_gpio4_io06: IOMUXC_GPIO_EMC_06_GPIO4_IO06 {
		pinmux = <0x401f802c 5 0x0 0 0x401f821c>;
	};
	/omit-if-no-ref/ iomuxc_gpio_emc_07_gpio4_io07: IOMUXC_GPIO_EMC_07_GPIO4_IO07 {
		pinmux = <0x401f8030 5 0x0 0 0x401f8220>;
	};
	/omit-if-no-ref/ iomuxc_gpio_emc_08_gpio4_io08: IOMUXC_GPIO_EMC_08_GPIO4_IO08 {
		pinmux = <0x401f8034 5 0x0 0 0x401f8224>;
	};
	/omit-if-no-ref/ iomuxc_gpio_emc_09_gpio4_io09: IOMUXC_GPIO_EMC_09_GPIO4_IO09 {
		pinmux = <0x401f8038 5 0x0 0 0x401f8228>;
	};
	/omit-if-no-ref/ iomuxc_gpio_emc_10_gpio4_io10: IOMUXC_GPIO_EMC_10_GPIO4_IO10 {
		pinmux = <0x401f803c 5 0x0 0 0x401f822c>;
	};
	/omit-if-no-ref/ iomuxc_gpio_emc_11_gpio4_io11: IOMUXC_GPIO_EMC_11_GPIO4_IO11 {
		pinmux = <0x401f8040 5 0x0 0 0x401f8230>;
	};
	/omit-if-no-ref/ iomuxc_gpio_emc_12_gpio4_io12: IOMUXC_GPIO_EMC_12_GPIO4_IO12 {
		pinmux = <0x401f8044 5 0x0 0 0x401f8234>;
	};
	/omit-if-no-ref/ iomuxc_gpio_emc_13_gpio4_io13: IOMUXC_GPIO_EMC_13_GPIO4_IO13 {
		pinmux = <0x401f8048 5 0x0 0 0x401f8238>;
	};
	/omit-if-no-ref/ iomuxc_gpio_emc_14_gpio4_io14: IOMUXC_GPIO_EMC_14_GPIO4_IO14 {
		pinmux = <0x401f804c 5 0x0 0 0x401f823c>;
	};
	/omit-if-no-ref/ iomuxc_gpio_emc_15_gpio4_io15: IOMUXC_GPIO_EMC_15_GPIO4_IO15 {
		pinmux = <0x401f8050 5 0x0 0 0x401f8240>;
	};
	/omit-if-no-ref/ iomuxc_gpio_emc_16_gpio4_io16: IOMUXC_GPIO_EMC_16_GPIO4_IO16 {
		pinmux = <0x401f8054 5 0x0 0 0x401f8244>;
	};
	/omit-if-no-ref/ iomuxc_gpio_emc_17_gpio4_io17: IOMUXC_GPIO_EMC_17_GPIO4_IO17 {
		pinmux = <0x401f8058 5 0x0 0 0x401f8248>;
	};
	/omit-if-no-ref/ iomuxc_gpio_emc_18_gpio4_io18: IOMUXC_GPIO_EMC_18_GPIO4_IO18 {
		pinmux = <0x401f805c 5 0x0 0 0x401f824c>;
	};
	/omit-if-no-ref/ iomuxc_gpio_emc_19_gpio4_io19: IOMUXC_GPIO_EMC_19_GPIO4_IO19 {
		pinmux = <0x401f8060 5 0x0 0 0x401f8250>;
	};
	/omit-if-no-ref/ iomuxc_gpio_emc_20_gpio4_io20: IOMUXC_GPIO_EMC_20_GPIO4_IO20 {
		pinmux = <0x401f8064 5 0x0 0 0x401f8254>;
	};
	/omit-if-no-ref/ iomuxc_gpio_emc_21_gpio4_io21: IOMUXC_GPIO_EMC_21_GPIO4_IO21 {
		pinmux = <0x401f8068 5 0x0 0 0x401f8258>;
	};
	/omit-if-no-ref/ iomuxc_gpio_emc_22_gpio4_io22: IOMUXC_GPIO_EMC_22_GPIO4_IO22 {
		pinmux = <0x401f806c 5 0x0 0 0x401f825c>;
	};
	/omit-if-no-ref/ iomuxc_gpio_emc_23_gpio4_io23: IOMUXC_GPIO_EMC_23_GPIO4_IO23 {
		pinmux = <0x401f8070 5 0x0 0 0x401f8260>;
	};
	/omit-if-no-ref/ iomuxc_gpio_emc_23_gpt1_capture2: IOMUXC_GPIO_EMC_23_GPT1_CAPTURE2 {
		pinmux = <0x401f8070 4 0x0 0 0x401f8260>;
	};
	/omit-if-no-ref/ iomuxc_gpio_emc_24_gpio4_io24: IOMUXC_GPIO_EMC_24_GPIO4_IO24 {
		pinmux = <0x401f8074 5 0x0 0 0x401f8264>;
	};
	/omit-if-no-ref/ iomuxc_gpio_emc_24_gpt1_capture1: IOMUXC_GPIO_EMC_24_GPT1_CAPTURE1 {
		pinmux = <0x401f8074 4 0x0 0 0x401f8264>;
	};
	/omit-if-no-ref/ iomuxc_gpio_emc_25_gpio4_io25: IOMUXC_GPIO_EMC_25_GPIO4_IO25 {
		pinmux = <0x401f8078 5 0x0 0 0x401f8268>;
	};
	/omit-if-no-ref/ iomuxc_gpio_emc_26_gpio4_io26: IOMUXC_GPIO_EMC_26_GPIO4_IO26 {
		pinmux = <0x401f807c 5 0x0 0 0x401f826c>;
	};
	/omit-if-no-ref/ iomuxc_gpio_emc_27_gpio4_io27: IOMUXC_GPIO_EMC_27_GPIO4_IO27 {
		pinmux = <0x401f8080 5 0x0 0 0x401f8270>;
	};
	/omit-if-no-ref/ iomuxc_gpio_emc_28_gpio4_io28: IOMUXC_GPIO_EMC_28_GPIO4_IO28 {
		pinmux = <0x401f8084 5 0x0 0 0x401f8274>;
	};
	/omit-if-no-ref/ iomuxc_gpio_emc_29_gpio4_io29: IOMUXC_GPIO_EMC_29_GPIO4_IO29 {
		pinmux = <0x401f8088 5 0x0 0 0x401f8278>;
	};
	/omit-if-no-ref/ iomuxc_gpio_emc_30_gpio4_io30: IOMUXC_GPIO_EMC_30_GPIO4_IO30 {
		pinmux = <0x401f808c 5 0x0 0 0x401f827c>;
	};
	/omit-if-no-ref/ iomuxc_gpio_emc_31_gpio4_io31: IOMUXC_GPIO_EMC_31_GPIO4_IO31 {
		pinmux = <0x401f8090 5 0x0 0 0x401f8280>;
	};
	/omit-if-no-ref/ iomuxc_gpio_emc_32_gpio3_io18: IOMUXC_GPIO_EMC_32_GPIO3_IO18 {
		pinmux = <0x401f8094 5 0x0 0 0x401f8284>;
	};
	/omit-if-no-ref/ iomuxc_gpio_emc_33_gpio3_io19: IOMUXC_GPIO_EMC_33_GPIO3_IO19 {
		pinmux = <0x401f8098 5 0x0 0 0x401f8288>;
	};
	/omit-if-no-ref/ iomuxc_gpio_emc_33_sai3_rx_data: IOMUXC_GPIO_EMC_33_SAI3_RX_DATA {
		pinmux = <0x401f8098 3 0x0 0 0x401f8288>;
	};
	/omit-if-no-ref/ iomuxc_gpio_emc_34_gpio3_io20: IOMUXC_GPIO_EMC_34_GPIO3_IO20 {
		pinmux = <0x401f809c 5 0x0 0 0x401f828c>;
	};
	/omit-if-no-ref/ iomuxc_gpio_emc_34_sai3_rx_sync: IOMUXC_GPIO_EMC_34_SAI3_RX_SYNC {
		pinmux = <0x401f809c 3 0x0 0 0x401f828c>;
	};
	/omit-if-no-ref/ iomuxc_gpio_emc_35_gpio3_io21: IOMUXC_GPIO_EMC_35_GPIO3_IO21 {
		pinmux = <0x401f80a0 5 0x0 0 0x401f8290>;
	};
	/omit-if-no-ref/ iomuxc_gpio_emc_35_sai3_rx_bclk: IOMUXC_GPIO_EMC_35_SAI3_RX_BCLK {
		pinmux = <0x401f80a0 3 0x0 0 0x401f8290>;
	};
	/omit-if-no-ref/ iomuxc_gpio_emc_36_gpio3_io22: IOMUXC_GPIO_EMC_36_GPIO3_IO22 {
		pinmux = <0x401f80a4 5 0x0 0 0x401f8294>;
	};
	/omit-if-no-ref/ iomuxc_gpio_emc_37_gpio3_io23: IOMUXC_GPIO_EMC_37_GPIO3_IO23 {
		pinmux = <0x401f80a8 5 0x0 0 0x401f8298>;
	};
	/omit-if-no-ref/ iomuxc_gpio_emc_37_sai3_mclk: IOMUXC_GPIO_EMC_37_SAI3_MCLK {
		pinmux = <0x401f80a8 3 0x0 0 0x401f8298>;
	};
	/omit-if-no-ref/ iomuxc_gpio_emc_38_gpio3_io24: IOMUXC_GPIO_EMC_38_GPIO3_IO24 {
		pinmux = <0x401f80ac 5 0x0 0 0x401f829c>;
	};
	/omit-if-no-ref/ iomuxc_gpio_emc_38_sai3_tx_bclk: IOMUXC_GPIO_EMC_38_SAI3_TX_BCLK {
		pinmux = <0x401f80ac 3 0x0 0 0x401f829c>;
	};
	/omit-if-no-ref/ iomuxc_gpio_emc_39_gpio3_io25: IOMUXC_GPIO_EMC_39_GPIO3_IO25 {
		pinmux = <0x401f80b0 5 0x0 0 0x401f82a0>;
	};
	/omit-if-no-ref/ iomuxc_gpio_emc_39_sai3_tx_sync: IOMUXC_GPIO_EMC_39_SAI3_TX_SYNC {
		pinmux = <0x401f80b0 3 0x0 0 0x401f82a0>;
	};
	/omit-if-no-ref/ iomuxc_gpio_emc_40_gpio3_io26: IOMUXC_GPIO_EMC_40_GPIO3_IO26 {
		pinmux = <0x401f80b4 5 0x0 0 0x401f82a4>;
	};
	/omit-if-no-ref/ iomuxc_gpio_emc_40_gpt2_capture2: IOMUXC_GPIO_EMC_40_GPT2_CAPTURE2 {
		pinmux = <0x401f80b4 1 0x0 0 0x401f82a4>;
	};
	/omit-if-no-ref/ iomuxc_gpio_emc_41_gpio3_io27: IOMUXC_GPIO_EMC_41_GPIO3_IO27 {
		pinmux = <0x401f80b8 5 0x0 0 0x401f82a8>;
	};
	/omit-if-no-ref/ iomuxc_gpio_emc_41_gpt2_capture1: IOMUXC_GPIO_EMC_41_GPT2_CAPTURE1 {
		pinmux = <0x401f80b8 1 0x0 0 0x401f82a8>;
	};
	/omit-if-no-ref/ iomuxc_gpio_sd_b0_00_gpio3_io12: IOMUXC_GPIO_SD_B0_00_GPIO3_IO12 {
		pinmux = <0x401f81bc 5 0x0 0 0x401f83ac>;
	};
	/omit-if-no-ref/ iomuxc_gpio_sd_b0_01_gpio3_io13: IOMUXC_GPIO_SD_B0_01_GPIO3_IO13 {
		pinmux = <0x401f81c0 5 0x0 0 0x401f83b0>;
	};
	/omit-if-no-ref/ iomuxc_gpio_sd_b0_02_gpio3_io14: IOMUXC_GPIO_SD_B0_02_GPIO3_IO14 {
		pinmux = <0x401f81c4 5 0x0 0 0x401f83b4>;
	};
	/omit-if-no-ref/ iomuxc_gpio_sd_b0_03_gpio3_io15: IOMUXC_GPIO_SD_B0_03_GPIO3_IO15 {
		pinmux = <0x401f81c8 5 0x0 0 0x401f83b8>;
	};
	/omit-if-no-ref/ iomuxc_gpio_sd_b0_04_gpio3_io16: IOMUXC_GPIO_SD_B0_04_GPIO3_IO16 {
		pinmux = <0x401f81cc 5 0x0 0 0x401f83bc>;
	};
	/omit-if-no-ref/ iomuxc_gpio_sd_b0_05_gpio3_io17: IOMUXC_GPIO_SD_B0_05_GPIO3_IO17 {
		pinmux = <0x401f81d0 5 0x0 0 0x401f83c0>;
	};
	/omit-if-no-ref/ iomuxc_gpio_sd_b1_00_gpio3_io00: IOMUXC_GPIO_SD_B1_00_GPIO3_IO00 {
		pinmux = <0x401f81d4 5 0x0 0 0x401f83c4>;
	};
	/omit-if-no-ref/ iomuxc_gpio_sd_b1_01_gpio3_io01: IOMUXC_GPIO_SD_B1_01_GPIO3_IO01 {
		pinmux = <0x401f81d8 5 0x0 0 0x401f83c8>;
	};
	/omit-if-no-ref/ iomuxc_gpio_sd_b1_02_gpio3_io02: IOMUXC_GPIO_SD_B1_02_GPIO3_IO02 {
		pinmux = <0x401f81dc 5 0x0 0 0x401f83cc>;
	};
	/omit-if-no-ref/ iomuxc_gpio_sd_b1_03_gpio3_io03: IOMUXC_GPIO_SD_B1_03_GPIO3_IO03 {
		pinmux = <0x401f81e0 5 0x0 0 0x401f83d0>;
	};
	/omit-if-no-ref/ iomuxc_gpio_sd_b1_04_gpio3_io04: IOMUXC_GPIO_SD_B1_04_GPIO3_IO04 {
		pinmux = <0x401f81e4 5 0x0 0 0x401f83d4>;
	};
	/omit-if-no-ref/ iomuxc_gpio_sd_b1_05_gpio3_io05: IOMUXC_GPIO_SD_B1_05_GPIO3_IO05 {
		pinmux = <0x401f81e8 5 0x0 0 0x401f83d8>;
	};
	/omit-if-no-ref/ iomuxc_gpio_sd_b1_06_gpio3_io06: IOMUXC_GPIO_SD_B1_06_GPIO3_IO06 {
		pinmux = <0x401f81ec 5 0x0 0 0x401f83dc>;
	};
	/omit-if-no-ref/ iomuxc_gpio_sd_b1_07_gpio3_io07: IOMUXC_GPIO_SD_B1_07_GPIO3_IO07 {
		pinmux = <0x401f81f0 5 0x0 0 0x401f83e0>;
	};
	/omit-if-no-ref/ iomuxc_gpio_sd_b1_08_gpio3_io08: IOMUXC_GPIO_SD_B1_08_GPIO3_IO08 {
		pinmux = <0x401f81f4 5 0x0 0 0x401f83e4>;
	};
	/omit-if-no-ref/ iomuxc_gpio_sd_b1_09_gpio3_io09: IOMUXC_GPIO_SD_B1_09_GPIO3_IO09 {
		pinmux = <0x401f81f8 5 0x0 0 0x401f83e8>;
	};
	/omit-if-no-ref/ iomuxc_gpio_sd_b1_10_gpio3_io10: IOMUXC_GPIO_SD_B1_10_GPIO3_IO10 {
		pinmux = <0x401f81fc 5 0x0 0 0x401f83ec>;
	};
	/omit-if-no-ref/ iomuxc_gpio_sd_b1_11_gpio3_io11: IOMUXC_GPIO_SD_B1_11_GPIO3_IO11 {
		pinmux = <0x401f8200 5 0x0 0 0x401f83f0>;
	};
	/omit-if-no-ref/ iomuxc_gpio_b0_14_arm_cm7_txev: IOMUXC_GPIO_B0_14_ARM_CM7_TXEV {
		pinmux = <0x401f8174 2 0x0 0 0x401f8364>;
	};
	/omit-if-no-ref/ iomuxc_gpio_b0_15_arm_cm7_rxev: IOMUXC_GPIO_B0_15_ARM_CM7_RXEV {
		pinmux = <0x401f8178 2 0x0 0 0x401f8368>;
	};
};
