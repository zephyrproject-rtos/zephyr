/*
 * Copyright 2024, NXP
 * SPDX-License-Identifier: Apache-2.0
 *
 * Note: File generated by gen_soc_headers.py
 * from configuration data for MIMXRT1015CAF4B
 */

/*
 * Content deduplicated by dedup_pinctrl.py:
 * the pin mux data of this part is identical to mimxrt1015daf5b-pinctrl.dtsi.
 * Do not edit; edit the canonical file instead.
 * target-hash: 999979606ade8006
 */

#include "mimxrt1015daf5b-pinctrl.dtsi"
