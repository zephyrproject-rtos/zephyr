/*
 * Copyright 2023, NXP
 * SPDX-License-Identifier: Apache-2.0
 *
 * Note: File generated by gen_soc_headers.py
 * from configuration data for MIMXRT1061DVL6B
 */

/*
 * Content deduplicated by dedup_pinctrl.py:
 * the pin mux data of this part is identical to mimxrt1061dvj6a-pinctrl.dtsi.
 * Do not edit; edit the canonical file instead.
 * target-hash: 5fa2d63da186290a
 */

#include "mimxrt1061dvj6a-pinctrl.dtsi"
