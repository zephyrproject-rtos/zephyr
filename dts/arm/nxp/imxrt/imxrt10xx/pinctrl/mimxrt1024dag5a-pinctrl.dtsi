/*
 * Copyright (c) 2022, NXP
 * SPDX-License-Identifier: Apache-2.0
 *
 * Note: File generated by rt_cfg_utils.py
 * from configuration data for MIMXRT1024DAG5A
 */

/*
 * SOC level pinctrl defintions
 * These definitions define SOC level defaults for each pin,
 * and select the pinmux for the pin. Pinmux entries are a tuple of:
 * <mux_register mux_mode input_register input_daisy config_register>
 * the mux_register and input_daisy reside in the IOMUXC peripheral, and
 * the pinctrl driver will write the mux_mode and input_daisy values into
 * each register, respectively. The config_register is used to configure
 * the pin based on the devicetree properties set
 */

&iomuxc {
	/omit-if-no-ref/ iomuxc_gpio_ad_b0_00_gpio1_io00: IOMUXC_GPIO_AD_B0_00_GPIO1_IO00 {
		pinmux = <0x401f80bc 5 0x0 0 0x401f8230>;
	};
	/omit-if-no-ref/ iomuxc_gpio_ad_b0_00_gpt1_compare1: IOMUXC_GPIO_AD_B0_00_GPT1_COMPARE1 {
		pinmux = <0x401f80bc 7 0x0 0 0x401f8230>;
	};
	/omit-if-no-ref/ iomuxc_gpio_ad_b0_00_jtag_tms: IOMUXC_GPIO_AD_B0_00_JTAG_TMS {
		pinmux = <0x401f80bc 0 0x0 0 0x401f8230>;
	};
	/omit-if-no-ref/ iomuxc_gpio_ad_b0_01_gpio1_io01: IOMUXC_GPIO_AD_B0_01_GPIO1_IO01 {
		pinmux = <0x401f80c0 5 0x0 0 0x401f8234>;
	};
	/omit-if-no-ref/ iomuxc_gpio_ad_b0_01_gpt1_capture2: IOMUXC_GPIO_AD_B0_01_GPT1_CAPTURE2 {
		pinmux = <0x401f80c0 7 0x0 0 0x401f8234>;
	};
	/omit-if-no-ref/ iomuxc_gpio_ad_b0_01_jtag_tck: IOMUXC_GPIO_AD_B0_01_JTAG_TCK {
		pinmux = <0x401f80c0 0 0x0 0 0x401f8234>;
	};
	/omit-if-no-ref/ iomuxc_gpio_ad_b0_02_gpio1_io02: IOMUXC_GPIO_AD_B0_02_GPIO1_IO02 {
		pinmux = <0x401f80c4 5 0x0 0 0x401f8238>;
	};
	/omit-if-no-ref/ iomuxc_gpio_ad_b0_02_gpt1_capture1: IOMUXC_GPIO_AD_B0_02_GPT1_CAPTURE1 {
		pinmux = <0x401f80c4 7 0x0 0 0x401f8238>;
	};
	/omit-if-no-ref/ iomuxc_gpio_ad_b0_02_jtag_mod: IOMUXC_GPIO_AD_B0_02_JTAG_MOD {
		pinmux = <0x401f80c4 0 0x0 0 0x401f8238>;
	};
	/omit-if-no-ref/ iomuxc_gpio_ad_b0_03_ccm_pmic_rdy: IOMUXC_GPIO_AD_B0_03_CCM_PMIC_RDY {
		pinmux = <0x401f80c8 7 0x401f8300 2 0x401f823c>;
	};
	/omit-if-no-ref/ iomuxc_gpio_ad_b0_03_gpio1_io03: IOMUXC_GPIO_AD_B0_03_GPIO1_IO03 {
		pinmux = <0x401f80c8 5 0x0 0 0x401f823c>;
	};
	/omit-if-no-ref/ iomuxc_gpio_ad_b0_03_jtag_tdi: IOMUXC_GPIO_AD_B0_03_JTAG_TDI {
		pinmux = <0x401f80c8 0 0x0 0 0x401f823c>;
	};
	/omit-if-no-ref/ iomuxc_gpio_ad_b0_03_sai1_mclk: IOMUXC_GPIO_AD_B0_03_SAI1_MCLK {
		pinmux = <0x401f80c8 3 0x401f8430 1 0x401f823c>;
	};
	/omit-if-no-ref/ iomuxc_gpio_ad_b0_03_usb_otg1_oc: IOMUXC_GPIO_AD_B0_03_USB_OTG1_OC {
		pinmux = <0x401f80c8 6 0x401f848c 0 0x401f823c>;
	};
	/omit-if-no-ref/ iomuxc_gpio_ad_b0_03_usdhc1_wp: IOMUXC_GPIO_AD_B0_03_USDHC1_WP {
		pinmux = <0x401f80c8 4 0x401f8494 0 0x401f823c>;
	};
	/omit-if-no-ref/ iomuxc_gpio_ad_b0_03_usdhc2_cd_b: IOMUXC_GPIO_AD_B0_03_USDHC2_CD_B {
		pinmux = <0x401f80c8 1 0x401f8498 1 0x401f823c>;
	};
	/omit-if-no-ref/ iomuxc_gpio_ad_b0_03_wdog1_b: IOMUXC_GPIO_AD_B0_03_WDOG1_B {
		pinmux = <0x401f80c8 2 0x0 0 0x401f823c>;
	};
	/omit-if-no-ref/ iomuxc_gpio_ad_b0_04_enet_mdio: IOMUXC_GPIO_AD_B0_04_ENET_MDIO {
		pinmux = <0x401f80cc 4 0x401f8308 1 0x401f8240>;
	};
	/omit-if-no-ref/ iomuxc_gpio_ad_b0_04_ewm_out_b: IOMUXC_GPIO_AD_B0_04_EWM_OUT_B {
		pinmux = <0x401f80cc 7 0x0 0 0x401f8240>;
	};
	/omit-if-no-ref/ iomuxc_gpio_ad_b0_04_flexcan1_tx: IOMUXC_GPIO_AD_B0_04_FLEXCAN1_TX {
		pinmux = <0x401f80cc 1 0x0 0 0x401f8240>;
	};
	/omit-if-no-ref/ iomuxc_gpio_ad_b0_04_gpio1_io04: IOMUXC_GPIO_AD_B0_04_GPIO1_IO04 {
		pinmux = <0x401f80cc 5 0x0 0 0x401f8240>;
	};
	/omit-if-no-ref/ iomuxc_gpio_ad_b0_04_jtag_tdo: IOMUXC_GPIO_AD_B0_04_JTAG_TDO {
		pinmux = <0x401f80cc 0 0x0 0 0x401f8240>;
	};
	/omit-if-no-ref/ iomuxc_gpio_ad_b0_04_qtimer2_timer0: IOMUXC_GPIO_AD_B0_04_QTIMER2_TIMER0 {
		pinmux = <0x401f80cc 3 0x401f8420 1 0x401f8240>;
		gpr = <0x400ac018 0x4 0x0>;
	};
	/omit-if-no-ref/ iomuxc_gpio_ad_b0_04_usb_otg1_pwr: IOMUXC_GPIO_AD_B0_04_USB_OTG1_PWR {
		pinmux = <0x401f80cc 6 0x0 0 0x401f8240>;
	};
	/omit-if-no-ref/ iomuxc_gpio_ad_b0_04_usdhc1_wp: IOMUXC_GPIO_AD_B0_04_USDHC1_WP {
		pinmux = <0x401f80cc 2 0x401f8494 1 0x401f8240>;
	};
	/omit-if-no-ref/ iomuxc_gpio_ad_b0_05_arm_nmi: IOMUXC_GPIO_AD_B0_05_ARM_NMI {
		pinmux = <0x401f80d0 7 0x401f840c 0 0x401f8244>;
	};
	/omit-if-no-ref/ iomuxc_gpio_ad_b0_05_enet_mdc: IOMUXC_GPIO_AD_B0_05_ENET_MDC {
		pinmux = <0x401f80d0 4 0x0 0 0x401f8244>;
	};
	/omit-if-no-ref/ iomuxc_gpio_ad_b0_05_flexcan1_rx: IOMUXC_GPIO_AD_B0_05_FLEXCAN1_RX {
		pinmux = <0x401f80d0 1 0x401f8320 2 0x401f8244>;
	};
	/omit-if-no-ref/ iomuxc_gpio_ad_b0_05_gpio1_io05: IOMUXC_GPIO_AD_B0_05_GPIO1_IO05 {
		pinmux = <0x401f80d0 5 0x0 0 0x401f8244>;
	};
	/omit-if-no-ref/ iomuxc_gpio_ad_b0_05_jtag_trstb: IOMUXC_GPIO_AD_B0_05_JTAG_TRSTB {
		pinmux = <0x401f80d0 0 0x0 0 0x401f8244>;
	};
	/omit-if-no-ref/ iomuxc_gpio_ad_b0_05_qtimer2_timer1: IOMUXC_GPIO_AD_B0_05_QTIMER2_TIMER1 {
		pinmux = <0x401f80d0 3 0x401f8424 1 0x401f8244>;
		gpr = <0x400ac018 0x5 0x0>;
	};
	/omit-if-no-ref/ iomuxc_gpio_ad_b0_05_usb_otg1_id: IOMUXC_GPIO_AD_B0_05_USB_OTG1_ID {
		pinmux = <0x401f80d0 6 0x401f82fc 0 0x401f8244>;
	};
	/omit-if-no-ref/ iomuxc_gpio_ad_b0_05_usdhc1_cd_b: IOMUXC_GPIO_AD_B0_05_USDHC1_CD_B {
		pinmux = <0x401f80d0 2 0x401f8490 1 0x401f8244>;
	};
	/omit-if-no-ref/ iomuxc_gpio_ad_b0_06_flexpwm2_pwma3: IOMUXC_GPIO_AD_B0_06_FLEXPWM2_PWMA3 {
		pinmux = <0x401f80d4 4 0x401f8354 0 0x401f8248>;
	};
	/omit-if-no-ref/ iomuxc_gpio_ad_b0_06_gpio1_io06: IOMUXC_GPIO_AD_B0_06_GPIO1_IO06 {
		pinmux = <0x401f80d4 5 0x0 0 0x401f8248>;
	};
	/omit-if-no-ref/ iomuxc_gpio_ad_b0_06_lpuart1_tx: IOMUXC_GPIO_AD_B0_06_LPUART1_TX {
		pinmux = <0x401f80d4 2 0x0 0 0x401f8248>;
	};
	/omit-if-no-ref/ iomuxc_gpio_ad_b0_06_mqs_right: IOMUXC_GPIO_AD_B0_06_MQS_RIGHT {
		pinmux = <0x401f80d4 1 0x0 0 0x401f8248>;
	};
	/omit-if-no-ref/ iomuxc_gpio_ad_b0_06_pit_trigger0: IOMUXC_GPIO_AD_B0_06_PIT_TRIGGER0 {
		pinmux = <0x401f80d4 0 0x0 0 0x401f8248>;
	};
	/omit-if-no-ref/ iomuxc_gpio_ad_b0_06_qtimer2_timer2: IOMUXC_GPIO_AD_B0_06_QTIMER2_TIMER2 {
		pinmux = <0x401f80d4 3 0x401f8428 1 0x401f8248>;
		gpr = <0x400ac018 0x6 0x0>;
	};
	/omit-if-no-ref/ iomuxc_gpio_ad_b0_06_ref_32k_out: IOMUXC_GPIO_AD_B0_06_REF_32K_OUT {
		pinmux = <0x401f80d4 6 0x0 0 0x401f8248>;
	};
	/omit-if-no-ref/ iomuxc_gpio_ad_b0_07_flexpwm2_pwmb3: IOMUXC_GPIO_AD_B0_07_FLEXPWM2_PWMB3 {
		pinmux = <0x401f80d8 4 0x401f8364 0 0x401f824c>;
	};
	/omit-if-no-ref/ iomuxc_gpio_ad_b0_07_gpio1_io07: IOMUXC_GPIO_AD_B0_07_GPIO1_IO07 {
		pinmux = <0x401f80d8 5 0x0 0 0x401f824c>;
	};
	/omit-if-no-ref/ iomuxc_gpio_ad_b0_07_lpuart1_rx: IOMUXC_GPIO_AD_B0_07_LPUART1_RX {
		pinmux = <0x401f80d8 2 0x0 0 0x401f824c>;
	};
	/omit-if-no-ref/ iomuxc_gpio_ad_b0_07_mqs_left: IOMUXC_GPIO_AD_B0_07_MQS_LEFT {
		pinmux = <0x401f80d8 1 0x0 0 0x401f824c>;
	};
	/omit-if-no-ref/ iomuxc_gpio_ad_b0_07_pit_trigger1: IOMUXC_GPIO_AD_B0_07_PIT_TRIGGER1 {
		pinmux = <0x401f80d8 0 0x0 0 0x401f824c>;
	};
	/omit-if-no-ref/ iomuxc_gpio_ad_b0_07_qtimer2_timer3: IOMUXC_GPIO_AD_B0_07_QTIMER2_TIMER3 {
		pinmux = <0x401f80d8 3 0x401f842c 1 0x401f824c>;
		gpr = <0x400ac018 0x7 0x0>;
	};
	/omit-if-no-ref/ iomuxc_gpio_ad_b0_07_ref_24m_out: IOMUXC_GPIO_AD_B0_07_REF_24M_OUT {
		pinmux = <0x401f80d8 6 0x0 0 0x401f824c>;
	};
	/omit-if-no-ref/ iomuxc_gpio_ad_b0_08_acmp1_in4: IOMUXC_GPIO_AD_B0_08_ACMP1_IN4 {
		pinmux = <0x401f80dc 5 0x0 0 0x401f8250>;
	};
	/omit-if-no-ref/ iomuxc_gpio_ad_b0_08_arm_cm7_txev: IOMUXC_GPIO_AD_B0_08_ARM_CM7_TXEV {
		pinmux = <0x401f80dc 6 0x0 0 0x401f8250>;
	};
	/omit-if-no-ref/ iomuxc_gpio_ad_b0_08_enet_ref_clk: IOMUXC_GPIO_AD_B0_08_ENET_REF_CLK {
		pinmux = <0x401f80dc 4 0x401f8304 1 0x401f8250>;
	};
	/omit-if-no-ref/ iomuxc_gpio_ad_b0_08_enet_tx_clk: IOMUXC_GPIO_AD_B0_08_ENET_TX_CLK {
		pinmux = <0x401f80dc 0 0x401f831c 1 0x401f8250>;
	};
	/omit-if-no-ref/ iomuxc_gpio_ad_b0_08_gpio1_io08: IOMUXC_GPIO_AD_B0_08_GPIO1_IO08 {
		pinmux = <0x401f80dc 5 0x0 0 0x401f8250>;
	};
	/omit-if-no-ref/ iomuxc_gpio_ad_b0_08_kpp_col0: IOMUXC_GPIO_AD_B0_08_KPP_COL0 {
		pinmux = <0x401f80dc 3 0x0 0 0x401f8250>;
	};
	/omit-if-no-ref/ iomuxc_gpio_ad_b0_08_lpi2c3_scl: IOMUXC_GPIO_AD_B0_08_LPI2C3_SCL {
		pinmux = <0x401f80dc 1 0x401f838c 1 0x401f8250>;
	};
	/omit-if-no-ref/ iomuxc_gpio_ad_b0_08_lpuart1_cts_b: IOMUXC_GPIO_AD_B0_08_LPUART1_CTS_B {
		pinmux = <0x401f80dc 2 0x0 0 0x401f8250>;
	};
	/omit-if-no-ref/ iomuxc_gpio_ad_b0_09_acmp2_in4: IOMUXC_GPIO_AD_B0_09_ACMP2_IN4 {
		pinmux = <0x401f80e0 5 0x0 0 0x401f8254>;
	};
	/omit-if-no-ref/ iomuxc_gpio_ad_b0_09_arm_cm7_rxev: IOMUXC_GPIO_AD_B0_09_ARM_CM7_RXEV {
		pinmux = <0x401f80e0 6 0x0 0 0x401f8254>;
	};
	/omit-if-no-ref/ iomuxc_gpio_ad_b0_09_enet_rx_data1: IOMUXC_GPIO_AD_B0_09_ENET_RX_DATA1 {
		pinmux = <0x401f80e0 0 0x401f8310 1 0x401f8254>;
	};
	/omit-if-no-ref/ iomuxc_gpio_ad_b0_09_gpio1_io09: IOMUXC_GPIO_AD_B0_09_GPIO1_IO09 {
		pinmux = <0x401f80e0 5 0x0 0 0x401f8254>;
	};
	/omit-if-no-ref/ iomuxc_gpio_ad_b0_09_kpp_row0: IOMUXC_GPIO_AD_B0_09_KPP_ROW0 {
		pinmux = <0x401f80e0 3 0x0 0 0x401f8254>;
	};
	/omit-if-no-ref/ iomuxc_gpio_ad_b0_09_lpi2c3_sda: IOMUXC_GPIO_AD_B0_09_LPI2C3_SDA {
		pinmux = <0x401f80e0 1 0x401f8390 1 0x401f8254>;
	};
	/omit-if-no-ref/ iomuxc_gpio_ad_b0_09_lpuart1_rts_b: IOMUXC_GPIO_AD_B0_09_LPUART1_RTS_B {
		pinmux = <0x401f80e0 2 0x0 0 0x401f8254>;
	};
	/omit-if-no-ref/ iomuxc_gpio_ad_b0_10_acmp3_in4: IOMUXC_GPIO_AD_B0_10_ACMP3_IN4 {
		pinmux = <0x401f80e4 5 0x0 0 0x401f8258>;
	};
	/omit-if-no-ref/ iomuxc_gpio_ad_b0_10_arm_trace_clk: IOMUXC_GPIO_AD_B0_10_ARM_TRACE_CLK {
		pinmux = <0x401f80e4 6 0x0 0 0x401f8258>;
	};
	/omit-if-no-ref/ iomuxc_gpio_ad_b0_10_enet_rx_data0: IOMUXC_GPIO_AD_B0_10_ENET_RX_DATA0 {
		pinmux = <0x401f80e4 0 0x401f830c 1 0x401f8258>;
	};
	/omit-if-no-ref/ iomuxc_gpio_ad_b0_10_flexpwm2_pwma2: IOMUXC_GPIO_AD_B0_10_FLEXPWM2_PWMA2 {
		pinmux = <0x401f80e4 4 0x401f8350 0 0x401f8258>;
	};
	/omit-if-no-ref/ iomuxc_gpio_ad_b0_10_gpio1_io10: IOMUXC_GPIO_AD_B0_10_GPIO1_IO10 {
		pinmux = <0x401f80e4 5 0x0 0 0x401f8258>;
	};
	/omit-if-no-ref/ iomuxc_gpio_ad_b0_10_kpp_col1: IOMUXC_GPIO_AD_B0_10_KPP_COL1 {
		pinmux = <0x401f80e4 3 0x0 0 0x401f8258>;
	};
	/omit-if-no-ref/ iomuxc_gpio_ad_b0_10_lpspi1_sck: IOMUXC_GPIO_AD_B0_10_LPSPI1_SCK {
		pinmux = <0x401f80e4 1 0x401f83a0 1 0x401f8258>;
	};
	/omit-if-no-ref/ iomuxc_gpio_ad_b0_10_lpuart5_tx: IOMUXC_GPIO_AD_B0_10_LPUART5_TX {
		pinmux = <0x401f80e4 2 0x401f83f0 0 0x401f8258>;
	};
	/omit-if-no-ref/ iomuxc_gpio_ad_b0_11_acmp4_in4: IOMUXC_GPIO_AD_B0_11_ACMP4_IN4 {
		pinmux = <0x401f80e8 5 0x0 0 0x401f825c>;
	};
	/omit-if-no-ref/ iomuxc_gpio_ad_b0_11_arm_trace_swo: IOMUXC_GPIO_AD_B0_11_ARM_TRACE_SWO {
		pinmux = <0x401f80e8 6 0x0 0 0x401f825c>;
	};
	/omit-if-no-ref/ iomuxc_gpio_ad_b0_11_enet_rx_en: IOMUXC_GPIO_AD_B0_11_ENET_RX_EN {
		pinmux = <0x401f80e8 0 0x401f8314 1 0x401f825c>;
	};
	/omit-if-no-ref/ iomuxc_gpio_ad_b0_11_flexpwm2_pwmb2: IOMUXC_GPIO_AD_B0_11_FLEXPWM2_PWMB2 {
		pinmux = <0x401f80e8 4 0x401f8360 0 0x401f825c>;
	};
	/omit-if-no-ref/ iomuxc_gpio_ad_b0_11_gpio1_io11: IOMUXC_GPIO_AD_B0_11_GPIO1_IO11 {
		pinmux = <0x401f80e8 5 0x0 0 0x401f825c>;
	};
	/omit-if-no-ref/ iomuxc_gpio_ad_b0_11_kpp_row1: IOMUXC_GPIO_AD_B0_11_KPP_ROW1 {
		pinmux = <0x401f80e8 3 0x0 0 0x401f825c>;
	};
	/omit-if-no-ref/ iomuxc_gpio_ad_b0_11_lpspi1_pcs0: IOMUXC_GPIO_AD_B0_11_LPSPI1_PCS0 {
		pinmux = <0x401f80e8 1 0x401f839c 1 0x401f825c>;
	};
	/omit-if-no-ref/ iomuxc_gpio_ad_b0_11_lpuart5_rx: IOMUXC_GPIO_AD_B0_11_LPUART5_RX {
		pinmux = <0x401f80e8 2 0x401f83ec 0 0x401f825c>;
	};
	/omit-if-no-ref/ iomuxc_gpio_ad_b0_12_adc1_in0: IOMUXC_GPIO_AD_B0_12_ADC1_IN0 {
		pinmux = <0x401f80ec 5 0x0 0 0x401f8260>;
	};
	/omit-if-no-ref/ iomuxc_gpio_ad_b0_12_arm_trace0: IOMUXC_GPIO_AD_B0_12_ARM_TRACE0 {
		pinmux = <0x401f80ec 6 0x0 0 0x401f8260>;
	};
	/omit-if-no-ref/ iomuxc_gpio_ad_b0_12_enet_rx_er: IOMUXC_GPIO_AD_B0_12_ENET_RX_ER {
		pinmux = <0x401f80ec 0 0x401f8318 1 0x401f8260>;
	};
	/omit-if-no-ref/ iomuxc_gpio_ad_b0_12_flexpwm2_pwma1: IOMUXC_GPIO_AD_B0_12_FLEXPWM2_PWMA1 {
		pinmux = <0x401f80ec 4 0x401f834c 0 0x401f8260>;
	};
	/omit-if-no-ref/ iomuxc_gpio_ad_b0_12_gpio1_io12: IOMUXC_GPIO_AD_B0_12_GPIO1_IO12 {
		pinmux = <0x401f80ec 5 0x0 0 0x401f8260>;
	};
	/omit-if-no-ref/ iomuxc_gpio_ad_b0_12_kpp_col2: IOMUXC_GPIO_AD_B0_12_KPP_COL2 {
		pinmux = <0x401f80ec 3 0x0 0 0x401f8260>;
	};
	/omit-if-no-ref/ iomuxc_gpio_ad_b0_12_lpspi1_sdo: IOMUXC_GPIO_AD_B0_12_LPSPI1_SDO {
		pinmux = <0x401f80ec 1 0x401f83a8 1 0x401f8260>;
	};
	/omit-if-no-ref/ iomuxc_gpio_ad_b0_12_lpuart3_cts_b: IOMUXC_GPIO_AD_B0_12_LPUART3_CTS_B {
		pinmux = <0x401f80ec 2 0x0 0 0x401f8260>;
	};
	/omit-if-no-ref/ iomuxc_gpio_ad_b0_12_snvs_vio_5_ctl: IOMUXC_GPIO_AD_B0_12_SNVS_VIO_5_CTL {
		pinmux = <0x401f80ec 7 0x0 0 0x401f8260>;
	};
	/omit-if-no-ref/ iomuxc_gpio_ad_b0_13_adc2_in0: IOMUXC_GPIO_AD_B0_13_ADC2_IN0 {
		pinmux = <0x401f80f0 5 0x0 0 0x401f8264>;
	};
	/omit-if-no-ref/ iomuxc_gpio_ad_b0_13_arm_trace1: IOMUXC_GPIO_AD_B0_13_ARM_TRACE1 {
		pinmux = <0x401f80f0 6 0x0 0 0x401f8264>;
	};
	/omit-if-no-ref/ iomuxc_gpio_ad_b0_13_enet_tx_en: IOMUXC_GPIO_AD_B0_13_ENET_TX_EN {
		pinmux = <0x401f80f0 0 0x0 0 0x401f8264>;
	};
	/omit-if-no-ref/ iomuxc_gpio_ad_b0_13_flexpwm2_pwmb1: IOMUXC_GPIO_AD_B0_13_FLEXPWM2_PWMB1 {
		pinmux = <0x401f80f0 4 0x401f835c 0 0x401f8264>;
	};
	/omit-if-no-ref/ iomuxc_gpio_ad_b0_13_gpio1_io13: IOMUXC_GPIO_AD_B0_13_GPIO1_IO13 {
		pinmux = <0x401f80f0 5 0x0 0 0x401f8264>;
	};
	/omit-if-no-ref/ iomuxc_gpio_ad_b0_13_kpp_row2: IOMUXC_GPIO_AD_B0_13_KPP_ROW2 {
		pinmux = <0x401f80f0 3 0x0 0 0x401f8264>;
	};
	/omit-if-no-ref/ iomuxc_gpio_ad_b0_13_lpspi1_sdi: IOMUXC_GPIO_AD_B0_13_LPSPI1_SDI {
		pinmux = <0x401f80f0 1 0x401f83a4 1 0x401f8264>;
	};
	/omit-if-no-ref/ iomuxc_gpio_ad_b0_13_lpuart3_rts_b: IOMUXC_GPIO_AD_B0_13_LPUART3_RTS_B {
		pinmux = <0x401f80f0 2 0x0 0 0x401f8264>;
	};
	/omit-if-no-ref/ iomuxc_gpio_ad_b0_13_snvs_vio_5_b: IOMUXC_GPIO_AD_B0_13_SNVS_VIO_5_B {
		pinmux = <0x401f80f0 7 0x0 0 0x401f8264>;
	};
	/omit-if-no-ref/ iomuxc_gpio_ad_b0_14_acmp1_in0: IOMUXC_GPIO_AD_B0_14_ACMP1_IN0 {
		pinmux = <0x401f80f4 5 0x0 0 0x401f8268>;
	};
	/omit-if-no-ref/ iomuxc_gpio_ad_b0_14_acmp2_in0: IOMUXC_GPIO_AD_B0_14_ACMP2_IN0 {
		pinmux = <0x401f80f4 5 0x0 0 0x401f8268>;
	};
	/omit-if-no-ref/ iomuxc_gpio_ad_b0_14_acmp3_in0: IOMUXC_GPIO_AD_B0_14_ACMP3_IN0 {
		pinmux = <0x401f80f4 5 0x0 0 0x401f8268>;
	};
	/omit-if-no-ref/ iomuxc_gpio_ad_b0_14_acmp4_in0: IOMUXC_GPIO_AD_B0_14_ACMP4_IN0 {
		pinmux = <0x401f80f4 5 0x0 0 0x401f8268>;
	};
	/omit-if-no-ref/ iomuxc_gpio_ad_b0_14_adc1_in1: IOMUXC_GPIO_AD_B0_14_ADC1_IN1 {
		pinmux = <0x401f80f4 5 0x0 0 0x401f8268>;
	};
	/omit-if-no-ref/ iomuxc_gpio_ad_b0_14_adc2_in1: IOMUXC_GPIO_AD_B0_14_ADC2_IN1 {
		pinmux = <0x401f80f4 5 0x0 0 0x401f8268>;
	};
	/omit-if-no-ref/ iomuxc_gpio_ad_b0_14_arm_trace2: IOMUXC_GPIO_AD_B0_14_ARM_TRACE2 {
		pinmux = <0x401f80f4 6 0x0 0 0x401f8268>;
	};
	/omit-if-no-ref/ iomuxc_gpio_ad_b0_14_enet_tx_data0: IOMUXC_GPIO_AD_B0_14_ENET_TX_DATA0 {
		pinmux = <0x401f80f4 0 0x0 0 0x401f8268>;
	};
	/omit-if-no-ref/ iomuxc_gpio_ad_b0_14_flexcan2_tx: IOMUXC_GPIO_AD_B0_14_FLEXCAN2_TX {
		pinmux = <0x401f80f4 1 0x0 0 0x401f8268>;
	};
	/omit-if-no-ref/ iomuxc_gpio_ad_b0_14_flexpwm2_pwma0: IOMUXC_GPIO_AD_B0_14_FLEXPWM2_PWMA0 {
		pinmux = <0x401f80f4 4 0x401f8348 0 0x401f8268>;
	};
	/omit-if-no-ref/ iomuxc_gpio_ad_b0_14_gpio1_io14: IOMUXC_GPIO_AD_B0_14_GPIO1_IO14 {
		pinmux = <0x401f80f4 5 0x0 0 0x401f8268>;
	};
	/omit-if-no-ref/ iomuxc_gpio_ad_b0_14_kpp_col3: IOMUXC_GPIO_AD_B0_14_KPP_COL3 {
		pinmux = <0x401f80f4 3 0x0 0 0x401f8268>;
	};
	/omit-if-no-ref/ iomuxc_gpio_ad_b0_14_lpuart3_tx: IOMUXC_GPIO_AD_B0_14_LPUART3_TX {
		pinmux = <0x401f80f4 2 0x401f83dc 1 0x401f8268>;
	};
	/omit-if-no-ref/ iomuxc_gpio_ad_b0_14_wdog1_any: IOMUXC_GPIO_AD_B0_14_WDOG1_ANY {
		pinmux = <0x401f80f4 7 0x0 0 0x401f8268>;
	};
	/omit-if-no-ref/ iomuxc_gpio_ad_b0_15_acmp1_in1: IOMUXC_GPIO_AD_B0_15_ACMP1_IN1 {
		pinmux = <0x401f80f8 5 0x0 0 0x401f826c>;
	};
	/omit-if-no-ref/ iomuxc_gpio_ad_b0_15_acmp2_in1: IOMUXC_GPIO_AD_B0_15_ACMP2_IN1 {
		pinmux = <0x401f80f8 5 0x0 0 0x401f826c>;
	};
	/omit-if-no-ref/ iomuxc_gpio_ad_b0_15_acmp3_in1: IOMUXC_GPIO_AD_B0_15_ACMP3_IN1 {
		pinmux = <0x401f80f8 5 0x0 0 0x401f826c>;
	};
	/omit-if-no-ref/ iomuxc_gpio_ad_b0_15_acmp4_in1: IOMUXC_GPIO_AD_B0_15_ACMP4_IN1 {
		pinmux = <0x401f80f8 5 0x0 0 0x401f826c>;
	};
	/omit-if-no-ref/ iomuxc_gpio_ad_b0_15_adc1_in2: IOMUXC_GPIO_AD_B0_15_ADC1_IN2 {
		pinmux = <0x401f80f8 5 0x0 0 0x401f826c>;
	};
	/omit-if-no-ref/ iomuxc_gpio_ad_b0_15_adc2_in2: IOMUXC_GPIO_AD_B0_15_ADC2_IN2 {
		pinmux = <0x401f80f8 5 0x0 0 0x401f826c>;
	};
	/omit-if-no-ref/ iomuxc_gpio_ad_b0_15_arm_trace3: IOMUXC_GPIO_AD_B0_15_ARM_TRACE3 {
		pinmux = <0x401f80f8 6 0x0 0 0x401f826c>;
	};
	/omit-if-no-ref/ iomuxc_gpio_ad_b0_15_enet_tx_data1: IOMUXC_GPIO_AD_B0_15_ENET_TX_DATA1 {
		pinmux = <0x401f80f8 0 0x0 0 0x401f826c>;
	};
	/omit-if-no-ref/ iomuxc_gpio_ad_b0_15_flexcan2_rx: IOMUXC_GPIO_AD_B0_15_FLEXCAN2_RX {
		pinmux = <0x401f80f8 1 0x401f8324 2 0x401f826c>;
	};
	/omit-if-no-ref/ iomuxc_gpio_ad_b0_15_flexpwm2_pwmb0: IOMUXC_GPIO_AD_B0_15_FLEXPWM2_PWMB0 {
		pinmux = <0x401f80f8 4 0x401f8358 0 0x401f826c>;
	};
	/omit-if-no-ref/ iomuxc_gpio_ad_b0_15_gpio1_io15: IOMUXC_GPIO_AD_B0_15_GPIO1_IO15 {
		pinmux = <0x401f80f8 5 0x0 0 0x401f826c>;
	};
	/omit-if-no-ref/ iomuxc_gpio_ad_b0_15_kpp_row3: IOMUXC_GPIO_AD_B0_15_KPP_ROW3 {
		pinmux = <0x401f80f8 3 0x0 0 0x401f826c>;
	};
	/omit-if-no-ref/ iomuxc_gpio_ad_b0_15_lpuart3_rx: IOMUXC_GPIO_AD_B0_15_LPUART3_RX {
		pinmux = <0x401f80f8 2 0x401f83d8 1 0x401f826c>;
	};
	/omit-if-no-ref/ iomuxc_gpio_ad_b1_06_acmp3_in3: IOMUXC_GPIO_AD_B1_06_ACMP3_IN3 {
		pinmux = <0x401f8114 5 0x0 0 0x401f8288>;
	};
	/omit-if-no-ref/ iomuxc_gpio_ad_b1_06_adc1_in6: IOMUXC_GPIO_AD_B1_06_ADC1_IN6 {
		pinmux = <0x401f8114 5 0x0 0 0x401f8288>;
	};
	/omit-if-no-ref/ iomuxc_gpio_ad_b1_06_adc2_in6: IOMUXC_GPIO_AD_B1_06_ADC2_IN6 {
		pinmux = <0x401f8114 5 0x0 0 0x401f8288>;
	};
	/omit-if-no-ref/ iomuxc_gpio_ad_b1_06_flexio1_flexio09: IOMUXC_GPIO_AD_B1_06_FLEXIO1_FLEXIO09 {
		pinmux = <0x401f8114 4 0x0 0 0x401f8288>;
	};
	/omit-if-no-ref/ iomuxc_gpio_ad_b1_06_flexpwm1_pwma0: IOMUXC_GPIO_AD_B1_06_FLEXPWM1_PWMA0 {
		pinmux = <0x401f8114 1 0x401f8328 0 0x401f8288>;
	};
	/omit-if-no-ref/ iomuxc_gpio_ad_b1_06_gpio1_io22: IOMUXC_GPIO_AD_B1_06_GPIO1_IO22 {
		pinmux = <0x401f8114 5 0x0 0 0x401f8288>;
	};
	/omit-if-no-ref/ iomuxc_gpio_ad_b1_06_kpp_col7: IOMUXC_GPIO_AD_B1_06_KPP_COL7 {
		pinmux = <0x401f8114 7 0x0 0 0x401f8288>;
	};
	/omit-if-no-ref/ iomuxc_gpio_ad_b1_06_lpspi1_pcs3: IOMUXC_GPIO_AD_B1_06_LPSPI1_PCS3 {
		pinmux = <0x401f8114 6 0x0 0 0x401f8288>;
	};
	/omit-if-no-ref/ iomuxc_gpio_ad_b1_06_lpuart2_cts_b: IOMUXC_GPIO_AD_B1_06_LPUART2_CTS_B {
		pinmux = <0x401f8114 2 0x401f83cc 0 0x401f8288>;
	};
	/omit-if-no-ref/ iomuxc_gpio_ad_b1_06_sai1_rx_bclk: IOMUXC_GPIO_AD_B1_06_SAI1_RX_BCLK {
		pinmux = <0x401f8114 3 0x401f8434 0 0x401f8288>;
	};
	/omit-if-no-ref/ iomuxc_gpio_ad_b1_06_usdhc1_reset_b: IOMUXC_GPIO_AD_B1_06_USDHC1_RESET_B {
		pinmux = <0x401f8114 0 0x0 0 0x401f8288>;
	};
	/omit-if-no-ref/ iomuxc_gpio_ad_b1_07_acmp4_in3: IOMUXC_GPIO_AD_B1_07_ACMP4_IN3 {
		pinmux = <0x401f8118 5 0x0 0 0x401f828c>;
	};
	/omit-if-no-ref/ iomuxc_gpio_ad_b1_07_adc1_in7: IOMUXC_GPIO_AD_B1_07_ADC1_IN7 {
		pinmux = <0x401f8118 5 0x0 0 0x401f828c>;
	};
	/omit-if-no-ref/ iomuxc_gpio_ad_b1_07_adc2_in7: IOMUXC_GPIO_AD_B1_07_ADC2_IN7 {
		pinmux = <0x401f8118 5 0x0 0 0x401f828c>;
	};
	/omit-if-no-ref/ iomuxc_gpio_ad_b1_07_flexio1_flexio08: IOMUXC_GPIO_AD_B1_07_FLEXIO1_FLEXIO08 {
		pinmux = <0x401f8118 4 0x0 0 0x401f828c>;
	};
	/omit-if-no-ref/ iomuxc_gpio_ad_b1_07_flexpwm1_pwmb0: IOMUXC_GPIO_AD_B1_07_FLEXPWM1_PWMB0 {
		pinmux = <0x401f8118 1 0x401f8338 0 0x401f828c>;
	};
	/omit-if-no-ref/ iomuxc_gpio_ad_b1_07_gpio1_io23: IOMUXC_GPIO_AD_B1_07_GPIO1_IO23 {
		pinmux = <0x401f8118 5 0x0 0 0x401f828c>;
	};
	/omit-if-no-ref/ iomuxc_gpio_ad_b1_07_kpp_row7: IOMUXC_GPIO_AD_B1_07_KPP_ROW7 {
		pinmux = <0x401f8118 7 0x0 0 0x401f828c>;
	};
	/omit-if-no-ref/ iomuxc_gpio_ad_b1_07_lpspi3_pcs3: IOMUXC_GPIO_AD_B1_07_LPSPI3_PCS3 {
		pinmux = <0x401f8118 6 0x0 0 0x401f828c>;
	};
	/omit-if-no-ref/ iomuxc_gpio_ad_b1_07_lpuart2_rts_b: IOMUXC_GPIO_AD_B1_07_LPUART2_RTS_B {
		pinmux = <0x401f8118 2 0x0 0 0x401f828c>;
	};
	/omit-if-no-ref/ iomuxc_gpio_ad_b1_07_sai1_tx_data1: IOMUXC_GPIO_AD_B1_07_SAI1_TX_DATA1 {
		pinmux = <0x401f8118 3 0x401f8444 0 0x401f828c>;
	};
	/omit-if-no-ref/ iomuxc_gpio_ad_b1_07_usdhc1_vselect: IOMUXC_GPIO_AD_B1_07_USDHC1_VSELECT {
		pinmux = <0x401f8118 0 0x0 0 0x401f828c>;
	};
	/omit-if-no-ref/ iomuxc_gpio_ad_b1_08_acmp1_in5: IOMUXC_GPIO_AD_B1_08_ACMP1_IN5 {
		pinmux = <0x401f811c 5 0x0 0 0x401f8290>;
	};
	/omit-if-no-ref/ iomuxc_gpio_ad_b1_08_adc1_in8: IOMUXC_GPIO_AD_B1_08_ADC1_IN8 {
		pinmux = <0x401f811c 5 0x0 0 0x401f8290>;
	};
	/omit-if-no-ref/ iomuxc_gpio_ad_b1_08_adc2_in8: IOMUXC_GPIO_AD_B1_08_ADC2_IN8 {
		pinmux = <0x401f811c 5 0x0 0 0x401f8290>;
	};
	/omit-if-no-ref/ iomuxc_gpio_ad_b1_08_flexio1_flexio07: IOMUXC_GPIO_AD_B1_08_FLEXIO1_FLEXIO07 {
		pinmux = <0x401f811c 4 0x0 0 0x401f8290>;
	};
	/omit-if-no-ref/ iomuxc_gpio_ad_b1_08_flexpwm1_pwma1: IOMUXC_GPIO_AD_B1_08_FLEXPWM1_PWMA1 {
		pinmux = <0x401f811c 1 0x401f832c 0 0x401f8290>;
	};
	/omit-if-no-ref/ iomuxc_gpio_ad_b1_08_gpio1_io24: IOMUXC_GPIO_AD_B1_08_GPIO1_IO24 {
		pinmux = <0x401f811c 5 0x0 0 0x401f8290>;
	};
	/omit-if-no-ref/ iomuxc_gpio_ad_b1_08_lpi2c2_scl: IOMUXC_GPIO_AD_B1_08_LPI2C2_SCL {
		pinmux = <0x401f811c 0 0x401f8384 0 0x401f8290>;
	};
	/omit-if-no-ref/ iomuxc_gpio_ad_b1_08_lpspi3_pcs2: IOMUXC_GPIO_AD_B1_08_LPSPI3_PCS2 {
		pinmux = <0x401f811c 6 0x0 0 0x401f8290>;
	};
	/omit-if-no-ref/ iomuxc_gpio_ad_b1_08_lpuart2_tx: IOMUXC_GPIO_AD_B1_08_LPUART2_TX {
		pinmux = <0x401f811c 2 0x401f83d4 0 0x401f8290>;
	};
	/omit-if-no-ref/ iomuxc_gpio_ad_b1_08_sai1_tx_data2: IOMUXC_GPIO_AD_B1_08_SAI1_TX_DATA2 {
		pinmux = <0x401f811c 3 0x401f8440 0 0x401f8290>;
	};
	/omit-if-no-ref/ iomuxc_gpio_ad_b1_08_xbar1_xbar_in12: IOMUXC_GPIO_AD_B1_08_XBAR1_XBAR_IN12 {
		pinmux = <0x401f811c 7 0x401f84b4 1 0x401f8290>;
		gpr = <0x400ac018 0x18 0x0>;
	};
	/omit-if-no-ref/ iomuxc_gpio_ad_b1_08_xbar1_xbar_inout12: IOMUXC_GPIO_AD_B1_08_XBAR1_XBAR_INOUT12 {
		pinmux = <0x401f811c 7 0x401f84b4 1 0x401f8290>;
		gpr = <0x400ac018 0x18 0x0>;
	};
	/omit-if-no-ref/ iomuxc_gpio_ad_b1_09_acmp2_in5: IOMUXC_GPIO_AD_B1_09_ACMP2_IN5 {
		pinmux = <0x401f8120 5 0x0 0 0x401f8294>;
	};
	/omit-if-no-ref/ iomuxc_gpio_ad_b1_09_adc1_in9: IOMUXC_GPIO_AD_B1_09_ADC1_IN9 {
		pinmux = <0x401f8120 5 0x0 0 0x401f8294>;
	};
	/omit-if-no-ref/ iomuxc_gpio_ad_b1_09_adc2_in9: IOMUXC_GPIO_AD_B1_09_ADC2_IN9 {
		pinmux = <0x401f8120 5 0x0 0 0x401f8294>;
	};
	/omit-if-no-ref/ iomuxc_gpio_ad_b1_09_flexio1_flexio06: IOMUXC_GPIO_AD_B1_09_FLEXIO1_FLEXIO06 {
		pinmux = <0x401f8120 4 0x0 0 0x401f8294>;
	};
	/omit-if-no-ref/ iomuxc_gpio_ad_b1_09_flexpwm1_pwmb1: IOMUXC_GPIO_AD_B1_09_FLEXPWM1_PWMB1 {
		pinmux = <0x401f8120 1 0x401f833c 0 0x401f8294>;
	};
	/omit-if-no-ref/ iomuxc_gpio_ad_b1_09_gpio1_io25: IOMUXC_GPIO_AD_B1_09_GPIO1_IO25 {
		pinmux = <0x401f8120 5 0x0 0 0x401f8294>;
	};
	/omit-if-no-ref/ iomuxc_gpio_ad_b1_09_lpi2c2_sda: IOMUXC_GPIO_AD_B1_09_LPI2C2_SDA {
		pinmux = <0x401f8120 0 0x401f8388 0 0x401f8294>;
	};
	/omit-if-no-ref/ iomuxc_gpio_ad_b1_09_lpspi3_pcs1: IOMUXC_GPIO_AD_B1_09_LPSPI3_PCS1 {
		pinmux = <0x401f8120 6 0x0 0 0x401f8294>;
	};
	/omit-if-no-ref/ iomuxc_gpio_ad_b1_09_lpuart2_rx: IOMUXC_GPIO_AD_B1_09_LPUART2_RX {
		pinmux = <0x401f8120 2 0x401f83d0 0 0x401f8294>;
	};
	/omit-if-no-ref/ iomuxc_gpio_ad_b1_09_sai1_tx_data3: IOMUXC_GPIO_AD_B1_09_SAI1_TX_DATA3 {
		pinmux = <0x401f8120 3 0x401f843c 0 0x401f8294>;
	};
	/omit-if-no-ref/ iomuxc_gpio_ad_b1_09_xbar1_xbar_in13: IOMUXC_GPIO_AD_B1_09_XBAR1_XBAR_IN13 {
		pinmux = <0x401f8120 7 0x401f84b8 1 0x401f8294>;
		gpr = <0x400ac018 0x19 0x0>;
	};
	/omit-if-no-ref/ iomuxc_gpio_ad_b1_09_xbar1_xbar_inout13: IOMUXC_GPIO_AD_B1_09_XBAR1_XBAR_INOUT13 {
		pinmux = <0x401f8120 7 0x401f84b8 1 0x401f8294>;
		gpr = <0x400ac018 0x19 0x0>;
	};
	/omit-if-no-ref/ iomuxc_gpio_ad_b1_10_acmp3_in5: IOMUXC_GPIO_AD_B1_10_ACMP3_IN5 {
		pinmux = <0x401f8124 5 0x0 0 0x401f8298>;
	};
	/omit-if-no-ref/ iomuxc_gpio_ad_b1_10_adc1_in10: IOMUXC_GPIO_AD_B1_10_ADC1_IN10 {
		pinmux = <0x401f8124 5 0x0 0 0x401f8298>;
	};
	/omit-if-no-ref/ iomuxc_gpio_ad_b1_10_adc2_in10: IOMUXC_GPIO_AD_B1_10_ADC2_IN10 {
		pinmux = <0x401f8124 5 0x0 0 0x401f8298>;
	};
	/omit-if-no-ref/ iomuxc_gpio_ad_b1_10_flexio1_flexio05: IOMUXC_GPIO_AD_B1_10_FLEXIO1_FLEXIO05 {
		pinmux = <0x401f8124 4 0x0 0 0x401f8298>;
	};
	/omit-if-no-ref/ iomuxc_gpio_ad_b1_10_flexpwm1_pwma2: IOMUXC_GPIO_AD_B1_10_FLEXPWM1_PWMA2 {
		pinmux = <0x401f8124 1 0x401f8330 0 0x401f8298>;
	};
	/omit-if-no-ref/ iomuxc_gpio_ad_b1_10_gpio1_io26: IOMUXC_GPIO_AD_B1_10_GPIO1_IO26 {
		pinmux = <0x401f8124 5 0x0 0 0x401f8298>;
	};
	/omit-if-no-ref/ iomuxc_gpio_ad_b1_10_gpt2_capture1: IOMUXC_GPIO_AD_B1_10_GPT2_CAPTURE1 {
		pinmux = <0x401f8124 6 0x0 0 0x401f8298>;
	};
	/omit-if-no-ref/ iomuxc_gpio_ad_b1_10_lpuart4_tx: IOMUXC_GPIO_AD_B1_10_LPUART4_TX {
		pinmux = <0x401f8124 2 0x401f83e8 1 0x401f8298>;
	};
	/omit-if-no-ref/ iomuxc_gpio_ad_b1_10_usb_otg1_pwr: IOMUXC_GPIO_AD_B1_10_USB_OTG1_PWR {
		pinmux = <0x401f8124 0 0x0 0 0x401f8298>;
	};
	/omit-if-no-ref/ iomuxc_gpio_ad_b1_10_usdhc1_cd_b: IOMUXC_GPIO_AD_B1_10_USDHC1_CD_B {
		pinmux = <0x401f8124 3 0x401f8490 2 0x401f8298>;
	};
	/omit-if-no-ref/ iomuxc_gpio_ad_b1_11_acmp4_in5: IOMUXC_GPIO_AD_B1_11_ACMP4_IN5 {
		pinmux = <0x401f8128 5 0x0 0 0x401f829c>;
	};
	/omit-if-no-ref/ iomuxc_gpio_ad_b1_11_adc1_in11: IOMUXC_GPIO_AD_B1_11_ADC1_IN11 {
		pinmux = <0x401f8128 5 0x0 0 0x401f829c>;
	};
	/omit-if-no-ref/ iomuxc_gpio_ad_b1_11_adc2_in11: IOMUXC_GPIO_AD_B1_11_ADC2_IN11 {
		pinmux = <0x401f8128 5 0x0 0 0x401f829c>;
	};
	/omit-if-no-ref/ iomuxc_gpio_ad_b1_11_flexio1_flexio04: IOMUXC_GPIO_AD_B1_11_FLEXIO1_FLEXIO04 {
		pinmux = <0x401f8128 4 0x0 0 0x401f829c>;
	};
	/omit-if-no-ref/ iomuxc_gpio_ad_b1_11_flexpwm1_pwmb2: IOMUXC_GPIO_AD_B1_11_FLEXPWM1_PWMB2 {
		pinmux = <0x401f8128 1 0x401f8340 0 0x401f829c>;
	};
	/omit-if-no-ref/ iomuxc_gpio_ad_b1_11_gpio1_io27: IOMUXC_GPIO_AD_B1_11_GPIO1_IO27 {
		pinmux = <0x401f8128 5 0x0 0 0x401f829c>;
	};
	/omit-if-no-ref/ iomuxc_gpio_ad_b1_11_gpt2_compare1: IOMUXC_GPIO_AD_B1_11_GPT2_COMPARE1 {
		pinmux = <0x401f8128 6 0x0 0 0x401f829c>;
	};
	/omit-if-no-ref/ iomuxc_gpio_ad_b1_11_lpuart4_rx: IOMUXC_GPIO_AD_B1_11_LPUART4_RX {
		pinmux = <0x401f8128 2 0x401f83e4 1 0x401f829c>;
	};
	/omit-if-no-ref/ iomuxc_gpio_ad_b1_11_usb_otg1_id: IOMUXC_GPIO_AD_B1_11_USB_OTG1_ID {
		pinmux = <0x401f8128 0 0x401f82fc 1 0x401f829c>;
	};
	/omit-if-no-ref/ iomuxc_gpio_ad_b1_11_usdhc1_wp: IOMUXC_GPIO_AD_B1_11_USDHC1_WP {
		pinmux = <0x401f8128 3 0x401f8494 3 0x401f829c>;
	};
	/omit-if-no-ref/ iomuxc_gpio_ad_b1_12_acmp1_in6: IOMUXC_GPIO_AD_B1_12_ACMP1_IN6 {
		pinmux = <0x401f812c 5 0x0 0 0x401f82a0>;
	};
	/omit-if-no-ref/ iomuxc_gpio_ad_b1_12_acmp1_out: IOMUXC_GPIO_AD_B1_12_ACMP1_OUT {
		pinmux = <0x401f812c 1 0x0 0 0x401f82a0>;
	};
	/omit-if-no-ref/ iomuxc_gpio_ad_b1_12_adc1_in12: IOMUXC_GPIO_AD_B1_12_ADC1_IN12 {
		pinmux = <0x401f812c 5 0x0 0 0x401f82a0>;
	};
	/omit-if-no-ref/ iomuxc_gpio_ad_b1_12_adc2_in12: IOMUXC_GPIO_AD_B1_12_ADC2_IN12 {
		pinmux = <0x401f812c 5 0x0 0 0x401f82a0>;
	};
	/omit-if-no-ref/ iomuxc_gpio_ad_b1_12_flexio1_flexio03: IOMUXC_GPIO_AD_B1_12_FLEXIO1_FLEXIO03 {
		pinmux = <0x401f812c 4 0x0 0 0x401f82a0>;
	};
	/omit-if-no-ref/ iomuxc_gpio_ad_b1_12_flexpwm1_pwma3: IOMUXC_GPIO_AD_B1_12_FLEXPWM1_PWMA3 {
		pinmux = <0x401f812c 6 0x401f8334 0 0x401f82a0>;
	};
	/omit-if-no-ref/ iomuxc_gpio_ad_b1_12_gpio1_io28: IOMUXC_GPIO_AD_B1_12_GPIO1_IO28 {
		pinmux = <0x401f812c 5 0x0 0 0x401f82a0>;
	};
	/omit-if-no-ref/ iomuxc_gpio_ad_b1_12_lpspi3_sck: IOMUXC_GPIO_AD_B1_12_LPSPI3_SCK {
		pinmux = <0x401f812c 2 0x0 0 0x401f82a0>;
	};
	/omit-if-no-ref/ iomuxc_gpio_ad_b1_12_usb_otg1_oc: IOMUXC_GPIO_AD_B1_12_USB_OTG1_OC {
		pinmux = <0x401f812c 0 0x401f848c 1 0x401f82a0>;
	};
	/omit-if-no-ref/ iomuxc_gpio_ad_b1_12_usdhc2_cd_b: IOMUXC_GPIO_AD_B1_12_USDHC2_CD_B {
		pinmux = <0x401f812c 3 0x401f8498 2 0x401f82a0>;
	};
	/omit-if-no-ref/ iomuxc_gpio_ad_b1_13_acmp2_in6: IOMUXC_GPIO_AD_B1_13_ACMP2_IN6 {
		pinmux = <0x401f8130 5 0x0 0 0x401f82a4>;
	};
	/omit-if-no-ref/ iomuxc_gpio_ad_b1_13_acmp2_out: IOMUXC_GPIO_AD_B1_13_ACMP2_OUT {
		pinmux = <0x401f8130 1 0x0 0 0x401f82a4>;
	};
	/omit-if-no-ref/ iomuxc_gpio_ad_b1_13_adc1_in13: IOMUXC_GPIO_AD_B1_13_ADC1_IN13 {
		pinmux = <0x401f8130 5 0x0 0 0x401f82a4>;
	};
	/omit-if-no-ref/ iomuxc_gpio_ad_b1_13_adc2_in13: IOMUXC_GPIO_AD_B1_13_ADC2_IN13 {
		pinmux = <0x401f8130 5 0x0 0 0x401f82a4>;
	};
	/omit-if-no-ref/ iomuxc_gpio_ad_b1_13_flexio1_flexio02: IOMUXC_GPIO_AD_B1_13_FLEXIO1_FLEXIO02 {
		pinmux = <0x401f8130 4 0x0 0 0x401f82a4>;
	};
	/omit-if-no-ref/ iomuxc_gpio_ad_b1_13_flexpwm1_pwmb3: IOMUXC_GPIO_AD_B1_13_FLEXPWM1_PWMB3 {
		pinmux = <0x401f8130 6 0x401f8344 0 0x401f82a4>;
	};
	/omit-if-no-ref/ iomuxc_gpio_ad_b1_13_gpio1_io29: IOMUXC_GPIO_AD_B1_13_GPIO1_IO29 {
		pinmux = <0x401f8130 5 0x0 0 0x401f82a4>;
	};
	/omit-if-no-ref/ iomuxc_gpio_ad_b1_13_lpi2c1_hreq: IOMUXC_GPIO_AD_B1_13_LPI2C1_HREQ {
		pinmux = <0x401f8130 0 0x0 0 0x401f82a4>;
	};
	/omit-if-no-ref/ iomuxc_gpio_ad_b1_13_lpspi3_pcs0: IOMUXC_GPIO_AD_B1_13_LPSPI3_PCS0 {
		pinmux = <0x401f8130 2 0x0 0 0x401f82a4>;
	};
	/omit-if-no-ref/ iomuxc_gpio_ad_b1_13_usdhc2_wp: IOMUXC_GPIO_AD_B1_13_USDHC2_WP {
		pinmux = <0x401f8130 3 0x401f849c 0 0x401f82a4>;
	};
	/omit-if-no-ref/ iomuxc_gpio_ad_b1_14_acmp3_in6: IOMUXC_GPIO_AD_B1_14_ACMP3_IN6 {
		pinmux = <0x401f8134 5 0x0 0 0x401f82a8>;
	};
	/omit-if-no-ref/ iomuxc_gpio_ad_b1_14_acmp3_out: IOMUXC_GPIO_AD_B1_14_ACMP3_OUT {
		pinmux = <0x401f8134 1 0x0 0 0x401f82a8>;
	};
	/omit-if-no-ref/ iomuxc_gpio_ad_b1_14_adc1_in14: IOMUXC_GPIO_AD_B1_14_ADC1_IN14 {
		pinmux = <0x401f8134 5 0x0 0 0x401f82a8>;
	};
	/omit-if-no-ref/ iomuxc_gpio_ad_b1_14_adc2_in14: IOMUXC_GPIO_AD_B1_14_ADC2_IN14 {
		pinmux = <0x401f8134 5 0x0 0 0x401f82a8>;
	};
	/omit-if-no-ref/ iomuxc_gpio_ad_b1_14_enet_1588_event0_out: IOMUXC_GPIO_AD_B1_14_ENET_1588_EVENT0_OUT {
		pinmux = <0x401f8134 3 0x0 0 0x401f82a8>;
	};
	/omit-if-no-ref/ iomuxc_gpio_ad_b1_14_flexio1_flexio01: IOMUXC_GPIO_AD_B1_14_FLEXIO1_FLEXIO01 {
		pinmux = <0x401f8134 4 0x0 0 0x401f82a8>;
	};
	/omit-if-no-ref/ iomuxc_gpio_ad_b1_14_gpio1_io30: IOMUXC_GPIO_AD_B1_14_GPIO1_IO30 {
		pinmux = <0x401f8134 5 0x0 0 0x401f82a8>;
	};
	/omit-if-no-ref/ iomuxc_gpio_ad_b1_14_lpi2c1_scl: IOMUXC_GPIO_AD_B1_14_LPI2C1_SCL {
		pinmux = <0x401f8134 0 0x401f837c 1 0x401f82a8>;
	};
	/omit-if-no-ref/ iomuxc_gpio_ad_b1_14_lpspi3_sdo: IOMUXC_GPIO_AD_B1_14_LPSPI3_SDO {
		pinmux = <0x401f8134 2 0x0 0 0x401f82a8>;
	};
	/omit-if-no-ref/ iomuxc_gpio_ad_b1_15_acmp4_in6: IOMUXC_GPIO_AD_B1_15_ACMP4_IN6 {
		pinmux = <0x401f8138 5 0x0 0 0x401f82ac>;
	};
	/omit-if-no-ref/ iomuxc_gpio_ad_b1_15_acmp4_out: IOMUXC_GPIO_AD_B1_15_ACMP4_OUT {
		pinmux = <0x401f8138 1 0x0 0 0x401f82ac>;
	};
	/omit-if-no-ref/ iomuxc_gpio_ad_b1_15_adc1_in15: IOMUXC_GPIO_AD_B1_15_ADC1_IN15 {
		pinmux = <0x401f8138 5 0x0 0 0x401f82ac>;
	};
	/omit-if-no-ref/ iomuxc_gpio_ad_b1_15_adc2_in15: IOMUXC_GPIO_AD_B1_15_ADC2_IN15 {
		pinmux = <0x401f8138 5 0x0 0 0x401f82ac>;
	};
	/omit-if-no-ref/ iomuxc_gpio_ad_b1_15_enet_1588_event0_in: IOMUXC_GPIO_AD_B1_15_ENET_1588_EVENT0_IN {
		pinmux = <0x401f8138 3 0x0 0 0x401f82ac>;
	};
	/omit-if-no-ref/ iomuxc_gpio_ad_b1_15_flexio1_flexio00: IOMUXC_GPIO_AD_B1_15_FLEXIO1_FLEXIO00 {
		pinmux = <0x401f8138 4 0x0 0 0x401f82ac>;
	};
	/omit-if-no-ref/ iomuxc_gpio_ad_b1_15_gpio1_io31: IOMUXC_GPIO_AD_B1_15_GPIO1_IO31 {
		pinmux = <0x401f8138 5 0x0 0 0x401f82ac>;
	};
	/omit-if-no-ref/ iomuxc_gpio_ad_b1_15_lpi2c1_sda: IOMUXC_GPIO_AD_B1_15_LPI2C1_SDA {
		pinmux = <0x401f8138 0 0x401f8380 1 0x401f82ac>;
	};
	/omit-if-no-ref/ iomuxc_gpio_ad_b1_15_lpspi3_sdi: IOMUXC_GPIO_AD_B1_15_LPSPI3_SDI {
		pinmux = <0x401f8138 2 0x0 0 0x401f82ac>;
	};
	/omit-if-no-ref/ iomuxc_gpio_emc_00_flexcan1_tx: IOMUXC_GPIO_EMC_00_FLEXCAN1_TX {
		pinmux = <0x401f8014 6 0x0 0 0x401f8188>;
	};
	/omit-if-no-ref/ iomuxc_gpio_emc_00_gpio2_io00: IOMUXC_GPIO_EMC_00_GPIO2_IO00 {
		pinmux = <0x401f8014 5 0x0 0 0x401f8188>;
	};
	/omit-if-no-ref/ iomuxc_gpio_emc_00_lpspi2_sck: IOMUXC_GPIO_EMC_00_LPSPI2_SCK {
		pinmux = <0x401f8014 4 0x401f83b0 0 0x401f8188>;
	};
	/omit-if-no-ref/ iomuxc_gpio_emc_00_lpuart4_cts_b: IOMUXC_GPIO_EMC_00_LPUART4_CTS_B {
		pinmux = <0x401f8014 2 0x401f83e0 0 0x401f8188>;
	};
	/omit-if-no-ref/ iomuxc_gpio_emc_00_pit_trigger2: IOMUXC_GPIO_EMC_00_PIT_TRIGGER2 {
		pinmux = <0x401f8014 7 0x0 0 0x401f8188>;
	};
	/omit-if-no-ref/ iomuxc_gpio_emc_00_qtimer2_timer0: IOMUXC_GPIO_EMC_00_QTIMER2_TIMER0 {
		pinmux = <0x401f8014 1 0x401f8420 0 0x401f8188>;
		gpr = <0x400ac018 0x4 0x0>;
	};
	/omit-if-no-ref/ iomuxc_gpio_emc_00_semc_data00: IOMUXC_GPIO_EMC_00_SEMC_DATA00 {
		pinmux = <0x401f8014 0 0x0 0 0x401f8188>;
	};
	/omit-if-no-ref/ iomuxc_gpio_emc_00_spdif_sr_clk: IOMUXC_GPIO_EMC_00_SPDIF_SR_CLK {
		pinmux = <0x401f8014 3 0x0 0 0x401f8188>;
	};
	/omit-if-no-ref/ iomuxc_gpio_emc_01_flexcan1_rx: IOMUXC_GPIO_EMC_01_FLEXCAN1_RX {
		pinmux = <0x401f8018 6 0x401f8320 0 0x401f818c>;
	};
	/omit-if-no-ref/ iomuxc_gpio_emc_01_gpio2_io01: IOMUXC_GPIO_EMC_01_GPIO2_IO01 {
		pinmux = <0x401f8018 5 0x0 0 0x401f818c>;
	};
	/omit-if-no-ref/ iomuxc_gpio_emc_01_lpspi2_pcs0: IOMUXC_GPIO_EMC_01_LPSPI2_PCS0 {
		pinmux = <0x401f8018 4 0x401f83ac 0 0x401f818c>;
	};
	/omit-if-no-ref/ iomuxc_gpio_emc_01_lpuart4_rts_b: IOMUXC_GPIO_EMC_01_LPUART4_RTS_B {
		pinmux = <0x401f8018 2 0x0 0 0x401f818c>;
	};
	/omit-if-no-ref/ iomuxc_gpio_emc_01_pit_trigger3: IOMUXC_GPIO_EMC_01_PIT_TRIGGER3 {
		pinmux = <0x401f8018 7 0x0 0 0x401f818c>;
	};
	/omit-if-no-ref/ iomuxc_gpio_emc_01_qtimer2_timer1: IOMUXC_GPIO_EMC_01_QTIMER2_TIMER1 {
		pinmux = <0x401f8018 1 0x401f8424 0 0x401f818c>;
		gpr = <0x400ac018 0x5 0x0>;
	};
	/omit-if-no-ref/ iomuxc_gpio_emc_01_semc_data01: IOMUXC_GPIO_EMC_01_SEMC_DATA01 {
		pinmux = <0x401f8018 0 0x0 0 0x401f818c>;
	};
	/omit-if-no-ref/ iomuxc_gpio_emc_01_spdif_out: IOMUXC_GPIO_EMC_01_SPDIF_OUT {
		pinmux = <0x401f8018 3 0x0 0 0x401f818c>;
	};
	/omit-if-no-ref/ iomuxc_gpio_emc_02_gpio2_io02: IOMUXC_GPIO_EMC_02_GPIO2_IO02 {
		pinmux = <0x401f801c 5 0x0 0 0x401f8190>;
	};
	/omit-if-no-ref/ iomuxc_gpio_emc_02_lpi2c1_scl: IOMUXC_GPIO_EMC_02_LPI2C1_SCL {
		pinmux = <0x401f801c 6 0x401f837c 0 0x401f8190>;
	};
	/omit-if-no-ref/ iomuxc_gpio_emc_02_lpspi2_sdo: IOMUXC_GPIO_EMC_02_LPSPI2_SDO {
		pinmux = <0x401f801c 4 0x401f83b8 0 0x401f8190>;
	};
	/omit-if-no-ref/ iomuxc_gpio_emc_02_lpuart4_tx: IOMUXC_GPIO_EMC_02_LPUART4_TX {
		pinmux = <0x401f801c 2 0x401f83e8 0 0x401f8190>;
	};
	/omit-if-no-ref/ iomuxc_gpio_emc_02_qtimer2_timer2: IOMUXC_GPIO_EMC_02_QTIMER2_TIMER2 {
		pinmux = <0x401f801c 1 0x401f8428 0 0x401f8190>;
		gpr = <0x400ac018 0x6 0x0>;
	};
	/omit-if-no-ref/ iomuxc_gpio_emc_02_semc_data02: IOMUXC_GPIO_EMC_02_SEMC_DATA02 {
		pinmux = <0x401f801c 0 0x0 0 0x401f8190>;
	};
	/omit-if-no-ref/ iomuxc_gpio_emc_02_spdif_lock: IOMUXC_GPIO_EMC_02_SPDIF_LOCK {
		pinmux = <0x401f801c 3 0x0 0 0x401f8190>;
	};
	/omit-if-no-ref/ iomuxc_gpio_emc_03_gpio2_io03: IOMUXC_GPIO_EMC_03_GPIO2_IO03 {
		pinmux = <0x401f8020 5 0x0 0 0x401f8194>;
	};
	/omit-if-no-ref/ iomuxc_gpio_emc_03_lpi2c1_sda: IOMUXC_GPIO_EMC_03_LPI2C1_SDA {
		pinmux = <0x401f8020 6 0x401f8380 0 0x401f8194>;
	};
	/omit-if-no-ref/ iomuxc_gpio_emc_03_lpspi2_sdi: IOMUXC_GPIO_EMC_03_LPSPI2_SDI {
		pinmux = <0x401f8020 4 0x401f83b4 0 0x401f8194>;
	};
	/omit-if-no-ref/ iomuxc_gpio_emc_03_lpuart4_rx: IOMUXC_GPIO_EMC_03_LPUART4_RX {
		pinmux = <0x401f8020 2 0x401f83e4 0 0x401f8194>;
	};
	/omit-if-no-ref/ iomuxc_gpio_emc_03_qtimer2_timer3: IOMUXC_GPIO_EMC_03_QTIMER2_TIMER3 {
		pinmux = <0x401f8020 1 0x401f842c 0 0x401f8194>;
		gpr = <0x400ac018 0x7 0x0>;
	};
	/omit-if-no-ref/ iomuxc_gpio_emc_03_semc_data03: IOMUXC_GPIO_EMC_03_SEMC_DATA03 {
		pinmux = <0x401f8020 0 0x0 0 0x401f8194>;
	};
	/omit-if-no-ref/ iomuxc_gpio_emc_03_spdif_ext_clk: IOMUXC_GPIO_EMC_03_SPDIF_EXT_CLK {
		pinmux = <0x401f8020 3 0x0 0 0x401f8194>;
	};
	/omit-if-no-ref/ iomuxc_gpio_emc_04_flexio1_flexio16: IOMUXC_GPIO_EMC_04_FLEXIO1_FLEXIO16 {
		pinmux = <0x401f8024 4 0x0 0 0x401f8198>;
	};
	/omit-if-no-ref/ iomuxc_gpio_emc_04_gpio2_io04: IOMUXC_GPIO_EMC_04_GPIO2_IO04 {
		pinmux = <0x401f8024 5 0x0 0 0x401f8198>;
	};
	/omit-if-no-ref/ iomuxc_gpio_emc_04_sai2_tx_bclk: IOMUXC_GPIO_EMC_04_SAI2_TX_BCLK {
		pinmux = <0x401f8024 3 0x401f8464 1 0x401f8198>;
	};
	/omit-if-no-ref/ iomuxc_gpio_emc_04_semc_data04: IOMUXC_GPIO_EMC_04_SEMC_DATA04 {
		pinmux = <0x401f8024 0 0x0 0 0x401f8198>;
	};
	/omit-if-no-ref/ iomuxc_gpio_emc_04_spdif_out: IOMUXC_GPIO_EMC_04_SPDIF_OUT {
		pinmux = <0x401f8024 2 0x0 0 0x401f8198>;
	};
	/omit-if-no-ref/ iomuxc_gpio_emc_04_xbar1_xbar_in04: IOMUXC_GPIO_EMC_04_XBAR1_XBAR_IN04 {
		pinmux = <0x401f8024 1 0x0 0 0x401f8198>;
		gpr = <0x400ac018 0x10 0x0>;
	};
	/omit-if-no-ref/ iomuxc_gpio_emc_04_xbar1_xbar_inout04: IOMUXC_GPIO_EMC_04_XBAR1_XBAR_INOUT04 {
		pinmux = <0x401f8024 1 0x0 0 0x401f8198>;
		gpr = <0x400ac018 0x10 0x0>;
	};
	/omit-if-no-ref/ iomuxc_gpio_emc_05_flexio1_flexio17: IOMUXC_GPIO_EMC_05_FLEXIO1_FLEXIO17 {
		pinmux = <0x401f8028 4 0x0 0 0x401f819c>;
	};
	/omit-if-no-ref/ iomuxc_gpio_emc_05_gpio2_io05: IOMUXC_GPIO_EMC_05_GPIO2_IO05 {
		pinmux = <0x401f8028 5 0x0 0 0x401f819c>;
	};
	/omit-if-no-ref/ iomuxc_gpio_emc_05_sai2_tx_sync: IOMUXC_GPIO_EMC_05_SAI2_TX_SYNC {
		pinmux = <0x401f8028 3 0x401f8468 1 0x401f819c>;
	};
	/omit-if-no-ref/ iomuxc_gpio_emc_05_semc_data05: IOMUXC_GPIO_EMC_05_SEMC_DATA05 {
		pinmux = <0x401f8028 0 0x0 0 0x401f819c>;
	};
	/omit-if-no-ref/ iomuxc_gpio_emc_05_spdif_in: IOMUXC_GPIO_EMC_05_SPDIF_IN {
		pinmux = <0x401f8028 2 0x401f8488 0 0x401f819c>;
	};
	/omit-if-no-ref/ iomuxc_gpio_emc_05_xbar1_xbar_in05: IOMUXC_GPIO_EMC_05_XBAR1_XBAR_IN05 {
		pinmux = <0x401f8028 1 0x0 0 0x401f819c>;
		gpr = <0x400ac018 0x11 0x0>;
	};
	/omit-if-no-ref/ iomuxc_gpio_emc_05_xbar1_xbar_inout05: IOMUXC_GPIO_EMC_05_XBAR1_XBAR_INOUT05 {
		pinmux = <0x401f8028 1 0x0 0 0x401f819c>;
		gpr = <0x400ac018 0x11 0x0>;
	};
	/omit-if-no-ref/ iomuxc_gpio_emc_06_flexio1_flexio18: IOMUXC_GPIO_EMC_06_FLEXIO1_FLEXIO18 {
		pinmux = <0x401f802c 4 0x0 0 0x401f81a0>;
	};
	/omit-if-no-ref/ iomuxc_gpio_emc_06_gpio2_io06: IOMUXC_GPIO_EMC_06_GPIO2_IO06 {
		pinmux = <0x401f802c 5 0x0 0 0x401f81a0>;
	};
	/omit-if-no-ref/ iomuxc_gpio_emc_06_lpuart3_tx: IOMUXC_GPIO_EMC_06_LPUART3_TX {
		pinmux = <0x401f802c 2 0x401f83dc 0 0x401f81a0>;
	};
	/omit-if-no-ref/ iomuxc_gpio_emc_06_sai2_tx_data: IOMUXC_GPIO_EMC_06_SAI2_TX_DATA {
		pinmux = <0x401f802c 3 0x0 0 0x401f81a0>;
	};
	/omit-if-no-ref/ iomuxc_gpio_emc_06_semc_data06: IOMUXC_GPIO_EMC_06_SEMC_DATA06 {
		pinmux = <0x401f802c 0 0x0 0 0x401f81a0>;
	};
	/omit-if-no-ref/ iomuxc_gpio_emc_06_xbar1_xbar_in06: IOMUXC_GPIO_EMC_06_XBAR1_XBAR_IN06 {
		pinmux = <0x401f802c 1 0x0 0 0x401f81a0>;
		gpr = <0x400ac018 0x12 0x0>;
	};
	/omit-if-no-ref/ iomuxc_gpio_emc_06_xbar1_xbar_inout06: IOMUXC_GPIO_EMC_06_XBAR1_XBAR_INOUT06 {
		pinmux = <0x401f802c 1 0x0 0 0x401f81a0>;
		gpr = <0x400ac018 0x12 0x0>;
	};
	/omit-if-no-ref/ iomuxc_gpio_emc_07_flexio1_flexio19: IOMUXC_GPIO_EMC_07_FLEXIO1_FLEXIO19 {
		pinmux = <0x401f8030 4 0x0 0 0x401f81a4>;
	};
	/omit-if-no-ref/ iomuxc_gpio_emc_07_gpio2_io07: IOMUXC_GPIO_EMC_07_GPIO2_IO07 {
		pinmux = <0x401f8030 5 0x0 0 0x401f81a4>;
	};
	/omit-if-no-ref/ iomuxc_gpio_emc_07_lpuart3_rx: IOMUXC_GPIO_EMC_07_LPUART3_RX {
		pinmux = <0x401f8030 2 0x401f83d8 0 0x401f81a4>;
	};
	/omit-if-no-ref/ iomuxc_gpio_emc_07_sai2_rx_sync: IOMUXC_GPIO_EMC_07_SAI2_RX_SYNC {
		pinmux = <0x401f8030 3 0x401f8460 1 0x401f81a4>;
	};
	/omit-if-no-ref/ iomuxc_gpio_emc_07_semc_data07: IOMUXC_GPIO_EMC_07_SEMC_DATA07 {
		pinmux = <0x401f8030 0 0x0 0 0x401f81a4>;
	};
	/omit-if-no-ref/ iomuxc_gpio_emc_07_xbar1_xbar_in07: IOMUXC_GPIO_EMC_07_XBAR1_XBAR_IN07 {
		pinmux = <0x401f8030 1 0x0 0 0x401f81a4>;
		gpr = <0x400ac018 0x13 0x0>;
	};
	/omit-if-no-ref/ iomuxc_gpio_emc_07_xbar1_xbar_inout07: IOMUXC_GPIO_EMC_07_XBAR1_XBAR_INOUT07 {
		pinmux = <0x401f8030 1 0x0 0 0x401f81a4>;
		gpr = <0x400ac018 0x13 0x0>;
	};
	/omit-if-no-ref/ iomuxc_gpio_emc_08_flexcan2_tx: IOMUXC_GPIO_EMC_08_FLEXCAN2_TX {
		pinmux = <0x401f8034 2 0x0 0 0x401f81a8>;
	};
	/omit-if-no-ref/ iomuxc_gpio_emc_08_flexio1_flexio20: IOMUXC_GPIO_EMC_08_FLEXIO1_FLEXIO20 {
		pinmux = <0x401f8034 4 0x0 0 0x401f81a8>;
	};
	/omit-if-no-ref/ iomuxc_gpio_emc_08_gpio2_io08: IOMUXC_GPIO_EMC_08_GPIO2_IO08 {
		pinmux = <0x401f8034 5 0x0 0 0x401f81a8>;
	};
	/omit-if-no-ref/ iomuxc_gpio_emc_08_sai2_rx_data: IOMUXC_GPIO_EMC_08_SAI2_RX_DATA {
		pinmux = <0x401f8034 3 0x401f845c 1 0x401f81a8>;
	};
	/omit-if-no-ref/ iomuxc_gpio_emc_08_semc_dm0: IOMUXC_GPIO_EMC_08_SEMC_DM0 {
		pinmux = <0x401f8034 0 0x0 0 0x401f81a8>;
	};
	/omit-if-no-ref/ iomuxc_gpio_emc_08_xbar1_xbar_in08: IOMUXC_GPIO_EMC_08_XBAR1_XBAR_IN08 {
		pinmux = <0x401f8034 1 0x0 0 0x401f81a8>;
		gpr = <0x400ac018 0x14 0x0>;
	};
	/omit-if-no-ref/ iomuxc_gpio_emc_08_xbar1_xbar_inout08: IOMUXC_GPIO_EMC_08_XBAR1_XBAR_INOUT08 {
		pinmux = <0x401f8034 1 0x0 0 0x401f81a8>;
		gpr = <0x400ac018 0x14 0x0>;
	};
	/omit-if-no-ref/ iomuxc_gpio_emc_09_flexcan2_rx: IOMUXC_GPIO_EMC_09_FLEXCAN2_RX {
		pinmux = <0x401f8038 2 0x401f8324 1 0x401f81ac>;
	};
	/omit-if-no-ref/ iomuxc_gpio_emc_09_flexio1_flexio21: IOMUXC_GPIO_EMC_09_FLEXIO1_FLEXIO21 {
		pinmux = <0x401f8038 4 0x0 0 0x401f81ac>;
	};
	/omit-if-no-ref/ iomuxc_gpio_emc_09_gpio2_io09: IOMUXC_GPIO_EMC_09_GPIO2_IO09 {
		pinmux = <0x401f8038 5 0x0 0 0x401f81ac>;
	};
	/omit-if-no-ref/ iomuxc_gpio_emc_09_sai2_rx_bclk: IOMUXC_GPIO_EMC_09_SAI2_RX_BCLK {
		pinmux = <0x401f8038 3 0x401f8458 1 0x401f81ac>;
	};
	/omit-if-no-ref/ iomuxc_gpio_emc_09_semc_we: IOMUXC_GPIO_EMC_09_SEMC_WE {
		pinmux = <0x401f8038 0 0x0 0 0x401f81ac>;
	};
	/omit-if-no-ref/ iomuxc_gpio_emc_09_xbar1_xbar_in09: IOMUXC_GPIO_EMC_09_XBAR1_XBAR_IN09 {
		pinmux = <0x401f8038 1 0x0 0 0x401f81ac>;
		gpr = <0x400ac018 0x15 0x0>;
	};
	/omit-if-no-ref/ iomuxc_gpio_emc_09_xbar1_xbar_inout09: IOMUXC_GPIO_EMC_09_XBAR1_XBAR_INOUT09 {
		pinmux = <0x401f8038 1 0x0 0 0x401f81ac>;
		gpr = <0x400ac018 0x15 0x0>;
	};
	/omit-if-no-ref/ iomuxc_gpio_emc_10_flexpwm2_pwmx0: IOMUXC_GPIO_EMC_10_FLEXPWM2_PWMX0 {
		pinmux = <0x401f803c 6 0x0 0 0x401f81b0>;
	};
	/omit-if-no-ref/ iomuxc_gpio_emc_10_gpio2_io10: IOMUXC_GPIO_EMC_10_GPIO2_IO10 {
		pinmux = <0x401f803c 5 0x0 0 0x401f81b0>;
	};
	/omit-if-no-ref/ iomuxc_gpio_emc_10_lpi2c4_sda: IOMUXC_GPIO_EMC_10_LPI2C4_SDA {
		pinmux = <0x401f803c 2 0x401f8398 0 0x401f81b0>;
	};
	/omit-if-no-ref/ iomuxc_gpio_emc_10_lpspi2_sck: IOMUXC_GPIO_EMC_10_LPSPI2_SCK {
		pinmux = <0x401f803c 4 0x401f83b0 1 0x401f81b0>;
	};
	/omit-if-no-ref/ iomuxc_gpio_emc_10_sai1_tx_sync: IOMUXC_GPIO_EMC_10_SAI1_TX_SYNC {
		pinmux = <0x401f803c 3 0x401f8450 0 0x401f81b0>;
	};
	/omit-if-no-ref/ iomuxc_gpio_emc_10_semc_cas: IOMUXC_GPIO_EMC_10_SEMC_CAS {
		pinmux = <0x401f803c 0 0x0 0 0x401f81b0>;
	};
	/omit-if-no-ref/ iomuxc_gpio_emc_10_xbar1_xbar_in10: IOMUXC_GPIO_EMC_10_XBAR1_XBAR_IN10 {
		pinmux = <0x401f803c 1 0x401f84b0 0 0x401f81b0>;
		gpr = <0x400ac018 0x16 0x0>;
	};
	/omit-if-no-ref/ iomuxc_gpio_emc_10_xbar1_xbar_inout10: IOMUXC_GPIO_EMC_10_XBAR1_XBAR_INOUT10 {
		pinmux = <0x401f803c 1 0x401f84b0 0 0x401f81b0>;
		gpr = <0x400ac018 0x16 0x0>;
	};
	/omit-if-no-ref/ iomuxc_gpio_emc_11_flexpwm2_pwmx1: IOMUXC_GPIO_EMC_11_FLEXPWM2_PWMX1 {
		pinmux = <0x401f8040 6 0x0 0 0x401f81b4>;
	};
	/omit-if-no-ref/ iomuxc_gpio_emc_11_gpio2_io11: IOMUXC_GPIO_EMC_11_GPIO2_IO11 {
		pinmux = <0x401f8040 5 0x0 0 0x401f81b4>;
	};
	/omit-if-no-ref/ iomuxc_gpio_emc_11_lpi2c4_scl: IOMUXC_GPIO_EMC_11_LPI2C4_SCL {
		pinmux = <0x401f8040 2 0x401f8394 0 0x401f81b4>;
	};
	/omit-if-no-ref/ iomuxc_gpio_emc_11_lpspi2_pcs0: IOMUXC_GPIO_EMC_11_LPSPI2_PCS0 {
		pinmux = <0x401f8040 4 0x401f83ac 1 0x401f81b4>;
	};
	/omit-if-no-ref/ iomuxc_gpio_emc_11_sai1_tx_bclk: IOMUXC_GPIO_EMC_11_SAI1_TX_BCLK {
		pinmux = <0x401f8040 3 0x401f844c 0 0x401f81b4>;
	};
	/omit-if-no-ref/ iomuxc_gpio_emc_11_semc_ras: IOMUXC_GPIO_EMC_11_SEMC_RAS {
		pinmux = <0x401f8040 0 0x0 0 0x401f81b4>;
	};
	/omit-if-no-ref/ iomuxc_gpio_emc_11_xbar1_xbar_in11: IOMUXC_GPIO_EMC_11_XBAR1_XBAR_IN11 {
		pinmux = <0x401f8040 1 0x0 0 0x401f81b4>;
		gpr = <0x400ac018 0x17 0x0>;
	};
	/omit-if-no-ref/ iomuxc_gpio_emc_11_xbar1_xbar_inout11: IOMUXC_GPIO_EMC_11_XBAR1_XBAR_INOUT11 {
		pinmux = <0x401f8040 1 0x0 0 0x401f81b4>;
		gpr = <0x400ac018 0x17 0x0>;
	};
	/omit-if-no-ref/ iomuxc_gpio_emc_12_flexpwm2_pwmx2: IOMUXC_GPIO_EMC_12_FLEXPWM2_PWMX2 {
		pinmux = <0x401f8044 6 0x0 0 0x401f81b8>;
	};
	/omit-if-no-ref/ iomuxc_gpio_emc_12_gpio2_io12: IOMUXC_GPIO_EMC_12_GPIO2_IO12 {
		pinmux = <0x401f8044 5 0x0 0 0x401f81b8>;
	};
	/omit-if-no-ref/ iomuxc_gpio_emc_12_lpspi2_sdo: IOMUXC_GPIO_EMC_12_LPSPI2_SDO {
		pinmux = <0x401f8044 4 0x401f83b8 1 0x401f81b8>;
	};
	/omit-if-no-ref/ iomuxc_gpio_emc_12_lpuart6_tx: IOMUXC_GPIO_EMC_12_LPUART6_TX {
		pinmux = <0x401f8044 2 0x401f83f8 0 0x401f81b8>;
	};
	/omit-if-no-ref/ iomuxc_gpio_emc_12_sai1_tx_data0: IOMUXC_GPIO_EMC_12_SAI1_TX_DATA0 {
		pinmux = <0x401f8044 3 0x0 0 0x401f81b8>;
	};
	/omit-if-no-ref/ iomuxc_gpio_emc_12_semc_cs0: IOMUXC_GPIO_EMC_12_SEMC_CS0 {
		pinmux = <0x401f8044 0 0x0 0 0x401f81b8>;
	};
	/omit-if-no-ref/ iomuxc_gpio_emc_12_xbar1_xbar_in12: IOMUXC_GPIO_EMC_12_XBAR1_XBAR_IN12 {
		pinmux = <0x401f8044 1 0x401f84b4 0 0x401f81b8>;
		gpr = <0x400ac018 0x18 0x0>;
	};
	/omit-if-no-ref/ iomuxc_gpio_emc_12_xbar1_xbar_inout12: IOMUXC_GPIO_EMC_12_XBAR1_XBAR_INOUT12 {
		pinmux = <0x401f8044 1 0x401f84b4 0 0x401f81b8>;
		gpr = <0x400ac018 0x18 0x0>;
	};
	/omit-if-no-ref/ iomuxc_gpio_emc_13_ccm_pmic_rdy: IOMUXC_GPIO_EMC_13_CCM_PMIC_RDY {
		pinmux = <0x401f8048 7 0x401f8300 0 0x401f81bc>;
	};
	/omit-if-no-ref/ iomuxc_gpio_emc_13_flexpwm2_pwmx3: IOMUXC_GPIO_EMC_13_FLEXPWM2_PWMX3 {
		pinmux = <0x401f8048 6 0x0 0 0x401f81bc>;
	};
	/omit-if-no-ref/ iomuxc_gpio_emc_13_gpio2_io13: IOMUXC_GPIO_EMC_13_GPIO2_IO13 {
		pinmux = <0x401f8048 5 0x0 0 0x401f81bc>;
	};
	/omit-if-no-ref/ iomuxc_gpio_emc_13_lpspi2_sdi: IOMUXC_GPIO_EMC_13_LPSPI2_SDI {
		pinmux = <0x401f8048 4 0x401f83b4 1 0x401f81bc>;
	};
	/omit-if-no-ref/ iomuxc_gpio_emc_13_lpuart6_rx: IOMUXC_GPIO_EMC_13_LPUART6_RX {
		pinmux = <0x401f8048 2 0x401f83f4 0 0x401f81bc>;
	};
	/omit-if-no-ref/ iomuxc_gpio_emc_13_sai1_rx_data0: IOMUXC_GPIO_EMC_13_SAI1_RX_DATA0 {
		pinmux = <0x401f8048 3 0x401f8438 0 0x401f81bc>;
	};
	/omit-if-no-ref/ iomuxc_gpio_emc_13_semc_ba0: IOMUXC_GPIO_EMC_13_SEMC_BA0 {
		pinmux = <0x401f8048 0 0x0 0 0x401f81bc>;
	};
	/omit-if-no-ref/ iomuxc_gpio_emc_13_xbar1_xbar_in13: IOMUXC_GPIO_EMC_13_XBAR1_XBAR_IN13 {
		pinmux = <0x401f8048 1 0x401f84b8 0 0x401f81bc>;
		gpr = <0x400ac018 0x19 0x0>;
	};
	/omit-if-no-ref/ iomuxc_gpio_emc_13_xbar1_xbar_inout13: IOMUXC_GPIO_EMC_13_XBAR1_XBAR_INOUT13 {
		pinmux = <0x401f8048 1 0x401f84b8 0 0x401f81bc>;
		gpr = <0x400ac018 0x19 0x0>;
	};
	/omit-if-no-ref/ iomuxc_gpio_emc_14_flexcan1_tx: IOMUXC_GPIO_EMC_14_FLEXCAN1_TX {
		pinmux = <0x401f804c 6 0x0 0 0x401f81c0>;
	};
	/omit-if-no-ref/ iomuxc_gpio_emc_14_gpio2_io14: IOMUXC_GPIO_EMC_14_GPIO2_IO14 {
		pinmux = <0x401f804c 5 0x0 0 0x401f81c0>;
	};
	/omit-if-no-ref/ iomuxc_gpio_emc_14_lpspi2_pcs1: IOMUXC_GPIO_EMC_14_LPSPI2_PCS1 {
		pinmux = <0x401f804c 4 0x0 0 0x401f81c0>;
	};
	/omit-if-no-ref/ iomuxc_gpio_emc_14_lpuart6_cts_b: IOMUXC_GPIO_EMC_14_LPUART6_CTS_B {
		pinmux = <0x401f804c 2 0x0 0 0x401f81c0>;
	};
	/omit-if-no-ref/ iomuxc_gpio_emc_14_sai1_rx_bclk: IOMUXC_GPIO_EMC_14_SAI1_RX_BCLK {
		pinmux = <0x401f804c 3 0x401f8434 1 0x401f81c0>;
	};
	/omit-if-no-ref/ iomuxc_gpio_emc_14_semc_ba1: IOMUXC_GPIO_EMC_14_SEMC_BA1 {
		pinmux = <0x401f804c 0 0x0 0 0x401f81c0>;
	};
	/omit-if-no-ref/ iomuxc_gpio_emc_14_xbar1_xbar_in14: IOMUXC_GPIO_EMC_14_XBAR1_XBAR_IN14 {
		pinmux = <0x401f804c 1 0x401f84a0 1 0x401f81c0>;
		gpr = <0x400ac018 0x1a 0x0>;
	};
	/omit-if-no-ref/ iomuxc_gpio_emc_14_xbar1_xbar_inout14: IOMUXC_GPIO_EMC_14_XBAR1_XBAR_INOUT14 {
		pinmux = <0x401f804c 1 0x401f84a0 1 0x401f81c0>;
		gpr = <0x400ac018 0x1a 0x0>;
	};
	/omit-if-no-ref/ iomuxc_gpio_emc_15_flexcan1_rx: IOMUXC_GPIO_EMC_15_FLEXCAN1_RX {
		pinmux = <0x401f8050 6 0x401f8320 3 0x401f81c4>;
	};
	/omit-if-no-ref/ iomuxc_gpio_emc_15_gpio2_io15: IOMUXC_GPIO_EMC_15_GPIO2_IO15 {
		pinmux = <0x401f8050 5 0x0 0 0x401f81c4>;
	};
	/omit-if-no-ref/ iomuxc_gpio_emc_15_lpuart6_rts_b: IOMUXC_GPIO_EMC_15_LPUART6_RTS_B {
		pinmux = <0x401f8050 2 0x0 0 0x401f81c4>;
	};
	/omit-if-no-ref/ iomuxc_gpio_emc_15_sai1_rx_sync: IOMUXC_GPIO_EMC_15_SAI1_RX_SYNC {
		pinmux = <0x401f8050 3 0x401f8448 1 0x401f81c4>;
	};
	/omit-if-no-ref/ iomuxc_gpio_emc_15_semc_addr10: IOMUXC_GPIO_EMC_15_SEMC_ADDR10 {
		pinmux = <0x401f8050 0 0x0 0 0x401f81c4>;
	};
	/omit-if-no-ref/ iomuxc_gpio_emc_15_wdog1_b: IOMUXC_GPIO_EMC_15_WDOG1_B {
		pinmux = <0x401f8050 4 0x0 0 0x401f81c4>;
	};
	/omit-if-no-ref/ iomuxc_gpio_emc_15_xbar1_xbar_in15: IOMUXC_GPIO_EMC_15_XBAR1_XBAR_IN15 {
		pinmux = <0x401f8050 1 0x401f84a4 1 0x401f81c4>;
		gpr = <0x400ac018 0x1b 0x0>;
	};
	/omit-if-no-ref/ iomuxc_gpio_emc_15_xbar1_xbar_inout15: IOMUXC_GPIO_EMC_15_XBAR1_XBAR_INOUT15 {
		pinmux = <0x401f8050 1 0x401f84a4 1 0x401f81c4>;
		gpr = <0x400ac018 0x1b 0x0>;
	};
	/omit-if-no-ref/ iomuxc_gpio_emc_16_gpio2_io16: IOMUXC_GPIO_EMC_16_GPIO2_IO16 {
		pinmux = <0x401f8054 5 0x0 0 0x401f81c8>;
	};
	/omit-if-no-ref/ iomuxc_gpio_emc_16_mqs_right: IOMUXC_GPIO_EMC_16_MQS_RIGHT {
		pinmux = <0x401f8054 2 0x0 0 0x401f81c8>;
	};
	/omit-if-no-ref/ iomuxc_gpio_emc_16_sai2_mclk: IOMUXC_GPIO_EMC_16_SAI2_MCLK {
		pinmux = <0x401f8054 3 0x401f8454 1 0x401f81c8>;
	};
	/omit-if-no-ref/ iomuxc_gpio_emc_16_semc_addr00: IOMUXC_GPIO_EMC_16_SEMC_ADDR00 {
		pinmux = <0x401f8054 0 0x0 0 0x401f81c8>;
	};
	/omit-if-no-ref/ iomuxc_gpio_emc_16_src_boot_mode0: IOMUXC_GPIO_EMC_16_SRC_BOOT_MODE0 {
		pinmux = <0x401f8054 6 0x0 0 0x401f81c8>;
	};
	/omit-if-no-ref/ iomuxc_gpio_emc_17_gpio2_io17: IOMUXC_GPIO_EMC_17_GPIO2_IO17 {
		pinmux = <0x401f8058 5 0x0 0 0x401f81cc>;
	};
	/omit-if-no-ref/ iomuxc_gpio_emc_17_mqs_left: IOMUXC_GPIO_EMC_17_MQS_LEFT {
		pinmux = <0x401f8058 2 0x0 0 0x401f81cc>;
	};
	/omit-if-no-ref/ iomuxc_gpio_emc_17_sai3_mclk: IOMUXC_GPIO_EMC_17_SAI3_MCLK {
		pinmux = <0x401f8058 3 0x401f846c 1 0x401f81cc>;
	};
	/omit-if-no-ref/ iomuxc_gpio_emc_17_semc_addr01: IOMUXC_GPIO_EMC_17_SEMC_ADDR01 {
		pinmux = <0x401f8058 0 0x0 0 0x401f81cc>;
	};
	/omit-if-no-ref/ iomuxc_gpio_emc_17_src_boot_mode1: IOMUXC_GPIO_EMC_17_SRC_BOOT_MODE1 {
		pinmux = <0x401f8058 6 0x0 0 0x401f81cc>;
	};
	/omit-if-no-ref/ iomuxc_gpio_emc_18_flexio1_flexio22: IOMUXC_GPIO_EMC_18_FLEXIO1_FLEXIO22 {
		pinmux = <0x401f805c 4 0x0 0 0x401f81d0>;
	};
	/omit-if-no-ref/ iomuxc_gpio_emc_18_gpio2_io18: IOMUXC_GPIO_EMC_18_GPIO2_IO18 {
		pinmux = <0x401f805c 5 0x0 0 0x401f81d0>;
	};
	/omit-if-no-ref/ iomuxc_gpio_emc_18_lpi2c2_sda: IOMUXC_GPIO_EMC_18_LPI2C2_SDA {
		pinmux = <0x401f805c 2 0x401f8388 1 0x401f81d0>;
	};
	/omit-if-no-ref/ iomuxc_gpio_emc_18_sai1_rx_sync: IOMUXC_GPIO_EMC_18_SAI1_RX_SYNC {
		pinmux = <0x401f805c 3 0x401f8448 2 0x401f81d0>;
	};
	/omit-if-no-ref/ iomuxc_gpio_emc_18_semc_addr02: IOMUXC_GPIO_EMC_18_SEMC_ADDR02 {
		pinmux = <0x401f805c 0 0x0 0 0x401f81d0>;
	};
	/omit-if-no-ref/ iomuxc_gpio_emc_18_src_bt_cfg0: IOMUXC_GPIO_EMC_18_SRC_BT_CFG0 {
		pinmux = <0x401f805c 6 0x0 0 0x401f81d0>;
	};
	/omit-if-no-ref/ iomuxc_gpio_emc_18_xbar1_xbar_in16: IOMUXC_GPIO_EMC_18_XBAR1_XBAR_IN16 {
		pinmux = <0x401f805c 1 0x401f84a8 1 0x401f81d0>;
		gpr = <0x400ac018 0x1c 0x0>;
	};
	/omit-if-no-ref/ iomuxc_gpio_emc_18_xbar1_xbar_inout16: IOMUXC_GPIO_EMC_18_XBAR1_XBAR_INOUT16 {
		pinmux = <0x401f805c 1 0x401f84a8 1 0x401f81d0>;
		gpr = <0x400ac018 0x1c 0x0>;
	};
	/omit-if-no-ref/ iomuxc_gpio_emc_19_flexio1_flexio23: IOMUXC_GPIO_EMC_19_FLEXIO1_FLEXIO23 {
		pinmux = <0x401f8060 4 0x0 0 0x401f81d4>;
	};
	/omit-if-no-ref/ iomuxc_gpio_emc_19_gpio2_io19: IOMUXC_GPIO_EMC_19_GPIO2_IO19 {
		pinmux = <0x401f8060 5 0x0 0 0x401f81d4>;
	};
	/omit-if-no-ref/ iomuxc_gpio_emc_19_lpi2c2_scl: IOMUXC_GPIO_EMC_19_LPI2C2_SCL {
		pinmux = <0x401f8060 2 0x401f8384 1 0x401f81d4>;
	};
	/omit-if-no-ref/ iomuxc_gpio_emc_19_sai1_rx_bclk: IOMUXC_GPIO_EMC_19_SAI1_RX_BCLK {
		pinmux = <0x401f8060 3 0x401f8434 2 0x401f81d4>;
	};
	/omit-if-no-ref/ iomuxc_gpio_emc_19_semc_addr03: IOMUXC_GPIO_EMC_19_SEMC_ADDR03 {
		pinmux = <0x401f8060 0 0x0 0 0x401f81d4>;
	};
	/omit-if-no-ref/ iomuxc_gpio_emc_19_src_bt_cfg1: IOMUXC_GPIO_EMC_19_SRC_BT_CFG1 {
		pinmux = <0x401f8060 6 0x0 0 0x401f81d4>;
	};
	/omit-if-no-ref/ iomuxc_gpio_emc_19_xbar1_xbar_in17: IOMUXC_GPIO_EMC_19_XBAR1_XBAR_IN17 {
		pinmux = <0x401f8060 1 0x401f84ac 1 0x401f81d4>;
		gpr = <0x400ac018 0x1d 0x0>;
	};
	/omit-if-no-ref/ iomuxc_gpio_emc_19_xbar1_xbar_inout17: IOMUXC_GPIO_EMC_19_XBAR1_XBAR_INOUT17 {
		pinmux = <0x401f8060 1 0x401f84ac 1 0x401f81d4>;
		gpr = <0x400ac018 0x1d 0x0>;
	};
	/omit-if-no-ref/ iomuxc_gpio_emc_20_flexio1_flexio24: IOMUXC_GPIO_EMC_20_FLEXIO1_FLEXIO24 {
		pinmux = <0x401f8064 4 0x0 0 0x401f81d8>;
	};
	/omit-if-no-ref/ iomuxc_gpio_emc_20_flexpwm1_pwma3: IOMUXC_GPIO_EMC_20_FLEXPWM1_PWMA3 {
		pinmux = <0x401f8064 1 0x401f8334 1 0x401f81d8>;
	};
	/omit-if-no-ref/ iomuxc_gpio_emc_20_gpio2_io20: IOMUXC_GPIO_EMC_20_GPIO2_IO20 {
		pinmux = <0x401f8064 5 0x0 0 0x401f81d8>;
	};
	/omit-if-no-ref/ iomuxc_gpio_emc_20_lpuart2_cts_b: IOMUXC_GPIO_EMC_20_LPUART2_CTS_B {
		pinmux = <0x401f8064 2 0x401f83cc 1 0x401f81d8>;
	};
	/omit-if-no-ref/ iomuxc_gpio_emc_20_sai1_mclk: IOMUXC_GPIO_EMC_20_SAI1_MCLK {
		pinmux = <0x401f8064 3 0x401f8430 3 0x401f81d8>;
	};
	/omit-if-no-ref/ iomuxc_gpio_emc_20_semc_addr04: IOMUXC_GPIO_EMC_20_SEMC_ADDR04 {
		pinmux = <0x401f8064 0 0x0 0 0x401f81d8>;
	};
	/omit-if-no-ref/ iomuxc_gpio_emc_20_src_bt_cfg2: IOMUXC_GPIO_EMC_20_SRC_BT_CFG2 {
		pinmux = <0x401f8064 6 0x0 0 0x401f81d8>;
	};
	/omit-if-no-ref/ iomuxc_gpio_emc_21_flexio1_flexio25: IOMUXC_GPIO_EMC_21_FLEXIO1_FLEXIO25 {
		pinmux = <0x401f8068 4 0x0 0 0x401f81dc>;
	};
	/omit-if-no-ref/ iomuxc_gpio_emc_21_flexpwm1_pwmb3: IOMUXC_GPIO_EMC_21_FLEXPWM1_PWMB3 {
		pinmux = <0x401f8068 1 0x401f8344 1 0x401f81dc>;
	};
	/omit-if-no-ref/ iomuxc_gpio_emc_21_gpio2_io21: IOMUXC_GPIO_EMC_21_GPIO2_IO21 {
		pinmux = <0x401f8068 5 0x0 0 0x401f81dc>;
	};
	/omit-if-no-ref/ iomuxc_gpio_emc_21_lpuart2_rts_b: IOMUXC_GPIO_EMC_21_LPUART2_RTS_B {
		pinmux = <0x401f8068 2 0x0 0 0x401f81dc>;
	};
	/omit-if-no-ref/ iomuxc_gpio_emc_21_sai1_rx_data0: IOMUXC_GPIO_EMC_21_SAI1_RX_DATA0 {
		pinmux = <0x401f8068 3 0x401f8438 2 0x401f81dc>;
	};
	/omit-if-no-ref/ iomuxc_gpio_emc_21_semc_addr05: IOMUXC_GPIO_EMC_21_SEMC_ADDR05 {
		pinmux = <0x401f8068 0 0x0 0 0x401f81dc>;
	};
	/omit-if-no-ref/ iomuxc_gpio_emc_21_src_bt_cfg3: IOMUXC_GPIO_EMC_21_SRC_BT_CFG3 {
		pinmux = <0x401f8068 6 0x0 0 0x401f81dc>;
	};
	/omit-if-no-ref/ iomuxc_gpio_emc_22_flexio1_flexio26: IOMUXC_GPIO_EMC_22_FLEXIO1_FLEXIO26 {
		pinmux = <0x401f806c 4 0x0 0 0x401f81e0>;
	};
	/omit-if-no-ref/ iomuxc_gpio_emc_22_flexpwm1_pwma2: IOMUXC_GPIO_EMC_22_FLEXPWM1_PWMA2 {
		pinmux = <0x401f806c 1 0x401f8330 1 0x401f81e0>;
	};
	/omit-if-no-ref/ iomuxc_gpio_emc_22_gpio2_io22: IOMUXC_GPIO_EMC_22_GPIO2_IO22 {
		pinmux = <0x401f806c 5 0x0 0 0x401f81e0>;
	};
	/omit-if-no-ref/ iomuxc_gpio_emc_22_lpuart2_tx: IOMUXC_GPIO_EMC_22_LPUART2_TX {
		pinmux = <0x401f806c 2 0x401f83d4 1 0x401f81e0>;
	};
	/omit-if-no-ref/ iomuxc_gpio_emc_22_sai1_tx_data3: IOMUXC_GPIO_EMC_22_SAI1_TX_DATA3 {
		pinmux = <0x401f806c 3 0x401f843c 1 0x401f81e0>;
	};
	/omit-if-no-ref/ iomuxc_gpio_emc_22_semc_addr06: IOMUXC_GPIO_EMC_22_SEMC_ADDR06 {
		pinmux = <0x401f806c 0 0x0 0 0x401f81e0>;
	};
	/omit-if-no-ref/ iomuxc_gpio_emc_22_src_bt_cfg4: IOMUXC_GPIO_EMC_22_SRC_BT_CFG4 {
		pinmux = <0x401f806c 6 0x0 0 0x401f81e0>;
	};
	/omit-if-no-ref/ iomuxc_gpio_emc_23_flexio1_flexio27: IOMUXC_GPIO_EMC_23_FLEXIO1_FLEXIO27 {
		pinmux = <0x401f8070 4 0x0 0 0x401f81e4>;
	};
	/omit-if-no-ref/ iomuxc_gpio_emc_23_flexpwm1_pwmb2: IOMUXC_GPIO_EMC_23_FLEXPWM1_PWMB2 {
		pinmux = <0x401f8070 1 0x401f8340 1 0x401f81e4>;
	};
	/omit-if-no-ref/ iomuxc_gpio_emc_23_gpio2_io23: IOMUXC_GPIO_EMC_23_GPIO2_IO23 {
		pinmux = <0x401f8070 5 0x0 0 0x401f81e4>;
	};
	/omit-if-no-ref/ iomuxc_gpio_emc_23_lpuart2_rx: IOMUXC_GPIO_EMC_23_LPUART2_RX {
		pinmux = <0x401f8070 2 0x401f83d0 1 0x401f81e4>;
	};
	/omit-if-no-ref/ iomuxc_gpio_emc_23_sai1_tx_data2: IOMUXC_GPIO_EMC_23_SAI1_TX_DATA2 {
		pinmux = <0x401f8070 3 0x401f8440 1 0x401f81e4>;
	};
	/omit-if-no-ref/ iomuxc_gpio_emc_23_semc_addr07: IOMUXC_GPIO_EMC_23_SEMC_ADDR07 {
		pinmux = <0x401f8070 0 0x0 0 0x401f81e4>;
	};
	/omit-if-no-ref/ iomuxc_gpio_emc_23_src_bt_cfg5: IOMUXC_GPIO_EMC_23_SRC_BT_CFG5 {
		pinmux = <0x401f8070 6 0x0 0 0x401f81e4>;
	};
	/omit-if-no-ref/ iomuxc_gpio_emc_24_flexio1_flexio28: IOMUXC_GPIO_EMC_24_FLEXIO1_FLEXIO28 {
		pinmux = <0x401f8074 4 0x0 0 0x401f81e8>;
	};
	/omit-if-no-ref/ iomuxc_gpio_emc_24_flexpwm1_pwma1: IOMUXC_GPIO_EMC_24_FLEXPWM1_PWMA1 {
		pinmux = <0x401f8074 1 0x401f832c 1 0x401f81e8>;
	};
	/omit-if-no-ref/ iomuxc_gpio_emc_24_gpio2_io24: IOMUXC_GPIO_EMC_24_GPIO2_IO24 {
		pinmux = <0x401f8074 5 0x0 0 0x401f81e8>;
	};
	/omit-if-no-ref/ iomuxc_gpio_emc_24_lpuart8_cts_b: IOMUXC_GPIO_EMC_24_LPUART8_CTS_B {
		pinmux = <0x401f8074 2 0x0 0 0x401f81e8>;
	};
	/omit-if-no-ref/ iomuxc_gpio_emc_24_sai1_tx_data1: IOMUXC_GPIO_EMC_24_SAI1_TX_DATA1 {
		pinmux = <0x401f8074 3 0x401f8444 1 0x401f81e8>;
	};
	/omit-if-no-ref/ iomuxc_gpio_emc_24_semc_addr08: IOMUXC_GPIO_EMC_24_SEMC_ADDR08 {
		pinmux = <0x401f8074 0 0x0 0 0x401f81e8>;
	};
	/omit-if-no-ref/ iomuxc_gpio_emc_24_src_bt_cfg6: IOMUXC_GPIO_EMC_24_SRC_BT_CFG6 {
		pinmux = <0x401f8074 6 0x0 0 0x401f81e8>;
	};
	/omit-if-no-ref/ iomuxc_gpio_emc_25_flexio1_flexio29: IOMUXC_GPIO_EMC_25_FLEXIO1_FLEXIO29 {
		pinmux = <0x401f8078 4 0x0 0 0x401f81ec>;
	};
	/omit-if-no-ref/ iomuxc_gpio_emc_25_flexpwm1_pwmb1: IOMUXC_GPIO_EMC_25_FLEXPWM1_PWMB1 {
		pinmux = <0x401f8078 1 0x401f833c 1 0x401f81ec>;
	};
	/omit-if-no-ref/ iomuxc_gpio_emc_25_gpio2_io25: IOMUXC_GPIO_EMC_25_GPIO2_IO25 {
		pinmux = <0x401f8078 5 0x0 0 0x401f81ec>;
	};
	/omit-if-no-ref/ iomuxc_gpio_emc_25_lpuart8_rts_b: IOMUXC_GPIO_EMC_25_LPUART8_RTS_B {
		pinmux = <0x401f8078 2 0x0 0 0x401f81ec>;
	};
	/omit-if-no-ref/ iomuxc_gpio_emc_25_sai1_tx_data0: IOMUXC_GPIO_EMC_25_SAI1_TX_DATA0 {
		pinmux = <0x401f8078 3 0x0 0 0x401f81ec>;
	};
	/omit-if-no-ref/ iomuxc_gpio_emc_25_semc_addr09: IOMUXC_GPIO_EMC_25_SEMC_ADDR09 {
		pinmux = <0x401f8078 0 0x0 0 0x401f81ec>;
	};
	/omit-if-no-ref/ iomuxc_gpio_emc_25_src_bt_cfg7: IOMUXC_GPIO_EMC_25_SRC_BT_CFG7 {
		pinmux = <0x401f8078 6 0x0 0 0x401f81ec>;
	};
	/omit-if-no-ref/ iomuxc_gpio_emc_26_flexio1_flexio30: IOMUXC_GPIO_EMC_26_FLEXIO1_FLEXIO30 {
		pinmux = <0x401f807c 4 0x0 0 0x401f81f0>;
	};
	/omit-if-no-ref/ iomuxc_gpio_emc_26_flexpwm1_pwma0: IOMUXC_GPIO_EMC_26_FLEXPWM1_PWMA0 {
		pinmux = <0x401f807c 1 0x401f8328 1 0x401f81f0>;
	};
	/omit-if-no-ref/ iomuxc_gpio_emc_26_gpio2_io26: IOMUXC_GPIO_EMC_26_GPIO2_IO26 {
		pinmux = <0x401f807c 5 0x0 0 0x401f81f0>;
	};
	/omit-if-no-ref/ iomuxc_gpio_emc_26_lpuart8_tx: IOMUXC_GPIO_EMC_26_LPUART8_TX {
		pinmux = <0x401f807c 2 0x401f8408 1 0x401f81f0>;
	};
	/omit-if-no-ref/ iomuxc_gpio_emc_26_sai1_tx_bclk: IOMUXC_GPIO_EMC_26_SAI1_TX_BCLK {
		pinmux = <0x401f807c 3 0x401f844c 2 0x401f81f0>;
	};
	/omit-if-no-ref/ iomuxc_gpio_emc_26_semc_addr11: IOMUXC_GPIO_EMC_26_SEMC_ADDR11 {
		pinmux = <0x401f807c 0 0x0 0 0x401f81f0>;
	};
	/omit-if-no-ref/ iomuxc_gpio_emc_26_src_bt_cfg8: IOMUXC_GPIO_EMC_26_SRC_BT_CFG8 {
		pinmux = <0x401f807c 6 0x0 0 0x401f81f0>;
	};
	/omit-if-no-ref/ iomuxc_gpio_emc_27_flexio1_flexio31: IOMUXC_GPIO_EMC_27_FLEXIO1_FLEXIO31 {
		pinmux = <0x401f8080 4 0x0 0 0x401f81f4>;
	};
	/omit-if-no-ref/ iomuxc_gpio_emc_27_flexpwm1_pwmb0: IOMUXC_GPIO_EMC_27_FLEXPWM1_PWMB0 {
		pinmux = <0x401f8080 1 0x401f8338 1 0x401f81f4>;
	};
	/omit-if-no-ref/ iomuxc_gpio_emc_27_gpio2_io27: IOMUXC_GPIO_EMC_27_GPIO2_IO27 {
		pinmux = <0x401f8080 5 0x0 0 0x401f81f4>;
	};
	/omit-if-no-ref/ iomuxc_gpio_emc_27_lpuart8_rx: IOMUXC_GPIO_EMC_27_LPUART8_RX {
		pinmux = <0x401f8080 2 0x401f8404 1 0x401f81f4>;
	};
	/omit-if-no-ref/ iomuxc_gpio_emc_27_sai1_tx_sync: IOMUXC_GPIO_EMC_27_SAI1_TX_SYNC {
		pinmux = <0x401f8080 3 0x401f8450 2 0x401f81f4>;
	};
	/omit-if-no-ref/ iomuxc_gpio_emc_27_semc_addr12: IOMUXC_GPIO_EMC_27_SEMC_ADDR12 {
		pinmux = <0x401f8080 0 0x0 0 0x401f81f4>;
	};
	/omit-if-no-ref/ iomuxc_gpio_emc_27_src_bt_cfg9: IOMUXC_GPIO_EMC_27_SRC_BT_CFG9 {
		pinmux = <0x401f8080 6 0x0 0 0x401f81f4>;
	};
	/omit-if-no-ref/ iomuxc_gpio_emc_28_ewm_out_b: IOMUXC_GPIO_EMC_28_EWM_OUT_B {
		pinmux = <0x401f8084 4 0x0 0 0x401f81f8>;
	};
	/omit-if-no-ref/ iomuxc_gpio_emc_28_flexpwm1_pwmx0: IOMUXC_GPIO_EMC_28_FLEXPWM1_PWMX0 {
		pinmux = <0x401f8084 7 0x0 0 0x401f81f8>;
	};
	/omit-if-no-ref/ iomuxc_gpio_emc_28_flexpwm2_pwma3: IOMUXC_GPIO_EMC_28_FLEXPWM2_PWMA3 {
		pinmux = <0x401f8084 1 0x401f8354 1 0x401f81f8>;
	};
	/omit-if-no-ref/ iomuxc_gpio_emc_28_gpio2_io28: IOMUXC_GPIO_EMC_28_GPIO2_IO28 {
		pinmux = <0x401f8084 5 0x0 0 0x401f81f8>;
	};
	/omit-if-no-ref/ iomuxc_gpio_emc_28_gpt2_capture2: IOMUXC_GPIO_EMC_28_GPT2_CAPTURE2 {
		pinmux = <0x401f8084 6 0x0 0 0x401f81f8>;
	};
	/omit-if-no-ref/ iomuxc_gpio_emc_28_sai3_mclk: IOMUXC_GPIO_EMC_28_SAI3_MCLK {
		pinmux = <0x401f8084 3 0x401f846c 2 0x401f81f8>;
	};
	/omit-if-no-ref/ iomuxc_gpio_emc_28_semc_dqs: IOMUXC_GPIO_EMC_28_SEMC_DQS {
		pinmux = <0x401f8084 0 0x0 0 0x401f81f8>;
	};
	/omit-if-no-ref/ iomuxc_gpio_emc_28_xbar1_xbar_in18: IOMUXC_GPIO_EMC_28_XBAR1_XBAR_IN18 {
		pinmux = <0x401f8084 2 0x401f84bc 0 0x401f81f8>;
		gpr = <0x400ac018 0x1e 0x0>;
	};
	/omit-if-no-ref/ iomuxc_gpio_emc_28_xbar1_xbar_inout18: IOMUXC_GPIO_EMC_28_XBAR1_XBAR_INOUT18 {
		pinmux = <0x401f8084 2 0x401f84bc 0 0x401f81f8>;
		gpr = <0x400ac018 0x1e 0x0>;
	};
	/omit-if-no-ref/ iomuxc_gpio_emc_29_flexpwm1_pwmx1: IOMUXC_GPIO_EMC_29_FLEXPWM1_PWMX1 {
		pinmux = <0x401f8088 7 0x0 0 0x401f81fc>;
	};
	/omit-if-no-ref/ iomuxc_gpio_emc_29_flexpwm2_pwmb3: IOMUXC_GPIO_EMC_29_FLEXPWM2_PWMB3 {
		pinmux = <0x401f8088 1 0x401f8364 1 0x401f81fc>;
	};
	/omit-if-no-ref/ iomuxc_gpio_emc_29_gpio2_io29: IOMUXC_GPIO_EMC_29_GPIO2_IO29 {
		pinmux = <0x401f8088 5 0x0 0 0x401f81fc>;
	};
	/omit-if-no-ref/ iomuxc_gpio_emc_29_gpt2_compare2: IOMUXC_GPIO_EMC_29_GPT2_COMPARE2 {
		pinmux = <0x401f8088 6 0x0 0 0x401f81fc>;
	};
	/omit-if-no-ref/ iomuxc_gpio_emc_29_sai3_rx_bclk: IOMUXC_GPIO_EMC_29_SAI3_RX_BCLK {
		pinmux = <0x401f8088 3 0x401f8470 1 0x401f81fc>;
	};
	/omit-if-no-ref/ iomuxc_gpio_emc_29_semc_cke: IOMUXC_GPIO_EMC_29_SEMC_CKE {
		pinmux = <0x401f8088 0 0x0 0 0x401f81fc>;
	};
	/omit-if-no-ref/ iomuxc_gpio_emc_29_wdog2_rst_b_deb: IOMUXC_GPIO_EMC_29_WDOG2_RST_B_DEB {
		pinmux = <0x401f8088 4 0x0 0 0x401f81fc>;
	};
	/omit-if-no-ref/ iomuxc_gpio_emc_29_xbar1_xbar_in19: IOMUXC_GPIO_EMC_29_XBAR1_XBAR_IN19 {
		pinmux = <0x401f8088 2 0x401f84c0 0 0x401f81fc>;
		gpr = <0x400ac018 0x1f 0x0>;
	};
	/omit-if-no-ref/ iomuxc_gpio_emc_29_xbar1_xbar_inout19: IOMUXC_GPIO_EMC_29_XBAR1_XBAR_INOUT19 {
		pinmux = <0x401f8088 2 0x401f84c0 0 0x401f81fc>;
		gpr = <0x400ac018 0x1f 0x0>;
	};
	/omit-if-no-ref/ iomuxc_gpio_emc_30_flexpwm1_pwmx2: IOMUXC_GPIO_EMC_30_FLEXPWM1_PWMX2 {
		pinmux = <0x401f808c 7 0x0 0 0x401f8200>;
	};
	/omit-if-no-ref/ iomuxc_gpio_emc_30_flexpwm2_pwma2: IOMUXC_GPIO_EMC_30_FLEXPWM2_PWMA2 {
		pinmux = <0x401f808c 1 0x401f8350 1 0x401f8200>;
	};
	/omit-if-no-ref/ iomuxc_gpio_emc_30_gpio2_io30: IOMUXC_GPIO_EMC_30_GPIO2_IO30 {
		pinmux = <0x401f808c 5 0x0 0 0x401f8200>;
	};
	/omit-if-no-ref/ iomuxc_gpio_emc_30_gpt2_compare3: IOMUXC_GPIO_EMC_30_GPT2_COMPARE3 {
		pinmux = <0x401f808c 6 0x0 0 0x401f8200>;
	};
	/omit-if-no-ref/ iomuxc_gpio_emc_30_lpuart4_cts_b: IOMUXC_GPIO_EMC_30_LPUART4_CTS_B {
		pinmux = <0x401f808c 2 0x401f83e0 1 0x401f8200>;
	};
	/omit-if-no-ref/ iomuxc_gpio_emc_30_sai3_rx_sync: IOMUXC_GPIO_EMC_30_SAI3_RX_SYNC {
		pinmux = <0x401f808c 3 0x401f8478 1 0x401f8200>;
	};
	/omit-if-no-ref/ iomuxc_gpio_emc_30_semc_clk: IOMUXC_GPIO_EMC_30_SEMC_CLK {
		pinmux = <0x401f808c 0 0x0 0 0x401f8200>;
	};
	/omit-if-no-ref/ iomuxc_gpio_emc_30_wdog1_rst_b_deb: IOMUXC_GPIO_EMC_30_WDOG1_RST_B_DEB {
		pinmux = <0x401f808c 4 0x0 0 0x401f8200>;
	};
	/omit-if-no-ref/ iomuxc_gpio_emc_31_flexpwm1_pwmx3: IOMUXC_GPIO_EMC_31_FLEXPWM1_PWMX3 {
		pinmux = <0x401f8090 7 0x0 0 0x401f8204>;
	};
	/omit-if-no-ref/ iomuxc_gpio_emc_31_flexpwm2_pwmb2: IOMUXC_GPIO_EMC_31_FLEXPWM2_PWMB2 {
		pinmux = <0x401f8090 1 0x401f8360 1 0x401f8204>;
	};
	/omit-if-no-ref/ iomuxc_gpio_emc_31_gpio2_io31: IOMUXC_GPIO_EMC_31_GPIO2_IO31 {
		pinmux = <0x401f8090 5 0x0 0 0x401f8204>;
	};
	/omit-if-no-ref/ iomuxc_gpio_emc_31_gpt2_clk: IOMUXC_GPIO_EMC_31_GPT2_CLK {
		pinmux = <0x401f8090 6 0x0 0 0x401f8204>;
	};
	/omit-if-no-ref/ iomuxc_gpio_emc_31_lpuart4_rts_b: IOMUXC_GPIO_EMC_31_LPUART4_RTS_B {
		pinmux = <0x401f8090 2 0x0 0 0x401f8204>;
	};
	/omit-if-no-ref/ iomuxc_gpio_emc_31_sai3_rx_data: IOMUXC_GPIO_EMC_31_SAI3_RX_DATA {
		pinmux = <0x401f8090 3 0x401f8474 1 0x401f8204>;
	};
	/omit-if-no-ref/ iomuxc_gpio_emc_31_semc_dm1: IOMUXC_GPIO_EMC_31_SEMC_DM1 {
		pinmux = <0x401f8090 0 0x0 0 0x401f8204>;
	};
	/omit-if-no-ref/ iomuxc_gpio_emc_31_wdog2_b: IOMUXC_GPIO_EMC_31_WDOG2_B {
		pinmux = <0x401f8090 4 0x0 0 0x401f8204>;
	};
	/omit-if-no-ref/ iomuxc_gpio_emc_32_gpio3_io00: IOMUXC_GPIO_EMC_32_GPIO3_IO00 {
		pinmux = <0x401f8094 5 0x0 0 0x401f8208>;
	};
	/omit-if-no-ref/ iomuxc_gpio_emc_32_lpspi4_sck: IOMUXC_GPIO_EMC_32_LPSPI4_SCK {
		pinmux = <0x401f8094 4 0x401f83c0 1 0x401f8208>;
	};
	/omit-if-no-ref/ iomuxc_gpio_emc_32_lpuart4_tx: IOMUXC_GPIO_EMC_32_LPUART4_TX {
		pinmux = <0x401f8094 2 0x401f83e8 2 0x401f8208>;
	};
	/omit-if-no-ref/ iomuxc_gpio_emc_32_qtimer1_timer0: IOMUXC_GPIO_EMC_32_QTIMER1_TIMER0 {
		pinmux = <0x401f8094 1 0x401f8410 1 0x401f8208>;
		gpr = <0x400ac018 0x0 0x0>;
	};
	/omit-if-no-ref/ iomuxc_gpio_emc_32_ref_24m_out: IOMUXC_GPIO_EMC_32_REF_24M_OUT {
		pinmux = <0x401f8094 7 0x0 0 0x401f8208>;
	};
	/omit-if-no-ref/ iomuxc_gpio_emc_32_sai3_tx_data: IOMUXC_GPIO_EMC_32_SAI3_TX_DATA {
		pinmux = <0x401f8094 3 0x0 0 0x401f8208>;
	};
	/omit-if-no-ref/ iomuxc_gpio_emc_32_semc_data08: IOMUXC_GPIO_EMC_32_SEMC_DATA08 {
		pinmux = <0x401f8094 0 0x0 0 0x401f8208>;
	};
	/omit-if-no-ref/ iomuxc_gpio_emc_33_gpio3_io01: IOMUXC_GPIO_EMC_33_GPIO3_IO01 {
		pinmux = <0x401f8098 5 0x0 0 0x401f820c>;
	};
	/omit-if-no-ref/ iomuxc_gpio_emc_33_lpspi4_pcs0: IOMUXC_GPIO_EMC_33_LPSPI4_PCS0 {
		pinmux = <0x401f8098 4 0x401f83bc 1 0x401f820c>;
	};
	/omit-if-no-ref/ iomuxc_gpio_emc_33_lpuart4_rx: IOMUXC_GPIO_EMC_33_LPUART4_RX {
		pinmux = <0x401f8098 2 0x401f83e4 2 0x401f820c>;
	};
	/omit-if-no-ref/ iomuxc_gpio_emc_33_qtimer1_timer1: IOMUXC_GPIO_EMC_33_QTIMER1_TIMER1 {
		pinmux = <0x401f8098 1 0x401f8414 1 0x401f820c>;
		gpr = <0x400ac018 0x1 0x0>;
	};
	/omit-if-no-ref/ iomuxc_gpio_emc_33_sai3_tx_bclk: IOMUXC_GPIO_EMC_33_SAI3_TX_BCLK {
		pinmux = <0x401f8098 3 0x401f847c 1 0x401f820c>;
	};
	/omit-if-no-ref/ iomuxc_gpio_emc_33_semc_data09: IOMUXC_GPIO_EMC_33_SEMC_DATA09 {
		pinmux = <0x401f8098 0 0x0 0 0x401f820c>;
	};
	/omit-if-no-ref/ iomuxc_gpio_emc_34_enet_crs: IOMUXC_GPIO_EMC_34_ENET_CRS {
		pinmux = <0x401f809c 6 0x0 0 0x401f8210>;
	};
	/omit-if-no-ref/ iomuxc_gpio_emc_34_gpio3_io02: IOMUXC_GPIO_EMC_34_GPIO3_IO02 {
		pinmux = <0x401f809c 5 0x0 0 0x401f8210>;
	};
	/omit-if-no-ref/ iomuxc_gpio_emc_34_lpspi4_sdo: IOMUXC_GPIO_EMC_34_LPSPI4_SDO {
		pinmux = <0x401f809c 4 0x401f83c8 1 0x401f8210>;
	};
	/omit-if-no-ref/ iomuxc_gpio_emc_34_lpuart7_tx: IOMUXC_GPIO_EMC_34_LPUART7_TX {
		pinmux = <0x401f809c 2 0x401f8400 1 0x401f8210>;
	};
	/omit-if-no-ref/ iomuxc_gpio_emc_34_qtimer1_timer2: IOMUXC_GPIO_EMC_34_QTIMER1_TIMER2 {
		pinmux = <0x401f809c 1 0x401f8418 1 0x401f8210>;
		gpr = <0x400ac018 0x2 0x0>;
	};
	/omit-if-no-ref/ iomuxc_gpio_emc_34_sai3_tx_sync: IOMUXC_GPIO_EMC_34_SAI3_TX_SYNC {
		pinmux = <0x401f809c 3 0x401f8480 1 0x401f8210>;
	};
	/omit-if-no-ref/ iomuxc_gpio_emc_34_semc_data10: IOMUXC_GPIO_EMC_34_SEMC_DATA10 {
		pinmux = <0x401f809c 0 0x0 0 0x401f8210>;
	};
	/omit-if-no-ref/ iomuxc_gpio_emc_35_enet_col: IOMUXC_GPIO_EMC_35_ENET_COL {
		pinmux = <0x401f80a0 6 0x0 0 0x401f8214>;
	};
	/omit-if-no-ref/ iomuxc_gpio_emc_35_gpio3_io03: IOMUXC_GPIO_EMC_35_GPIO3_IO03 {
		pinmux = <0x401f80a0 5 0x0 0 0x401f8214>;
	};
	/omit-if-no-ref/ iomuxc_gpio_emc_35_lpspi4_sdi: IOMUXC_GPIO_EMC_35_LPSPI4_SDI {
		pinmux = <0x401f80a0 4 0x401f83c4 1 0x401f8214>;
	};
	/omit-if-no-ref/ iomuxc_gpio_emc_35_lpuart7_rx: IOMUXC_GPIO_EMC_35_LPUART7_RX {
		pinmux = <0x401f80a0 2 0x401f83fc 1 0x401f8214>;
	};
	/omit-if-no-ref/ iomuxc_gpio_emc_35_qtimer1_timer3: IOMUXC_GPIO_EMC_35_QTIMER1_TIMER3 {
		pinmux = <0x401f80a0 1 0x401f841c 1 0x401f8214>;
		gpr = <0x400ac018 0x3 0x0>;
	};
	/omit-if-no-ref/ iomuxc_gpio_emc_35_semc_data11: IOMUXC_GPIO_EMC_35_SEMC_DATA11 {
		pinmux = <0x401f80a0 0 0x0 0 0x401f8214>;
	};
	/omit-if-no-ref/ iomuxc_gpio_emc_35_usdhc2_wp: IOMUXC_GPIO_EMC_35_USDHC2_WP {
		pinmux = <0x401f80a0 3 0x401f849c 1 0x401f8214>;
	};
	/omit-if-no-ref/ iomuxc_gpio_emc_36_ccm_pmic_rdy: IOMUXC_GPIO_EMC_36_CCM_PMIC_RDY {
		pinmux = <0x401f80a4 3 0x401f8300 3 0x401f8218>;
	};
	/omit-if-no-ref/ iomuxc_gpio_emc_36_enet_rx_clk: IOMUXC_GPIO_EMC_36_ENET_RX_CLK {
		pinmux = <0x401f80a4 6 0x0 0 0x401f8218>;
	};
	/omit-if-no-ref/ iomuxc_gpio_emc_36_flexpwm2_pwma1: IOMUXC_GPIO_EMC_36_FLEXPWM2_PWMA1 {
		pinmux = <0x401f80a4 1 0x401f834c 1 0x401f8218>;
	};
	/omit-if-no-ref/ iomuxc_gpio_emc_36_gpio3_io04: IOMUXC_GPIO_EMC_36_GPIO3_IO04 {
		pinmux = <0x401f80a4 5 0x0 0 0x401f8218>;
	};
	/omit-if-no-ref/ iomuxc_gpio_emc_36_lpspi4_pcs1: IOMUXC_GPIO_EMC_36_LPSPI4_PCS1 {
		pinmux = <0x401f80a4 4 0x0 0 0x401f8218>;
	};
	/omit-if-no-ref/ iomuxc_gpio_emc_36_lpuart5_cts_b: IOMUXC_GPIO_EMC_36_LPUART5_CTS_B {
		pinmux = <0x401f80a4 2 0x0 0 0x401f8218>;
	};
	/omit-if-no-ref/ iomuxc_gpio_emc_36_semc_data12: IOMUXC_GPIO_EMC_36_SEMC_DATA12 {
		pinmux = <0x401f80a4 0 0x0 0 0x401f8218>;
	};
	/omit-if-no-ref/ iomuxc_gpio_emc_36_usdhc1_wp: IOMUXC_GPIO_EMC_36_USDHC1_WP {
		pinmux = <0x401f80a4 7 0x401f8494 4 0x401f8218>;
	};
	/omit-if-no-ref/ iomuxc_gpio_emc_37_enet_rx_data3: IOMUXC_GPIO_EMC_37_ENET_RX_DATA3 {
		pinmux = <0x401f80a8 6 0x0 0 0x401f821c>;
	};
	/omit-if-no-ref/ iomuxc_gpio_emc_37_flexpwm2_pwmb1: IOMUXC_GPIO_EMC_37_FLEXPWM2_PWMB1 {
		pinmux = <0x401f80a8 1 0x401f835c 1 0x401f821c>;
	};
	/omit-if-no-ref/ iomuxc_gpio_emc_37_gpio3_io05: IOMUXC_GPIO_EMC_37_GPIO3_IO05 {
		pinmux = <0x401f80a8 5 0x0 0 0x401f821c>;
	};
	/omit-if-no-ref/ iomuxc_gpio_emc_37_lpspi4_pcs2: IOMUXC_GPIO_EMC_37_LPSPI4_PCS2 {
		pinmux = <0x401f80a8 4 0x0 0 0x401f821c>;
	};
	/omit-if-no-ref/ iomuxc_gpio_emc_37_lpuart5_rts_b: IOMUXC_GPIO_EMC_37_LPUART5_RTS_B {
		pinmux = <0x401f80a8 2 0x0 0 0x401f821c>;
	};
	/omit-if-no-ref/ iomuxc_gpio_emc_37_mqs_right: IOMUXC_GPIO_EMC_37_MQS_RIGHT {
		pinmux = <0x401f80a8 3 0x0 0 0x401f821c>;
	};
	/omit-if-no-ref/ iomuxc_gpio_emc_37_semc_data13: IOMUXC_GPIO_EMC_37_SEMC_DATA13 {
		pinmux = <0x401f80a8 0 0x0 0 0x401f821c>;
	};
	/omit-if-no-ref/ iomuxc_gpio_emc_37_usdhc1_vselect: IOMUXC_GPIO_EMC_37_USDHC1_VSELECT {
		pinmux = <0x401f80a8 7 0x0 0 0x401f821c>;
	};
	/omit-if-no-ref/ iomuxc_gpio_emc_38_enet_rx_data2: IOMUXC_GPIO_EMC_38_ENET_RX_DATA2 {
		pinmux = <0x401f80ac 6 0x0 0 0x401f8220>;
	};
	/omit-if-no-ref/ iomuxc_gpio_emc_38_flexpwm2_pwma0: IOMUXC_GPIO_EMC_38_FLEXPWM2_PWMA0 {
		pinmux = <0x401f80ac 1 0x401f8348 1 0x401f8220>;
	};
	/omit-if-no-ref/ iomuxc_gpio_emc_38_gpio3_io06: IOMUXC_GPIO_EMC_38_GPIO3_IO06 {
		pinmux = <0x401f80ac 5 0x0 0 0x401f8220>;
	};
	/omit-if-no-ref/ iomuxc_gpio_emc_38_lpspi4_pcs3: IOMUXC_GPIO_EMC_38_LPSPI4_PCS3 {
		pinmux = <0x401f80ac 4 0x0 0 0x401f8220>;
	};
	/omit-if-no-ref/ iomuxc_gpio_emc_38_lpuart5_tx: IOMUXC_GPIO_EMC_38_LPUART5_TX {
		pinmux = <0x401f80ac 2 0x401f83f0 1 0x401f8220>;
	};
	/omit-if-no-ref/ iomuxc_gpio_emc_38_mqs_left: IOMUXC_GPIO_EMC_38_MQS_LEFT {
		pinmux = <0x401f80ac 3 0x0 0 0x401f8220>;
	};
	/omit-if-no-ref/ iomuxc_gpio_emc_38_semc_data14: IOMUXC_GPIO_EMC_38_SEMC_DATA14 {
		pinmux = <0x401f80ac 0 0x0 0 0x401f8220>;
	};
	/omit-if-no-ref/ iomuxc_gpio_emc_38_usdhc1_cd_b: IOMUXC_GPIO_EMC_38_USDHC1_CD_B {
		pinmux = <0x401f80ac 7 0x401f8490 3 0x401f8220>;
	};
	/omit-if-no-ref/ iomuxc_gpio_emc_39_enet_tx_er: IOMUXC_GPIO_EMC_39_ENET_TX_ER {
		pinmux = <0x401f80b0 6 0x0 0 0x401f8224>;
	};
	/omit-if-no-ref/ iomuxc_gpio_emc_39_flexpwm2_pwmb0: IOMUXC_GPIO_EMC_39_FLEXPWM2_PWMB0 {
		pinmux = <0x401f80b0 1 0x401f8358 1 0x401f8224>;
	};
	/omit-if-no-ref/ iomuxc_gpio_emc_39_gpio3_io07: IOMUXC_GPIO_EMC_39_GPIO3_IO07 {
		pinmux = <0x401f80b0 5 0x0 0 0x401f8224>;
	};
	/omit-if-no-ref/ iomuxc_gpio_emc_39_gpt1_clk: IOMUXC_GPIO_EMC_39_GPT1_CLK {
		pinmux = <0x401f80b0 7 0x0 0 0x401f8224>;
	};
	/omit-if-no-ref/ iomuxc_gpio_emc_39_lpuart5_rx: IOMUXC_GPIO_EMC_39_LPUART5_RX {
		pinmux = <0x401f80b0 2 0x401f83ec 1 0x401f8224>;
	};
	/omit-if-no-ref/ iomuxc_gpio_emc_39_semc_data15: IOMUXC_GPIO_EMC_39_SEMC_DATA15 {
		pinmux = <0x401f80b0 0 0x0 0 0x401f8224>;
	};
	/omit-if-no-ref/ iomuxc_gpio_emc_39_usb_otg1_oc: IOMUXC_GPIO_EMC_39_USB_OTG1_OC {
		pinmux = <0x401f80b0 3 0x401f848c 2 0x401f8224>;
	};
	/omit-if-no-ref/ iomuxc_gpio_emc_39_wdog1_b: IOMUXC_GPIO_EMC_39_WDOG1_B {
		pinmux = <0x401f80b0 4 0x0 0 0x401f8224>;
	};
	/omit-if-no-ref/ iomuxc_gpio_emc_40_enet_mdio: IOMUXC_GPIO_EMC_40_ENET_MDIO {
		pinmux = <0x401f80b4 4 0x401f8308 2 0x401f8228>;
	};
	/omit-if-no-ref/ iomuxc_gpio_emc_40_enet_tx_data3: IOMUXC_GPIO_EMC_40_ENET_TX_DATA3 {
		pinmux = <0x401f80b4 6 0x0 0 0x401f8228>;
	};
	/omit-if-no-ref/ iomuxc_gpio_emc_40_gpio3_io08: IOMUXC_GPIO_EMC_40_GPIO3_IO08 {
		pinmux = <0x401f80b4 5 0x0 0 0x401f8228>;
	};
	/omit-if-no-ref/ iomuxc_gpio_emc_40_gpt1_compare3: IOMUXC_GPIO_EMC_40_GPT1_COMPARE3 {
		pinmux = <0x401f80b4 7 0x0 0 0x401f8228>;
	};
	/omit-if-no-ref/ iomuxc_gpio_emc_40_semc_csx0: IOMUXC_GPIO_EMC_40_SEMC_CSX0 {
		pinmux = <0x401f80b4 0 0x0 0 0x401f8228>;
	};
	/omit-if-no-ref/ iomuxc_gpio_emc_40_spdif_out: IOMUXC_GPIO_EMC_40_SPDIF_OUT {
		pinmux = <0x401f80b4 2 0x0 0 0x401f8228>;
	};
	/omit-if-no-ref/ iomuxc_gpio_emc_40_usb_otg1_id: IOMUXC_GPIO_EMC_40_USB_OTG1_ID {
		pinmux = <0x401f80b4 3 0x401f82fc 2 0x401f8228>;
	};
	/omit-if-no-ref/ iomuxc_gpio_emc_40_xbar1_xbar_in18: IOMUXC_GPIO_EMC_40_XBAR1_XBAR_IN18 {
		pinmux = <0x401f80b4 1 0x401f84bc 1 0x401f8228>;
		gpr = <0x400ac018 0x1e 0x0>;
	};
	/omit-if-no-ref/ iomuxc_gpio_emc_40_xbar1_xbar_inout18: IOMUXC_GPIO_EMC_40_XBAR1_XBAR_INOUT18 {
		pinmux = <0x401f80b4 1 0x401f84bc 1 0x401f8228>;
		gpr = <0x400ac018 0x1e 0x0>;
	};
	/omit-if-no-ref/ iomuxc_gpio_emc_41_enet_mdc: IOMUXC_GPIO_EMC_41_ENET_MDC {
		pinmux = <0x401f80b8 4 0x0 0 0x401f822c>;
	};
	/omit-if-no-ref/ iomuxc_gpio_emc_41_enet_tx_data2: IOMUXC_GPIO_EMC_41_ENET_TX_DATA2 {
		pinmux = <0x401f80b8 6 0x0 0 0x401f822c>;
	};
	/omit-if-no-ref/ iomuxc_gpio_emc_41_gpio3_io09: IOMUXC_GPIO_EMC_41_GPIO3_IO09 {
		pinmux = <0x401f80b8 5 0x0 0 0x401f822c>;
	};
	/omit-if-no-ref/ iomuxc_gpio_emc_41_gpt1_compare2: IOMUXC_GPIO_EMC_41_GPT1_COMPARE2 {
		pinmux = <0x401f80b8 7 0x0 0 0x401f822c>;
	};
	/omit-if-no-ref/ iomuxc_gpio_emc_41_semc_rdy: IOMUXC_GPIO_EMC_41_SEMC_RDY {
		pinmux = <0x401f80b8 0 0x401f8484 1 0x401f822c>;
	};
	/omit-if-no-ref/ iomuxc_gpio_emc_41_spdif_in: IOMUXC_GPIO_EMC_41_SPDIF_IN {
		pinmux = <0x401f80b8 2 0x401f8488 1 0x401f822c>;
	};
	/omit-if-no-ref/ iomuxc_gpio_emc_41_usb_otg1_pwr: IOMUXC_GPIO_EMC_41_USB_OTG1_PWR {
		pinmux = <0x401f80b8 3 0x0 0 0x401f822c>;
	};
	/omit-if-no-ref/ iomuxc_gpio_emc_41_xbar1_xbar_in19: IOMUXC_GPIO_EMC_41_XBAR1_XBAR_IN19 {
		pinmux = <0x401f80b8 1 0x401f84c0 1 0x401f822c>;
		gpr = <0x400ac018 0x1f 0x0>;
	};
	/omit-if-no-ref/ iomuxc_gpio_emc_41_xbar1_xbar_inout19: IOMUXC_GPIO_EMC_41_XBAR1_XBAR_INOUT19 {
		pinmux = <0x401f80b8 1 0x401f84c0 1 0x401f822c>;
		gpr = <0x400ac018 0x1f 0x0>;
	};
	/omit-if-no-ref/ iomuxc_gpio_sd_b0_00_flexspi_a_ss1_b: IOMUXC_GPIO_SD_B0_00_FLEXSPI_A_SS1_B {
		pinmux = <0x401f813c 6 0x0 0 0x401f82b0>;
	};
	/omit-if-no-ref/ iomuxc_gpio_sd_b0_00_gpio3_io13: IOMUXC_GPIO_SD_B0_00_GPIO3_IO13 {
		pinmux = <0x401f813c 5 0x0 0 0x401f82b0>;
	};
	/omit-if-no-ref/ iomuxc_gpio_sd_b0_00_lpi2c3_scl: IOMUXC_GPIO_SD_B0_00_LPI2C3_SCL {
		pinmux = <0x401f813c 4 0x401f838c 0 0x401f82b0>;
	};
	/omit-if-no-ref/ iomuxc_gpio_sd_b0_00_qtimer1_timer0: IOMUXC_GPIO_SD_B0_00_QTIMER1_TIMER0 {
		pinmux = <0x401f813c 1 0x401f8410 0 0x401f82b0>;
		gpr = <0x400ac018 0x0 0x0>;
	};
	/omit-if-no-ref/ iomuxc_gpio_sd_b0_00_sai1_mclk: IOMUXC_GPIO_SD_B0_00_SAI1_MCLK {
		pinmux = <0x401f813c 2 0x401f8430 0 0x401f82b0>;
	};
	/omit-if-no-ref/ iomuxc_gpio_sd_b0_00_sai2_mclk: IOMUXC_GPIO_SD_B0_00_SAI2_MCLK {
		pinmux = <0x401f813c 3 0x401f8454 0 0x401f82b0>;
	};
	/omit-if-no-ref/ iomuxc_gpio_sd_b0_00_usdhc1_data2: IOMUXC_GPIO_SD_B0_00_USDHC1_DATA2 {
		pinmux = <0x401f813c 0 0x0 0 0x401f82b0>;
	};
	/omit-if-no-ref/ iomuxc_gpio_sd_b0_00_xbar1_xbar_in14: IOMUXC_GPIO_SD_B0_00_XBAR1_XBAR_IN14 {
		pinmux = <0x401f813c 7 0x401f84a0 0 0x401f82b0>;
		gpr = <0x400ac018 0x1a 0x0>;
	};
	/omit-if-no-ref/ iomuxc_gpio_sd_b0_00_xbar1_xbar_inout14: IOMUXC_GPIO_SD_B0_00_XBAR1_XBAR_INOUT14 {
		pinmux = <0x401f813c 7 0x401f84a0 0 0x401f82b0>;
		gpr = <0x400ac018 0x1a 0x0>;
	};
	/omit-if-no-ref/ iomuxc_gpio_sd_b0_01_flexspi_b_ss1_b: IOMUXC_GPIO_SD_B0_01_FLEXSPI_B_SS1_B {
		pinmux = <0x401f8140 6 0x0 0 0x401f82b4>;
	};
	/omit-if-no-ref/ iomuxc_gpio_sd_b0_01_gpio3_io14: IOMUXC_GPIO_SD_B0_01_GPIO3_IO14 {
		pinmux = <0x401f8140 5 0x0 0 0x401f82b4>;
	};
	/omit-if-no-ref/ iomuxc_gpio_sd_b0_01_lpi2c3_sda: IOMUXC_GPIO_SD_B0_01_LPI2C3_SDA {
		pinmux = <0x401f8140 4 0x401f8390 0 0x401f82b4>;
	};
	/omit-if-no-ref/ iomuxc_gpio_sd_b0_01_qtimer1_timer1: IOMUXC_GPIO_SD_B0_01_QTIMER1_TIMER1 {
		pinmux = <0x401f8140 1 0x401f8414 0 0x401f82b4>;
		gpr = <0x400ac018 0x1 0x0>;
	};
	/omit-if-no-ref/ iomuxc_gpio_sd_b0_01_ref_24m_out: IOMUXC_GPIO_SD_B0_01_REF_24M_OUT {
		pinmux = <0x401f8140 2 0x0 0 0x401f82b4>;
	};
	/omit-if-no-ref/ iomuxc_gpio_sd_b0_01_sai2_rx_sync: IOMUXC_GPIO_SD_B0_01_SAI2_RX_SYNC {
		pinmux = <0x401f8140 3 0x401f8460 0 0x401f82b4>;
	};
	/omit-if-no-ref/ iomuxc_gpio_sd_b0_01_usdhc1_data3: IOMUXC_GPIO_SD_B0_01_USDHC1_DATA3 {
		pinmux = <0x401f8140 0 0x0 0 0x401f82b4>;
	};
	/omit-if-no-ref/ iomuxc_gpio_sd_b0_01_xbar1_xbar_in15: IOMUXC_GPIO_SD_B0_01_XBAR1_XBAR_IN15 {
		pinmux = <0x401f8140 7 0x401f84a4 0 0x401f82b4>;
		gpr = <0x400ac018 0x1b 0x0>;
	};
	/omit-if-no-ref/ iomuxc_gpio_sd_b0_01_xbar1_xbar_inout15: IOMUXC_GPIO_SD_B0_01_XBAR1_XBAR_INOUT15 {
		pinmux = <0x401f8140 7 0x401f84a4 0 0x401f82b4>;
		gpr = <0x400ac018 0x1b 0x0>;
	};
	/omit-if-no-ref/ iomuxc_gpio_sd_b0_02_enet_mdio: IOMUXC_GPIO_SD_B0_02_ENET_MDIO {
		pinmux = <0x401f8144 6 0x401f8308 0 0x401f82b8>;
	};
	/omit-if-no-ref/ iomuxc_gpio_sd_b0_02_gpio3_io15: IOMUXC_GPIO_SD_B0_02_GPIO3_IO15 {
		pinmux = <0x401f8144 5 0x0 0 0x401f82b8>;
	};
	/omit-if-no-ref/ iomuxc_gpio_sd_b0_02_lpspi1_sck: IOMUXC_GPIO_SD_B0_02_LPSPI1_SCK {
		pinmux = <0x401f8144 4 0x401f83a0 0 0x401f82b8>;
	};
	/omit-if-no-ref/ iomuxc_gpio_sd_b0_02_lpuart7_cts_b: IOMUXC_GPIO_SD_B0_02_LPUART7_CTS_B {
		pinmux = <0x401f8144 2 0x0 0 0x401f82b8>;
	};
	/omit-if-no-ref/ iomuxc_gpio_sd_b0_02_qtimer1_timer2: IOMUXC_GPIO_SD_B0_02_QTIMER1_TIMER2 {
		pinmux = <0x401f8144 1 0x401f8418 0 0x401f82b8>;
		gpr = <0x400ac018 0x2 0x0>;
	};
	/omit-if-no-ref/ iomuxc_gpio_sd_b0_02_sai2_rx_bclk: IOMUXC_GPIO_SD_B0_02_SAI2_RX_BCLK {
		pinmux = <0x401f8144 3 0x401f8458 0 0x401f82b8>;
	};
	/omit-if-no-ref/ iomuxc_gpio_sd_b0_02_usdhc1_cmd: IOMUXC_GPIO_SD_B0_02_USDHC1_CMD {
		pinmux = <0x401f8144 0 0x0 0 0x401f82b8>;
	};
	/omit-if-no-ref/ iomuxc_gpio_sd_b0_02_xbar1_xbar_in16: IOMUXC_GPIO_SD_B0_02_XBAR1_XBAR_IN16 {
		pinmux = <0x401f8144 7 0x401f84a8 0 0x401f82b8>;
		gpr = <0x400ac018 0x1c 0x0>;
	};
	/omit-if-no-ref/ iomuxc_gpio_sd_b0_02_xbar1_xbar_inout16: IOMUXC_GPIO_SD_B0_02_XBAR1_XBAR_INOUT16 {
		pinmux = <0x401f8144 7 0x401f84a8 0 0x401f82b8>;
		gpr = <0x400ac018 0x1c 0x0>;
	};
	/omit-if-no-ref/ iomuxc_gpio_sd_b0_03_enet_mdc: IOMUXC_GPIO_SD_B0_03_ENET_MDC {
		pinmux = <0x401f8148 6 0x0 0 0x401f82bc>;
	};
	/omit-if-no-ref/ iomuxc_gpio_sd_b0_03_gpio3_io16: IOMUXC_GPIO_SD_B0_03_GPIO3_IO16 {
		pinmux = <0x401f8148 5 0x0 0 0x401f82bc>;
	};
	/omit-if-no-ref/ iomuxc_gpio_sd_b0_03_lpspi1_pcs0: IOMUXC_GPIO_SD_B0_03_LPSPI1_PCS0 {
		pinmux = <0x401f8148 4 0x401f839c 0 0x401f82bc>;
	};
	/omit-if-no-ref/ iomuxc_gpio_sd_b0_03_lpuart7_rts_b: IOMUXC_GPIO_SD_B0_03_LPUART7_RTS_B {
		pinmux = <0x401f8148 2 0x0 0 0x401f82bc>;
	};
	/omit-if-no-ref/ iomuxc_gpio_sd_b0_03_qtimer1_timer3: IOMUXC_GPIO_SD_B0_03_QTIMER1_TIMER3 {
		pinmux = <0x401f8148 1 0x401f841c 0 0x401f82bc>;
		gpr = <0x400ac018 0x3 0x0>;
	};
	/omit-if-no-ref/ iomuxc_gpio_sd_b0_03_sai2_rx_data: IOMUXC_GPIO_SD_B0_03_SAI2_RX_DATA {
		pinmux = <0x401f8148 3 0x401f845c 0 0x401f82bc>;
	};
	/omit-if-no-ref/ iomuxc_gpio_sd_b0_03_usdhc1_clk: IOMUXC_GPIO_SD_B0_03_USDHC1_CLK {
		pinmux = <0x401f8148 0 0x0 0 0x401f82bc>;
	};
	/omit-if-no-ref/ iomuxc_gpio_sd_b0_04_flexcan2_tx: IOMUXC_GPIO_SD_B0_04_FLEXCAN2_TX {
		pinmux = <0x401f814c 1 0x0 0 0x401f82c0>;
	};
	/omit-if-no-ref/ iomuxc_gpio_sd_b0_04_flexspi_b_ss0_b: IOMUXC_GPIO_SD_B0_04_FLEXSPI_B_SS0_B {
		pinmux = <0x401f814c 6 0x0 0 0x401f82c0>;
	};
	/omit-if-no-ref/ iomuxc_gpio_sd_b0_04_gpio3_io17: IOMUXC_GPIO_SD_B0_04_GPIO3_IO17 {
		pinmux = <0x401f814c 5 0x0 0 0x401f82c0>;
	};
	/omit-if-no-ref/ iomuxc_gpio_sd_b0_04_lpspi1_sdo: IOMUXC_GPIO_SD_B0_04_LPSPI1_SDO {
		pinmux = <0x401f814c 4 0x401f83a8 0 0x401f82c0>;
	};
	/omit-if-no-ref/ iomuxc_gpio_sd_b0_04_lpuart7_tx: IOMUXC_GPIO_SD_B0_04_LPUART7_TX {
		pinmux = <0x401f814c 2 0x401f8400 0 0x401f82c0>;
	};
	/omit-if-no-ref/ iomuxc_gpio_sd_b0_04_sai2_tx_data: IOMUXC_GPIO_SD_B0_04_SAI2_TX_DATA {
		pinmux = <0x401f814c 3 0x0 0 0x401f82c0>;
	};
	/omit-if-no-ref/ iomuxc_gpio_sd_b0_04_usdhc1_data0: IOMUXC_GPIO_SD_B0_04_USDHC1_DATA0 {
		pinmux = <0x401f814c 0 0x0 0 0x401f82c0>;
	};
	/omit-if-no-ref/ iomuxc_gpio_sd_b0_05_flexcan2_rx: IOMUXC_GPIO_SD_B0_05_FLEXCAN2_RX {
		pinmux = <0x401f8150 1 0x401f8324 0 0x401f82c4>;
	};
	/omit-if-no-ref/ iomuxc_gpio_sd_b0_05_flexspi_b_dqs: IOMUXC_GPIO_SD_B0_05_FLEXSPI_B_DQS {
		pinmux = <0x401f8150 6 0x0 0 0x401f82c4>;
	};
	/omit-if-no-ref/ iomuxc_gpio_sd_b0_05_gpio3_io18: IOMUXC_GPIO_SD_B0_05_GPIO3_IO18 {
		pinmux = <0x401f8150 5 0x0 0 0x401f82c4>;
	};
	/omit-if-no-ref/ iomuxc_gpio_sd_b0_05_lpspi1_sdi: IOMUXC_GPIO_SD_B0_05_LPSPI1_SDI {
		pinmux = <0x401f8150 4 0x401f83a4 0 0x401f82c4>;
	};
	/omit-if-no-ref/ iomuxc_gpio_sd_b0_05_lpuart7_rx: IOMUXC_GPIO_SD_B0_05_LPUART7_RX {
		pinmux = <0x401f8150 2 0x401f83fc 0 0x401f82c4>;
	};
	/omit-if-no-ref/ iomuxc_gpio_sd_b0_05_sai2_tx_bclk: IOMUXC_GPIO_SD_B0_05_SAI2_TX_BCLK {
		pinmux = <0x401f8150 3 0x401f8464 0 0x401f82c4>;
	};
	/omit-if-no-ref/ iomuxc_gpio_sd_b0_05_usdhc1_data1: IOMUXC_GPIO_SD_B0_05_USDHC1_DATA1 {
		pinmux = <0x401f8150 0 0x0 0 0x401f82c4>;
	};
	/omit-if-no-ref/ iomuxc_gpio_sd_b0_06_gpio3_io19: IOMUXC_GPIO_SD_B0_06_GPIO3_IO19 {
		pinmux = <0x401f8154 5 0x0 0 0x401f82c8>;
	};
	/omit-if-no-ref/ iomuxc_gpio_sd_b0_06_ref_32k_out: IOMUXC_GPIO_SD_B0_06_REF_32K_OUT {
		pinmux = <0x401f8154 2 0x0 0 0x401f82c8>;
	};
	/omit-if-no-ref/ iomuxc_gpio_sd_b0_06_sai2_tx_sync: IOMUXC_GPIO_SD_B0_06_SAI2_TX_SYNC {
		pinmux = <0x401f8154 3 0x401f8468 0 0x401f82c8>;
	};
	/omit-if-no-ref/ iomuxc_gpio_sd_b0_06_usdhc1_cd_b: IOMUXC_GPIO_SD_B0_06_USDHC1_CD_B {
		pinmux = <0x401f8154 0 0x401f8490 0 0x401f82c8>;
	};
	/omit-if-no-ref/ iomuxc_gpio_sd_b0_06_usdhc1_reset_b: IOMUXC_GPIO_SD_B0_06_USDHC1_RESET_B {
		pinmux = <0x401f8154 1 0x0 0 0x401f82c8>;
	};
	/omit-if-no-ref/ iomuxc_gpio_sd_b0_06_wdog1_b: IOMUXC_GPIO_SD_B0_06_WDOG1_B {
		pinmux = <0x401f8154 4 0x0 0 0x401f82c8>;
	};
	/omit-if-no-ref/ iomuxc_gpio_sd_b0_06_xbar1_xbar_in17: IOMUXC_GPIO_SD_B0_06_XBAR1_XBAR_IN17 {
		pinmux = <0x401f8154 6 0x401f84ac 0 0x401f82c8>;
		gpr = <0x400ac018 0x1d 0x0>;
	};
	/omit-if-no-ref/ iomuxc_gpio_sd_b0_06_xbar1_xbar_inout17: IOMUXC_GPIO_SD_B0_06_XBAR1_XBAR_INOUT17 {
		pinmux = <0x401f8154 6 0x401f84ac 0 0x401f82c8>;
		gpr = <0x400ac018 0x1d 0x0>;
	};
	/omit-if-no-ref/ iomuxc_gpio_sd_b1_00_flexcan1_tx: IOMUXC_GPIO_SD_B1_00_FLEXCAN1_TX {
		pinmux = <0x401f8158 4 0x0 0 0x401f82cc>;
	};
	/omit-if-no-ref/ iomuxc_gpio_sd_b1_00_flexspi_b_data3: IOMUXC_GPIO_SD_B1_00_FLEXSPI_B_DATA3 {
		pinmux = <0x401f8158 1 0x0 0 0x401f82cc>;
	};
	/omit-if-no-ref/ iomuxc_gpio_sd_b1_00_gpio3_io20: IOMUXC_GPIO_SD_B1_00_GPIO3_IO20 {
		pinmux = <0x401f8158 5 0x0 0 0x401f82cc>;
	};
	/omit-if-no-ref/ iomuxc_gpio_sd_b1_00_lpuart6_tx: IOMUXC_GPIO_SD_B1_00_LPUART6_TX {
		pinmux = <0x401f8158 2 0x401f83f8 1 0x401f82cc>;
	};
	/omit-if-no-ref/ iomuxc_gpio_sd_b1_00_usdhc2_data2: IOMUXC_GPIO_SD_B1_00_USDHC2_DATA2 {
		pinmux = <0x401f8158 0 0x0 0 0x401f82cc>;
	};
	/omit-if-no-ref/ iomuxc_gpio_sd_b1_00_xbar1_xbar_in10: IOMUXC_GPIO_SD_B1_00_XBAR1_XBAR_IN10 {
		pinmux = <0x401f8158 3 0x401f84b0 1 0x401f82cc>;
		gpr = <0x400ac018 0x16 0x0>;
	};
	/omit-if-no-ref/ iomuxc_gpio_sd_b1_00_xbar1_xbar_inout10: IOMUXC_GPIO_SD_B1_00_XBAR1_XBAR_INOUT10 {
		pinmux = <0x401f8158 3 0x401f84b0 1 0x401f82cc>;
		gpr = <0x400ac018 0x16 0x0>;
	};
	/omit-if-no-ref/ iomuxc_gpio_sd_b1_01_flexcan1_rx: IOMUXC_GPIO_SD_B1_01_FLEXCAN1_RX {
		pinmux = <0x401f815c 4 0x401f8320 1 0x401f82d0>;
	};
	/omit-if-no-ref/ iomuxc_gpio_sd_b1_01_flexspi_a_ss1_b: IOMUXC_GPIO_SD_B1_01_FLEXSPI_A_SS1_B {
		pinmux = <0x401f815c 3 0x0 0 0x401f82d0>;
	};
	/omit-if-no-ref/ iomuxc_gpio_sd_b1_01_flexspi_b_sclk: IOMUXC_GPIO_SD_B1_01_FLEXSPI_B_SCLK {
		pinmux = <0x401f815c 1 0x0 0 0x401f82d0>;
	};
	/omit-if-no-ref/ iomuxc_gpio_sd_b1_01_gpio3_io21: IOMUXC_GPIO_SD_B1_01_GPIO3_IO21 {
		pinmux = <0x401f815c 5 0x0 0 0x401f82d0>;
	};
	/omit-if-no-ref/ iomuxc_gpio_sd_b1_01_lpuart6_rx: IOMUXC_GPIO_SD_B1_01_LPUART6_RX {
		pinmux = <0x401f815c 2 0x401f83f4 1 0x401f82d0>;
	};
	/omit-if-no-ref/ iomuxc_gpio_sd_b1_01_usdhc2_data3: IOMUXC_GPIO_SD_B1_01_USDHC2_DATA3 {
		pinmux = <0x401f815c 0 0x0 0 0x401f82d0>;
	};
	/omit-if-no-ref/ iomuxc_gpio_sd_b1_02_ccm_clko1: IOMUXC_GPIO_SD_B1_02_CCM_CLKO1 {
		pinmux = <0x401f8160 6 0x0 0 0x401f82d4>;
	};
	/omit-if-no-ref/ iomuxc_gpio_sd_b1_02_enet_1588_event1_out: IOMUXC_GPIO_SD_B1_02_ENET_1588_EVENT1_OUT {
		pinmux = <0x401f8160 4 0x0 0 0x401f82d4>;
	};
	/omit-if-no-ref/ iomuxc_gpio_sd_b1_02_flexspi_b_data0: IOMUXC_GPIO_SD_B1_02_FLEXSPI_B_DATA0 {
		pinmux = <0x401f8160 1 0x0 0 0x401f82d4>;
	};
	/omit-if-no-ref/ iomuxc_gpio_sd_b1_02_gpio3_io22: IOMUXC_GPIO_SD_B1_02_GPIO3_IO22 {
		pinmux = <0x401f8160 5 0x0 0 0x401f82d4>;
	};
	/omit-if-no-ref/ iomuxc_gpio_sd_b1_02_lpi2c4_scl: IOMUXC_GPIO_SD_B1_02_LPI2C4_SCL {
		pinmux = <0x401f8160 3 0x401f8394 1 0x401f82d4>;
	};
	/omit-if-no-ref/ iomuxc_gpio_sd_b1_02_lpuart8_tx: IOMUXC_GPIO_SD_B1_02_LPUART8_TX {
		pinmux = <0x401f8160 2 0x401f8408 0 0x401f82d4>;
	};
	/omit-if-no-ref/ iomuxc_gpio_sd_b1_02_usdhc2_cmd: IOMUXC_GPIO_SD_B1_02_USDHC2_CMD {
		pinmux = <0x401f8160 0 0x0 0 0x401f82d4>;
	};
	/omit-if-no-ref/ iomuxc_gpio_sd_b1_03_ccm_clko2: IOMUXC_GPIO_SD_B1_03_CCM_CLKO2 {
		pinmux = <0x401f8164 6 0x0 0 0x401f82d8>;
	};
	/omit-if-no-ref/ iomuxc_gpio_sd_b1_03_enet_1588_event1_in: IOMUXC_GPIO_SD_B1_03_ENET_1588_EVENT1_IN {
		pinmux = <0x401f8164 4 0x0 0 0x401f82d8>;
	};
	/omit-if-no-ref/ iomuxc_gpio_sd_b1_03_flexspi_b_data2: IOMUXC_GPIO_SD_B1_03_FLEXSPI_B_DATA2 {
		pinmux = <0x401f8164 1 0x0 0 0x401f82d8>;
	};
	/omit-if-no-ref/ iomuxc_gpio_sd_b1_03_gpio3_io23: IOMUXC_GPIO_SD_B1_03_GPIO3_IO23 {
		pinmux = <0x401f8164 5 0x0 0 0x401f82d8>;
	};
	/omit-if-no-ref/ iomuxc_gpio_sd_b1_03_lpi2c4_sda: IOMUXC_GPIO_SD_B1_03_LPI2C4_SDA {
		pinmux = <0x401f8164 3 0x401f8398 1 0x401f82d8>;
	};
	/omit-if-no-ref/ iomuxc_gpio_sd_b1_03_lpuart8_rx: IOMUXC_GPIO_SD_B1_03_LPUART8_RX {
		pinmux = <0x401f8164 2 0x401f8404 0 0x401f82d8>;
	};
	/omit-if-no-ref/ iomuxc_gpio_sd_b1_03_usdhc2_clk: IOMUXC_GPIO_SD_B1_03_USDHC2_CLK {
		pinmux = <0x401f8164 0 0x0 0 0x401f82d8>;
	};
	/omit-if-no-ref/ iomuxc_gpio_sd_b1_04_ccm_wait: IOMUXC_GPIO_SD_B1_04_CCM_WAIT {
		pinmux = <0x401f8168 6 0x0 0 0x401f82dc>;
	};
	/omit-if-no-ref/ iomuxc_gpio_sd_b1_04_enet_ref_clk: IOMUXC_GPIO_SD_B1_04_ENET_REF_CLK {
		pinmux = <0x401f8168 3 0x401f8304 0 0x401f82dc>;
	};
	/omit-if-no-ref/ iomuxc_gpio_sd_b1_04_enet_tx_clk: IOMUXC_GPIO_SD_B1_04_ENET_TX_CLK {
		pinmux = <0x401f8168 2 0x401f831c 0 0x401f82dc>;
	};
	/omit-if-no-ref/ iomuxc_gpio_sd_b1_04_ewm_out_b: IOMUXC_GPIO_SD_B1_04_EWM_OUT_B {
		pinmux = <0x401f8168 4 0x0 0 0x401f82dc>;
	};
	/omit-if-no-ref/ iomuxc_gpio_sd_b1_04_flexspi_b_data1: IOMUXC_GPIO_SD_B1_04_FLEXSPI_B_DATA1 {
		pinmux = <0x401f8168 1 0x0 0 0x401f82dc>;
	};
	/omit-if-no-ref/ iomuxc_gpio_sd_b1_04_gpio3_io24: IOMUXC_GPIO_SD_B1_04_GPIO3_IO24 {
		pinmux = <0x401f8168 5 0x0 0 0x401f82dc>;
	};
	/omit-if-no-ref/ iomuxc_gpio_sd_b1_04_usdhc2_data0: IOMUXC_GPIO_SD_B1_04_USDHC2_DATA0 {
		pinmux = <0x401f8168 0 0x0 0 0x401f82dc>;
	};
	/omit-if-no-ref/ iomuxc_gpio_sd_b1_05_ccm_pmic_rdy: IOMUXC_GPIO_SD_B1_05_CCM_PMIC_RDY {
		pinmux = <0x401f816c 6 0x401f8300 1 0x401f82e0>;
	};
	/omit-if-no-ref/ iomuxc_gpio_sd_b1_05_enet_rx_data1: IOMUXC_GPIO_SD_B1_05_ENET_RX_DATA1 {
		pinmux = <0x401f816c 2 0x401f8310 0 0x401f82e0>;
	};
	/omit-if-no-ref/ iomuxc_gpio_sd_b1_05_flexspi_a_dqs: IOMUXC_GPIO_SD_B1_05_FLEXSPI_A_DQS {
		pinmux = <0x401f816c 1 0x0 0 0x401f82e0>;
	};
	/omit-if-no-ref/ iomuxc_gpio_sd_b1_05_flexspi_b_ss0_b: IOMUXC_GPIO_SD_B1_05_FLEXSPI_B_SS0_B {
		pinmux = <0x401f816c 4 0x0 0 0x401f82e0>;
	};
	/omit-if-no-ref/ iomuxc_gpio_sd_b1_05_gpio3_io25: IOMUXC_GPIO_SD_B1_05_GPIO3_IO25 {
		pinmux = <0x401f816c 5 0x0 0 0x401f82e0>;
	};
	/omit-if-no-ref/ iomuxc_gpio_sd_b1_05_sai3_mclk: IOMUXC_GPIO_SD_B1_05_SAI3_MCLK {
		pinmux = <0x401f816c 3 0x401f846c 0 0x401f82e0>;
	};
	/omit-if-no-ref/ iomuxc_gpio_sd_b1_05_usdhc2_data1: IOMUXC_GPIO_SD_B1_05_USDHC2_DATA1 {
		pinmux = <0x401f816c 0 0x0 0 0x401f82e0>;
	};
	/omit-if-no-ref/ iomuxc_gpio_sd_b1_06_ccm_stop: IOMUXC_GPIO_SD_B1_06_CCM_STOP {
		pinmux = <0x401f8170 6 0x0 0 0x401f82e4>;
	};
	/omit-if-no-ref/ iomuxc_gpio_sd_b1_06_enet_rx_data0: IOMUXC_GPIO_SD_B1_06_ENET_RX_DATA0 {
		pinmux = <0x401f8170 2 0x401f830c 0 0x401f82e4>;
	};
	/omit-if-no-ref/ iomuxc_gpio_sd_b1_06_flexspi_a_data3: IOMUXC_GPIO_SD_B1_06_FLEXSPI_A_DATA3 {
		pinmux = <0x401f8170 1 0x401f8374 0 0x401f82e4>;
	};
	/omit-if-no-ref/ iomuxc_gpio_sd_b1_06_gpio3_io26: IOMUXC_GPIO_SD_B1_06_GPIO3_IO26 {
		pinmux = <0x401f8170 5 0x0 0 0x401f82e4>;
	};
	/omit-if-no-ref/ iomuxc_gpio_sd_b1_06_lpspi2_pcs0: IOMUXC_GPIO_SD_B1_06_LPSPI2_PCS0 {
		pinmux = <0x401f8170 4 0x401f83ac 2 0x401f82e4>;
	};
	/omit-if-no-ref/ iomuxc_gpio_sd_b1_06_sai3_tx_bclk: IOMUXC_GPIO_SD_B1_06_SAI3_TX_BCLK {
		pinmux = <0x401f8170 3 0x401f847c 0 0x401f82e4>;
	};
	/omit-if-no-ref/ iomuxc_gpio_sd_b1_06_usdhc2_cd_b: IOMUXC_GPIO_SD_B1_06_USDHC2_CD_B {
		pinmux = <0x401f8170 0 0x401f8498 0 0x401f82e4>;
	};
	/omit-if-no-ref/ iomuxc_gpio_sd_b1_07_enet_rx_en: IOMUXC_GPIO_SD_B1_07_ENET_RX_EN {
		pinmux = <0x401f8174 2 0x401f8314 0 0x401f82e8>;
	};
	/omit-if-no-ref/ iomuxc_gpio_sd_b1_07_flexspi_a_sclk: IOMUXC_GPIO_SD_B1_07_FLEXSPI_A_SCLK {
		pinmux = <0x401f8174 1 0x401f8378 0 0x401f82e8>;
	};
	/omit-if-no-ref/ iomuxc_gpio_sd_b1_07_gpio3_io27: IOMUXC_GPIO_SD_B1_07_GPIO3_IO27 {
		pinmux = <0x401f8174 5 0x0 0 0x401f82e8>;
	};
	/omit-if-no-ref/ iomuxc_gpio_sd_b1_07_lpspi2_sck: IOMUXC_GPIO_SD_B1_07_LPSPI2_SCK {
		pinmux = <0x401f8174 4 0x401f83b0 2 0x401f82e8>;
	};
	/omit-if-no-ref/ iomuxc_gpio_sd_b1_07_sai3_tx_sync: IOMUXC_GPIO_SD_B1_07_SAI3_TX_SYNC {
		pinmux = <0x401f8174 3 0x401f8480 0 0x401f82e8>;
	};
	/omit-if-no-ref/ iomuxc_gpio_sd_b1_07_usdhc2_reset_b: IOMUXC_GPIO_SD_B1_07_USDHC2_RESET_B {
		pinmux = <0x401f8174 0 0x0 0 0x401f82e8>;
	};
	/omit-if-no-ref/ iomuxc_gpio_sd_b1_08_enet_rx_er: IOMUXC_GPIO_SD_B1_08_ENET_RX_ER {
		pinmux = <0x401f8178 2 0x401f8318 0 0x401f82ec>;
	};
	/omit-if-no-ref/ iomuxc_gpio_sd_b1_08_flexspi_a_data0: IOMUXC_GPIO_SD_B1_08_FLEXSPI_A_DATA0 {
		pinmux = <0x401f8178 1 0x401f8368 0 0x401f82ec>;
	};
	/omit-if-no-ref/ iomuxc_gpio_sd_b1_08_gpio3_io28: IOMUXC_GPIO_SD_B1_08_GPIO3_IO28 {
		pinmux = <0x401f8178 5 0x0 0 0x401f82ec>;
	};
	/omit-if-no-ref/ iomuxc_gpio_sd_b1_08_lpspi2_sdo: IOMUXC_GPIO_SD_B1_08_LPSPI2_SDO {
		pinmux = <0x401f8178 4 0x401f83b8 2 0x401f82ec>;
	};
	/omit-if-no-ref/ iomuxc_gpio_sd_b1_08_sai3_tx_data: IOMUXC_GPIO_SD_B1_08_SAI3_TX_DATA {
		pinmux = <0x401f8178 3 0x0 0 0x401f82ec>;
	};
	/omit-if-no-ref/ iomuxc_gpio_sd_b1_08_usdhc2_data4: IOMUXC_GPIO_SD_B1_08_USDHC2_DATA4 {
		pinmux = <0x401f8178 0 0x0 0 0x401f82ec>;
	};
	/omit-if-no-ref/ iomuxc_gpio_sd_b1_09_enet_tx_en: IOMUXC_GPIO_SD_B1_09_ENET_TX_EN {
		pinmux = <0x401f817c 2 0x0 0 0x401f82f0>;
	};
	/omit-if-no-ref/ iomuxc_gpio_sd_b1_09_flexspi_a_data2: IOMUXC_GPIO_SD_B1_09_FLEXSPI_A_DATA2 {
		pinmux = <0x401f817c 1 0x401f8370 0 0x401f82f0>;
	};
	/omit-if-no-ref/ iomuxc_gpio_sd_b1_09_gpio3_io29: IOMUXC_GPIO_SD_B1_09_GPIO3_IO29 {
		pinmux = <0x401f817c 5 0x0 0 0x401f82f0>;
	};
	/omit-if-no-ref/ iomuxc_gpio_sd_b1_09_lpspi2_sdi: IOMUXC_GPIO_SD_B1_09_LPSPI2_SDI {
		pinmux = <0x401f817c 4 0x401f83b4 2 0x401f82f0>;
	};
	/omit-if-no-ref/ iomuxc_gpio_sd_b1_09_sai3_rx_bclk: IOMUXC_GPIO_SD_B1_09_SAI3_RX_BCLK {
		pinmux = <0x401f817c 3 0x401f8470 0 0x401f82f0>;
	};
	/omit-if-no-ref/ iomuxc_gpio_sd_b1_09_usdhc2_data5: IOMUXC_GPIO_SD_B1_09_USDHC2_DATA5 {
		pinmux = <0x401f817c 0 0x0 0 0x401f82f0>;
	};
	/omit-if-no-ref/ iomuxc_gpio_sd_b1_10_enet_tx_data0: IOMUXC_GPIO_SD_B1_10_ENET_TX_DATA0 {
		pinmux = <0x401f8180 2 0x0 0 0x401f82f4>;
	};
	/omit-if-no-ref/ iomuxc_gpio_sd_b1_10_flexspi_a_data1: IOMUXC_GPIO_SD_B1_10_FLEXSPI_A_DATA1 {
		pinmux = <0x401f8180 1 0x401f836c 0 0x401f82f4>;
	};
	/omit-if-no-ref/ iomuxc_gpio_sd_b1_10_gpio3_io30: IOMUXC_GPIO_SD_B1_10_GPIO3_IO30 {
		pinmux = <0x401f8180 5 0x0 0 0x401f82f4>;
	};
	/omit-if-no-ref/ iomuxc_gpio_sd_b1_10_lpspi2_pcs2: IOMUXC_GPIO_SD_B1_10_LPSPI2_PCS2 {
		pinmux = <0x401f8180 4 0x0 0 0x401f82f4>;
	};
	/omit-if-no-ref/ iomuxc_gpio_sd_b1_10_sai3_rx_sync: IOMUXC_GPIO_SD_B1_10_SAI3_RX_SYNC {
		pinmux = <0x401f8180 3 0x401f8478 0 0x401f82f4>;
	};
	/omit-if-no-ref/ iomuxc_gpio_sd_b1_10_usdhc2_data6: IOMUXC_GPIO_SD_B1_10_USDHC2_DATA6 {
		pinmux = <0x401f8180 0 0x0 0 0x401f82f4>;
	};
	/omit-if-no-ref/ iomuxc_gpio_sd_b1_11_enet_tx_data1: IOMUXC_GPIO_SD_B1_11_ENET_TX_DATA1 {
		pinmux = <0x401f8184 2 0x0 0 0x401f82f8>;
	};
	/omit-if-no-ref/ iomuxc_gpio_sd_b1_11_flexspi_a_ss0_b: IOMUXC_GPIO_SD_B1_11_FLEXSPI_A_SS0_B {
		pinmux = <0x401f8184 1 0x0 0 0x401f82f8>;
	};
	/omit-if-no-ref/ iomuxc_gpio_sd_b1_11_gpio3_io31: IOMUXC_GPIO_SD_B1_11_GPIO3_IO31 {
		pinmux = <0x401f8184 5 0x0 0 0x401f82f8>;
	};
	/omit-if-no-ref/ iomuxc_gpio_sd_b1_11_lpspi2_pcs3: IOMUXC_GPIO_SD_B1_11_LPSPI2_PCS3 {
		pinmux = <0x401f8184 4 0x0 0 0x401f82f8>;
	};
	/omit-if-no-ref/ iomuxc_gpio_sd_b1_11_sai3_rx_data: IOMUXC_GPIO_SD_B1_11_SAI3_RX_DATA {
		pinmux = <0x401f8184 3 0x401f8474 0 0x401f82f8>;
	};
	/omit-if-no-ref/ iomuxc_gpio_sd_b1_11_usdhc2_data7: IOMUXC_GPIO_SD_B1_11_USDHC2_DATA7 {
		pinmux = <0x401f8184 0 0x0 0 0x401f82f8>;
	};
	/omit-if-no-ref/ iomuxc_snvs_onoff_src_reset_b: IOMUXC_SNVS_ONOFF_SRC_RESET_B {
		pinmux = <0x0 0 0x0 0 0x400a8014>;
	};
	/omit-if-no-ref/ iomuxc_snvs_pmic_on_req_gpio5_io01: IOMUXC_SNVS_PMIC_ON_REQ_GPIO5_IO01 {
		pinmux = <0x400a8004 5 0x0 0 0x400a801c>;
	};
	/omit-if-no-ref/ iomuxc_snvs_pmic_on_req_snvs_pmic_on_req: IOMUXC_SNVS_PMIC_ON_REQ_SNVS_PMIC_ON_REQ {
		pinmux = <0x400a8004 0 0x0 0 0x400a801c>;
	};
	/omit-if-no-ref/ iomuxc_snvs_pmic_stby_req_ccm_pmic_vstby_req: IOMUXC_SNVS_PMIC_STBY_REQ_CCM_PMIC_VSTBY_REQ {
		pinmux = <0x400a8008 0 0x0 0 0x400a8020>;
	};
	/omit-if-no-ref/ iomuxc_snvs_pmic_stby_req_gpio5_io02: IOMUXC_SNVS_PMIC_STBY_REQ_GPIO5_IO02 {
		pinmux = <0x400a8008 5 0x0 0 0x400a8020>;
	};
	/omit-if-no-ref/ iomuxc_snvs_por_b_src_por_b: IOMUXC_SNVS_POR_B_SRC_POR_B {
		pinmux = <0x0 0 0x0 0 0x400a8010>;
	};
	/omit-if-no-ref/ iomuxc_snvs_test_mode_test_mode: IOMUXC_SNVS_TEST_MODE_TEST_MODE {
		pinmux = <0x0 0 0x0 0 0x400a800c>;
	};
	/omit-if-no-ref/ iomuxc_snvs_wakeup_arm_nmi: IOMUXC_SNVS_WAKEUP_ARM_NMI {
		pinmux = <0x400a8000 7 0x401f840c 1 0x400a8018>;
	};
	/omit-if-no-ref/ iomuxc_snvs_wakeup_gpio5_io00: IOMUXC_SNVS_WAKEUP_GPIO5_IO00 {
		pinmux = <0x400a8000 5 0x0 0 0x400a8018>;
	};
};
