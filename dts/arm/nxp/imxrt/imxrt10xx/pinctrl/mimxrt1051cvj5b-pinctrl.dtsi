/*
 * Copyright (c) 2023, Centralp
 * SPDX-License-Identifier: Apache-2.0
 *
 * Note: File generated by imx_cfg_utils.py
 * from configuration data for MIMXRT1051CVJ5B
 */

/*
 * Content deduplicated by dedup_pinctrl.py:
 * the pin mux data of this part is identical to mimxrt1051dvj6b-pinctrl.dtsi.
 * Do not edit; edit the canonical file instead.
 * target-hash: 2463287a5c6ea99b
 */

#include "mimxrt1051dvj6b-pinctrl.dtsi"
