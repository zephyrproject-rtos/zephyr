/*
 * Copyright 2026, NXP
 * SPDX-License-Identifier: Apache-2.0
 *
 * Note: File generated by gen_soc_headers.py
 * from configuration data for MIMXRT1041XJM5B
 */

/*
 * Content deduplicated by dedup_pinctrl.py:
 * the pin mux data of this part is identical to mimxrt1041dfp6b-pinctrl.dtsi.
 * Do not edit; edit the canonical file instead.
 * target-hash: 06b51d63fdcd00d3
 */

#include "mimxrt1041dfp6b-pinctrl.dtsi"
