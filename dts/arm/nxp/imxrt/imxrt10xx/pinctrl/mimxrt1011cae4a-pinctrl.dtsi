/*
 * Copyright (c) 2022, NXP
 * SPDX-License-Identifier: Apache-2.0
 *
 * Note: File generated by rt_cfg_utils.py
 * from configuration data for MIMXRT1011CAE4A
 */

/*
 * Content deduplicated by dedup_pinctrl.py:
 * the pin mux data of this part is identical to mimxrt1011dae5a-pinctrl.dtsi.
 * Do not edit; edit the canonical file instead.
 * target-hash: ccab6e234cb53e76
 */

#include "mimxrt1011dae5a-pinctrl.dtsi"
