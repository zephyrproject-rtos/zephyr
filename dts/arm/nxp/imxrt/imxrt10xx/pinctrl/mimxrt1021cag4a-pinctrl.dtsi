/*
 * Copyright (c) 2022, NXP
 * SPDX-License-Identifier: Apache-2.0
 *
 * Note: File generated by rt_cfg_utils.py
 * from configuration data for MIMXRT1021CAG4A
 */

/*
 * Content deduplicated by dedup_pinctrl.py:
 * the pin mux data of this part is identical to mimxrt1021dag5a-pinctrl.dtsi.
 * Do not edit; edit the canonical file instead.
 * target-hash: e98203c10992def1
 */

#include "mimxrt1021dag5a-pinctrl.dtsi"
