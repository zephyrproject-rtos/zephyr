/*
 * Copyright 2024, NXP
 * SPDX-License-Identifier: Apache-2.0
 *
 * Note: File generated by gen_soc_headers.py
 * from configuration data for MIMXRT1064DVL6B
 */

/*
 * Content deduplicated by dedup_pinctrl.py:
 * the pin mux data of this part is identical to mimxrt1064dvj6b-pinctrl.dtsi.
 * Do not edit; edit the canonical file instead.
 * target-hash: 241ec03dc1aadff4
 */

#include "mimxrt1064dvj6b-pinctrl.dtsi"
