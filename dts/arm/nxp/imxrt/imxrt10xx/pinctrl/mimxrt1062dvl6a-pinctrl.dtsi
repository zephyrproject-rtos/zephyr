/*
 * Copyright (c) 2022, NXP
 * SPDX-License-Identifier: Apache-2.0
 *
 * Note: File generated by rt_cfg_utils.py
 * from configuration data for MIMXRT1062DVL6A
 */

/*
 * Content deduplicated by dedup_pinctrl.py:
 * the pin mux data of this part is identical to mimxrt1062dvj6a-pinctrl.dtsi.
 * Do not edit; edit the canonical file instead.
 * target-hash: 84c4aea164f9571a
 */

#include "mimxrt1062dvj6a-pinctrl.dtsi"
