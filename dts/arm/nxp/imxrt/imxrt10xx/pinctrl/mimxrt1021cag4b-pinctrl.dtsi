/*
 * Copyright 2024, NXP
 * SPDX-License-Identifier: Apache-2.0
 *
 * Note: File generated by gen_soc_headers.py
 * from configuration data for MIMXRT1021CAG4B
 */

/*
 * Content deduplicated by dedup_pinctrl.py:
 * the pin mux data of this part is identical to mimxrt1021dag5b-pinctrl.dtsi.
 * Do not edit; edit the canonical file instead.
 * target-hash: 05beb11f33cfdff0
 */

#include "mimxrt1021dag5b-pinctrl.dtsi"
