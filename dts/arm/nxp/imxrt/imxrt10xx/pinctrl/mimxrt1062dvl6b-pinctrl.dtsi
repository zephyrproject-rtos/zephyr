/*
 * Copyright 2023, NXP
 * SPDX-License-Identifier: Apache-2.0
 *
 * Note: File generated by imx_cfg_utils.py
 * from configuration data for MIMXRT1062DVL6B
 */

/*
 * Content deduplicated by dedup_pinctrl.py:
 * the pin mux data of this part is identical to mimxrt1062dvj6b-pinctrl.dtsi.
 * Do not edit; edit the canonical file instead.
 * target-hash: 291a959afd3e1de3
 */

#include "mimxrt1062dvj6b-pinctrl.dtsi"
