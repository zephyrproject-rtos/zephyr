/*
 * Copyright 2024, NXP
 * SPDX-License-Identifier: Apache-2.0
 *
 * Note: File generated by gen_soc_headers.py
 * from configuration data for MIMXRT1015DAF5B
 */

/*
 * SOC level pinctrl definitions
 * These definitions define SOC level defaults for each pin,
 * and select the pinmux for the pin. Pinmux entries are a tuple of:
 * <mux_register mux_mode input_register input_daisy config_register>
 * the mux_register and input_daisy reside in the IOMUXC peripheral, and
 * the pinctrl driver will write the mux_mode and input_daisy values into
 * each register, respectively. The config_register is used to configure
 * the pin based on the devicetree properties set
 */

&iomuxc {
	/omit-if-no-ref/ iomuxc_gpio_ad_b0_00_gpio1_io00: IOMUXC_GPIO_AD_B0_00_GPIO1_IO00 {
		pinmux = <0x401f80bc 5 0x0 0 0x401f8230>;
	};

	/omit-if-no-ref/ iomuxc_gpio_ad_b0_00_gpt1_compare1: IOMUXC_GPIO_AD_B0_00_GPT1_COMPARE1 {
		pinmux = <0x401f80bc 7 0x0 0 0x401f8230>;
	};

	/omit-if-no-ref/ iomuxc_gpio_ad_b0_00_jtag_tms: IOMUXC_GPIO_AD_B0_00_JTAG_TMS {
		pinmux = <0x401f80bc 0 0x0 0 0x401f8230>;
	};

	/omit-if-no-ref/ iomuxc_gpio_ad_b0_01_gpio1_io01: IOMUXC_GPIO_AD_B0_01_GPIO1_IO01 {
		pinmux = <0x401f80c0 5 0x0 0 0x401f8234>;
	};

	/omit-if-no-ref/ iomuxc_gpio_ad_b0_01_gpt1_capture2: IOMUXC_GPIO_AD_B0_01_GPT1_CAPTURE2 {
		pinmux = <0x401f80c0 7 0x0 0 0x401f8234>;
	};

	/omit-if-no-ref/ iomuxc_gpio_ad_b0_01_jtag_tck: IOMUXC_GPIO_AD_B0_01_JTAG_TCK {
		pinmux = <0x401f80c0 0 0x0 0 0x401f8234>;
	};

	/omit-if-no-ref/ iomuxc_gpio_ad_b0_02_gpio1_io02: IOMUXC_GPIO_AD_B0_02_GPIO1_IO02 {
		pinmux = <0x401f80c4 5 0x0 0 0x401f8238>;
	};

	/omit-if-no-ref/ iomuxc_gpio_ad_b0_02_gpt1_capture1: IOMUXC_GPIO_AD_B0_02_GPT1_CAPTURE1 {
		pinmux = <0x401f80c4 7 0x0 0 0x401f8238>;
	};

	/omit-if-no-ref/ iomuxc_gpio_ad_b0_02_jtag_mod: IOMUXC_GPIO_AD_B0_02_JTAG_MOD {
		pinmux = <0x401f80c4 0 0x0 0 0x401f8238>;
	};

	/omit-if-no-ref/ iomuxc_gpio_ad_b0_03_ccm_pmic_rdy: IOMUXC_GPIO_AD_B0_03_CCM_PMIC_RDY {
		pinmux = <0x401f80c8 7 0x401f8300 2 0x401f823c>;
	};

	/omit-if-no-ref/ iomuxc_gpio_ad_b0_03_gpio1_io03: IOMUXC_GPIO_AD_B0_03_GPIO1_IO03 {
		pinmux = <0x401f80c8 5 0x0 0 0x401f823c>;
	};

	/omit-if-no-ref/ iomuxc_gpio_ad_b0_03_jtag_tdi: IOMUXC_GPIO_AD_B0_03_JTAG_TDI {
		pinmux = <0x401f80c8 0 0x0 0 0x401f823c>;
	};

	/omit-if-no-ref/ iomuxc_gpio_ad_b0_03_sai1_mclk: IOMUXC_GPIO_AD_B0_03_SAI1_MCLK {
		pinmux = <0x401f80c8 3 0x401f8430 1 0x401f823c>;
	};

	/omit-if-no-ref/ iomuxc_gpio_ad_b0_03_usb_otg1_oc: IOMUXC_GPIO_AD_B0_03_USB_OTG1_OC {
		pinmux = <0x401f80c8 6 0x401f848c 0 0x401f823c>;
	};

	/omit-if-no-ref/ iomuxc_gpio_ad_b0_03_wdog1_b: IOMUXC_GPIO_AD_B0_03_WDOG1_B {
		pinmux = <0x401f80c8 2 0x0 0 0x401f823c>;
	};

	/omit-if-no-ref/ iomuxc_gpio_ad_b0_04_ewm_out_b: IOMUXC_GPIO_AD_B0_04_EWM_OUT_B {
		pinmux = <0x401f80cc 7 0x0 0 0x401f8240>;
	};

	/omit-if-no-ref/ iomuxc_gpio_ad_b0_04_gpio1_io04: IOMUXC_GPIO_AD_B0_04_GPIO1_IO04 {
		pinmux = <0x401f80cc 5 0x0 0 0x401f8240>;
	};

	/omit-if-no-ref/ iomuxc_gpio_ad_b0_04_jtag_tdo: IOMUXC_GPIO_AD_B0_04_JTAG_TDO {
		pinmux = <0x401f80cc 0 0x0 0 0x401f8240>;
	};

	/omit-if-no-ref/ iomuxc_gpio_ad_b0_04_usb_otg1_pwr: IOMUXC_GPIO_AD_B0_04_USB_OTG1_PWR {
		pinmux = <0x401f80cc 6 0x0 0 0x401f8240>;
	};

	/omit-if-no-ref/ iomuxc_gpio_ad_b0_05_arm_nmi: IOMUXC_GPIO_AD_B0_05_ARM_NMI {
		pinmux = <0x401f80d0 7 0x401f840c 0 0x401f8244>;
	};

	/omit-if-no-ref/ iomuxc_gpio_ad_b0_05_gpio1_io05: IOMUXC_GPIO_AD_B0_05_GPIO1_IO05 {
		pinmux = <0x401f80d0 5 0x0 0 0x401f8244>;
	};

	/omit-if-no-ref/ iomuxc_gpio_ad_b0_05_jtag_trstb: IOMUXC_GPIO_AD_B0_05_JTAG_TRSTB {
		pinmux = <0x401f80d0 0 0x0 0 0x401f8244>;
	};

	/omit-if-no-ref/ iomuxc_gpio_ad_b0_05_usb_otg1_id: IOMUXC_GPIO_AD_B0_05_USB_OTG1_ID {
		pinmux = <0x401f80d0 6 0x401f82fc 0 0x401f8244>;
	};

	/omit-if-no-ref/ iomuxc_gpio_ad_b0_06_gpio1_io06: IOMUXC_GPIO_AD_B0_06_GPIO1_IO06 {
		pinmux = <0x401f80d4 5 0x0 0 0x401f8248>;
	};

	/omit-if-no-ref/ iomuxc_gpio_ad_b0_06_lpuart1_tx: IOMUXC_GPIO_AD_B0_06_LPUART1_TX {
		pinmux = <0x401f80d4 2 0x0 0 0x401f8248>;
	};

	/omit-if-no-ref/ iomuxc_gpio_ad_b0_06_mqs_right: IOMUXC_GPIO_AD_B0_06_MQS_RIGHT {
		pinmux = <0x401f80d4 1 0x0 0 0x401f8248>;
	};

	/omit-if-no-ref/ iomuxc_gpio_ad_b0_06_pit_trigger0: IOMUXC_GPIO_AD_B0_06_PIT_TRIGGER0 {
		pinmux = <0x401f80d4 0 0x0 0 0x401f8248>;
	};

	/omit-if-no-ref/ iomuxc_gpio_ad_b0_06_ref_32k_out: IOMUXC_GPIO_AD_B0_06_REF_32K_OUT {
		pinmux = <0x401f80d4 6 0x0 0 0x401f8248>;
	};

	/omit-if-no-ref/ iomuxc_gpio_ad_b0_07_gpio1_io07: IOMUXC_GPIO_AD_B0_07_GPIO1_IO07 {
		pinmux = <0x401f80d8 5 0x0 0 0x401f824c>;
	};

	/omit-if-no-ref/ iomuxc_gpio_ad_b0_07_lpuart1_rx: IOMUXC_GPIO_AD_B0_07_LPUART1_RX {
		pinmux = <0x401f80d8 2 0x0 0 0x401f824c>;
	};

	/omit-if-no-ref/ iomuxc_gpio_ad_b0_07_mqs_left: IOMUXC_GPIO_AD_B0_07_MQS_LEFT {
		pinmux = <0x401f80d8 1 0x0 0 0x401f824c>;
	};

	/omit-if-no-ref/ iomuxc_gpio_ad_b0_07_pit_trigger1: IOMUXC_GPIO_AD_B0_07_PIT_TRIGGER1 {
		pinmux = <0x401f80d8 0 0x0 0 0x401f824c>;
	};

	/omit-if-no-ref/ iomuxc_gpio_ad_b0_07_ref_24m_out: IOMUXC_GPIO_AD_B0_07_REF_24M_OUT {
		pinmux = <0x401f80d8 6 0x0 0 0x401f824c>;
	};

	/omit-if-no-ref/ iomuxc_gpio_ad_b0_08_arm_cm7_txev: IOMUXC_GPIO_AD_B0_08_ARM_CM7_TXEV {
		pinmux = <0x401f80dc 6 0x0 0 0x401f8250>;
	};

	/omit-if-no-ref/ iomuxc_gpio_ad_b0_08_gpio1_io08: IOMUXC_GPIO_AD_B0_08_GPIO1_IO08 {
		pinmux = <0x401f80dc 5 0x0 0 0x401f8250>;
	};

	/omit-if-no-ref/ iomuxc_gpio_ad_b0_08_kpp_col0: IOMUXC_GPIO_AD_B0_08_KPP_COL0 {
		pinmux = <0x401f80dc 3 0x0 0 0x401f8250>;
	};

	/omit-if-no-ref/ iomuxc_gpio_ad_b0_08_lpuart1_cts_b: IOMUXC_GPIO_AD_B0_08_LPUART1_CTS_B {
		pinmux = <0x401f80dc 2 0x0 0 0x401f8250>;
	};

	/omit-if-no-ref/ iomuxc_gpio_ad_b0_09_arm_cm7_rxev: IOMUXC_GPIO_AD_B0_09_ARM_CM7_RXEV {
		pinmux = <0x401f80e0 6 0x0 0 0x401f8254>;
	};

	/omit-if-no-ref/ iomuxc_gpio_ad_b0_09_gpio1_io09: IOMUXC_GPIO_AD_B0_09_GPIO1_IO09 {
		pinmux = <0x401f80e0 5 0x0 0 0x401f8254>;
	};

	/omit-if-no-ref/ iomuxc_gpio_ad_b0_09_kpp_row0: IOMUXC_GPIO_AD_B0_09_KPP_ROW0 {
		pinmux = <0x401f80e0 3 0x0 0 0x401f8254>;
	};

	/omit-if-no-ref/ iomuxc_gpio_ad_b0_09_lpuart1_rts_b: IOMUXC_GPIO_AD_B0_09_LPUART1_RTS_B {
		pinmux = <0x401f80e0 2 0x0 0 0x401f8254>;
	};

	/omit-if-no-ref/ iomuxc_gpio_ad_b0_10_arm_trace_clk: IOMUXC_GPIO_AD_B0_10_ARM_TRACE_CLK {
		pinmux = <0x401f80e4 6 0x0 0 0x401f8258>;
	};

	/omit-if-no-ref/ iomuxc_gpio_ad_b0_10_gpio1_io10: IOMUXC_GPIO_AD_B0_10_GPIO1_IO10 {
		pinmux = <0x401f80e4 5 0x0 0 0x401f8258>;
	};

	/omit-if-no-ref/ iomuxc_gpio_ad_b0_10_kpp_col1: IOMUXC_GPIO_AD_B0_10_KPP_COL1 {
		pinmux = <0x401f80e4 3 0x0 0 0x401f8258>;
	};

	/omit-if-no-ref/ iomuxc_gpio_ad_b0_10_lpspi1_sck: IOMUXC_GPIO_AD_B0_10_LPSPI1_SCK {
		pinmux = <0x401f80e4 1 0x401f83a0 1 0x401f8258>;
	};

	/omit-if-no-ref/ iomuxc_gpio_ad_b0_11_arm_trace_swo: IOMUXC_GPIO_AD_B0_11_ARM_TRACE_SWO {
		pinmux = <0x401f80e8 6 0x0 0 0x401f825c>;
	};

	/omit-if-no-ref/ iomuxc_gpio_ad_b0_11_gpio1_io11: IOMUXC_GPIO_AD_B0_11_GPIO1_IO11 {
		pinmux = <0x401f80e8 5 0x0 0 0x401f825c>;
	};

	/omit-if-no-ref/ iomuxc_gpio_ad_b0_11_kpp_row1: IOMUXC_GPIO_AD_B0_11_KPP_ROW1 {
		pinmux = <0x401f80e8 3 0x0 0 0x401f825c>;
	};

	/omit-if-no-ref/ iomuxc_gpio_ad_b0_11_lpspi1_pcs0: IOMUXC_GPIO_AD_B0_11_LPSPI1_PCS0 {
		pinmux = <0x401f80e8 1 0x401f839c 1 0x401f825c>;
	};

	/omit-if-no-ref/ iomuxc_gpio_ad_b0_12_adc1_in0: IOMUXC_GPIO_AD_B0_12_ADC1_IN0 {
		pinmux = <0x401f80ec 5 0x0 0 0x401f8260>;
	};

	/omit-if-no-ref/ iomuxc_gpio_ad_b0_12_arm_trace0: IOMUXC_GPIO_AD_B0_12_ARM_TRACE0 {
		pinmux = <0x401f80ec 6 0x0 0 0x401f8260>;
	};

	/omit-if-no-ref/ iomuxc_gpio_ad_b0_12_gpio1_io12: IOMUXC_GPIO_AD_B0_12_GPIO1_IO12 {
		pinmux = <0x401f80ec 5 0x0 0 0x401f8260>;
	};

	/omit-if-no-ref/ iomuxc_gpio_ad_b0_12_kpp_col2: IOMUXC_GPIO_AD_B0_12_KPP_COL2 {
		pinmux = <0x401f80ec 3 0x0 0 0x401f8260>;
	};

	/omit-if-no-ref/ iomuxc_gpio_ad_b0_12_lpspi1_sdo: IOMUXC_GPIO_AD_B0_12_LPSPI1_SDO {
		pinmux = <0x401f80ec 1 0x401f83a8 1 0x401f8260>;
	};

	/omit-if-no-ref/ iomuxc_gpio_ad_b0_12_lpuart3_cts_b: IOMUXC_GPIO_AD_B0_12_LPUART3_CTS_B {
		pinmux = <0x401f80ec 2 0x0 0 0x401f8260>;
	};

	/omit-if-no-ref/ iomuxc_gpio_ad_b0_12_snvs_vio_5_ctl: IOMUXC_GPIO_AD_B0_12_SNVS_VIO_5_CTL {
		pinmux = <0x401f80ec 7 0x0 0 0x401f8260>;
	};

	/omit-if-no-ref/ iomuxc_gpio_ad_b0_13_arm_trace1: IOMUXC_GPIO_AD_B0_13_ARM_TRACE1 {
		pinmux = <0x401f80f0 6 0x0 0 0x401f8264>;
	};

	/omit-if-no-ref/ iomuxc_gpio_ad_b0_13_gpio1_io13: IOMUXC_GPIO_AD_B0_13_GPIO1_IO13 {
		pinmux = <0x401f80f0 5 0x0 0 0x401f8264>;
	};

	/omit-if-no-ref/ iomuxc_gpio_ad_b0_13_kpp_row2: IOMUXC_GPIO_AD_B0_13_KPP_ROW2 {
		pinmux = <0x401f80f0 3 0x0 0 0x401f8264>;
	};

	/omit-if-no-ref/ iomuxc_gpio_ad_b0_13_lpspi1_sdi: IOMUXC_GPIO_AD_B0_13_LPSPI1_SDI {
		pinmux = <0x401f80f0 1 0x401f83a4 1 0x401f8264>;
	};

	/omit-if-no-ref/ iomuxc_gpio_ad_b0_13_lpuart3_rts_b: IOMUXC_GPIO_AD_B0_13_LPUART3_RTS_B {
		pinmux = <0x401f80f0 2 0x0 0 0x401f8264>;
	};

	/omit-if-no-ref/ iomuxc_gpio_ad_b0_13_snvs_vio_5_b: IOMUXC_GPIO_AD_B0_13_SNVS_VIO_5_B {
		pinmux = <0x401f80f0 7 0x0 0 0x401f8264>;
	};

	/omit-if-no-ref/ iomuxc_gpio_ad_b0_14_adc1_in1: IOMUXC_GPIO_AD_B0_14_ADC1_IN1 {
		pinmux = <0x401f80f4 5 0x0 0 0x401f8268>;
	};

	/omit-if-no-ref/ iomuxc_gpio_ad_b0_14_arm_trace2: IOMUXC_GPIO_AD_B0_14_ARM_TRACE2 {
		pinmux = <0x401f80f4 6 0x0 0 0x401f8268>;
	};

	/omit-if-no-ref/ iomuxc_gpio_ad_b0_14_gpio1_io14: IOMUXC_GPIO_AD_B0_14_GPIO1_IO14 {
		pinmux = <0x401f80f4 5 0x0 0 0x401f8268>;
	};

	/omit-if-no-ref/ iomuxc_gpio_ad_b0_14_kpp_col3: IOMUXC_GPIO_AD_B0_14_KPP_COL3 {
		pinmux = <0x401f80f4 3 0x0 0 0x401f8268>;
	};

	/omit-if-no-ref/ iomuxc_gpio_ad_b0_14_lpuart3_tx: IOMUXC_GPIO_AD_B0_14_LPUART3_TX {
		pinmux = <0x401f80f4 2 0x401f83dc 1 0x401f8268>;
	};

	/omit-if-no-ref/ iomuxc_gpio_ad_b0_14_wdog1_any: IOMUXC_GPIO_AD_B0_14_WDOG1_ANY {
		pinmux = <0x401f80f4 7 0x0 0 0x401f8268>;
	};

	/omit-if-no-ref/ iomuxc_gpio_ad_b0_15_adc1_in2: IOMUXC_GPIO_AD_B0_15_ADC1_IN2 {
		pinmux = <0x401f80f8 5 0x0 0 0x401f826c>;
	};

	/omit-if-no-ref/ iomuxc_gpio_ad_b0_15_arm_trace3: IOMUXC_GPIO_AD_B0_15_ARM_TRACE3 {
		pinmux = <0x401f80f8 6 0x0 0 0x401f826c>;
	};

	/omit-if-no-ref/ iomuxc_gpio_ad_b0_15_gpio1_io15: IOMUXC_GPIO_AD_B0_15_GPIO1_IO15 {
		pinmux = <0x401f80f8 5 0x0 0 0x401f826c>;
	};

	/omit-if-no-ref/ iomuxc_gpio_ad_b0_15_kpp_row3: IOMUXC_GPIO_AD_B0_15_KPP_ROW3 {
		pinmux = <0x401f80f8 3 0x0 0 0x401f826c>;
	};

	/omit-if-no-ref/ iomuxc_gpio_ad_b0_15_lpuart3_rx: IOMUXC_GPIO_AD_B0_15_LPUART3_RX {
		pinmux = <0x401f80f8 2 0x401f83d8 1 0x401f826c>;
	};

	/omit-if-no-ref/ iomuxc_gpio_ad_b1_10_adc1_in10: IOMUXC_GPIO_AD_B1_10_ADC1_IN10 {
		pinmux = <0x401f8124 5 0x0 0 0x401f8298>;
	};

	/omit-if-no-ref/ iomuxc_gpio_ad_b1_10_flexio1_flexio05:
	IOMUXC_GPIO_AD_B1_10_FLEXIO1_FLEXIO05 {
		pinmux = <0x401f8124 4 0x0 0 0x401f8298>;
	};

	/omit-if-no-ref/ iomuxc_gpio_ad_b1_10_flexpwm1_pwma2: IOMUXC_GPIO_AD_B1_10_FLEXPWM1_PWMA2 {
		pinmux = <0x401f8124 1 0x401f8330 0 0x401f8298>;
	};

	/omit-if-no-ref/ iomuxc_gpio_ad_b1_10_gpio1_io26: IOMUXC_GPIO_AD_B1_10_GPIO1_IO26 {
		pinmux = <0x401f8124 5 0x0 0 0x401f8298>;
	};

	/omit-if-no-ref/ iomuxc_gpio_ad_b1_10_gpt2_capture1: IOMUXC_GPIO_AD_B1_10_GPT2_CAPTURE1 {
		pinmux = <0x401f8124 6 0x0 0 0x401f8298>;
	};

	/omit-if-no-ref/ iomuxc_gpio_ad_b1_10_lpuart4_tx: IOMUXC_GPIO_AD_B1_10_LPUART4_TX {
		pinmux = <0x401f8124 2 0x401f83e8 1 0x401f8298>;
	};

	/omit-if-no-ref/ iomuxc_gpio_ad_b1_10_usb_otg1_pwr: IOMUXC_GPIO_AD_B1_10_USB_OTG1_PWR {
		pinmux = <0x401f8124 0 0x0 0 0x401f8298>;
	};

	/omit-if-no-ref/ iomuxc_gpio_ad_b1_11_adc1_in11: IOMUXC_GPIO_AD_B1_11_ADC1_IN11 {
		pinmux = <0x401f8128 5 0x0 0 0x401f829c>;
	};

	/omit-if-no-ref/ iomuxc_gpio_ad_b1_11_flexio1_flexio04:
	IOMUXC_GPIO_AD_B1_11_FLEXIO1_FLEXIO04 {
		pinmux = <0x401f8128 4 0x0 0 0x401f829c>;
	};

	/omit-if-no-ref/ iomuxc_gpio_ad_b1_11_flexpwm1_pwmb2: IOMUXC_GPIO_AD_B1_11_FLEXPWM1_PWMB2 {
		pinmux = <0x401f8128 1 0x401f8340 0 0x401f829c>;
	};

	/omit-if-no-ref/ iomuxc_gpio_ad_b1_11_gpio1_io27: IOMUXC_GPIO_AD_B1_11_GPIO1_IO27 {
		pinmux = <0x401f8128 5 0x0 0 0x401f829c>;
	};

	/omit-if-no-ref/ iomuxc_gpio_ad_b1_11_gpt2_compare1: IOMUXC_GPIO_AD_B1_11_GPT2_COMPARE1 {
		pinmux = <0x401f8128 6 0x0 0 0x401f829c>;
	};

	/omit-if-no-ref/ iomuxc_gpio_ad_b1_11_lpuart4_rx: IOMUXC_GPIO_AD_B1_11_LPUART4_RX {
		pinmux = <0x401f8128 2 0x401f83e4 1 0x401f829c>;
	};

	/omit-if-no-ref/ iomuxc_gpio_ad_b1_11_usb_otg1_id: IOMUXC_GPIO_AD_B1_11_USB_OTG1_ID {
		pinmux = <0x401f8128 0 0x401f82fc 1 0x401f829c>;
	};

	/omit-if-no-ref/ iomuxc_gpio_ad_b1_12_adc1_in12: IOMUXC_GPIO_AD_B1_12_ADC1_IN12 {
		pinmux = <0x401f812c 5 0x0 0 0x401f82a0>;
	};

	/omit-if-no-ref/ iomuxc_gpio_ad_b1_12_flexio1_flexio03:
	IOMUXC_GPIO_AD_B1_12_FLEXIO1_FLEXIO03 {
		pinmux = <0x401f812c 4 0x0 0 0x401f82a0>;
	};

	/omit-if-no-ref/ iomuxc_gpio_ad_b1_12_flexpwm1_pwma3: IOMUXC_GPIO_AD_B1_12_FLEXPWM1_PWMA3 {
		pinmux = <0x401f812c 6 0x401f8334 0 0x401f82a0>;
	};

	/omit-if-no-ref/ iomuxc_gpio_ad_b1_12_gpio1_io28: IOMUXC_GPIO_AD_B1_12_GPIO1_IO28 {
		pinmux = <0x401f812c 5 0x0 0 0x401f82a0>;
	};

	/omit-if-no-ref/ iomuxc_gpio_ad_b1_12_usb_otg1_oc: IOMUXC_GPIO_AD_B1_12_USB_OTG1_OC {
		pinmux = <0x401f812c 0 0x401f848c 1 0x401f82a0>;
	};

	/omit-if-no-ref/ iomuxc_gpio_ad_b1_13_adc1_in13: IOMUXC_GPIO_AD_B1_13_ADC1_IN13 {
		pinmux = <0x401f8130 5 0x0 0 0x401f82a4>;
	};

	/omit-if-no-ref/ iomuxc_gpio_ad_b1_13_flexio1_flexio02:
	IOMUXC_GPIO_AD_B1_13_FLEXIO1_FLEXIO02 {
		pinmux = <0x401f8130 4 0x0 0 0x401f82a4>;
	};

	/omit-if-no-ref/ iomuxc_gpio_ad_b1_13_flexpwm1_pwmb3: IOMUXC_GPIO_AD_B1_13_FLEXPWM1_PWMB3 {
		pinmux = <0x401f8130 6 0x401f8344 0 0x401f82a4>;
	};

	/omit-if-no-ref/ iomuxc_gpio_ad_b1_13_gpio1_io29: IOMUXC_GPIO_AD_B1_13_GPIO1_IO29 {
		pinmux = <0x401f8130 5 0x0 0 0x401f82a4>;
	};

	/omit-if-no-ref/ iomuxc_gpio_ad_b1_13_lpi2c1_hreq: IOMUXC_GPIO_AD_B1_13_LPI2C1_HREQ {
		pinmux = <0x401f8130 0 0x0 0 0x401f82a4>;
	};

	/omit-if-no-ref/ iomuxc_gpio_ad_b1_14_adc1_in14: IOMUXC_GPIO_AD_B1_14_ADC1_IN14 {
		pinmux = <0x401f8134 5 0x0 0 0x401f82a8>;
	};

	/omit-if-no-ref/ iomuxc_gpio_ad_b1_14_flexio1_flexio01:
	IOMUXC_GPIO_AD_B1_14_FLEXIO1_FLEXIO01 {
		pinmux = <0x401f8134 4 0x0 0 0x401f82a8>;
	};

	/omit-if-no-ref/ iomuxc_gpio_ad_b1_14_gpio1_io30: IOMUXC_GPIO_AD_B1_14_GPIO1_IO30 {
		pinmux = <0x401f8134 5 0x0 0 0x401f82a8>;
	};

	/omit-if-no-ref/ iomuxc_gpio_ad_b1_14_lpi2c1_scl: IOMUXC_GPIO_AD_B1_14_LPI2C1_SCL {
		pinmux = <0x401f8134 0 0x401f837c 1 0x401f82a8>;
	};

	/omit-if-no-ref/ iomuxc_gpio_ad_b1_15_adc1_in15: IOMUXC_GPIO_AD_B1_15_ADC1_IN15 {
		pinmux = <0x401f8138 5 0x0 0 0x401f82ac>;
	};

	/omit-if-no-ref/ iomuxc_gpio_ad_b1_15_flexio1_flexio00:
	IOMUXC_GPIO_AD_B1_15_FLEXIO1_FLEXIO00 {
		pinmux = <0x401f8138 4 0x0 0 0x401f82ac>;
	};

	/omit-if-no-ref/ iomuxc_gpio_ad_b1_15_gpio1_io31: IOMUXC_GPIO_AD_B1_15_GPIO1_IO31 {
		pinmux = <0x401f8138 5 0x0 0 0x401f82ac>;
	};

	/omit-if-no-ref/ iomuxc_gpio_ad_b1_15_lpi2c1_sda: IOMUXC_GPIO_AD_B1_15_LPI2C1_SDA {
		pinmux = <0x401f8138 0 0x401f8380 1 0x401f82ac>;
	};

	/omit-if-no-ref/ iomuxc_gpio_emc_04_flexio1_flexio16: IOMUXC_GPIO_EMC_04_FLEXIO1_FLEXIO16 {
		pinmux = <0x401f8024 4 0x0 0 0x401f8198>;
	};

	/omit-if-no-ref/ iomuxc_gpio_emc_04_gpio2_io04: IOMUXC_GPIO_EMC_04_GPIO2_IO04 {
		pinmux = <0x401f8024 5 0x0 0 0x401f8198>;
	};

	/omit-if-no-ref/ iomuxc_gpio_emc_04_sai2_tx_bclk: IOMUXC_GPIO_EMC_04_SAI2_TX_BCLK {
		pinmux = <0x401f8024 3 0x401f8464 1 0x401f8198>;
	};

	/omit-if-no-ref/ iomuxc_gpio_emc_04_spdif_out: IOMUXC_GPIO_EMC_04_SPDIF_OUT {
		pinmux = <0x401f8024 2 0x0 0 0x401f8198>;
	};

	/omit-if-no-ref/ iomuxc_gpio_emc_04_xbar1_xbar_in04: IOMUXC_GPIO_EMC_04_XBAR1_XBAR_IN04 {
		pinmux = <0x401f8024 1 0x0 0 0x401f8198>;
		gpr = <0x400ac018 0x10 0x0>;
	};

	/omit-if-no-ref/ iomuxc_gpio_emc_04_xbar1_xbar_inout04:
	IOMUXC_GPIO_EMC_04_XBAR1_XBAR_INOUT04 {
		pinmux = <0x401f8024 1 0x0 0 0x401f8198>;
		gpr = <0x400ac018 0x10 0x1>;
	};

	/omit-if-no-ref/ iomuxc_gpio_emc_05_flexio1_flexio17: IOMUXC_GPIO_EMC_05_FLEXIO1_FLEXIO17 {
		pinmux = <0x401f8028 4 0x0 0 0x401f819c>;
	};

	/omit-if-no-ref/ iomuxc_gpio_emc_05_gpio2_io05: IOMUXC_GPIO_EMC_05_GPIO2_IO05 {
		pinmux = <0x401f8028 5 0x0 0 0x401f819c>;
	};

	/omit-if-no-ref/ iomuxc_gpio_emc_05_sai2_tx_sync: IOMUXC_GPIO_EMC_05_SAI2_TX_SYNC {
		pinmux = <0x401f8028 3 0x401f8468 1 0x401f819c>;
	};

	/omit-if-no-ref/ iomuxc_gpio_emc_05_spdif_in: IOMUXC_GPIO_EMC_05_SPDIF_IN {
		pinmux = <0x401f8028 2 0x401f8488 0 0x401f819c>;
	};

	/omit-if-no-ref/ iomuxc_gpio_emc_05_xbar1_xbar_in05: IOMUXC_GPIO_EMC_05_XBAR1_XBAR_IN05 {
		pinmux = <0x401f8028 1 0x0 0 0x401f819c>;
		gpr = <0x400ac018 0x11 0x0>;
	};

	/omit-if-no-ref/ iomuxc_gpio_emc_05_xbar1_xbar_inout05:
	IOMUXC_GPIO_EMC_05_XBAR1_XBAR_INOUT05 {
		pinmux = <0x401f8028 1 0x0 0 0x401f819c>;
		gpr = <0x400ac018 0x11 0x1>;
	};

	/omit-if-no-ref/ iomuxc_gpio_emc_06_flexio1_flexio18: IOMUXC_GPIO_EMC_06_FLEXIO1_FLEXIO18 {
		pinmux = <0x401f802c 4 0x0 0 0x401f81a0>;
	};

	/omit-if-no-ref/ iomuxc_gpio_emc_06_gpio2_io06: IOMUXC_GPIO_EMC_06_GPIO2_IO06 {
		pinmux = <0x401f802c 5 0x0 0 0x401f81a0>;
	};

	/omit-if-no-ref/ iomuxc_gpio_emc_06_lpuart3_tx: IOMUXC_GPIO_EMC_06_LPUART3_TX {
		pinmux = <0x401f802c 2 0x401f83dc 0 0x401f81a0>;
	};

	/omit-if-no-ref/ iomuxc_gpio_emc_06_sai2_tx_data: IOMUXC_GPIO_EMC_06_SAI2_TX_DATA {
		pinmux = <0x401f802c 3 0x0 0 0x401f81a0>;
	};

	/omit-if-no-ref/ iomuxc_gpio_emc_06_xbar1_xbar_in06: IOMUXC_GPIO_EMC_06_XBAR1_XBAR_IN06 {
		pinmux = <0x401f802c 1 0x0 0 0x401f81a0>;
		gpr = <0x400ac018 0x12 0x0>;
	};

	/omit-if-no-ref/ iomuxc_gpio_emc_06_xbar1_xbar_inout06:
	IOMUXC_GPIO_EMC_06_XBAR1_XBAR_INOUT06 {
		pinmux = <0x401f802c 1 0x0 0 0x401f81a0>;
		gpr = <0x400ac018 0x12 0x1>;
	};

	/omit-if-no-ref/ iomuxc_gpio_emc_07_flexio1_flexio19: IOMUXC_GPIO_EMC_07_FLEXIO1_FLEXIO19 {
		pinmux = <0x401f8030 4 0x0 0 0x401f81a4>;
	};

	/omit-if-no-ref/ iomuxc_gpio_emc_07_gpio2_io07: IOMUXC_GPIO_EMC_07_GPIO2_IO07 {
		pinmux = <0x401f8030 5 0x0 0 0x401f81a4>;
	};

	/omit-if-no-ref/ iomuxc_gpio_emc_07_lpuart3_rx: IOMUXC_GPIO_EMC_07_LPUART3_RX {
		pinmux = <0x401f8030 2 0x401f83d8 0 0x401f81a4>;
	};

	/omit-if-no-ref/ iomuxc_gpio_emc_07_sai2_rx_sync: IOMUXC_GPIO_EMC_07_SAI2_RX_SYNC {
		pinmux = <0x401f8030 3 0x401f8460 1 0x401f81a4>;
	};

	/omit-if-no-ref/ iomuxc_gpio_emc_07_xbar1_xbar_in07: IOMUXC_GPIO_EMC_07_XBAR1_XBAR_IN07 {
		pinmux = <0x401f8030 1 0x0 0 0x401f81a4>;
		gpr = <0x400ac018 0x13 0x0>;
	};

	/omit-if-no-ref/ iomuxc_gpio_emc_07_xbar1_xbar_inout07:
	IOMUXC_GPIO_EMC_07_XBAR1_XBAR_INOUT07 {
		pinmux = <0x401f8030 1 0x0 0 0x401f81a4>;
		gpr = <0x400ac018 0x13 0x1>;
	};

	/omit-if-no-ref/ iomuxc_gpio_emc_08_flexio1_flexio20: IOMUXC_GPIO_EMC_08_FLEXIO1_FLEXIO20 {
		pinmux = <0x401f8034 4 0x0 0 0x401f81a8>;
	};

	/omit-if-no-ref/ iomuxc_gpio_emc_08_gpio2_io08: IOMUXC_GPIO_EMC_08_GPIO2_IO08 {
		pinmux = <0x401f8034 5 0x0 0 0x401f81a8>;
	};

	/omit-if-no-ref/ iomuxc_gpio_emc_08_sai2_rx_data: IOMUXC_GPIO_EMC_08_SAI2_RX_DATA {
		pinmux = <0x401f8034 3 0x401f845c 1 0x401f81a8>;
	};

	/omit-if-no-ref/ iomuxc_gpio_emc_08_xbar1_xbar_in08: IOMUXC_GPIO_EMC_08_XBAR1_XBAR_IN08 {
		pinmux = <0x401f8034 1 0x0 0 0x401f81a8>;
		gpr = <0x400ac018 0x14 0x0>;
	};

	/omit-if-no-ref/ iomuxc_gpio_emc_08_xbar1_xbar_inout08:
	IOMUXC_GPIO_EMC_08_XBAR1_XBAR_INOUT08 {
		pinmux = <0x401f8034 1 0x0 0 0x401f81a8>;
		gpr = <0x400ac018 0x14 0x1>;
	};

	/omit-if-no-ref/ iomuxc_gpio_emc_09_flexio1_flexio21: IOMUXC_GPIO_EMC_09_FLEXIO1_FLEXIO21 {
		pinmux = <0x401f8038 4 0x0 0 0x401f81ac>;
	};

	/omit-if-no-ref/ iomuxc_gpio_emc_09_gpio2_io09: IOMUXC_GPIO_EMC_09_GPIO2_IO09 {
		pinmux = <0x401f8038 5 0x0 0 0x401f81ac>;
	};

	/omit-if-no-ref/ iomuxc_gpio_emc_09_sai2_rx_bclk: IOMUXC_GPIO_EMC_09_SAI2_RX_BCLK {
		pinmux = <0x401f8038 3 0x401f8458 1 0x401f81ac>;
	};

	/omit-if-no-ref/ iomuxc_gpio_emc_09_xbar1_xbar_in09: IOMUXC_GPIO_EMC_09_XBAR1_XBAR_IN09 {
		pinmux = <0x401f8038 1 0x0 0 0x401f81ac>;
		gpr = <0x400ac018 0x15 0x0>;
	};

	/omit-if-no-ref/ iomuxc_gpio_emc_09_xbar1_xbar_inout09:
	IOMUXC_GPIO_EMC_09_XBAR1_XBAR_INOUT09 {
		pinmux = <0x401f8038 1 0x0 0 0x401f81ac>;
		gpr = <0x400ac018 0x15 0x1>;
	};

	/omit-if-no-ref/ iomuxc_gpio_emc_16_gpio2_io16: IOMUXC_GPIO_EMC_16_GPIO2_IO16 {
		pinmux = <0x401f8054 5 0x0 0 0x401f81c8>;
	};

	/omit-if-no-ref/ iomuxc_gpio_emc_16_mqs_right: IOMUXC_GPIO_EMC_16_MQS_RIGHT {
		pinmux = <0x401f8054 2 0x0 0 0x401f81c8>;
	};

	/omit-if-no-ref/ iomuxc_gpio_emc_16_sai2_mclk: IOMUXC_GPIO_EMC_16_SAI2_MCLK {
		pinmux = <0x401f8054 3 0x401f8454 1 0x401f81c8>;
	};

	/omit-if-no-ref/ iomuxc_gpio_emc_16_src_boot_mode0: IOMUXC_GPIO_EMC_16_SRC_BOOT_MODE0 {
		pinmux = <0x401f8054 6 0x0 0 0x401f81c8>;
	};

	/omit-if-no-ref/ iomuxc_gpio_emc_17_gpio2_io17: IOMUXC_GPIO_EMC_17_GPIO2_IO17 {
		pinmux = <0x401f8058 5 0x0 0 0x401f81cc>;
	};

	/omit-if-no-ref/ iomuxc_gpio_emc_17_mqs_left: IOMUXC_GPIO_EMC_17_MQS_LEFT {
		pinmux = <0x401f8058 2 0x0 0 0x401f81cc>;
	};

	/omit-if-no-ref/ iomuxc_gpio_emc_17_sai3_mclk: IOMUXC_GPIO_EMC_17_SAI3_MCLK {
		pinmux = <0x401f8058 3 0x401f846c 1 0x401f81cc>;
	};

	/omit-if-no-ref/ iomuxc_gpio_emc_17_src_boot_mode1: IOMUXC_GPIO_EMC_17_SRC_BOOT_MODE1 {
		pinmux = <0x401f8058 6 0x0 0 0x401f81cc>;
	};

	/omit-if-no-ref/ iomuxc_gpio_emc_18_flexio1_flexio22: IOMUXC_GPIO_EMC_18_FLEXIO1_FLEXIO22 {
		pinmux = <0x401f805c 4 0x0 0 0x401f81d0>;
	};

	/omit-if-no-ref/ iomuxc_gpio_emc_18_gpio2_io18: IOMUXC_GPIO_EMC_18_GPIO2_IO18 {
		pinmux = <0x401f805c 5 0x0 0 0x401f81d0>;
	};

	/omit-if-no-ref/ iomuxc_gpio_emc_18_lpi2c2_sda: IOMUXC_GPIO_EMC_18_LPI2C2_SDA {
		pinmux = <0x401f805c 2 0x401f8388 1 0x401f81d0>;
	};

	/omit-if-no-ref/ iomuxc_gpio_emc_18_sai1_rx_sync: IOMUXC_GPIO_EMC_18_SAI1_RX_SYNC {
		pinmux = <0x401f805c 3 0x401f8448 2 0x401f81d0>;
	};

	/omit-if-no-ref/ iomuxc_gpio_emc_18_src_bt_cfg0: IOMUXC_GPIO_EMC_18_SRC_BT_CFG0 {
		pinmux = <0x401f805c 6 0x0 0 0x401f81d0>;
	};

	/omit-if-no-ref/ iomuxc_gpio_emc_18_xbar1_xbar_in16: IOMUXC_GPIO_EMC_18_XBAR1_XBAR_IN16 {
		pinmux = <0x401f805c 1 0x401f84a8 1 0x401f81d0>;
		gpr = <0x400ac018 0x1c 0x0>;
	};

	/omit-if-no-ref/ iomuxc_gpio_emc_18_xbar1_xbar_inout16:
	IOMUXC_GPIO_EMC_18_XBAR1_XBAR_INOUT16 {
		pinmux = <0x401f805c 1 0x401f84a8 1 0x401f81d0>;
		gpr = <0x400ac018 0x1c 0x1>;
	};

	/omit-if-no-ref/ iomuxc_gpio_emc_19_flexio1_flexio23: IOMUXC_GPIO_EMC_19_FLEXIO1_FLEXIO23 {
		pinmux = <0x401f8060 4 0x0 0 0x401f81d4>;
	};

	/omit-if-no-ref/ iomuxc_gpio_emc_19_gpio2_io19: IOMUXC_GPIO_EMC_19_GPIO2_IO19 {
		pinmux = <0x401f8060 5 0x0 0 0x401f81d4>;
	};

	/omit-if-no-ref/ iomuxc_gpio_emc_19_lpi2c2_scl: IOMUXC_GPIO_EMC_19_LPI2C2_SCL {
		pinmux = <0x401f8060 2 0x401f8384 1 0x401f81d4>;
	};

	/omit-if-no-ref/ iomuxc_gpio_emc_19_sai1_rx_bclk: IOMUXC_GPIO_EMC_19_SAI1_RX_BCLK {
		pinmux = <0x401f8060 3 0x401f8434 2 0x401f81d4>;
	};

	/omit-if-no-ref/ iomuxc_gpio_emc_19_src_bt_cfg1: IOMUXC_GPIO_EMC_19_SRC_BT_CFG1 {
		pinmux = <0x401f8060 6 0x0 0 0x401f81d4>;
	};

	/omit-if-no-ref/ iomuxc_gpio_emc_19_xbar1_xbar_in17: IOMUXC_GPIO_EMC_19_XBAR1_XBAR_IN17 {
		pinmux = <0x401f8060 1 0x401f84ac 1 0x401f81d4>;
		gpr = <0x400ac018 0x1d 0x0>;
	};

	/omit-if-no-ref/ iomuxc_gpio_emc_19_xbar1_xbar_inout17:
	IOMUXC_GPIO_EMC_19_XBAR1_XBAR_INOUT17 {
		pinmux = <0x401f8060 1 0x401f84ac 1 0x401f81d4>;
		gpr = <0x400ac018 0x1d 0x1>;
	};

	/omit-if-no-ref/ iomuxc_gpio_emc_20_flexio1_flexio24: IOMUXC_GPIO_EMC_20_FLEXIO1_FLEXIO24 {
		pinmux = <0x401f8064 4 0x0 0 0x401f81d8>;
	};

	/omit-if-no-ref/ iomuxc_gpio_emc_20_flexpwm1_pwma3: IOMUXC_GPIO_EMC_20_FLEXPWM1_PWMA3 {
		pinmux = <0x401f8064 1 0x401f8334 1 0x401f81d8>;
	};

	/omit-if-no-ref/ iomuxc_gpio_emc_20_gpio2_io20: IOMUXC_GPIO_EMC_20_GPIO2_IO20 {
		pinmux = <0x401f8064 5 0x0 0 0x401f81d8>;
	};

	/omit-if-no-ref/ iomuxc_gpio_emc_20_lpuart2_cts_b: IOMUXC_GPIO_EMC_20_LPUART2_CTS_B {
		pinmux = <0x401f8064 2 0x401f83cc 1 0x401f81d8>;
	};

	/omit-if-no-ref/ iomuxc_gpio_emc_20_sai1_mclk: IOMUXC_GPIO_EMC_20_SAI1_MCLK {
		pinmux = <0x401f8064 3 0x401f8430 3 0x401f81d8>;
	};

	/omit-if-no-ref/ iomuxc_gpio_emc_20_src_bt_cfg2: IOMUXC_GPIO_EMC_20_SRC_BT_CFG2 {
		pinmux = <0x401f8064 6 0x0 0 0x401f81d8>;
	};

	/omit-if-no-ref/ iomuxc_gpio_emc_21_flexio1_flexio25: IOMUXC_GPIO_EMC_21_FLEXIO1_FLEXIO25 {
		pinmux = <0x401f8068 4 0x0 0 0x401f81dc>;
	};

	/omit-if-no-ref/ iomuxc_gpio_emc_21_flexpwm1_pwmb3: IOMUXC_GPIO_EMC_21_FLEXPWM1_PWMB3 {
		pinmux = <0x401f8068 1 0x401f8344 1 0x401f81dc>;
	};

	/omit-if-no-ref/ iomuxc_gpio_emc_21_gpio2_io21: IOMUXC_GPIO_EMC_21_GPIO2_IO21 {
		pinmux = <0x401f8068 5 0x0 0 0x401f81dc>;
	};

	/omit-if-no-ref/ iomuxc_gpio_emc_21_lpuart2_rts_b: IOMUXC_GPIO_EMC_21_LPUART2_RTS_B {
		pinmux = <0x401f8068 2 0x0 0 0x401f81dc>;
	};

	/omit-if-no-ref/ iomuxc_gpio_emc_21_sai1_rx_data0: IOMUXC_GPIO_EMC_21_SAI1_RX_DATA0 {
		pinmux = <0x401f8068 3 0x401f8438 2 0x401f81dc>;
	};

	/omit-if-no-ref/ iomuxc_gpio_emc_21_src_bt_cfg3: IOMUXC_GPIO_EMC_21_SRC_BT_CFG3 {
		pinmux = <0x401f8068 6 0x0 0 0x401f81dc>;
	};

	/omit-if-no-ref/ iomuxc_gpio_emc_22_flexio1_flexio26: IOMUXC_GPIO_EMC_22_FLEXIO1_FLEXIO26 {
		pinmux = <0x401f806c 4 0x0 0 0x401f81e0>;
	};

	/omit-if-no-ref/ iomuxc_gpio_emc_22_flexpwm1_pwma2: IOMUXC_GPIO_EMC_22_FLEXPWM1_PWMA2 {
		pinmux = <0x401f806c 1 0x401f8330 1 0x401f81e0>;
	};

	/omit-if-no-ref/ iomuxc_gpio_emc_22_gpio2_io22: IOMUXC_GPIO_EMC_22_GPIO2_IO22 {
		pinmux = <0x401f806c 5 0x0 0 0x401f81e0>;
	};

	/omit-if-no-ref/ iomuxc_gpio_emc_22_lpuart2_tx: IOMUXC_GPIO_EMC_22_LPUART2_TX {
		pinmux = <0x401f806c 2 0x401f83d4 1 0x401f81e0>;
	};

	/omit-if-no-ref/ iomuxc_gpio_emc_22_sai1_tx_data3: IOMUXC_GPIO_EMC_22_SAI1_TX_DATA3 {
		pinmux = <0x401f806c 3 0x401f843c 1 0x401f81e0>;
	};

	/omit-if-no-ref/ iomuxc_gpio_emc_22_src_bt_cfg4: IOMUXC_GPIO_EMC_22_SRC_BT_CFG4 {
		pinmux = <0x401f806c 6 0x0 0 0x401f81e0>;
	};

	/omit-if-no-ref/ iomuxc_gpio_emc_23_flexio1_flexio27: IOMUXC_GPIO_EMC_23_FLEXIO1_FLEXIO27 {
		pinmux = <0x401f8070 4 0x0 0 0x401f81e4>;
	};

	/omit-if-no-ref/ iomuxc_gpio_emc_23_flexpwm1_pwmb2: IOMUXC_GPIO_EMC_23_FLEXPWM1_PWMB2 {
		pinmux = <0x401f8070 1 0x401f8340 1 0x401f81e4>;
	};

	/omit-if-no-ref/ iomuxc_gpio_emc_23_gpio2_io23: IOMUXC_GPIO_EMC_23_GPIO2_IO23 {
		pinmux = <0x401f8070 5 0x0 0 0x401f81e4>;
	};

	/omit-if-no-ref/ iomuxc_gpio_emc_23_lpuart2_rx: IOMUXC_GPIO_EMC_23_LPUART2_RX {
		pinmux = <0x401f8070 2 0x401f83d0 1 0x401f81e4>;
	};

	/omit-if-no-ref/ iomuxc_gpio_emc_23_sai1_tx_data2: IOMUXC_GPIO_EMC_23_SAI1_TX_DATA2 {
		pinmux = <0x401f8070 3 0x401f8440 1 0x401f81e4>;
	};

	/omit-if-no-ref/ iomuxc_gpio_emc_23_src_bt_cfg5: IOMUXC_GPIO_EMC_23_SRC_BT_CFG5 {
		pinmux = <0x401f8070 6 0x0 0 0x401f81e4>;
	};

	/omit-if-no-ref/ iomuxc_gpio_emc_24_flexio1_flexio28: IOMUXC_GPIO_EMC_24_FLEXIO1_FLEXIO28 {
		pinmux = <0x401f8074 4 0x0 0 0x401f81e8>;
	};

	/omit-if-no-ref/ iomuxc_gpio_emc_24_flexpwm1_pwma1: IOMUXC_GPIO_EMC_24_FLEXPWM1_PWMA1 {
		pinmux = <0x401f8074 1 0x401f832c 1 0x401f81e8>;
	};

	/omit-if-no-ref/ iomuxc_gpio_emc_24_gpio2_io24: IOMUXC_GPIO_EMC_24_GPIO2_IO24 {
		pinmux = <0x401f8074 5 0x0 0 0x401f81e8>;
	};

	/omit-if-no-ref/ iomuxc_gpio_emc_24_sai1_tx_data1: IOMUXC_GPIO_EMC_24_SAI1_TX_DATA1 {
		pinmux = <0x401f8074 3 0x401f8444 1 0x401f81e8>;
	};

	/omit-if-no-ref/ iomuxc_gpio_emc_24_src_bt_cfg6: IOMUXC_GPIO_EMC_24_SRC_BT_CFG6 {
		pinmux = <0x401f8074 6 0x0 0 0x401f81e8>;
	};

	/omit-if-no-ref/ iomuxc_gpio_emc_25_flexio1_flexio29: IOMUXC_GPIO_EMC_25_FLEXIO1_FLEXIO29 {
		pinmux = <0x401f8078 4 0x0 0 0x401f81ec>;
	};

	/omit-if-no-ref/ iomuxc_gpio_emc_25_flexpwm1_pwmb1: IOMUXC_GPIO_EMC_25_FLEXPWM1_PWMB1 {
		pinmux = <0x401f8078 1 0x401f833c 1 0x401f81ec>;
	};

	/omit-if-no-ref/ iomuxc_gpio_emc_25_gpio2_io25: IOMUXC_GPIO_EMC_25_GPIO2_IO25 {
		pinmux = <0x401f8078 5 0x0 0 0x401f81ec>;
	};

	/omit-if-no-ref/ iomuxc_gpio_emc_25_sai1_tx_data0: IOMUXC_GPIO_EMC_25_SAI1_TX_DATA0 {
		pinmux = <0x401f8078 3 0x0 0 0x401f81ec>;
	};

	/omit-if-no-ref/ iomuxc_gpio_emc_25_src_bt_cfg7: IOMUXC_GPIO_EMC_25_SRC_BT_CFG7 {
		pinmux = <0x401f8078 6 0x0 0 0x401f81ec>;
	};

	/omit-if-no-ref/ iomuxc_gpio_emc_26_flexio1_flexio30: IOMUXC_GPIO_EMC_26_FLEXIO1_FLEXIO30 {
		pinmux = <0x401f807c 4 0x0 0 0x401f81f0>;
	};

	/omit-if-no-ref/ iomuxc_gpio_emc_26_flexpwm1_pwma0: IOMUXC_GPIO_EMC_26_FLEXPWM1_PWMA0 {
		pinmux = <0x401f807c 1 0x401f8328 1 0x401f81f0>;
	};

	/omit-if-no-ref/ iomuxc_gpio_emc_26_gpio2_io26: IOMUXC_GPIO_EMC_26_GPIO2_IO26 {
		pinmux = <0x401f807c 5 0x0 0 0x401f81f0>;
	};

	/omit-if-no-ref/ iomuxc_gpio_emc_26_sai1_tx_bclk: IOMUXC_GPIO_EMC_26_SAI1_TX_BCLK {
		pinmux = <0x401f807c 3 0x401f844c 2 0x401f81f0>;
	};

	/omit-if-no-ref/ iomuxc_gpio_emc_26_src_bt_cfg8: IOMUXC_GPIO_EMC_26_SRC_BT_CFG8 {
		pinmux = <0x401f807c 6 0x0 0 0x401f81f0>;
	};

	/omit-if-no-ref/ iomuxc_gpio_emc_27_flexio1_flexio31: IOMUXC_GPIO_EMC_27_FLEXIO1_FLEXIO31 {
		pinmux = <0x401f8080 4 0x0 0 0x401f81f4>;
	};

	/omit-if-no-ref/ iomuxc_gpio_emc_27_flexpwm1_pwmb0: IOMUXC_GPIO_EMC_27_FLEXPWM1_PWMB0 {
		pinmux = <0x401f8080 1 0x401f8338 1 0x401f81f4>;
	};

	/omit-if-no-ref/ iomuxc_gpio_emc_27_gpio2_io27: IOMUXC_GPIO_EMC_27_GPIO2_IO27 {
		pinmux = <0x401f8080 5 0x0 0 0x401f81f4>;
	};

	/omit-if-no-ref/ iomuxc_gpio_emc_27_sai1_tx_sync: IOMUXC_GPIO_EMC_27_SAI1_TX_SYNC {
		pinmux = <0x401f8080 3 0x401f8450 2 0x401f81f4>;
	};

	/omit-if-no-ref/ iomuxc_gpio_emc_27_src_bt_cfg9: IOMUXC_GPIO_EMC_27_SRC_BT_CFG9 {
		pinmux = <0x401f8080 6 0x0 0 0x401f81f4>;
	};

	/omit-if-no-ref/ iomuxc_gpio_emc_32_gpio3_io00: IOMUXC_GPIO_EMC_32_GPIO3_IO00 {
		pinmux = <0x401f8094 5 0x0 0 0x401f8208>;
	};

	/omit-if-no-ref/ iomuxc_gpio_emc_32_lpuart4_tx: IOMUXC_GPIO_EMC_32_LPUART4_TX {
		pinmux = <0x401f8094 2 0x401f83e8 2 0x401f8208>;
	};

	/omit-if-no-ref/ iomuxc_gpio_emc_32_qtimer1_timer0: IOMUXC_GPIO_EMC_32_QTIMER1_TIMER0 {
		pinmux = <0x401f8094 1 0x401f8410 1 0x401f8208>;
		gpr = <0x400ac018 0x0 0x0>;
	};

	/omit-if-no-ref/ iomuxc_gpio_emc_32_ref_24m_out: IOMUXC_GPIO_EMC_32_REF_24M_OUT {
		pinmux = <0x401f8094 7 0x0 0 0x401f8208>;
	};

	/omit-if-no-ref/ iomuxc_gpio_emc_32_sai3_tx_data: IOMUXC_GPIO_EMC_32_SAI3_TX_DATA {
		pinmux = <0x401f8094 3 0x0 0 0x401f8208>;
	};

	/omit-if-no-ref/ iomuxc_gpio_emc_33_gpio3_io01: IOMUXC_GPIO_EMC_33_GPIO3_IO01 {
		pinmux = <0x401f8098 5 0x0 0 0x401f820c>;
	};

	/omit-if-no-ref/ iomuxc_gpio_emc_33_lpuart4_rx: IOMUXC_GPIO_EMC_33_LPUART4_RX {
		pinmux = <0x401f8098 2 0x401f83e4 2 0x401f820c>;
	};

	/omit-if-no-ref/ iomuxc_gpio_emc_33_qtimer1_timer1: IOMUXC_GPIO_EMC_33_QTIMER1_TIMER1 {
		pinmux = <0x401f8098 1 0x401f8414 1 0x401f820c>;
		gpr = <0x400ac018 0x1 0x0>;
	};

	/omit-if-no-ref/ iomuxc_gpio_emc_33_sai3_tx_bclk: IOMUXC_GPIO_EMC_33_SAI3_TX_BCLK {
		pinmux = <0x401f8098 3 0x401f847c 1 0x401f820c>;
	};

	/omit-if-no-ref/ iomuxc_gpio_emc_34_gpio3_io02: IOMUXC_GPIO_EMC_34_GPIO3_IO02 {
		pinmux = <0x401f809c 5 0x0 0 0x401f8210>;
	};

	/omit-if-no-ref/ iomuxc_gpio_emc_34_qtimer1_timer2: IOMUXC_GPIO_EMC_34_QTIMER1_TIMER2 {
		pinmux = <0x401f809c 1 0x401f8418 1 0x401f8210>;
		gpr = <0x400ac018 0x2 0x0>;
	};

	/omit-if-no-ref/ iomuxc_gpio_emc_34_sai3_tx_sync: IOMUXC_GPIO_EMC_34_SAI3_TX_SYNC {
		pinmux = <0x401f809c 3 0x401f8480 1 0x401f8210>;
	};

	/omit-if-no-ref/ iomuxc_gpio_emc_35_gpio3_io03: IOMUXC_GPIO_EMC_35_GPIO3_IO03 {
		pinmux = <0x401f80a0 5 0x0 0 0x401f8214>;
	};

	/omit-if-no-ref/ iomuxc_gpio_emc_35_qtimer1_timer3: IOMUXC_GPIO_EMC_35_QTIMER1_TIMER3 {
		pinmux = <0x401f80a0 1 0x401f841c 1 0x401f8214>;
		gpr = <0x400ac018 0x3 0x0>;
	};

	/omit-if-no-ref/ iomuxc_gpio_sd_b1_00_flexspi_b_data3:
	IOMUXC_GPIO_SD_B1_00_FLEXSPI_B_DATA3 {
		pinmux = <0x401f8158 1 0x0 0 0x401f82cc>;
	};

	/omit-if-no-ref/ iomuxc_gpio_sd_b1_00_gpio3_io20: IOMUXC_GPIO_SD_B1_00_GPIO3_IO20 {
		pinmux = <0x401f8158 5 0x0 0 0x401f82cc>;
	};

	/omit-if-no-ref/ iomuxc_gpio_sd_b1_00_xbar1_xbar_in10:
	IOMUXC_GPIO_SD_B1_00_XBAR1_XBAR_IN10 {
		pinmux = <0x401f8158 3 0x401f84b0 1 0x401f82cc>;
		gpr = <0x400ac018 0x16 0x0>;
	};

	/omit-if-no-ref/ iomuxc_gpio_sd_b1_00_xbar1_xbar_inout10:
	IOMUXC_GPIO_SD_B1_00_XBAR1_XBAR_INOUT10 {
		pinmux = <0x401f8158 3 0x401f84b0 1 0x401f82cc>;
		gpr = <0x400ac018 0x16 0x1>;
	};

	/omit-if-no-ref/ iomuxc_gpio_sd_b1_01_flexspi_a_ss1_b:
	IOMUXC_GPIO_SD_B1_01_FLEXSPI_A_SS1_B {
		pinmux = <0x401f815c 3 0x0 0 0x401f82d0>;
	};

	/omit-if-no-ref/ iomuxc_gpio_sd_b1_01_flexspi_b_sclk: IOMUXC_GPIO_SD_B1_01_FLEXSPI_B_SCLK {
		pinmux = <0x401f815c 1 0x0 0 0x401f82d0>;
	};

	/omit-if-no-ref/ iomuxc_gpio_sd_b1_01_gpio3_io21: IOMUXC_GPIO_SD_B1_01_GPIO3_IO21 {
		pinmux = <0x401f815c 5 0x0 0 0x401f82d0>;
	};

	/omit-if-no-ref/ iomuxc_gpio_sd_b1_02_ccm_clko1: IOMUXC_GPIO_SD_B1_02_CCM_CLKO1 {
		pinmux = <0x401f8160 6 0x0 0 0x401f82d4>;
	};

	/omit-if-no-ref/ iomuxc_gpio_sd_b1_02_flexspi_b_data0:
	IOMUXC_GPIO_SD_B1_02_FLEXSPI_B_DATA0 {
		pinmux = <0x401f8160 1 0x0 0 0x401f82d4>;
	};

	/omit-if-no-ref/ iomuxc_gpio_sd_b1_02_gpio3_io22: IOMUXC_GPIO_SD_B1_02_GPIO3_IO22 {
		pinmux = <0x401f8160 5 0x0 0 0x401f82d4>;
	};

	/omit-if-no-ref/ iomuxc_gpio_sd_b1_03_ccm_clko2: IOMUXC_GPIO_SD_B1_03_CCM_CLKO2 {
		pinmux = <0x401f8164 6 0x0 0 0x401f82d8>;
	};

	/omit-if-no-ref/ iomuxc_gpio_sd_b1_03_flexspi_b_data2:
	IOMUXC_GPIO_SD_B1_03_FLEXSPI_B_DATA2 {
		pinmux = <0x401f8164 1 0x0 0 0x401f82d8>;
	};

	/omit-if-no-ref/ iomuxc_gpio_sd_b1_03_gpio3_io23: IOMUXC_GPIO_SD_B1_03_GPIO3_IO23 {
		pinmux = <0x401f8164 5 0x0 0 0x401f82d8>;
	};

	/omit-if-no-ref/ iomuxc_gpio_sd_b1_04_ccm_wait: IOMUXC_GPIO_SD_B1_04_CCM_WAIT {
		pinmux = <0x401f8168 6 0x0 0 0x401f82dc>;
	};

	/omit-if-no-ref/ iomuxc_gpio_sd_b1_04_ewm_out_b: IOMUXC_GPIO_SD_B1_04_EWM_OUT_B {
		pinmux = <0x401f8168 4 0x0 0 0x401f82dc>;
	};

	/omit-if-no-ref/ iomuxc_gpio_sd_b1_04_flexspi_b_data1:
	IOMUXC_GPIO_SD_B1_04_FLEXSPI_B_DATA1 {
		pinmux = <0x401f8168 1 0x0 0 0x401f82dc>;
	};

	/omit-if-no-ref/ iomuxc_gpio_sd_b1_04_gpio3_io24: IOMUXC_GPIO_SD_B1_04_GPIO3_IO24 {
		pinmux = <0x401f8168 5 0x0 0 0x401f82dc>;
	};

	/omit-if-no-ref/ iomuxc_gpio_sd_b1_05_ccm_pmic_rdy: IOMUXC_GPIO_SD_B1_05_CCM_PMIC_RDY {
		pinmux = <0x401f816c 6 0x401f8300 1 0x401f82e0>;
	};

	/omit-if-no-ref/ iomuxc_gpio_sd_b1_05_flexspi_a_dqs: IOMUXC_GPIO_SD_B1_05_FLEXSPI_A_DQS {
		pinmux = <0x401f816c 1 0x0 0 0x401f82e0>;
	};

	/omit-if-no-ref/ iomuxc_gpio_sd_b1_05_flexspi_b_ss0_b:
	IOMUXC_GPIO_SD_B1_05_FLEXSPI_B_SS0_B {
		pinmux = <0x401f816c 4 0x0 0 0x401f82e0>;
	};

	/omit-if-no-ref/ iomuxc_gpio_sd_b1_05_gpio3_io25: IOMUXC_GPIO_SD_B1_05_GPIO3_IO25 {
		pinmux = <0x401f816c 5 0x0 0 0x401f82e0>;
	};

	/omit-if-no-ref/ iomuxc_gpio_sd_b1_05_sai3_mclk: IOMUXC_GPIO_SD_B1_05_SAI3_MCLK {
		pinmux = <0x401f816c 3 0x401f846c 0 0x401f82e0>;
	};

	/omit-if-no-ref/ iomuxc_gpio_sd_b1_06_ccm_stop: IOMUXC_GPIO_SD_B1_06_CCM_STOP {
		pinmux = <0x401f8170 6 0x0 0 0x401f82e4>;
	};

	/omit-if-no-ref/ iomuxc_gpio_sd_b1_06_flexspi_a_data3:
	IOMUXC_GPIO_SD_B1_06_FLEXSPI_A_DATA3 {
		pinmux = <0x401f8170 1 0x401f8374 0 0x401f82e4>;
	};

	/omit-if-no-ref/ iomuxc_gpio_sd_b1_06_gpio3_io26: IOMUXC_GPIO_SD_B1_06_GPIO3_IO26 {
		pinmux = <0x401f8170 5 0x0 0 0x401f82e4>;
	};

	/omit-if-no-ref/ iomuxc_gpio_sd_b1_06_lpspi2_pcs0: IOMUXC_GPIO_SD_B1_06_LPSPI2_PCS0 {
		pinmux = <0x401f8170 4 0x401f83ac 2 0x401f82e4>;
	};

	/omit-if-no-ref/ iomuxc_gpio_sd_b1_06_sai3_tx_bclk: IOMUXC_GPIO_SD_B1_06_SAI3_TX_BCLK {
		pinmux = <0x401f8170 3 0x401f847c 0 0x401f82e4>;
	};

	/omit-if-no-ref/ iomuxc_gpio_sd_b1_07_flexspi_a_sclk: IOMUXC_GPIO_SD_B1_07_FLEXSPI_A_SCLK {
		pinmux = <0x401f8174 1 0x401f8378 0 0x401f82e8>;
	};

	/omit-if-no-ref/ iomuxc_gpio_sd_b1_07_gpio3_io27: IOMUXC_GPIO_SD_B1_07_GPIO3_IO27 {
		pinmux = <0x401f8174 5 0x0 0 0x401f82e8>;
	};

	/omit-if-no-ref/ iomuxc_gpio_sd_b1_07_lpspi2_sck: IOMUXC_GPIO_SD_B1_07_LPSPI2_SCK {
		pinmux = <0x401f8174 4 0x401f83b0 2 0x401f82e8>;
	};

	/omit-if-no-ref/ iomuxc_gpio_sd_b1_07_sai3_tx_sync: IOMUXC_GPIO_SD_B1_07_SAI3_TX_SYNC {
		pinmux = <0x401f8174 3 0x401f8480 0 0x401f82e8>;
	};

	/omit-if-no-ref/ iomuxc_gpio_sd_b1_08_flexspi_a_data0:
	IOMUXC_GPIO_SD_B1_08_FLEXSPI_A_DATA0 {
		pinmux = <0x401f8178 1 0x401f8368 0 0x401f82ec>;
	};

	/omit-if-no-ref/ iomuxc_gpio_sd_b1_08_gpio3_io28: IOMUXC_GPIO_SD_B1_08_GPIO3_IO28 {
		pinmux = <0x401f8178 5 0x0 0 0x401f82ec>;
	};

	/omit-if-no-ref/ iomuxc_gpio_sd_b1_08_lpspi2_sdo: IOMUXC_GPIO_SD_B1_08_LPSPI2_SDO {
		pinmux = <0x401f8178 4 0x401f83b8 2 0x401f82ec>;
	};

	/omit-if-no-ref/ iomuxc_gpio_sd_b1_08_sai3_tx_data: IOMUXC_GPIO_SD_B1_08_SAI3_TX_DATA {
		pinmux = <0x401f8178 3 0x0 0 0x401f82ec>;
	};

	/omit-if-no-ref/ iomuxc_gpio_sd_b1_09_ccm_ref_en_b: IOMUXC_GPIO_SD_B1_09_CCM_REF_EN_B {
		pinmux = <0x401f817c 6 0x0 0 0x401f82f0>;
	};

	/omit-if-no-ref/ iomuxc_gpio_sd_b1_09_flexspi_a_data2:
	IOMUXC_GPIO_SD_B1_09_FLEXSPI_A_DATA2 {
		pinmux = <0x401f817c 1 0x401f8370 0 0x401f82f0>;
	};

	/omit-if-no-ref/ iomuxc_gpio_sd_b1_09_gpio3_io29: IOMUXC_GPIO_SD_B1_09_GPIO3_IO29 {
		pinmux = <0x401f817c 5 0x0 0 0x401f82f0>;
	};

	/omit-if-no-ref/ iomuxc_gpio_sd_b1_09_lpspi2_sdi: IOMUXC_GPIO_SD_B1_09_LPSPI2_SDI {
		pinmux = <0x401f817c 4 0x401f83b4 2 0x401f82f0>;
	};

	/omit-if-no-ref/ iomuxc_gpio_sd_b1_09_sai3_rx_bclk: IOMUXC_GPIO_SD_B1_09_SAI3_RX_BCLK {
		pinmux = <0x401f817c 3 0x401f8470 0 0x401f82f0>;
	};

	/omit-if-no-ref/ iomuxc_gpio_sd_b1_10_flexspi_a_data1:
	IOMUXC_GPIO_SD_B1_10_FLEXSPI_A_DATA1 {
		pinmux = <0x401f8180 1 0x401f836c 0 0x401f82f4>;
	};

	/omit-if-no-ref/ iomuxc_gpio_sd_b1_10_gpio3_io30: IOMUXC_GPIO_SD_B1_10_GPIO3_IO30 {
		pinmux = <0x401f8180 5 0x0 0 0x401f82f4>;
	};

	/omit-if-no-ref/ iomuxc_gpio_sd_b1_10_lpspi2_pcs2: IOMUXC_GPIO_SD_B1_10_LPSPI2_PCS2 {
		pinmux = <0x401f8180 4 0x0 0 0x401f82f4>;
	};

	/omit-if-no-ref/ iomuxc_gpio_sd_b1_10_sai3_rx_sync: IOMUXC_GPIO_SD_B1_10_SAI3_RX_SYNC {
		pinmux = <0x401f8180 3 0x401f8478 0 0x401f82f4>;
	};

	/omit-if-no-ref/ iomuxc_gpio_sd_b1_11_flexspi_a_ss0_b:
	IOMUXC_GPIO_SD_B1_11_FLEXSPI_A_SS0_B {
		pinmux = <0x401f8184 1 0x0 0 0x401f82f8>;
	};

	/omit-if-no-ref/ iomuxc_gpio_sd_b1_11_gpio3_io31: IOMUXC_GPIO_SD_B1_11_GPIO3_IO31 {
		pinmux = <0x401f8184 5 0x0 0 0x401f82f8>;
	};

	/omit-if-no-ref/ iomuxc_gpio_sd_b1_11_lpspi2_pcs3: IOMUXC_GPIO_SD_B1_11_LPSPI2_PCS3 {
		pinmux = <0x401f8184 4 0x0 0 0x401f82f8>;
	};

	/omit-if-no-ref/ iomuxc_gpio_sd_b1_11_sai3_rx_data: IOMUXC_GPIO_SD_B1_11_SAI3_RX_DATA {
		pinmux = <0x401f8184 3 0x401f8474 0 0x401f82f8>;
	};

	/omit-if-no-ref/ iomuxc_snvs_onoff_src_reset_b: IOMUXC_SNVS_ONOFF_SRC_RESET_B {
		pinmux = <0x0 0 0x0 0 0x400a8014>;
	};

	/omit-if-no-ref/ iomuxc_snvs_pmic_on_req_gpio5_io01: IOMUXC_SNVS_PMIC_ON_REQ_GPIO5_IO01 {
		pinmux = <0x400a8004 5 0x0 0 0x400a801c>;
	};

	/omit-if-no-ref/ iomuxc_snvs_pmic_on_req_snvs_pmic_on_req:
	IOMUXC_SNVS_PMIC_ON_REQ_SNVS_PMIC_ON_REQ {
		pinmux = <0x400a8004 0 0x0 0 0x400a801c>;
	};

	/omit-if-no-ref/ iomuxc_snvs_por_b_src_por_b: IOMUXC_SNVS_POR_B_SRC_POR_B {
		pinmux = <0x0 0 0x0 0 0x400a8010>;
	};

	/omit-if-no-ref/ iomuxc_snvs_test_mode_test_mode: IOMUXC_SNVS_TEST_MODE_TEST_MODE {
		pinmux = <0x0 0 0x0 0 0x400a800c>;
	};
};
