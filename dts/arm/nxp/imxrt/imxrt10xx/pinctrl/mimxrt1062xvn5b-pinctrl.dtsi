/*
 * Copyright 2023, NXP
 * SPDX-License-Identifier: Apache-2.0
 *
 * Note: File generated by imx_cfg_utils.py
 * from configuration data for MIMXRT1062XVN5B
 */

/*
 * Content deduplicated by dedup_pinctrl.py:
 * the pin mux data of this part is identical to mimxrt1062dvn6b-pinctrl.dtsi.
 * Do not edit; edit the canonical file instead.
 * target-hash: 333eee9e73d28138
 */

#include "mimxrt1062dvn6b-pinctrl.dtsi"
