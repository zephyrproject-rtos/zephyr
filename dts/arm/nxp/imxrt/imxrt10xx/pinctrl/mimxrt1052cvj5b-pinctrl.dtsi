/*
 * Copyright (c) 2022, NXP
 * SPDX-License-Identifier: Apache-2.0
 *
 * Note: File generated by rt_cfg_utils.py
 * from configuration data for MIMXRT1052CVJ5B
 */

/*
 * Content deduplicated by dedup_pinctrl.py:
 * the pin mux data of this part is identical to mimxrt1052dvj6b-pinctrl.dtsi.
 * Do not edit; edit the canonical file instead.
 * target-hash: b8b9f9783ce15443
 */

#include "mimxrt1052dvj6b-pinctrl.dtsi"
