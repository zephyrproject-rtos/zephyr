/*
 * Copyright (c) 2022, NXP
 * SPDX-License-Identifier: Apache-2.0
 *
 * Note: File generated by rt_cfg_utils.py
 * from configuration data for MIMXRT1064CVL5A
 */

/*
 * Content deduplicated by dedup_pinctrl.py:
 * the pin mux data of this part is identical to mimxrt1064dvj6a-pinctrl.dtsi.
 * Do not edit; edit the canonical file instead.
 * target-hash: 304d2df1a5f7ddd6
 */

#include "mimxrt1064dvj6a-pinctrl.dtsi"
