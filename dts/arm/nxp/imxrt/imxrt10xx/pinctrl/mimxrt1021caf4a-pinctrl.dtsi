/*
 * Copyright (c) 2022, NXP
 * SPDX-License-Identifier: Apache-2.0
 *
 * Note: File generated by rt_cfg_utils.py
 * from configuration data for MIMXRT1021CAF4A
 */

/*
 * Content deduplicated by dedup_pinctrl.py:
 * the pin mux data of this part is identical to mimxrt1021daf5a-pinctrl.dtsi.
 * Do not edit; edit the canonical file instead.
 * target-hash: d7273e3a6bf16495
 */

#include "mimxrt1021daf5a-pinctrl.dtsi"
