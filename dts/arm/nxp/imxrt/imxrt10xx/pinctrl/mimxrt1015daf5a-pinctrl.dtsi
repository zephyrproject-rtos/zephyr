/*
 * Copyright (c) 2022, NXP
 * SPDX-License-Identifier: Apache-2.0
 *
 * Note: File generated by rt_cfg_utils.py
 * from configuration data for MIMXRT1015DAF5A
 */

/*
 * Delta-deduplicated by dedup_pinctrl.py:
 * based on mimxrt1015daf5b-pinctrl.dtsi with this part's differences applied
 * below (6 removed, 0 changed,
 * 0 added). Regenerate with dedup_pinctrl.py;
 * do not edit by hand.
 * target-hash: 999979606ade8006
 */

#include "mimxrt1015daf5b-pinctrl.dtsi"

/delete-node/ &iomuxc_gpio_ad_b0_10_arm_trace_clk;
/delete-node/ &iomuxc_gpio_ad_b0_11_arm_trace_swo;
/delete-node/ &iomuxc_gpio_ad_b0_12_arm_trace0;
/delete-node/ &iomuxc_gpio_ad_b0_13_arm_trace1;
/delete-node/ &iomuxc_gpio_ad_b0_14_arm_trace2;
/delete-node/ &iomuxc_gpio_ad_b0_15_arm_trace3;
