/*
 * Copyright (c) 2022, NXP
 * SPDX-License-Identifier: Apache-2.0
 *
 * Note: File generated by rt_cfg_utils.py
 * from configuration data for MIMXRT1011DAE5A
 */

/*
 * SOC level pinctrl definitions
 * These definitions define SOC level defaults for each pin,
 * and select the pinmux for the pin. Pinmux entries are a tuple of:
 * <mux_register mux_mode input_register input_daisy config_register>
 * the mux_register and input_daisy reside in the IOMUXC peripheral, and
 * the pinctrl driver will write the mux_mode and input_daisy values into
 * each register, respectively. The config_register is used to configure
 * the pin based on the devicetree properties set
 */

&iomuxc {
	/omit-if-no-ref/ iomuxc_gpio_00_flexspi_b_dqs: IOMUXC_GPIO_00_FLEXSPI_B_DQS {
		pinmux = <0x401f80bc 0 0x401f8198 1 0x401f816c>;
	};

	/omit-if-no-ref/ iomuxc_gpio_00_gpiomux_io00: IOMUXC_GPIO_00_GPIOMUX_IO00 {
		pinmux = <0x401f80bc 5 0x0 0 0x401f816c>;
	};

	/omit-if-no-ref/ iomuxc_gpio_00_lpspi1_pcs3: IOMUXC_GPIO_00_LPSPI1_PCS3 {
		pinmux = <0x401f80bc 3 0x0 0 0x401f816c>;
	};

	/omit-if-no-ref/ iomuxc_gpio_00_lpspi2_pcs3: IOMUXC_GPIO_00_LPSPI2_PCS3 {
		pinmux = <0x401f80bc 2 0x0 0 0x401f816c>;
	};

	/omit-if-no-ref/ iomuxc_gpio_00_pit_trigger0: IOMUXC_GPIO_00_PIT_TRIGGER0 {
		pinmux = <0x401f80bc 4 0x0 0 0x401f816c>;
	};

	/omit-if-no-ref/ iomuxc_gpio_00_sai3_mclk: IOMUXC_GPIO_00_SAI3_MCLK {
		pinmux = <0x401f80bc 1 0x0 0 0x401f816c>;
	};

	/omit-if-no-ref/ iomuxc_gpio_01_flexpwm1_pwm0_b: IOMUXC_GPIO_01_FLEXPWM1_PWM0_B {
		pinmux = <0x401f80b8 2 0x401f8184 1 0x401f8168>;
	};

	/omit-if-no-ref/ iomuxc_gpio_01_gpiomux_io01: IOMUXC_GPIO_01_GPIOMUX_IO01 {
		pinmux = <0x401f80b8 5 0x0 0 0x401f8168>;
	};

	/omit-if-no-ref/ iomuxc_gpio_01_kpp_row3: IOMUXC_GPIO_01_KPP_ROW3 {
		pinmux = <0x401f80b8 4 0x401f81b8 1 0x401f8168>;
	};

	/omit-if-no-ref/ iomuxc_gpio_01_lpi2c1_sda: IOMUXC_GPIO_01_LPI2C1_SDA {
		pinmux = <0x401f80b8 3 0x401f81c4 3 0x401f8168>;
	};

	/omit-if-no-ref/ iomuxc_gpio_01_sai1_rx_bclk: IOMUXC_GPIO_01_SAI1_RX_BCLK {
		pinmux = <0x401f80b8 0 0x0 0 0x401f8168>;
	};

	/omit-if-no-ref/ iomuxc_gpio_01_wdog1_any: IOMUXC_GPIO_01_WDOG1_ANY {
		pinmux = <0x401f80b8 1 0x0 0 0x401f8168>;
	};

	/omit-if-no-ref/ iomuxc_gpio_02_flexpwm1_pwm0_a: IOMUXC_GPIO_02_FLEXPWM1_PWM0_A {
		pinmux = <0x401f80b4 2 0x401f8174 1 0x401f8164>;
	};

	/omit-if-no-ref/ iomuxc_gpio_02_gpiomux_io02: IOMUXC_GPIO_02_GPIOMUX_IO02 {
		pinmux = <0x401f80b4 5 0x0 0 0x401f8164>;
	};

	/omit-if-no-ref/ iomuxc_gpio_02_kpp_col3: IOMUXC_GPIO_02_KPP_COL3 {
		pinmux = <0x401f80b4 4 0x401f81a8 1 0x401f8164>;
	};

	/omit-if-no-ref/ iomuxc_gpio_02_lpi2c1_scl: IOMUXC_GPIO_02_LPI2C1_SCL {
		pinmux = <0x401f80b4 3 0x401f81c0 3 0x401f8164>;
	};

	/omit-if-no-ref/ iomuxc_gpio_02_sai1_rx_sync: IOMUXC_GPIO_02_SAI1_RX_SYNC {
		pinmux = <0x401f80b4 0 0x0 0 0x401f8164>;
	};

	/omit-if-no-ref/ iomuxc_gpio_02_wdog2_b: IOMUXC_GPIO_02_WDOG2_B {
		pinmux = <0x401f80b4 1 0x0 0 0x401f8164>;
	};

	/omit-if-no-ref/ iomuxc_gpio_03_flexpwm1_pwm1_b: IOMUXC_GPIO_03_FLEXPWM1_PWM1_B {
		pinmux = <0x401f80b0 2 0x401f8188 1 0x401f8160>;
	};

	/omit-if-no-ref/ iomuxc_gpio_03_gpiomux_io03: IOMUXC_GPIO_03_GPIOMUX_IO03 {
		pinmux = <0x401f80b0 5 0x0 0 0x401f8160>;
	};

	/omit-if-no-ref/ iomuxc_gpio_03_gpt1_compare3: IOMUXC_GPIO_03_GPT1_COMPARE3 {
		pinmux = <0x401f80b0 1 0x0 0 0x401f8160>;
	};

	/omit-if-no-ref/ iomuxc_gpio_03_sai1_rx_data0: IOMUXC_GPIO_03_SAI1_RX_DATA0 {
		pinmux = <0x401f80b0 0 0x0 0 0x401f8160>;
	};

	/omit-if-no-ref/ iomuxc_gpio_03_spdif_sr_clk: IOMUXC_GPIO_03_SPDIF_SR_CLK {
		pinmux = <0x401f80b0 4 0x0 0 0x401f8160>;
	};

	/omit-if-no-ref/ iomuxc_gpio_04_flexpwm1_pwm1_a: IOMUXC_GPIO_04_FLEXPWM1_PWM1_A {
		pinmux = <0x401f80ac 2 0x401f8178 1 0x401f815c>;
	};

	/omit-if-no-ref/ iomuxc_gpio_04_gpiomux_io04: IOMUXC_GPIO_04_GPIOMUX_IO04 {
		pinmux = <0x401f80ac 5 0x0 0 0x401f815c>;
	};

	/omit-if-no-ref/ iomuxc_gpio_04_gpt1_capture2: IOMUXC_GPIO_04_GPT1_CAPTURE2 {
		pinmux = <0x401f80ac 1 0x0 0 0x401f815c>;
	};

	/omit-if-no-ref/ iomuxc_gpio_04_sai1_tx_data0: IOMUXC_GPIO_04_SAI1_TX_DATA0 {
		pinmux = <0x401f80ac 0 0x0 0 0x401f815c>;
	};

	/omit-if-no-ref/ iomuxc_gpio_04_spdif_in: IOMUXC_GPIO_04_SPDIF_IN {
		pinmux = <0x401f80ac 4 0x401f8214 1 0x401f815c>;
	};

	/omit-if-no-ref/ iomuxc_gpio_05_flexpwm1_pwm2_b: IOMUXC_GPIO_05_FLEXPWM1_PWM2_B {
		pinmux = <0x401f80a8 2 0x401f818c 1 0x401f8158>;
	};

	/omit-if-no-ref/ iomuxc_gpio_05_gpiomux_io05: IOMUXC_GPIO_05_GPIOMUX_IO05 {
		pinmux = <0x401f80a8 5 0x0 0 0x401f8158>;
	};

	/omit-if-no-ref/ iomuxc_gpio_05_gpt1_compare2: IOMUXC_GPIO_05_GPT1_COMPARE2 {
		pinmux = <0x401f80a8 1 0x0 0 0x401f8158>;
	};

	/omit-if-no-ref/ iomuxc_gpio_05_lpuart4_rxd: IOMUXC_GPIO_05_LPUART4_RXD {
		pinmux = <0x401f80a8 3 0x401f8208 1 0x401f8158>;
	};

	/omit-if-no-ref/ iomuxc_gpio_05_sai1_tx_data1: IOMUXC_GPIO_05_SAI1_TX_DATA1 {
		pinmux = <0x401f80a8 0 0x0 0 0x401f8158>;
	};

	/omit-if-no-ref/ iomuxc_gpio_05_spdif_out: IOMUXC_GPIO_05_SPDIF_OUT {
		pinmux = <0x401f80a8 4 0x0 0 0x401f8158>;
	};

	/omit-if-no-ref/ iomuxc_gpio_06_flexpwm1_pwm2_a: IOMUXC_GPIO_06_FLEXPWM1_PWM2_A {
		pinmux = <0x401f80a4 2 0x401f817c 1 0x401f8154>;
	};

	/omit-if-no-ref/ iomuxc_gpio_06_gpiomux_io06: IOMUXC_GPIO_06_GPIOMUX_IO06 {
		pinmux = <0x401f80a4 5 0x0 0 0x401f8154>;
	};

	/omit-if-no-ref/ iomuxc_gpio_06_gpt1_capture1: IOMUXC_GPIO_06_GPT1_CAPTURE1 {
		pinmux = <0x401f80a4 1 0x0 0 0x401f8154>;
	};

	/omit-if-no-ref/ iomuxc_gpio_06_lpuart4_txd: IOMUXC_GPIO_06_LPUART4_TXD {
		pinmux = <0x401f80a4 3 0x401f820c 1 0x401f8154>;
	};

	/omit-if-no-ref/ iomuxc_gpio_06_sai1_tx_bclk: IOMUXC_GPIO_06_SAI1_TX_BCLK {
		pinmux = <0x401f80a4 0 0x0 0 0x401f8154>;
	};

	/omit-if-no-ref/ iomuxc_gpio_06_spdif_ext_clk: IOMUXC_GPIO_06_SPDIF_EXT_CLK {
		pinmux = <0x401f80a4 4 0x401f8218 1 0x401f8154>;
	};

	/omit-if-no-ref/ iomuxc_gpio_07_flexpwm1_pwm3_b: IOMUXC_GPIO_07_FLEXPWM1_PWM3_B {
		pinmux = <0x401f80a0 2 0x401f8190 1 0x401f8150>;
	};

	/omit-if-no-ref/ iomuxc_gpio_07_gpiomux_io07: IOMUXC_GPIO_07_GPIOMUX_IO07 {
		pinmux = <0x401f80a0 5 0x0 0 0x401f8150>;
	};

	/omit-if-no-ref/ iomuxc_gpio_07_gpt1_compare1: IOMUXC_GPIO_07_GPT1_COMPARE1 {
		pinmux = <0x401f80a0 1 0x0 0 0x401f8150>;
	};

	/omit-if-no-ref/ iomuxc_gpio_07_lpuart1_rts_b: IOMUXC_GPIO_07_LPUART1_RTS_B {
		pinmux = <0x401f80a0 6 0x0 0 0x401f8150>;
	};

	/omit-if-no-ref/ iomuxc_gpio_07_lpuart3_rxd: IOMUXC_GPIO_07_LPUART3_RXD {
		pinmux = <0x401f80a0 3 0x401f8200 2 0x401f8150>;
	};

	/omit-if-no-ref/ iomuxc_gpio_07_sai1_tx_sync: IOMUXC_GPIO_07_SAI1_TX_SYNC {
		pinmux = <0x401f80a0 0 0x0 0 0x401f8150>;
	};

	/omit-if-no-ref/ iomuxc_gpio_07_spdif_lock: IOMUXC_GPIO_07_SPDIF_LOCK {
		pinmux = <0x401f80a0 4 0x0 0 0x401f8150>;
	};

	/omit-if-no-ref/ iomuxc_gpio_08_flexio1_io00: IOMUXC_GPIO_08_FLEXIO1_IO00 {
		pinmux = <0x401f809c 4 0x0 0 0x401f814c>;
	};

	/omit-if-no-ref/ iomuxc_gpio_08_flexpwm1_pwm3_a: IOMUXC_GPIO_08_FLEXPWM1_PWM3_A {
		pinmux = <0x401f809c 2 0x401f8180 1 0x401f814c>;
	};

	/omit-if-no-ref/ iomuxc_gpio_08_gpiomux_io08: IOMUXC_GPIO_08_GPIOMUX_IO08 {
		pinmux = <0x401f809c 5 0x0 0 0x401f814c>;
	};

	/omit-if-no-ref/ iomuxc_gpio_08_gpt1_clk: IOMUXC_GPIO_08_GPT1_CLK {
		pinmux = <0x401f809c 1 0x0 0 0x401f814c>;
	};

	/omit-if-no-ref/ iomuxc_gpio_08_lpuart1_cts_b: IOMUXC_GPIO_08_LPUART1_CTS_B {
		pinmux = <0x401f809c 6 0x0 0 0x401f814c>;
	};

	/omit-if-no-ref/ iomuxc_gpio_08_lpuart3_txd: IOMUXC_GPIO_08_LPUART3_TXD {
		pinmux = <0x401f809c 3 0x401f8204 2 0x401f814c>;
	};

	/omit-if-no-ref/ iomuxc_gpio_08_sai1_mclk: IOMUXC_GPIO_08_SAI1_MCLK {
		pinmux = <0x401f809c 0 0x0 0 0x401f814c>;
	};

	/omit-if-no-ref/ iomuxc_gpio_09_flexio1_io01: IOMUXC_GPIO_09_FLEXIO1_IO01 {
		pinmux = <0x401f8098 4 0x0 0 0x401f8148>;
	};

	/omit-if-no-ref/ iomuxc_gpio_09_flexspi_a_ss1_b: IOMUXC_GPIO_09_FLEXSPI_A_SS1_B {
		pinmux = <0x401f8098 2 0x0 0 0x401f8148>;
	};

	/omit-if-no-ref/ iomuxc_gpio_09_gpiomux_io09: IOMUXC_GPIO_09_GPIOMUX_IO09 {
		pinmux = <0x401f8098 5 0x0 0 0x401f8148>;
	};

	/omit-if-no-ref/ iomuxc_gpio_09_lpi2c2_sda: IOMUXC_GPIO_09_LPI2C2_SDA {
		pinmux = <0x401f8098 3 0x401f81cc 3 0x401f8148>;
	};

	/omit-if-no-ref/ iomuxc_gpio_09_lpuart1_rxd: IOMUXC_GPIO_09_LPUART1_RXD {
		pinmux = <0x401f8098 0 0x401f81f0 1 0x401f8148>;
	};

	/omit-if-no-ref/ iomuxc_gpio_09_spdif_sr_clk: IOMUXC_GPIO_09_SPDIF_SR_CLK {
		pinmux = <0x401f8098 6 0x0 0 0x401f8148>;
	};

	/omit-if-no-ref/ iomuxc_gpio_09_wdog1_b: IOMUXC_GPIO_09_WDOG1_B {
		pinmux = <0x401f8098 1 0x0 0 0x401f8148>;
	};

	/omit-if-no-ref/ iomuxc_gpio_10_ewm_out_b: IOMUXC_GPIO_10_EWM_OUT_B {
		pinmux = <0x401f8094 2 0x0 0 0x401f8144>;
	};

	/omit-if-no-ref/ iomuxc_gpio_10_flexio1_io02: IOMUXC_GPIO_10_FLEXIO1_IO02 {
		pinmux = <0x401f8094 4 0x0 0 0x401f8144>;
	};

	/omit-if-no-ref/ iomuxc_gpio_10_gpiomux_io10: IOMUXC_GPIO_10_GPIOMUX_IO10 {
		pinmux = <0x401f8094 5 0x0 0 0x401f8144>;
	};

	/omit-if-no-ref/ iomuxc_gpio_10_lpi2c1_hreq: IOMUXC_GPIO_10_LPI2C1_HREQ {
		pinmux = <0x401f8094 1 0x401f81bc 1 0x401f8144>;
	};

	/omit-if-no-ref/ iomuxc_gpio_10_lpi2c2_scl: IOMUXC_GPIO_10_LPI2C2_SCL {
		pinmux = <0x401f8094 3 0x401f81c8 3 0x401f8144>;
	};

	/omit-if-no-ref/ iomuxc_gpio_10_lpuart1_txd: IOMUXC_GPIO_10_LPUART1_TXD {
		pinmux = <0x401f8094 0 0x401f81f4 1 0x401f8144>;
	};

	/omit-if-no-ref/ iomuxc_gpio_10_spdif_in: IOMUXC_GPIO_10_SPDIF_IN {
		pinmux = <0x401f8094 6 0x401f8214 0 0x401f8144>;
	};

	/omit-if-no-ref/ iomuxc_gpio_11_arm_trace3: IOMUXC_GPIO_11_ARM_TRACE3 {
		pinmux = <0x401f8090 7 0x0 0 0x401f8140>;
	};

	/omit-if-no-ref/ iomuxc_gpio_11_flexio1_io03: IOMUXC_GPIO_11_FLEXIO1_IO03 {
		pinmux = <0x401f8090 4 0x0 0 0x401f8140>;
	};

	/omit-if-no-ref/ iomuxc_gpio_11_flexspi_b_ss1_b: IOMUXC_GPIO_11_FLEXSPI_B_SS1_B {
		pinmux = <0x401f8090 3 0x0 0 0x401f8140>;
	};

	/omit-if-no-ref/ iomuxc_gpio_11_gpiomux_io11: IOMUXC_GPIO_11_GPIOMUX_IO11 {
		pinmux = <0x401f8090 5 0x0 0 0x401f8140>;
	};

	/omit-if-no-ref/ iomuxc_gpio_11_kpp_row0: IOMUXC_GPIO_11_KPP_ROW0 {
		pinmux = <0x401f8090 2 0x401f81ac 1 0x401f8140>;
	};

	/omit-if-no-ref/ iomuxc_gpio_11_lpi2c1_sda: IOMUXC_GPIO_11_LPI2C1_SDA {
		pinmux = <0x401f8090 1 0x401f81c4 2 0x401f8140>;
	};

	/omit-if-no-ref/ iomuxc_gpio_11_lpuart3_rxd: IOMUXC_GPIO_11_LPUART3_RXD {
		pinmux = <0x401f8090 0 0x401f8200 1 0x401f8140>;
	};

	/omit-if-no-ref/ iomuxc_gpio_11_spdif_out: IOMUXC_GPIO_11_SPDIF_OUT {
		pinmux = <0x401f8090 6 0x0 0 0x401f8140>;
	};

	/omit-if-no-ref/ iomuxc_gpio_12_arm_trace2: IOMUXC_GPIO_12_ARM_TRACE2 {
		pinmux = <0x401f808c 7 0x0 0 0x401f813c>;
	};

	/omit-if-no-ref/ iomuxc_gpio_12_flexio1_io04: IOMUXC_GPIO_12_FLEXIO1_IO04 {
		pinmux = <0x401f808c 4 0x0 0 0x401f813c>;
	};

	/omit-if-no-ref/ iomuxc_gpio_12_gpiomux_io12: IOMUXC_GPIO_12_GPIOMUX_IO12 {
		pinmux = <0x401f808c 5 0x0 0 0x401f813c>;
	};

	/omit-if-no-ref/ iomuxc_gpio_12_kpp_col0: IOMUXC_GPIO_12_KPP_COL0 {
		pinmux = <0x401f808c 2 0x401f819c 1 0x401f813c>;
	};

	/omit-if-no-ref/ iomuxc_gpio_12_lpi2c1_scl: IOMUXC_GPIO_12_LPI2C1_SCL {
		pinmux = <0x401f808c 1 0x401f81c0 2 0x401f813c>;
	};

	/omit-if-no-ref/ iomuxc_gpio_12_lpuart3_txd: IOMUXC_GPIO_12_LPUART3_TXD {
		pinmux = <0x401f808c 0 0x401f8204 1 0x401f813c>;
	};

	/omit-if-no-ref/ iomuxc_gpio_12_spdif_ext_clk: IOMUXC_GPIO_12_SPDIF_EXT_CLK {
		pinmux = <0x401f808c 6 0x401f8218 0 0x401f813c>;
	};

	/omit-if-no-ref/ iomuxc_gpio_12_usb_otg1_oc: IOMUXC_GPIO_12_USB_OTG1_OC {
		pinmux = <0x401f808c 3 0x401f821c 1 0x401f813c>;
	};

	/omit-if-no-ref/ iomuxc_gpio_13_arm_trace1: IOMUXC_GPIO_13_ARM_TRACE1 {
		pinmux = <0x401f8088 7 0x0 0 0x401f8138>;
	};

	/omit-if-no-ref/ iomuxc_gpio_13_flexio1_io05: IOMUXC_GPIO_13_FLEXIO1_IO05 {
		pinmux = <0x401f8088 4 0x0 0 0x401f8138>;
	};

	/omit-if-no-ref/ iomuxc_gpio_13_gpiomux_io13: IOMUXC_GPIO_13_GPIOMUX_IO13 {
		pinmux = <0x401f8088 5 0x0 0 0x401f8138>;
	};

	/omit-if-no-ref/ iomuxc_gpio_13_kpp_row3: IOMUXC_GPIO_13_KPP_ROW3 {
		pinmux = <0x401f8088 2 0x401f81b8 0 0x401f8138>;
	};

	/omit-if-no-ref/ iomuxc_gpio_13_lpspi2_pcs2: IOMUXC_GPIO_13_LPSPI2_PCS2 {
		pinmux = <0x401f8088 1 0x0 0 0x401f8138>;
	};

	/omit-if-no-ref/ iomuxc_gpio_13_lpuart2_rxd: IOMUXC_GPIO_13_LPUART2_RXD {
		pinmux = <0x401f8088 0 0x401f81f8 1 0x401f8138>;
	};

	/omit-if-no-ref/ iomuxc_gpio_13_spdif_lock: IOMUXC_GPIO_13_SPDIF_LOCK {
		pinmux = <0x401f8088 6 0x0 0 0x401f8138>;
	};

	/omit-if-no-ref/ iomuxc_gpio_13_usb_otg1_id: IOMUXC_GPIO_13_USB_OTG1_ID {
		pinmux = <0x401f8088 3 0x401f8170 1 0x401f8138>;
	};

	/omit-if-no-ref/ iomuxc_gpio_ad_00_adc1_in0: IOMUXC_GPIO_AD_00_ADC1_IN0 {
		pinmux = <0x401f8048 5 0x0 0 0x401f80f8>;
	};

	/omit-if-no-ref/ iomuxc_gpio_ad_00_arm_nmi: IOMUXC_GPIO_AD_00_ARM_NMI {
		pinmux = <0x401f8048 6 0x401f8210 1 0x401f80f8>;
	};

	/omit-if-no-ref/ iomuxc_gpio_ad_00_arm_trace0: IOMUXC_GPIO_AD_00_ARM_TRACE0 {
		pinmux = <0x401f8048 7 0x0 0 0x401f80f8>;
	};

	/omit-if-no-ref/ iomuxc_gpio_ad_00_flexio1_io20: IOMUXC_GPIO_AD_00_FLEXIO1_IO20 {
		pinmux = <0x401f8048 4 0x0 0 0x401f80f8>;
	};

	/omit-if-no-ref/ iomuxc_gpio_ad_00_gpiomux_io14: IOMUXC_GPIO_AD_00_GPIOMUX_IO14 {
		pinmux = <0x401f8048 5 0x0 0 0x401f80f8>;
	};

	/omit-if-no-ref/ iomuxc_gpio_ad_00_kpp_col3: IOMUXC_GPIO_AD_00_KPP_COL3 {
		pinmux = <0x401f8048 2 0x401f81a8 0 0x401f80f8>;
	};

	/omit-if-no-ref/ iomuxc_gpio_ad_00_lpspi1_pcs2: IOMUXC_GPIO_AD_00_LPSPI1_PCS2 {
		pinmux = <0x401f8048 1 0x0 0 0x401f80f8>;
	};

	/omit-if-no-ref/ iomuxc_gpio_ad_00_lpuart2_txd: IOMUXC_GPIO_AD_00_LPUART2_TXD {
		pinmux = <0x401f8048 0 0x401f81fc 0 0x401f80f8>;
	};

	/omit-if-no-ref/ iomuxc_gpio_ad_00_usb_otg1_pwr: IOMUXC_GPIO_AD_00_USB_OTG1_PWR {
		pinmux = <0x401f8048 3 0x0 0 0x401f80f8>;
	};

	/omit-if-no-ref/ iomuxc_gpio_ad_01_adc1_in1: IOMUXC_GPIO_AD_01_ADC1_IN1 {
		pinmux = <0x401f8044 5 0x0 0 0x401f80f4>;
	};

	/omit-if-no-ref/ iomuxc_gpio_ad_01_arm_trace_swo: IOMUXC_GPIO_AD_01_ARM_TRACE_SWO {
		pinmux = <0x401f8044 7 0x0 0 0x401f80f4>;
	};

	/omit-if-no-ref/ iomuxc_gpio_ad_01_gpiomux_io15: IOMUXC_GPIO_AD_01_GPIOMUX_IO15 {
		pinmux = <0x401f8044 5 0x0 0 0x401f80f4>;
	};

	/omit-if-no-ref/ iomuxc_gpio_ad_01_lpi2c2_sda: IOMUXC_GPIO_AD_01_LPI2C2_SDA {
		pinmux = <0x401f8044 3 0x401f81cc 1 0x401f80f4>;
	};

	/omit-if-no-ref/ iomuxc_gpio_ad_01_lpspi2_pcs1: IOMUXC_GPIO_AD_01_LPSPI2_PCS1 {
		pinmux = <0x401f8044 1 0x0 0 0x401f80f4>;
	};

	/omit-if-no-ref/ iomuxc_gpio_ad_01_lpuart4_rxd: IOMUXC_GPIO_AD_01_LPUART4_RXD {
		pinmux = <0x401f8044 0 0x401f8208 0 0x401f80f4>;
	};

	/omit-if-no-ref/ iomuxc_gpio_ad_01_mqs_left: IOMUXC_GPIO_AD_01_MQS_LEFT {
		pinmux = <0x401f8044 4 0x0 0 0x401f80f4>;
	};

	/omit-if-no-ref/ iomuxc_gpio_ad_01_usb_otg1_oc: IOMUXC_GPIO_AD_01_USB_OTG1_OC {
		pinmux = <0x401f8044 6 0x401f821c 0 0x401f80f4>;
	};

	/omit-if-no-ref/ iomuxc_gpio_ad_01_wdog1_any: IOMUXC_GPIO_AD_01_WDOG1_ANY {
		pinmux = <0x401f8044 2 0x0 0 0x401f80f4>;
	};

	/omit-if-no-ref/ iomuxc_gpio_ad_02_adc1_in2: IOMUXC_GPIO_AD_02_ADC1_IN2 {
		pinmux = <0x401f8040 5 0x0 0 0x401f80f0>;
	};

	/omit-if-no-ref/ iomuxc_gpio_ad_02_arm_trace_clk: IOMUXC_GPIO_AD_02_ARM_TRACE_CLK {
		pinmux = <0x401f8040 7 0x0 0 0x401f80f0>;
	};

	/omit-if-no-ref/ iomuxc_gpio_ad_02_gpiomux_io16: IOMUXC_GPIO_AD_02_GPIOMUX_IO16 {
		pinmux = <0x401f8040 5 0x0 0 0x401f80f0>;
	};

	/omit-if-no-ref/ iomuxc_gpio_ad_02_lpi2c2_scl: IOMUXC_GPIO_AD_02_LPI2C2_SCL {
		pinmux = <0x401f8040 3 0x401f81c8 1 0x401f80f0>;
	};

	/omit-if-no-ref/ iomuxc_gpio_ad_02_lpspi1_pcs1: IOMUXC_GPIO_AD_02_LPSPI1_PCS1 {
		pinmux = <0x401f8040 1 0x0 0 0x401f80f0>;
	};

	/omit-if-no-ref/ iomuxc_gpio_ad_02_lpuart4_txd: IOMUXC_GPIO_AD_02_LPUART4_TXD {
		pinmux = <0x401f8040 0 0x401f820c 0 0x401f80f0>;
	};

	/omit-if-no-ref/ iomuxc_gpio_ad_02_mqs_right: IOMUXC_GPIO_AD_02_MQS_RIGHT {
		pinmux = <0x401f8040 4 0x0 0 0x401f80f0>;
	};

	/omit-if-no-ref/ iomuxc_gpio_ad_02_wdog2_b: IOMUXC_GPIO_AD_02_WDOG2_B {
		pinmux = <0x401f8040 2 0x0 0 0x401f80f0>;
	};

	/omit-if-no-ref/ iomuxc_gpio_ad_03_adc1_in3: IOMUXC_GPIO_AD_03_ADC1_IN3 {
		pinmux = <0x401f803c 5 0x0 0 0x401f80ec>;
	};

	/omit-if-no-ref/ iomuxc_gpio_ad_03_flexpwm1_pwm2_b: IOMUXC_GPIO_AD_03_FLEXPWM1_PWM2_B {
		pinmux = <0x401f803c 2 0x401f818c 0 0x401f80ec>;
	};

	/omit-if-no-ref/ iomuxc_gpio_ad_03_gpiomux_io17: IOMUXC_GPIO_AD_03_GPIOMUX_IO17 {
		pinmux = <0x401f803c 5 0x0 0 0x401f80ec>;
	};

	/omit-if-no-ref/ iomuxc_gpio_ad_03_gpt2_clk: IOMUXC_GPIO_AD_03_GPT2_CLK {
		pinmux = <0x401f803c 4 0x0 0 0x401f80ec>;
	};

	/omit-if-no-ref/ iomuxc_gpio_ad_03_jtag_de_b: IOMUXC_GPIO_AD_03_JTAG_DE_B {
		pinmux = <0x401f803c 7 0x0 0 0x401f80ec>;
	};

	/omit-if-no-ref/ iomuxc_gpio_ad_03_kpp_row2: IOMUXC_GPIO_AD_03_KPP_ROW2 {
		pinmux = <0x401f803c 3 0x401f81b4 1 0x401f80ec>;
	};

	/omit-if-no-ref/ iomuxc_gpio_ad_03_lpspi1_sdi: IOMUXC_GPIO_AD_03_LPSPI1_SDI {
		pinmux = <0x401f803c 0 0x401f81d8 0 0x401f80ec>;
	};

	/omit-if-no-ref/ iomuxc_gpio_ad_03_pit_trigger3: IOMUXC_GPIO_AD_03_PIT_TRIGGER3 {
		pinmux = <0x401f803c 1 0x0 0 0x401f80ec>;
	};

	/omit-if-no-ref/ iomuxc_gpio_ad_03_snvs_vio_5_b: IOMUXC_GPIO_AD_03_SNVS_VIO_5_B {
		pinmux = <0x401f803c 6 0x0 0 0x401f80ec>;
	};

	/omit-if-no-ref/ iomuxc_gpio_ad_04_adc1_in4: IOMUXC_GPIO_AD_04_ADC1_IN4 {
		pinmux = <0x401f8038 5 0x0 0 0x401f80e8>;
	};

	/omit-if-no-ref/ iomuxc_gpio_ad_04_flexpwm1_pwm2_a: IOMUXC_GPIO_AD_04_FLEXPWM1_PWM2_A {
		pinmux = <0x401f8038 2 0x401f817c 0 0x401f80e8>;
	};

	/omit-if-no-ref/ iomuxc_gpio_ad_04_gpiomux_io18: IOMUXC_GPIO_AD_04_GPIOMUX_IO18 {
		pinmux = <0x401f8038 5 0x0 0 0x401f80e8>;
	};

	/omit-if-no-ref/ iomuxc_gpio_ad_04_gpt2_compare1: IOMUXC_GPIO_AD_04_GPT2_COMPARE1 {
		pinmux = <0x401f8038 4 0x0 0 0x401f80e8>;
	};

	/omit-if-no-ref/ iomuxc_gpio_ad_04_kpp_col2: IOMUXC_GPIO_AD_04_KPP_COL2 {
		pinmux = <0x401f8038 3 0x401f81a4 1 0x401f80e8>;
	};

	/omit-if-no-ref/ iomuxc_gpio_ad_04_lpspi1_sdo: IOMUXC_GPIO_AD_04_LPSPI1_SDO {
		pinmux = <0x401f8038 0 0x401f81dc 0 0x401f80e8>;
	};

	/omit-if-no-ref/ iomuxc_gpio_ad_04_pit_trigger2: IOMUXC_GPIO_AD_04_PIT_TRIGGER2 {
		pinmux = <0x401f8038 1 0x0 0 0x401f80e8>;
	};

	/omit-if-no-ref/ iomuxc_gpio_ad_04_snvs_vio_5_ctl: IOMUXC_GPIO_AD_04_SNVS_VIO_5_CTL {
		pinmux = <0x401f8038 6 0x0 0 0x401f80e8>;
	};

	/omit-if-no-ref/ iomuxc_gpio_ad_05_adc1_in5: IOMUXC_GPIO_AD_05_ADC1_IN5 {
		pinmux = <0x401f8034 5 0x0 0 0x401f80e4>;
	};

	/omit-if-no-ref/ iomuxc_gpio_ad_05_flexpwm1_pwm3_b: IOMUXC_GPIO_AD_05_FLEXPWM1_PWM3_B {
		pinmux = <0x401f8034 2 0x401f8190 0 0x401f80e4>;
	};

	/omit-if-no-ref/ iomuxc_gpio_ad_05_gpiomux_io19: IOMUXC_GPIO_AD_05_GPIOMUX_IO19 {
		pinmux = <0x401f8034 5 0x0 0 0x401f80e4>;
	};

	/omit-if-no-ref/ iomuxc_gpio_ad_05_gpt2_capture1: IOMUXC_GPIO_AD_05_GPT2_CAPTURE1 {
		pinmux = <0x401f8034 4 0x0 0 0x401f80e4>;
	};

	/omit-if-no-ref/ iomuxc_gpio_ad_05_kpp_row1: IOMUXC_GPIO_AD_05_KPP_ROW1 {
		pinmux = <0x401f8034 3 0x401f81b0 1 0x401f80e4>;
	};

	/omit-if-no-ref/ iomuxc_gpio_ad_05_lpspi1_pcs0: IOMUXC_GPIO_AD_05_LPSPI1_PCS0 {
		pinmux = <0x401f8034 0 0x401f81d0 0 0x401f80e4>;
	};

	/omit-if-no-ref/ iomuxc_gpio_ad_05_pit_trigger1: IOMUXC_GPIO_AD_05_PIT_TRIGGER1 {
		pinmux = <0x401f8034 1 0x0 0 0x401f80e4>;
	};

	/omit-if-no-ref/ iomuxc_gpio_ad_06_adc1_in6: IOMUXC_GPIO_AD_06_ADC1_IN6 {
		pinmux = <0x401f8030 5 0x0 0 0x401f80e0>;
	};

	/omit-if-no-ref/ iomuxc_gpio_ad_06_flexpwm1_pwm3_a: IOMUXC_GPIO_AD_06_FLEXPWM1_PWM3_A {
		pinmux = <0x401f8030 2 0x401f8180 0 0x401f80e0>;
	};

	/omit-if-no-ref/ iomuxc_gpio_ad_06_gpiomux_io20: IOMUXC_GPIO_AD_06_GPIOMUX_IO20 {
		pinmux = <0x401f8030 5 0x0 0 0x401f80e0>;
	};

	/omit-if-no-ref/ iomuxc_gpio_ad_06_gpt2_compare2: IOMUXC_GPIO_AD_06_GPT2_COMPARE2 {
		pinmux = <0x401f8030 4 0x0 0 0x401f80e0>;
	};

	/omit-if-no-ref/ iomuxc_gpio_ad_06_kpp_col1: IOMUXC_GPIO_AD_06_KPP_COL1 {
		pinmux = <0x401f8030 3 0x401f81a0 1 0x401f80e0>;
	};

	/omit-if-no-ref/ iomuxc_gpio_ad_06_lpi2c1_hreq: IOMUXC_GPIO_AD_06_LPI2C1_HREQ {
		pinmux = <0x401f8030 6 0x401f81bc 0 0x401f80e0>;
	};

	/omit-if-no-ref/ iomuxc_gpio_ad_06_lpspi1_sck: IOMUXC_GPIO_AD_06_LPSPI1_SCK {
		pinmux = <0x401f8030 0 0x401f81d4 0 0x401f80e0>;
	};

	/omit-if-no-ref/ iomuxc_gpio_ad_06_pit_trigger0: IOMUXC_GPIO_AD_06_PIT_TRIGGER0 {
		pinmux = <0x401f8030 1 0x0 0 0x401f80e0>;
	};

	/omit-if-no-ref/ iomuxc_gpio_ad_07_adc1_in7: IOMUXC_GPIO_AD_07_ADC1_IN7 {
		pinmux = <0x401f802c 5 0x0 0 0x401f80dc>;
	};

	/omit-if-no-ref/ iomuxc_gpio_ad_07_arm_cm7_rxev: IOMUXC_GPIO_AD_07_ARM_CM7_RXEV {
		pinmux = <0x401f802c 2 0x401f8220 0 0x401f80dc>;
	};

	/omit-if-no-ref/ iomuxc_gpio_ad_07_gpiomux_io21: IOMUXC_GPIO_AD_07_GPIOMUX_IO21 {
		pinmux = <0x401f802c 5 0x0 0 0x401f80dc>;
	};

	/omit-if-no-ref/ iomuxc_gpio_ad_07_gpt2_capture2: IOMUXC_GPIO_AD_07_GPT2_CAPTURE2 {
		pinmux = <0x401f802c 4 0x0 0 0x401f80dc>;
	};

	/omit-if-no-ref/ iomuxc_gpio_ad_07_lpi2c2_sda: IOMUXC_GPIO_AD_07_LPI2C2_SDA {
		pinmux = <0x401f802c 0 0x401f81cc 0 0x401f80dc>;
	};

	/omit-if-no-ref/ iomuxc_gpio_ad_07_lpuart2_rts_b: IOMUXC_GPIO_AD_07_LPUART2_RTS_B {
		pinmux = <0x401f802c 3 0x0 0 0x401f80dc>;
	};

	/omit-if-no-ref/ iomuxc_gpio_ad_07_lpuart3_rxd: IOMUXC_GPIO_AD_07_LPUART3_RXD {
		pinmux = <0x401f802c 1 0x401f8200 0 0x401f80dc>;
	};

	/omit-if-no-ref/ iomuxc_gpio_ad_07_ocotp_fuse_latched:
	IOMUXC_GPIO_AD_07_OCOTP_FUSE_LATCHED {
		pinmux = <0x401f802c 6 0x0 0 0x401f80dc>;
	};

	/omit-if-no-ref/ iomuxc_gpio_ad_07_xbar1_in03: IOMUXC_GPIO_AD_07_XBAR1_IN03 {
		pinmux = <0x401f802c 7 0x0 0 0x401f80dc>;
		gpr = <0x400ac018 0x11 0x0>;
	};

	/omit-if-no-ref/ iomuxc_gpio_ad_07_xbar1_inout03: IOMUXC_GPIO_AD_07_XBAR1_INOUT03 {
		pinmux = <0x401f802c 7 0x0 0 0x401f80dc>;
		gpr = <0x400ac018 0x11 0x0>;
	};

	/omit-if-no-ref/ iomuxc_gpio_ad_08_adc1_in8: IOMUXC_GPIO_AD_08_ADC1_IN8 {
		pinmux = <0x401f8028 5 0x0 0 0x401f80d8>;
	};

	/omit-if-no-ref/ iomuxc_gpio_ad_08_arm_cm7_txev: IOMUXC_GPIO_AD_08_ARM_CM7_TXEV {
		pinmux = <0x401f8028 2 0x0 0 0x401f80d8>;
	};

	/omit-if-no-ref/ iomuxc_gpio_ad_08_ewm_out_b: IOMUXC_GPIO_AD_08_EWM_OUT_B {
		pinmux = <0x401f8028 6 0x0 0 0x401f80d8>;
	};

	/omit-if-no-ref/ iomuxc_gpio_ad_08_gpiomux_io22: IOMUXC_GPIO_AD_08_GPIOMUX_IO22 {
		pinmux = <0x401f8028 5 0x0 0 0x401f80d8>;
	};

	/omit-if-no-ref/ iomuxc_gpio_ad_08_gpt2_compare3: IOMUXC_GPIO_AD_08_GPT2_COMPARE3 {
		pinmux = <0x401f8028 4 0x0 0 0x401f80d8>;
	};

	/omit-if-no-ref/ iomuxc_gpio_ad_08_jtag_trstb: IOMUXC_GPIO_AD_08_JTAG_TRSTB {
		pinmux = <0x401f8028 7 0x0 0 0x401f80d8>;
	};

	/omit-if-no-ref/ iomuxc_gpio_ad_08_lpi2c2_scl: IOMUXC_GPIO_AD_08_LPI2C2_SCL {
		pinmux = <0x401f8028 0 0x401f81c8 0 0x401f80d8>;
	};

	/omit-if-no-ref/ iomuxc_gpio_ad_08_lpuart2_cts_b: IOMUXC_GPIO_AD_08_LPUART2_CTS_B {
		pinmux = <0x401f8028 3 0x0 0 0x401f80d8>;
	};

	/omit-if-no-ref/ iomuxc_gpio_ad_08_lpuart3_txd: IOMUXC_GPIO_AD_08_LPUART3_TXD {
		pinmux = <0x401f8028 1 0x401f8204 0 0x401f80d8>;
	};

	/omit-if-no-ref/ iomuxc_gpio_ad_09_adc1_in9: IOMUXC_GPIO_AD_09_ADC1_IN9 {
		pinmux = <0x401f8024 5 0x0 0 0x401f80d4>;
	};

	/omit-if-no-ref/ iomuxc_gpio_ad_09_arm_trace_swo: IOMUXC_GPIO_AD_09_ARM_TRACE_SWO {
		pinmux = <0x401f8024 3 0x0 0 0x401f80d4>;
	};

	/omit-if-no-ref/ iomuxc_gpio_ad_09_flexio1_io21: IOMUXC_GPIO_AD_09_FLEXIO1_IO21 {
		pinmux = <0x401f8024 4 0x0 0 0x401f80d4>;
	};

	/omit-if-no-ref/ iomuxc_gpio_ad_09_flexpwm1_pwm3_x: IOMUXC_GPIO_AD_09_FLEXPWM1_PWM3_X {
		pinmux = <0x401f8024 1 0x0 0 0x401f80d4>;
	};

	/omit-if-no-ref/ iomuxc_gpio_ad_09_gpiomux_io23: IOMUXC_GPIO_AD_09_GPIOMUX_IO23 {
		pinmux = <0x401f8024 5 0x0 0 0x401f80d4>;
	};

	/omit-if-no-ref/ iomuxc_gpio_ad_09_jtag_tdo: IOMUXC_GPIO_AD_09_JTAG_TDO {
		pinmux = <0x401f8024 7 0x0 0 0x401f80d4>;
	};

	/omit-if-no-ref/ iomuxc_gpio_ad_09_kpp_row2: IOMUXC_GPIO_AD_09_KPP_ROW2 {
		pinmux = <0x401f8024 2 0x401f81b4 0 0x401f80d4>;
	};

	/omit-if-no-ref/ iomuxc_gpio_ad_09_lpspi2_sdi: IOMUXC_GPIO_AD_09_LPSPI2_SDI {
		pinmux = <0x401f8024 0 0x401f81e8 0 0x401f80d4>;
	};

	/omit-if-no-ref/ iomuxc_gpio_ad_10_adc1_in10: IOMUXC_GPIO_AD_10_ADC1_IN10 {
		pinmux = <0x401f8020 5 0x0 0 0x401f80d0>;
	};

	/omit-if-no-ref/ iomuxc_gpio_ad_10_flexio1_io22: IOMUXC_GPIO_AD_10_FLEXIO1_IO22 {
		pinmux = <0x401f8020 4 0x0 0 0x401f80d0>;
	};

	/omit-if-no-ref/ iomuxc_gpio_ad_10_flexpwm1_pwm2_x: IOMUXC_GPIO_AD_10_FLEXPWM1_PWM2_X {
		pinmux = <0x401f8020 1 0x0 0 0x401f80d0>;
	};

	/omit-if-no-ref/ iomuxc_gpio_ad_10_gpiomux_io24: IOMUXC_GPIO_AD_10_GPIOMUX_IO24 {
		pinmux = <0x401f8020 5 0x0 0 0x401f80d0>;
	};

	/omit-if-no-ref/ iomuxc_gpio_ad_10_jtag_tdi: IOMUXC_GPIO_AD_10_JTAG_TDI {
		pinmux = <0x401f8020 7 0x0 0 0x401f80d0>;
	};

	/omit-if-no-ref/ iomuxc_gpio_ad_10_kpp_col2: IOMUXC_GPIO_AD_10_KPP_COL2 {
		pinmux = <0x401f8020 2 0x401f81a4 0 0x401f80d0>;
	};

	/omit-if-no-ref/ iomuxc_gpio_ad_10_lpspi2_sdo: IOMUXC_GPIO_AD_10_LPSPI2_SDO {
		pinmux = <0x401f8020 0 0x401f81ec 0 0x401f80d0>;
	};

	/omit-if-no-ref/ iomuxc_gpio_ad_10_pit_trigger3: IOMUXC_GPIO_AD_10_PIT_TRIGGER3 {
		pinmux = <0x401f8020 3 0x0 0 0x401f80d0>;
	};

	/omit-if-no-ref/ iomuxc_gpio_ad_10_usb_otg1_id: IOMUXC_GPIO_AD_10_USB_OTG1_ID {
		pinmux = <0x401f8020 6 0x401f8170 0 0x401f80d0>;
	};

	/omit-if-no-ref/ iomuxc_gpio_ad_11_adc1_in11: IOMUXC_GPIO_AD_11_ADC1_IN11 {
		pinmux = <0x401f801c 5 0x0 0 0x401f80cc>;
	};

	/omit-if-no-ref/ iomuxc_gpio_ad_11_flexio1_io23: IOMUXC_GPIO_AD_11_FLEXIO1_IO23 {
		pinmux = <0x401f801c 4 0x0 0 0x401f80cc>;
	};

	/omit-if-no-ref/ iomuxc_gpio_ad_11_flexpwm1_pwm1_x: IOMUXC_GPIO_AD_11_FLEXPWM1_PWM1_X {
		pinmux = <0x401f801c 1 0x0 0 0x401f80cc>;
	};

	/omit-if-no-ref/ iomuxc_gpio_ad_11_gpiomux_io25: IOMUXC_GPIO_AD_11_GPIOMUX_IO25 {
		pinmux = <0x401f801c 5 0x0 0 0x401f80cc>;
	};

	/omit-if-no-ref/ iomuxc_gpio_ad_11_jtag_mod: IOMUXC_GPIO_AD_11_JTAG_MOD {
		pinmux = <0x401f801c 7 0x0 0 0x401f80cc>;
	};

	/omit-if-no-ref/ iomuxc_gpio_ad_11_kpp_row1: IOMUXC_GPIO_AD_11_KPP_ROW1 {
		pinmux = <0x401f801c 2 0x401f81b0 0 0x401f80cc>;
	};

	/omit-if-no-ref/ iomuxc_gpio_ad_11_lpspi2_pcs0: IOMUXC_GPIO_AD_11_LPSPI2_PCS0 {
		pinmux = <0x401f801c 0 0x401f81e0 0 0x401f80cc>;
	};

	/omit-if-no-ref/ iomuxc_gpio_ad_11_pit_trigger2: IOMUXC_GPIO_AD_11_PIT_TRIGGER2 {
		pinmux = <0x401f801c 3 0x0 0 0x401f80cc>;
	};

	/omit-if-no-ref/ iomuxc_gpio_ad_11_wdog1_b: IOMUXC_GPIO_AD_11_WDOG1_B {
		pinmux = <0x401f801c 6 0x0 0 0x401f80cc>;
	};

	/omit-if-no-ref/ iomuxc_gpio_ad_12_adc1_in12: IOMUXC_GPIO_AD_12_ADC1_IN12 {
		pinmux = <0x401f8018 5 0x0 0 0x401f80c8>;
	};

	/omit-if-no-ref/ iomuxc_gpio_ad_12_flexio1_io24: IOMUXC_GPIO_AD_12_FLEXIO1_IO24 {
		pinmux = <0x401f8018 4 0x0 0 0x401f80c8>;
	};

	/omit-if-no-ref/ iomuxc_gpio_ad_12_flexpwm1_pwm0_x: IOMUXC_GPIO_AD_12_FLEXPWM1_PWM0_X {
		pinmux = <0x401f8018 1 0x0 0 0x401f80c8>;
	};

	/omit-if-no-ref/ iomuxc_gpio_ad_12_gpiomux_io26: IOMUXC_GPIO_AD_12_GPIOMUX_IO26 {
		pinmux = <0x401f8018 5 0x0 0 0x401f80c8>;
	};

	/omit-if-no-ref/ iomuxc_gpio_ad_12_jtag_tck: IOMUXC_GPIO_AD_12_JTAG_TCK {
		pinmux = <0x401f8018 7 0x0 0 0x401f80c8>;
	};

	/omit-if-no-ref/ iomuxc_gpio_ad_12_kpp_col1: IOMUXC_GPIO_AD_12_KPP_COL1 {
		pinmux = <0x401f8018 2 0x401f81a0 0 0x401f80c8>;
	};

	/omit-if-no-ref/ iomuxc_gpio_ad_12_lpspi2_sck: IOMUXC_GPIO_AD_12_LPSPI2_SCK {
		pinmux = <0x401f8018 0 0x401f81e4 0 0x401f80c8>;
	};

	/omit-if-no-ref/ iomuxc_gpio_ad_12_pit_trigger1: IOMUXC_GPIO_AD_12_PIT_TRIGGER1 {
		pinmux = <0x401f8018 3 0x0 0 0x401f80c8>;
	};

	/omit-if-no-ref/ iomuxc_gpio_ad_12_usb_otg1_pwr: IOMUXC_GPIO_AD_12_USB_OTG1_PWR {
		pinmux = <0x401f8018 6 0x0 0 0x401f80c8>;
	};

	/omit-if-no-ref/ iomuxc_gpio_ad_13_adc1_in13: IOMUXC_GPIO_AD_13_ADC1_IN13 {
		pinmux = <0x401f8014 5 0x0 0 0x401f80c4>;
	};

	/omit-if-no-ref/ iomuxc_gpio_ad_13_arm_nmi: IOMUXC_GPIO_AD_13_ARM_NMI {
		pinmux = <0x401f8014 6 0x401f8210 0 0x401f80c4>;
	};

	/omit-if-no-ref/ iomuxc_gpio_ad_13_flexio1_io25: IOMUXC_GPIO_AD_13_FLEXIO1_IO25 {
		pinmux = <0x401f8014 4 0x0 0 0x401f80c4>;
	};

	/omit-if-no-ref/ iomuxc_gpio_ad_13_gpiomux_io27: IOMUXC_GPIO_AD_13_GPIOMUX_IO27 {
		pinmux = <0x401f8014 5 0x0 0 0x401f80c4>;
	};

	/omit-if-no-ref/ iomuxc_gpio_ad_13_jtag_tms: IOMUXC_GPIO_AD_13_JTAG_TMS {
		pinmux = <0x401f8014 7 0x0 0 0x401f80c4>;
	};

	/omit-if-no-ref/ iomuxc_gpio_ad_13_kpp_row0: IOMUXC_GPIO_AD_13_KPP_ROW0 {
		pinmux = <0x401f8014 2 0x401f81ac 0 0x401f80c4>;
	};

	/omit-if-no-ref/ iomuxc_gpio_ad_13_lpi2c1_sda: IOMUXC_GPIO_AD_13_LPI2C1_SDA {
		pinmux = <0x401f8014 0 0x401f81c4 0 0x401f80c4>;
	};

	/omit-if-no-ref/ iomuxc_gpio_ad_13_lpuart3_rts_b: IOMUXC_GPIO_AD_13_LPUART3_RTS_B {
		pinmux = <0x401f8014 1 0x0 0 0x401f80c4>;
	};

	/omit-if-no-ref/ iomuxc_gpio_ad_13_lpuart4_rts_b: IOMUXC_GPIO_AD_13_LPUART4_RTS_B {
		pinmux = <0x401f8014 3 0x0 0 0x401f80c4>;
	};

	/omit-if-no-ref/ iomuxc_gpio_ad_14_adc1_in14: IOMUXC_GPIO_AD_14_ADC1_IN14 {
		pinmux = <0x401f8010 5 0x0 0 0x401f80c0>;
	};

	/omit-if-no-ref/ iomuxc_gpio_ad_14_flexio1_io26: IOMUXC_GPIO_AD_14_FLEXIO1_IO26 {
		pinmux = <0x401f8010 4 0x0 0 0x401f80c0>;
	};

	/omit-if-no-ref/ iomuxc_gpio_ad_14_gpiomux_io28: IOMUXC_GPIO_AD_14_GPIOMUX_IO28 {
		pinmux = <0x401f8010 5 0x0 0 0x401f80c0>;
	};

	/omit-if-no-ref/ iomuxc_gpio_ad_14_kpp_col0: IOMUXC_GPIO_AD_14_KPP_COL0 {
		pinmux = <0x401f8010 2 0x401f819c 0 0x401f80c0>;
	};

	/omit-if-no-ref/ iomuxc_gpio_ad_14_lpi2c1_scl: IOMUXC_GPIO_AD_14_LPI2C1_SCL {
		pinmux = <0x401f8010 0 0x401f81c0 0 0x401f80c0>;
	};

	/omit-if-no-ref/ iomuxc_gpio_ad_14_lpuart3_cts_b: IOMUXC_GPIO_AD_14_LPUART3_CTS_B {
		pinmux = <0x401f8010 1 0x0 0 0x401f80c0>;
	};

	/omit-if-no-ref/ iomuxc_gpio_ad_14_lpuart4_cts_b: IOMUXC_GPIO_AD_14_LPUART4_CTS_B {
		pinmux = <0x401f8010 3 0x0 0 0x401f80c0>;
	};

	/omit-if-no-ref/ iomuxc_gpio_ad_14_xbar1_in02: IOMUXC_GPIO_AD_14_XBAR1_IN02 {
		pinmux = <0x401f8010 7 0x0 0 0x401f80c0>;
		gpr = <0x400ac018 0x10 0x0>;
	};

	/omit-if-no-ref/ iomuxc_gpio_ad_14_xbar1_inout02: IOMUXC_GPIO_AD_14_XBAR1_INOUT02 {
		pinmux = <0x401f8010 7 0x0 0 0x401f80c0>;
		gpr = <0x400ac018 0x10 0x0>;
	};

	/omit-if-no-ref/ iomuxc_gpio_sd_00_arm_cm7_rxev: IOMUXC_GPIO_SD_00_ARM_CM7_RXEV {
		pinmux = <0x401f8084 2 0x401f8220 1 0x401f8134>;
	};

	/omit-if-no-ref/ iomuxc_gpio_sd_00_ccm_stop: IOMUXC_GPIO_SD_00_CCM_STOP {
		pinmux = <0x401f8084 3 0x0 0 0x401f8134>;
	};

	/omit-if-no-ref/ iomuxc_gpio_sd_00_flexio1_io06: IOMUXC_GPIO_SD_00_FLEXIO1_IO06 {
		pinmux = <0x401f8084 4 0x0 0 0x401f8134>;
	};

	/omit-if-no-ref/ iomuxc_gpio_sd_00_flexspi_b_ss0_b: IOMUXC_GPIO_SD_00_FLEXSPI_B_SS0_B {
		pinmux = <0x401f8084 0 0x0 0 0x401f8134>;
	};

	/omit-if-no-ref/ iomuxc_gpio_sd_00_gpio2_io00: IOMUXC_GPIO_SD_00_GPIO2_IO00 {
		pinmux = <0x401f8084 5 0x0 0 0x401f8134>;
	};

	/omit-if-no-ref/ iomuxc_gpio_sd_00_sai3_tx_sync: IOMUXC_GPIO_SD_00_SAI3_TX_SYNC {
		pinmux = <0x401f8084 1 0x0 0 0x401f8134>;
	};

	/omit-if-no-ref/ iomuxc_gpio_sd_00_src_bt_cfg2: IOMUXC_GPIO_SD_00_SRC_BT_CFG2 {
		pinmux = <0x401f8084 6 0x0 0 0x401f8134>;
	};

	/omit-if-no-ref/ iomuxc_gpio_sd_01_ccm_clko2: IOMUXC_GPIO_SD_01_CCM_CLKO2 {
		pinmux = <0x401f8080 3 0x0 0 0x401f8130>;
	};

	/omit-if-no-ref/ iomuxc_gpio_sd_01_flexio1_io07: IOMUXC_GPIO_SD_01_FLEXIO1_IO07 {
		pinmux = <0x401f8080 4 0x0 0 0x401f8130>;
	};

	/omit-if-no-ref/ iomuxc_gpio_sd_01_flexpwm1_pwm0_b: IOMUXC_GPIO_SD_01_FLEXPWM1_PWM0_B {
		pinmux = <0x401f8080 2 0x401f8184 0 0x401f8130>;
	};

	/omit-if-no-ref/ iomuxc_gpio_sd_01_flexspi_b_data1: IOMUXC_GPIO_SD_01_FLEXSPI_B_DATA1 {
		pinmux = <0x401f8080 0 0x0 0 0x401f8130>;
	};

	/omit-if-no-ref/ iomuxc_gpio_sd_01_gpio2_io01: IOMUXC_GPIO_SD_01_GPIO2_IO01 {
		pinmux = <0x401f8080 5 0x0 0 0x401f8130>;
	};

	/omit-if-no-ref/ iomuxc_gpio_sd_01_sai3_tx_bclk: IOMUXC_GPIO_SD_01_SAI3_TX_BCLK {
		pinmux = <0x401f8080 1 0x0 0 0x401f8130>;
	};

	/omit-if-no-ref/ iomuxc_gpio_sd_01_src_bt_cfg1: IOMUXC_GPIO_SD_01_SRC_BT_CFG1 {
		pinmux = <0x401f8080 6 0x0 0 0x401f8130>;
	};

	/omit-if-no-ref/ iomuxc_gpio_sd_02_ccm_clko1: IOMUXC_GPIO_SD_02_CCM_CLKO1 {
		pinmux = <0x401f807c 3 0x0 0 0x401f812c>;
	};

	/omit-if-no-ref/ iomuxc_gpio_sd_02_flexio1_io08: IOMUXC_GPIO_SD_02_FLEXIO1_IO08 {
		pinmux = <0x401f807c 4 0x0 0 0x401f812c>;
	};

	/omit-if-no-ref/ iomuxc_gpio_sd_02_flexpwm1_pwm0_a: IOMUXC_GPIO_SD_02_FLEXPWM1_PWM0_A {
		pinmux = <0x401f807c 2 0x401f8174 0 0x401f812c>;
	};

	/omit-if-no-ref/ iomuxc_gpio_sd_02_flexspi_b_data2: IOMUXC_GPIO_SD_02_FLEXSPI_B_DATA2 {
		pinmux = <0x401f807c 0 0x0 0 0x401f812c>;
	};

	/omit-if-no-ref/ iomuxc_gpio_sd_02_gpio2_io02: IOMUXC_GPIO_SD_02_GPIO2_IO02 {
		pinmux = <0x401f807c 5 0x0 0 0x401f812c>;
	};

	/omit-if-no-ref/ iomuxc_gpio_sd_02_sai3_tx_data: IOMUXC_GPIO_SD_02_SAI3_TX_DATA {
		pinmux = <0x401f807c 1 0x0 0 0x401f812c>;
	};

	/omit-if-no-ref/ iomuxc_gpio_sd_02_src_bt_cfg0: IOMUXC_GPIO_SD_02_SRC_BT_CFG0 {
		pinmux = <0x401f807c 6 0x0 0 0x401f812c>;
	};

	/omit-if-no-ref/ iomuxc_gpio_sd_03_ccm_ref_en_b: IOMUXC_GPIO_SD_03_CCM_REF_EN_B {
		pinmux = <0x401f8078 3 0x0 0 0x401f8128>;
	};

	/omit-if-no-ref/ iomuxc_gpio_sd_03_flexio1_io09: IOMUXC_GPIO_SD_03_FLEXIO1_IO09 {
		pinmux = <0x401f8078 4 0x0 0 0x401f8128>;
	};

	/omit-if-no-ref/ iomuxc_gpio_sd_03_flexpwm1_pwm1_b: IOMUXC_GPIO_SD_03_FLEXPWM1_PWM1_B {
		pinmux = <0x401f8078 2 0x401f8188 0 0x401f8128>;
	};

	/omit-if-no-ref/ iomuxc_gpio_sd_03_flexspi_b_data0: IOMUXC_GPIO_SD_03_FLEXSPI_B_DATA0 {
		pinmux = <0x401f8078 0 0x0 0 0x401f8128>;
	};

	/omit-if-no-ref/ iomuxc_gpio_sd_03_gpio2_io03: IOMUXC_GPIO_SD_03_GPIO2_IO03 {
		pinmux = <0x401f8078 5 0x0 0 0x401f8128>;
	};

	/omit-if-no-ref/ iomuxc_gpio_sd_03_sai3_rx_data: IOMUXC_GPIO_SD_03_SAI3_RX_DATA {
		pinmux = <0x401f8078 1 0x0 0 0x401f8128>;
	};

	/omit-if-no-ref/ iomuxc_gpio_sd_03_src_boot_mode1: IOMUXC_GPIO_SD_03_SRC_BOOT_MODE1 {
		pinmux = <0x401f8078 6 0x0 0 0x401f8128>;
	};

	/omit-if-no-ref/ iomuxc_gpio_sd_04_ccm_wait: IOMUXC_GPIO_SD_04_CCM_WAIT {
		pinmux = <0x401f8074 3 0x0 0 0x401f8124>;
	};

	/omit-if-no-ref/ iomuxc_gpio_sd_04_flexio1_io10: IOMUXC_GPIO_SD_04_FLEXIO1_IO10 {
		pinmux = <0x401f8074 4 0x0 0 0x401f8124>;
	};

	/omit-if-no-ref/ iomuxc_gpio_sd_04_flexpwm1_pwm1_a: IOMUXC_GPIO_SD_04_FLEXPWM1_PWM1_A {
		pinmux = <0x401f8074 2 0x401f8178 0 0x401f8124>;
	};

	/omit-if-no-ref/ iomuxc_gpio_sd_04_flexspi_b_data3: IOMUXC_GPIO_SD_04_FLEXSPI_B_DATA3 {
		pinmux = <0x401f8074 0 0x0 0 0x401f8124>;
	};

	/omit-if-no-ref/ iomuxc_gpio_sd_04_gpio2_io04: IOMUXC_GPIO_SD_04_GPIO2_IO04 {
		pinmux = <0x401f8074 5 0x0 0 0x401f8124>;
	};

	/omit-if-no-ref/ iomuxc_gpio_sd_04_sai3_rx_sync: IOMUXC_GPIO_SD_04_SAI3_RX_SYNC {
		pinmux = <0x401f8074 1 0x0 0 0x401f8124>;
	};

	/omit-if-no-ref/ iomuxc_gpio_sd_04_src_boot_mode0: IOMUXC_GPIO_SD_04_SRC_BOOT_MODE0 {
		pinmux = <0x401f8074 6 0x0 0 0x401f8124>;
	};

	/omit-if-no-ref/ iomuxc_gpio_sd_05_flexio1_io11: IOMUXC_GPIO_SD_05_FLEXIO1_IO11 {
		pinmux = <0x401f8070 4 0x0 0 0x401f8120>;
	};

	/omit-if-no-ref/ iomuxc_gpio_sd_05_flexspi_a_ss1_b: IOMUXC_GPIO_SD_05_FLEXSPI_A_SS1_B {
		pinmux = <0x401f8070 0 0x0 0 0x401f8120>;
	};

	/omit-if-no-ref/ iomuxc_gpio_sd_05_gpio2_io05: IOMUXC_GPIO_SD_05_GPIO2_IO05 {
		pinmux = <0x401f8070 5 0x0 0 0x401f8120>;
	};

	/omit-if-no-ref/ iomuxc_gpio_sd_05_lpi2c1_sda: IOMUXC_GPIO_SD_05_LPI2C1_SDA {
		pinmux = <0x401f8070 1 0x401f81c4 1 0x401f8120>;
	};

	/omit-if-no-ref/ iomuxc_gpio_sd_05_lpspi1_sdi: IOMUXC_GPIO_SD_05_LPSPI1_SDI {
		pinmux = <0x401f8070 2 0x401f81d8 1 0x401f8120>;
	};

	/omit-if-no-ref/ iomuxc_gpio_sd_06_flexio1_io12: IOMUXC_GPIO_SD_06_FLEXIO1_IO12 {
		pinmux = <0x401f806c 4 0x0 0 0x401f811c>;
	};

	/omit-if-no-ref/ iomuxc_gpio_sd_06_flexspi_a_ss0_b: IOMUXC_GPIO_SD_06_FLEXSPI_A_SS0_B {
		pinmux = <0x401f806c 0 0x0 0 0x401f811c>;
	};

	/omit-if-no-ref/ iomuxc_gpio_sd_06_gpio2_io06: IOMUXC_GPIO_SD_06_GPIO2_IO06 {
		pinmux = <0x401f806c 5 0x0 0 0x401f811c>;
	};

	/omit-if-no-ref/ iomuxc_gpio_sd_06_lpi2c1_scl: IOMUXC_GPIO_SD_06_LPI2C1_SCL {
		pinmux = <0x401f806c 1 0x401f81c0 1 0x401f811c>;
	};

	/omit-if-no-ref/ iomuxc_gpio_sd_06_lpspi1_sdo: IOMUXC_GPIO_SD_06_LPSPI1_SDO {
		pinmux = <0x401f806c 2 0x401f81dc 1 0x401f811c>;
	};

	/omit-if-no-ref/ iomuxc_gpio_sd_07_flexio1_io13: IOMUXC_GPIO_SD_07_FLEXIO1_IO13 {
		pinmux = <0x401f8068 4 0x0 0 0x401f8118>;
	};

	/omit-if-no-ref/ iomuxc_gpio_sd_07_flexspi_a_data1: IOMUXC_GPIO_SD_07_FLEXSPI_A_DATA1 {
		pinmux = <0x401f8068 0 0x0 0 0x401f8118>;
	};

	/omit-if-no-ref/ iomuxc_gpio_sd_07_gpio2_io07: IOMUXC_GPIO_SD_07_GPIO2_IO07 {
		pinmux = <0x401f8068 5 0x0 0 0x401f8118>;
	};

	/omit-if-no-ref/ iomuxc_gpio_sd_07_lpi2c2_sda: IOMUXC_GPIO_SD_07_LPI2C2_SDA {
		pinmux = <0x401f8068 1 0x401f81cc 2 0x401f8118>;
	};

	/omit-if-no-ref/ iomuxc_gpio_sd_07_lpspi1_pcs0: IOMUXC_GPIO_SD_07_LPSPI1_PCS0 {
		pinmux = <0x401f8068 2 0x401f81d0 1 0x401f8118>;
	};

	/omit-if-no-ref/ iomuxc_gpio_sd_08_flexio1_io14: IOMUXC_GPIO_SD_08_FLEXIO1_IO14 {
		pinmux = <0x401f8064 4 0x0 0 0x401f8114>;
	};

	/omit-if-no-ref/ iomuxc_gpio_sd_08_flexspi_a_data2: IOMUXC_GPIO_SD_08_FLEXSPI_A_DATA2 {
		pinmux = <0x401f8064 0 0x0 0 0x401f8114>;
	};

	/omit-if-no-ref/ iomuxc_gpio_sd_08_gpio2_io08: IOMUXC_GPIO_SD_08_GPIO2_IO08 {
		pinmux = <0x401f8064 5 0x0 0 0x401f8114>;
	};

	/omit-if-no-ref/ iomuxc_gpio_sd_08_lpi2c2_scl: IOMUXC_GPIO_SD_08_LPI2C2_SCL {
		pinmux = <0x401f8064 1 0x401f81c8 2 0x401f8114>;
	};

	/omit-if-no-ref/ iomuxc_gpio_sd_08_lpspi1_sck: IOMUXC_GPIO_SD_08_LPSPI1_SCK {
		pinmux = <0x401f8064 2 0x401f81d4 1 0x401f8114>;
	};

	/omit-if-no-ref/ iomuxc_gpio_sd_09_flexio1_io15: IOMUXC_GPIO_SD_09_FLEXIO1_IO15 {
		pinmux = <0x401f8060 4 0x0 0 0x401f8110>;
	};

	/omit-if-no-ref/ iomuxc_gpio_sd_09_flexspi_a_data0: IOMUXC_GPIO_SD_09_FLEXSPI_A_DATA0 {
		pinmux = <0x401f8060 0 0x0 0 0x401f8110>;
	};

	/omit-if-no-ref/ iomuxc_gpio_sd_09_gpio2_io09: IOMUXC_GPIO_SD_09_GPIO2_IO09 {
		pinmux = <0x401f8060 5 0x0 0 0x401f8110>;
	};

	/omit-if-no-ref/ iomuxc_gpio_sd_09_lpspi2_sdi: IOMUXC_GPIO_SD_09_LPSPI2_SDI {
		pinmux = <0x401f8060 1 0x401f81e8 1 0x401f8110>;
	};

	/omit-if-no-ref/ iomuxc_gpio_sd_09_lpuart2_rxd: IOMUXC_GPIO_SD_09_LPUART2_RXD {
		pinmux = <0x401f8060 2 0x401f81f8 0 0x401f8110>;
	};

	/omit-if-no-ref/ iomuxc_gpio_sd_10_flexio1_io16: IOMUXC_GPIO_SD_10_FLEXIO1_IO16 {
		pinmux = <0x401f805c 4 0x0 0 0x401f810c>;
	};

	/omit-if-no-ref/ iomuxc_gpio_sd_10_flexspi_a_sclk: IOMUXC_GPIO_SD_10_FLEXSPI_A_SCLK {
		pinmux = <0x401f805c 0 0x0 0 0x401f810c>;
	};

	/omit-if-no-ref/ iomuxc_gpio_sd_10_gpio2_io10: IOMUXC_GPIO_SD_10_GPIO2_IO10 {
		pinmux = <0x401f805c 5 0x0 0 0x401f810c>;
	};

	/omit-if-no-ref/ iomuxc_gpio_sd_10_lpspi2_sdo: IOMUXC_GPIO_SD_10_LPSPI2_SDO {
		pinmux = <0x401f805c 1 0x401f81ec 1 0x401f810c>;
	};

	/omit-if-no-ref/ iomuxc_gpio_sd_10_lpuart2_txd: IOMUXC_GPIO_SD_10_LPUART2_TXD {
		pinmux = <0x401f805c 2 0x401f81fc 1 0x401f810c>;
	};

	/omit-if-no-ref/ iomuxc_gpio_sd_11_flexio1_io17: IOMUXC_GPIO_SD_11_FLEXIO1_IO17 {
		pinmux = <0x401f8058 4 0x0 0 0x401f8108>;
	};

	/omit-if-no-ref/ iomuxc_gpio_sd_11_flexspi_a_data3: IOMUXC_GPIO_SD_11_FLEXSPI_A_DATA3 {
		pinmux = <0x401f8058 0 0x0 0 0x401f8108>;
	};

	/omit-if-no-ref/ iomuxc_gpio_sd_11_gpio2_io11: IOMUXC_GPIO_SD_11_GPIO2_IO11 {
		pinmux = <0x401f8058 5 0x0 0 0x401f8108>;
	};

	/omit-if-no-ref/ iomuxc_gpio_sd_11_lpspi2_sck: IOMUXC_GPIO_SD_11_LPSPI2_SCK {
		pinmux = <0x401f8058 1 0x401f81e4 1 0x401f8108>;
	};

	/omit-if-no-ref/ iomuxc_gpio_sd_11_lpuart1_rxd: IOMUXC_GPIO_SD_11_LPUART1_RXD {
		pinmux = <0x401f8058 2 0x401f81f0 0 0x401f8108>;
	};

	/omit-if-no-ref/ iomuxc_gpio_sd_11_wdog1_rst_b_deb: IOMUXC_GPIO_SD_11_WDOG1_RST_B_DEB {
		pinmux = <0x401f8058 6 0x0 0 0x401f8108>;
	};

	/omit-if-no-ref/ iomuxc_gpio_sd_12_flexio1_io18: IOMUXC_GPIO_SD_12_FLEXIO1_IO18 {
		pinmux = <0x401f8054 4 0x0 0 0x401f8104>;
	};

	/omit-if-no-ref/ iomuxc_gpio_sd_12_flexspi_a_dqs: IOMUXC_GPIO_SD_12_FLEXSPI_A_DQS {
		pinmux = <0x401f8054 0 0x401f8194 1 0x401f8104>;
	};

	/omit-if-no-ref/ iomuxc_gpio_sd_12_gpio2_io12: IOMUXC_GPIO_SD_12_GPIO2_IO12 {
		pinmux = <0x401f8054 5 0x0 0 0x401f8104>;
	};

	/omit-if-no-ref/ iomuxc_gpio_sd_12_lpspi2_pcs0: IOMUXC_GPIO_SD_12_LPSPI2_PCS0 {
		pinmux = <0x401f8054 1 0x401f81e0 1 0x401f8104>;
	};

	/omit-if-no-ref/ iomuxc_gpio_sd_12_lpuart1_txd: IOMUXC_GPIO_SD_12_LPUART1_TXD {
		pinmux = <0x401f8054 2 0x401f81f4 0 0x401f8104>;
	};

	/omit-if-no-ref/ iomuxc_gpio_sd_12_wdog2_rst_b_deb: IOMUXC_GPIO_SD_12_WDOG2_RST_B_DEB {
		pinmux = <0x401f8054 6 0x0 0 0x401f8104>;
	};

	/omit-if-no-ref/ iomuxc_gpio_sd_13_arm_cm7_txev: IOMUXC_GPIO_SD_13_ARM_CM7_TXEV {
		pinmux = <0x401f8050 2 0x0 0 0x401f8100>;
	};

	/omit-if-no-ref/ iomuxc_gpio_sd_13_ccm_pmic_rdy: IOMUXC_GPIO_SD_13_CCM_PMIC_RDY {
		pinmux = <0x401f8050 3 0x0 0 0x401f8100>;
	};

	/omit-if-no-ref/ iomuxc_gpio_sd_13_flexio1_io19: IOMUXC_GPIO_SD_13_FLEXIO1_IO19 {
		pinmux = <0x401f8050 4 0x0 0 0x401f8100>;
	};

	/omit-if-no-ref/ iomuxc_gpio_sd_13_flexspi_b_sclk: IOMUXC_GPIO_SD_13_FLEXSPI_B_SCLK {
		pinmux = <0x401f8050 0 0x0 0 0x401f8100>;
	};

	/omit-if-no-ref/ iomuxc_gpio_sd_13_gpio2_io13: IOMUXC_GPIO_SD_13_GPIO2_IO13 {
		pinmux = <0x401f8050 5 0x0 0 0x401f8100>;
	};

	/omit-if-no-ref/ iomuxc_gpio_sd_13_sai3_rx_bclk: IOMUXC_GPIO_SD_13_SAI3_RX_BCLK {
		pinmux = <0x401f8050 1 0x0 0 0x401f8100>;
	};

	/omit-if-no-ref/ iomuxc_gpio_sd_13_src_bt_cfg3: IOMUXC_GPIO_SD_13_SRC_BT_CFG3 {
		pinmux = <0x401f8050 6 0x0 0 0x401f8100>;
	};

	/omit-if-no-ref/ iomuxc_snvs_onoff_src_reset_b: IOMUXC_SNVS_ONOFF_SRC_RESET_B {
		pinmux = <0x0 0 0x0 0 0x400a800c>;
	};

	/omit-if-no-ref/ iomuxc_snvs_pmic_on_req_gpio5_io00: IOMUXC_SNVS_PMIC_ON_REQ_GPIO5_IO00 {
		pinmux = <0x400a8000 5 0x0 0 0x400a8010>;
	};

	/omit-if-no-ref/ iomuxc_snvs_pmic_on_req_snvs_pmic_on_req:
	IOMUXC_SNVS_PMIC_ON_REQ_SNVS_PMIC_ON_REQ {
		pinmux = <0x400a8000 0 0x0 0 0x400a8010>;
	};

	/omit-if-no-ref/ iomuxc_snvs_por_b_src_por_b: IOMUXC_SNVS_POR_B_SRC_POR_B {
		pinmux = <0x0 0 0x0 0 0x400a8008>;
	};

	/omit-if-no-ref/ iomuxc_snvs_test_mode_test_mode: IOMUXC_SNVS_TEST_MODE_TEST_MODE {
		pinmux = <0x0 0 0x0 0 0x400a8004>;
	};
};
