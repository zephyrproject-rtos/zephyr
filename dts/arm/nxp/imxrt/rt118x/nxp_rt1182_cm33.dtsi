/*
 * Copyright 2026 NXP
 *
 * SPDX-License-Identifier: Apache-2.0
 */

/* SOC DTS for MIMXRT1182 CM33 core (single-core part) */

#include <nxp/imxrt/rt118x/nxp_rt118x_cm33.dtsi>
#include <nxp/imxrt/rt118x/nxp_rt1182.dtsi>
