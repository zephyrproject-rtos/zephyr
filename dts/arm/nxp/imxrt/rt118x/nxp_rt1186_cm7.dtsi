/*
 * Copyright 2026 NXP
 *
 * SPDX-License-Identifier: Apache-2.0
 */

/* SOC DTS for MIMXRT1186 CM7 core */

#include <nxp/imxrt/rt118x/nxp_rt118x_cm7.dtsi>
#include <nxp/imxrt/rt118x/nxp_rt1186.dtsi>
