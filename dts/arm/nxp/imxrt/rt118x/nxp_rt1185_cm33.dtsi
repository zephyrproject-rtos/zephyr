/*
 * Copyright 2026 NXP
 *
 * SPDX-License-Identifier: Apache-2.0
 */

/* SOC DTS for MIMXRT1185 CM33 core */

/*
 * RT1185 shares the same package and peripheral set as RT1186, except it
 * has no EtherCAT block (no ECAT node exists in the DTS yet).
 */
#include <nxp/imxrt/rt118x/nxp_rt1186_cm33.dtsi>
