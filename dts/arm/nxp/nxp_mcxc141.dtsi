/*
 * Copyright 2024 NXP
 *
 * SPDX-License-Identifier: Apache-2.0
 */

#include <nxp/nxp_mcxc_common.dtsi>

&sram0 {
	reg = <0x1FFFF800 DT_SIZE_K(8)>;
};

&flash0 {
	reg = <0 DT_SIZE_K(32)>;
};

/delete-node/ &usb;
