/*
 * Copyright (c) 2019, Linaro
 *
 * SPDX-License-Identifier: Apache-2.0
 */

#include <nxp/nxp_rt1060.dtsi>

&flexspi2 {
	reg = <0x402a4000 0x4000>, <0x70000000 DT_SIZE_M(4)>;
	/* WINBOND */
	w25q32jvwj0: w25q32jvwj@0 {
		compatible = "nxp,imx-flexspi-nor";
		size = <33554432>;
		label = "W25Q32JVWJ0";
		reg = <0>;
		spi-max-frequency = <133000000>;
		status = "okay";
		jedec-id = [ef 40 16];
	};
};
