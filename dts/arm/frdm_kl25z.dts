/dts-v1/;

#include <nxp/nxp_kl25z.dtsi>

/ {
	model = "NXP Freedom KL25Z board";
	compatible = "nxp,frdm-kl25z", "nxp,kl25z", "nxp,mkl25z4";

	aliases {
		uart_0 = &uart0;
	};

	chosen {
		zephyr,sram = &sram0;
		zephyr,flash = &flash0;
		zephyr,console = &uart0;
	};
};

&uart0 {
	status = "ok";
	current-speed = <115200>;
};
