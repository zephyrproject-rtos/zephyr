/*
 * Copyright (c) 2024, Maxjta
 *
 * SPDX-License-Identifier: Apache-2.0
 */

#include <mem.h>
#include <artery/at32f402_405/at32f405.dtsi>

&flash0 {
	reg = <0x08000000 DT_SIZE_K(256)>;
};

&sram0 {
	reg = <0x20000000 DT_SIZE_K(96)>;
};
