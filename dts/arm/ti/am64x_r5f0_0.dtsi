/*
 * Copyright (c) 2025 Texas Instruments Incorporated
 *
 * SPDX-License-Identifier: Apache-2.0
 */

#include <ti/am64x_r5.dtsi>

&main_mbox2 {
	usr-id = <0>;
	status = "okay";
};

&main_rti8 {
	interrupts = <0 0 IRQ_TYPE_LEVEL IRQ_DEFAULT_PRIORITY>;
	interrupt-parent = <&vim>;
};

&dmsc {
	ti,host-id = <36>;
	mboxes = <&secure_proxy_main 2>, <&secure_proxy_main 3>;
};

&secure_proxy_main {
	interrupt-names = "rx_0", "rx_2";
	interrupts = <0 64 IRQ_TYPE_EDGE IRQ_DEFAULT_PRIORITY>,
		     <0 65 IRQ_TYPE_EDGE IRQ_DEFAULT_PRIORITY>;
	interrupt-parent = <&vim>;
};
