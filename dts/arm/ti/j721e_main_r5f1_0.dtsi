/*
 * Copyright (c) 2026 Dhruv Menon <dhruvmenon1104@gmail.com>
 *
 * SPDX-License-Identifier: Apache-2.0
 */

#include <ti/j721e_main_r5.dtsi>

/ {
	chosen {
		zephyr,system-timer = &timer14;
	};
};

&mbox2 {
	usr-id = <1>;
	status = "okay";
};

&timer14 {
	status = "okay";
};
