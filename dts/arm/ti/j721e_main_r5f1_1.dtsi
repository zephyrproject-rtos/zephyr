/*
 * Copyright (c) 2026 Dhruv Menon <dhruvmenon1104@gmail.com>
 *
 * SPDX-License-Identifier: Apache-2.0
 */

#include <ti/j721e_main_r5.dtsi>

/ {
	chosen {
		zephyr,system-timer = &timer15;
	};
};

&mbox2 {
	usr-id = <2>;
	status = "okay";
};

&timer15 {
	status = "okay";
};
