/*
 * Copyright (c) 2026 Dhruv Menon <dhruvmenon1104@gmail.com>
 *
 * SPDX-License-Identifier: Apache-2.0
 */

#include <mem.h>
#include <freq.h>
#include <zephyr/dt-bindings/interrupt-controller/ti-vim.h>

/ {
	#address-cells = <1>;
	#size-cells = <1>;

	mcu_uart0: uart@40a00000 {
		compatible = "ns16550";
		reg = <0x40a00000 0x100>;
		clock-frequency = <96000000>;
		/* MCU_UART0_USART_IRQ; TRM Table 9-43 */
		interrupts = <0 45 IRQ_TYPE_LEVEL IRQ_DEFAULT_PRIORITY>;
		interrupt-parent = <&vim>;
		reg-shift = <2>;
		status = "disabled";
	};

	mcu_timer0: timer@40400000 {
		compatible = "ti,am654-timer";
		reg = <0x40400000 0x70>;
		/* MCU_TIMER0_INTR_PEND_0; TRM Table 9-43 */
		interrupts = <0 28 IRQ_TYPE_LEVEL IRQ_DEFAULT_PRIORITY>;
		interrupt-parent = <&vim>;
		status = "disabled";
	};

	mcu_timer1: timer@40410000 {
		compatible = "ti,am654-timer";
		reg = <0x40410000 0x70>;
		/* MCU_TIMER1_INTR_PEND_0; TRM Table 9-43 */
		interrupts = <0 29 IRQ_TYPE_LEVEL IRQ_DEFAULT_PRIORITY>;
		interrupt-parent = <&vim>;
		status = "disabled";
	};
};
