/*
 * Copyright (c) 2026 Dhruv Menon <dhruvmenon1104@gmail.com>
 *
 * SPDX-License-Identifier: Apache-2.0
 */

#include <ti/j721e_main_r5.dtsi>

/ {
	chosen {
		zephyr,system-timer = &systick_timer;
	};
};

&mbox1 {
	usr-id = <2>;
	status = "okay";
};

&systick_timer {
	status = "okay";
};
