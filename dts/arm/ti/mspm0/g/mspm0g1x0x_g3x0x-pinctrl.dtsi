/*
 * Copyright (c) 2026 Texas Instruments Incorporated
 *
 * SPDX-License-Identifier: Apache-2.0
 */

#include <zephyr/dt-bindings/pinctrl/mspm0-pinctrl.h>

&pinctrl {
	/omit-if-no-ref/ analog_pa0: analog_pa0 {
		pinmux = <MSP_PINMUX(1, MSPM0_PIN_FUNCTION_ANALOG)>;
	};

	/omit-if-no-ref/ gpio_pa0: gpio_pa0 {
		pinmux = <MSP_PINMUX(1, MSPM0_PIN_FUNCTION_GPIO)>;
	};

	/omit-if-no-ref/ uart0_tx_pa0: uart0_tx_pa0 {
		pinmux = <MSP_PINMUX(1, MSPM0_PIN_FUNCTION_2)>;
	};

	/omit-if-no-ref/ i2c0_sda_pa0: i2c0_sda_pa0 {
		pinmux = <MSP_PINMUX(1, MSPM0_PIN_FUNCTION_3)>;
		input-enable;
		drive-open-drain;
		bias-disable;
	};

	/omit-if-no-ref/ tima0_ccp0_pa0: tima0_ccp0_pa0 {
		pinmux = <MSP_PINMUX(1, MSPM0_PIN_FUNCTION_4)>;
	};

	/omit-if-no-ref/ tima_fault1_pa0: tima_fault1_pa0 {
		pinmux = <MSP_PINMUX(1, MSPM0_PIN_FUNCTION_5)>;
	};

	/omit-if-no-ref/ timg8_ccp1_pa0: timg8_ccp1_pa0 {
		pinmux = <MSP_PINMUX(1, MSPM0_PIN_FUNCTION_6)>;
	};

	/omit-if-no-ref/ sysctl_fcc_in_pa0: sysctl_fcc_in_pa0 {
		pinmux = <MSP_PINMUX(1, MSPM0_PIN_FUNCTION_7)>;
		input-enable;
	};

	/omit-if-no-ref/ analog_pa1: analog_pa1 {
		pinmux = <MSP_PINMUX(2, MSPM0_PIN_FUNCTION_ANALOG)>;
	};

	/omit-if-no-ref/ gpio_pa1: gpio_pa1 {
		pinmux = <MSP_PINMUX(2, MSPM0_PIN_FUNCTION_GPIO)>;
	};

	/omit-if-no-ref/ uart0_rx_pa1: uart0_rx_pa1 {
		pinmux = <MSP_PINMUX(2, MSPM0_PIN_FUNCTION_2)>;
		input-enable;
	};

	/omit-if-no-ref/ i2c0_scl_pa1: i2c0_scl_pa1 {
		pinmux = <MSP_PINMUX(2, MSPM0_PIN_FUNCTION_3)>;
		input-enable;
		drive-open-drain;
		bias-disable;
	};

	/omit-if-no-ref/ tima0_ccp1_pa1: tima0_ccp1_pa1 {
		pinmux = <MSP_PINMUX(2, MSPM0_PIN_FUNCTION_4)>;
	};

	/omit-if-no-ref/ tima_fault2_pa1: tima_fault2_pa1 {
		pinmux = <MSP_PINMUX(2, MSPM0_PIN_FUNCTION_5)>;
	};

	/omit-if-no-ref/ timg8_idx_pa1: timg8_idx_pa1 {
		pinmux = <MSP_PINMUX(2, MSPM0_PIN_FUNCTION_6)>;
	};

	/omit-if-no-ref/ timg8_ccp0_pa1: timg8_ccp0_pa1 {
		pinmux = <MSP_PINMUX(2, MSPM0_PIN_FUNCTION_7)>;
	};

	/omit-if-no-ref/ analog_pa28: analog_pa28 {
		pinmux = <MSP_PINMUX(3, MSPM0_PIN_FUNCTION_ANALOG)>;
	};

	/omit-if-no-ref/ gpio_pa28: gpio_pa28 {
		pinmux = <MSP_PINMUX(3, MSPM0_PIN_FUNCTION_GPIO)>;
	};

	/omit-if-no-ref/ uart0_tx_pa28: uart0_tx_pa28 {
		pinmux = <MSP_PINMUX(3, MSPM0_PIN_FUNCTION_2)>;
	};

	/omit-if-no-ref/ i2c0_sda_pa28: i2c0_sda_pa28 {
		pinmux = <MSP_PINMUX(3, MSPM0_PIN_FUNCTION_3)>;
		input-enable;
		drive-open-drain;
		bias-disable;
	};

	/omit-if-no-ref/ tima0_ccp3_pa28: tima0_ccp3_pa28 {
		pinmux = <MSP_PINMUX(3, MSPM0_PIN_FUNCTION_4)>;
	};

	/omit-if-no-ref/ tima_fault0_pa28: tima_fault0_pa28 {
		pinmux = <MSP_PINMUX(3, MSPM0_PIN_FUNCTION_5)>;
	};

	/omit-if-no-ref/ timg7_ccp0_pa28: timg7_ccp0_pa28 {
		pinmux = <MSP_PINMUX(3, MSPM0_PIN_FUNCTION_6)>;
	};

	/omit-if-no-ref/ tima1_ccp0_pa28: tima1_ccp0_pa28 {
		pinmux = <MSP_PINMUX(3, MSPM0_PIN_FUNCTION_7)>;
	};

	/omit-if-no-ref/ analog_pa29: analog_pa29 {
		pinmux = <MSP_PINMUX(4, MSPM0_PIN_FUNCTION_ANALOG)>;
	};

	/omit-if-no-ref/ gpio_pa29: gpio_pa29 {
		pinmux = <MSP_PINMUX(4, MSPM0_PIN_FUNCTION_GPIO)>;
	};

	/omit-if-no-ref/ i2c1_scl_pa29: i2c1_scl_pa29 {
		pinmux = <MSP_PINMUX(4, MSPM0_PIN_FUNCTION_2)>;
		input-enable;
		drive-open-drain;
		bias-disable;
	};

	/omit-if-no-ref/ uart2_rts_pa29: uart2_rts_pa29 {
		pinmux = <MSP_PINMUX(4, MSPM0_PIN_FUNCTION_3)>;
	};

	/omit-if-no-ref/ timg8_ccp0_pa29: timg8_ccp0_pa29 {
		pinmux = <MSP_PINMUX(4, MSPM0_PIN_FUNCTION_4)>;
	};

	/omit-if-no-ref/ timg6_ccp0_pa29: timg6_ccp0_pa29 {
		pinmux = <MSP_PINMUX(4, MSPM0_PIN_FUNCTION_5)>;
	};

	/omit-if-no-ref/ analog_pa30: analog_pa30 {
		pinmux = <MSP_PINMUX(5, MSPM0_PIN_FUNCTION_ANALOG)>;
	};

	/omit-if-no-ref/ gpio_pa30: gpio_pa30 {
		pinmux = <MSP_PINMUX(5, MSPM0_PIN_FUNCTION_GPIO)>;
	};

	/omit-if-no-ref/ i2c1_sda_pa30: i2c1_sda_pa30 {
		pinmux = <MSP_PINMUX(5, MSPM0_PIN_FUNCTION_2)>;
		input-enable;
		drive-open-drain;
		bias-disable;
	};

	/omit-if-no-ref/ uart2_cts_pa30: uart2_cts_pa30 {
		pinmux = <MSP_PINMUX(5, MSPM0_PIN_FUNCTION_3)>;
		input-enable;
	};

	/omit-if-no-ref/ timg8_ccp1_pa30: timg8_ccp1_pa30 {
		pinmux = <MSP_PINMUX(5, MSPM0_PIN_FUNCTION_4)>;
	};

	/omit-if-no-ref/ timg6_ccp1_pa30: timg6_ccp1_pa30 {
		pinmux = <MSP_PINMUX(5, MSPM0_PIN_FUNCTION_5)>;
	};

	/omit-if-no-ref/ analog_pa31: analog_pa31 {
		pinmux = <MSP_PINMUX(6, MSPM0_PIN_FUNCTION_ANALOG)>;
	};

	/omit-if-no-ref/ gpio_pa31: gpio_pa31 {
		pinmux = <MSP_PINMUX(6, MSPM0_PIN_FUNCTION_GPIO)>;
	};

	/omit-if-no-ref/ uart0_rx_pa31: uart0_rx_pa31 {
		pinmux = <MSP_PINMUX(6, MSPM0_PIN_FUNCTION_2)>;
		input-enable;
	};

	/omit-if-no-ref/ i2c0_scl_pa31: i2c0_scl_pa31 {
		pinmux = <MSP_PINMUX(6, MSPM0_PIN_FUNCTION_3)>;
		input-enable;
		drive-open-drain;
		bias-disable;
	};

	/omit-if-no-ref/ tima0_ccp3_cmpl_pa31: tima0_ccp3_cmpl_pa31 {
		pinmux = <MSP_PINMUX(6, MSPM0_PIN_FUNCTION_4)>;
	};

	/omit-if-no-ref/ timg12_ccp1_pa31: timg12_ccp1_pa31 {
		pinmux = <MSP_PINMUX(6, MSPM0_PIN_FUNCTION_5)>;
	};

	/omit-if-no-ref/ sysctl_clk_out_pa31: sysctl_clk_out_pa31 {
		pinmux = <MSP_PINMUX(6, MSPM0_PIN_FUNCTION_6)>;
	};

	/omit-if-no-ref/ timg7_ccp1_pa31: timg7_ccp1_pa31 {
		pinmux = <MSP_PINMUX(6, MSPM0_PIN_FUNCTION_7)>;
	};

	/omit-if-no-ref/ tima1_ccp1_pa31: tima1_ccp1_pa31 {
		pinmux = <MSP_PINMUX(6, MSPM0_PIN_FUNCTION_8)>;
	};

	/omit-if-no-ref/ analog_pa2: analog_pa2 {
		pinmux = <MSP_PINMUX(7, MSPM0_PIN_FUNCTION_ANALOG)>;
	};

	/omit-if-no-ref/ gpio_pa2: gpio_pa2 {
		pinmux = <MSP_PINMUX(7, MSPM0_PIN_FUNCTION_GPIO)>;
	};

	/omit-if-no-ref/ timg8_ccp1_pa2: timg8_ccp1_pa2 {
		pinmux = <MSP_PINMUX(7, MSPM0_PIN_FUNCTION_2)>;
	};

	/omit-if-no-ref/ spi0_cs0_pa2: spi0_cs0_pa2 {
		pinmux = <MSP_PINMUX(7, MSPM0_PIN_FUNCTION_3)>;
	};

	/omit-if-no-ref/ timg7_ccp1_pa2: timg7_ccp1_pa2 {
		pinmux = <MSP_PINMUX(7, MSPM0_PIN_FUNCTION_4)>;
	};

	/omit-if-no-ref/ spi1_cs0_pa2: spi1_cs0_pa2 {
		pinmux = <MSP_PINMUX(7, MSPM0_PIN_FUNCTION_5)>;
	};

	/omit-if-no-ref/ analog_pa3: analog_pa3 {
		pinmux = <MSP_PINMUX(8, MSPM0_PIN_FUNCTION_ANALOG)>;
	};

	/omit-if-no-ref/ gpio_pa3: gpio_pa3 {
		pinmux = <MSP_PINMUX(8, MSPM0_PIN_FUNCTION_GPIO)>;
	};

	/omit-if-no-ref/ timg8_ccp0_pa3: timg8_ccp0_pa3 {
		pinmux = <MSP_PINMUX(8, MSPM0_PIN_FUNCTION_2)>;
	};

	/omit-if-no-ref/ spi0_cs1_poci1_pa3: spi0_cs1_poci1_pa3 {
		pinmux = <MSP_PINMUX(8, MSPM0_PIN_FUNCTION_3)>;
		input-enable;
	};

	/omit-if-no-ref/ uart2_cts_pa3: uart2_cts_pa3 {
		pinmux = <MSP_PINMUX(8, MSPM0_PIN_FUNCTION_4)>;
		input-enable;
	};

	/omit-if-no-ref/ tima0_ccp2_pa3: tima0_ccp2_pa3 {
		pinmux = <MSP_PINMUX(8, MSPM0_PIN_FUNCTION_5)>;
	};

	/omit-if-no-ref/ comp1_out_pa3: comp1_out_pa3 {
		pinmux = <MSP_PINMUX(8, MSPM0_PIN_FUNCTION_6)>;
	};

	/omit-if-no-ref/ timg7_ccp0_pa3: timg7_ccp0_pa3 {
		pinmux = <MSP_PINMUX(8, MSPM0_PIN_FUNCTION_7)>;
	};

	/omit-if-no-ref/ tima0_ccp1_pa3: tima0_ccp1_pa3 {
		pinmux = <MSP_PINMUX(8, MSPM0_PIN_FUNCTION_8)>;
	};

	/omit-if-no-ref/ i2c1_sda_pa3: i2c1_sda_pa3 {
		pinmux = <MSP_PINMUX(8, MSPM0_PIN_FUNCTION_9)>;
		input-enable;
		drive-open-drain;
		bias-disable;
	};

	/omit-if-no-ref/ analog_pa4: analog_pa4 {
		pinmux = <MSP_PINMUX(9, MSPM0_PIN_FUNCTION_ANALOG)>;
	};

	/omit-if-no-ref/ gpio_pa4: gpio_pa4 {
		pinmux = <MSP_PINMUX(9, MSPM0_PIN_FUNCTION_GPIO)>;
	};

	/omit-if-no-ref/ timg8_ccp1_pa4: timg8_ccp1_pa4 {
		pinmux = <MSP_PINMUX(9, MSPM0_PIN_FUNCTION_2)>;
	};

	/omit-if-no-ref/ spi0_poci_pa4: spi0_poci_pa4 {
		pinmux = <MSP_PINMUX(9, MSPM0_PIN_FUNCTION_3)>;
		input-enable;
	};

	/omit-if-no-ref/ uart2_rts_pa4: uart2_rts_pa4 {
		pinmux = <MSP_PINMUX(9, MSPM0_PIN_FUNCTION_4)>;
	};

	/omit-if-no-ref/ tima0_ccp3_pa4: tima0_ccp3_pa4 {
		pinmux = <MSP_PINMUX(9, MSPM0_PIN_FUNCTION_5)>;
	};

	/omit-if-no-ref/ sysctl_lfclkin_pa4: sysctl_lfclkin_pa4 {
		pinmux = <MSP_PINMUX(9, MSPM0_PIN_FUNCTION_6)>;
		input-enable;
	};

	/omit-if-no-ref/ timg7_ccp1_pa4: timg7_ccp1_pa4 {
		pinmux = <MSP_PINMUX(9, MSPM0_PIN_FUNCTION_7)>;
	};

	/omit-if-no-ref/ tima0_ccp1_cmpl_pa4: tima0_ccp1_cmpl_pa4 {
		pinmux = <MSP_PINMUX(9, MSPM0_PIN_FUNCTION_8)>;
	};

	/omit-if-no-ref/ i2c1_scl_pa4: i2c1_scl_pa4 {
		pinmux = <MSP_PINMUX(9, MSPM0_PIN_FUNCTION_9)>;
		input-enable;
		drive-open-drain;
		bias-disable;
	};

	/omit-if-no-ref/ analog_pa5: analog_pa5 {
		pinmux = <MSP_PINMUX(10, MSPM0_PIN_FUNCTION_ANALOG)>;
	};

	/omit-if-no-ref/ gpio_pa5: gpio_pa5 {
		pinmux = <MSP_PINMUX(10, MSPM0_PIN_FUNCTION_GPIO)>;
	};

	/omit-if-no-ref/ timg8_ccp0_pa5: timg8_ccp0_pa5 {
		pinmux = <MSP_PINMUX(10, MSPM0_PIN_FUNCTION_2)>;
	};

	/omit-if-no-ref/ spi0_pico_pa5: spi0_pico_pa5 {
		pinmux = <MSP_PINMUX(10, MSPM0_PIN_FUNCTION_3)>;
	};

	/omit-if-no-ref/ tima_fault1_pa5: tima_fault1_pa5 {
		pinmux = <MSP_PINMUX(10, MSPM0_PIN_FUNCTION_4)>;
	};

	/omit-if-no-ref/ timg0_ccp0_pa5: timg0_ccp0_pa5 {
		pinmux = <MSP_PINMUX(10, MSPM0_PIN_FUNCTION_5)>;
	};

	/omit-if-no-ref/ timg6_ccp0_pa5: timg6_ccp0_pa5 {
		pinmux = <MSP_PINMUX(10, MSPM0_PIN_FUNCTION_6)>;
	};

	/omit-if-no-ref/ sysctl_fcc_in_pa5: sysctl_fcc_in_pa5 {
		pinmux = <MSP_PINMUX(10, MSPM0_PIN_FUNCTION_7)>;
		input-enable;
	};

	/omit-if-no-ref/ analog_pa6: analog_pa6 {
		pinmux = <MSP_PINMUX(11, MSPM0_PIN_FUNCTION_ANALOG)>;
	};

	/omit-if-no-ref/ gpio_pa6: gpio_pa6 {
		pinmux = <MSP_PINMUX(11, MSPM0_PIN_FUNCTION_GPIO)>;
	};

	/omit-if-no-ref/ timg8_ccp1_pa6: timg8_ccp1_pa6 {
		pinmux = <MSP_PINMUX(11, MSPM0_PIN_FUNCTION_2)>;
	};

	/omit-if-no-ref/ spi0_sclk_pa6: spi0_sclk_pa6 {
		pinmux = <MSP_PINMUX(11, MSPM0_PIN_FUNCTION_3)>;
	};

	/omit-if-no-ref/ tima_fault0_pa6: tima_fault0_pa6 {
		pinmux = <MSP_PINMUX(11, MSPM0_PIN_FUNCTION_4)>;
	};

	/omit-if-no-ref/ timg0_ccp1_pa6: timg0_ccp1_pa6 {
		pinmux = <MSP_PINMUX(11, MSPM0_PIN_FUNCTION_5)>;
	};

	/omit-if-no-ref/ sysctl_hfclkin_pa6: sysctl_hfclkin_pa6 {
		pinmux = <MSP_PINMUX(11, MSPM0_PIN_FUNCTION_6)>;
		input-enable;
	};

	/omit-if-no-ref/ timg6_ccp1_pa6: timg6_ccp1_pa6 {
		pinmux = <MSP_PINMUX(11, MSPM0_PIN_FUNCTION_7)>;
	};

	/omit-if-no-ref/ tima0_ccp2_cmpl_pa6: tima0_ccp2_cmpl_pa6 {
		pinmux = <MSP_PINMUX(11, MSPM0_PIN_FUNCTION_8)>;
	};

	/omit-if-no-ref/ analog_pb0: analog_pb0 {
		pinmux = <MSP_PINMUX(12, MSPM0_PIN_FUNCTION_ANALOG)>;
	};

	/omit-if-no-ref/ gpio_pb0: gpio_pb0 {
		pinmux = <MSP_PINMUX(12, MSPM0_PIN_FUNCTION_GPIO)>;
	};

	/omit-if-no-ref/ uart0_tx_pb0: uart0_tx_pb0 {
		pinmux = <MSP_PINMUX(12, MSPM0_PIN_FUNCTION_2)>;
	};

	/omit-if-no-ref/ spi1_cs2_poci2_pb0: spi1_cs2_poci2_pb0 {
		pinmux = <MSP_PINMUX(12, MSPM0_PIN_FUNCTION_3)>;
		input-enable;
	};

	/omit-if-no-ref/ tima1_ccp0_pb0: tima1_ccp0_pb0 {
		pinmux = <MSP_PINMUX(12, MSPM0_PIN_FUNCTION_4)>;
	};

	/omit-if-no-ref/ tima0_ccp2_pb0: tima0_ccp2_pb0 {
		pinmux = <MSP_PINMUX(12, MSPM0_PIN_FUNCTION_5)>;
	};

	/omit-if-no-ref/ analog_pb1: analog_pb1 {
		pinmux = <MSP_PINMUX(13, MSPM0_PIN_FUNCTION_ANALOG)>;
	};

	/omit-if-no-ref/ gpio_pb1: gpio_pb1 {
		pinmux = <MSP_PINMUX(13, MSPM0_PIN_FUNCTION_GPIO)>;
	};

	/omit-if-no-ref/ uart0_rx_pb1: uart0_rx_pb1 {
		pinmux = <MSP_PINMUX(13, MSPM0_PIN_FUNCTION_2)>;
		input-enable;
	};

	/omit-if-no-ref/ spi1_cs3_cd_poci3_pb1: spi1_cs3_cd_poci3_pb1 {
		pinmux = <MSP_PINMUX(13, MSPM0_PIN_FUNCTION_3)>;
		input-enable;
	};

	/omit-if-no-ref/ tima1_ccp1_pb1: tima1_ccp1_pb1 {
		pinmux = <MSP_PINMUX(13, MSPM0_PIN_FUNCTION_4)>;
	};

	/omit-if-no-ref/ tima0_ccp2_cmpl_pb1: tima0_ccp2_cmpl_pb1 {
		pinmux = <MSP_PINMUX(13, MSPM0_PIN_FUNCTION_5)>;
	};

	/omit-if-no-ref/ analog_pa7: analog_pa7 {
		pinmux = <MSP_PINMUX(14, MSPM0_PIN_FUNCTION_ANALOG)>;
	};

	/omit-if-no-ref/ gpio_pa7: gpio_pa7 {
		pinmux = <MSP_PINMUX(14, MSPM0_PIN_FUNCTION_GPIO)>;
	};

	/omit-if-no-ref/ comp0_out_pa7: comp0_out_pa7 {
		pinmux = <MSP_PINMUX(14, MSPM0_PIN_FUNCTION_2)>;
	};

	/omit-if-no-ref/ sysctl_clk_out_pa7: sysctl_clk_out_pa7 {
		pinmux = <MSP_PINMUX(14, MSPM0_PIN_FUNCTION_3)>;
	};

	/omit-if-no-ref/ timg8_ccp0_pa7: timg8_ccp0_pa7 {
		pinmux = <MSP_PINMUX(14, MSPM0_PIN_FUNCTION_4)>;
	};

	/omit-if-no-ref/ tima0_ccp2_pa7: tima0_ccp2_pa7 {
		pinmux = <MSP_PINMUX(14, MSPM0_PIN_FUNCTION_5)>;
	};

	/omit-if-no-ref/ timg8_idx_pa7: timg8_idx_pa7 {
		pinmux = <MSP_PINMUX(14, MSPM0_PIN_FUNCTION_6)>;
	};

	/omit-if-no-ref/ timg7_ccp1_pa7: timg7_ccp1_pa7 {
		pinmux = <MSP_PINMUX(14, MSPM0_PIN_FUNCTION_7)>;
	};

	/omit-if-no-ref/ tima0_ccp1_pa7: tima0_ccp1_pa7 {
		pinmux = <MSP_PINMUX(14, MSPM0_PIN_FUNCTION_8)>;
	};

	/omit-if-no-ref/ analog_pb2: analog_pb2 {
		pinmux = <MSP_PINMUX(15, MSPM0_PIN_FUNCTION_ANALOG)>;
	};

	/omit-if-no-ref/ gpio_pb2: gpio_pb2 {
		pinmux = <MSP_PINMUX(15, MSPM0_PIN_FUNCTION_GPIO)>;
	};

	/omit-if-no-ref/ uart3_tx_pb2: uart3_tx_pb2 {
		pinmux = <MSP_PINMUX(15, MSPM0_PIN_FUNCTION_2)>;
	};

	/omit-if-no-ref/ uart2_cts_pb2: uart2_cts_pb2 {
		pinmux = <MSP_PINMUX(15, MSPM0_PIN_FUNCTION_3)>;
		input-enable;
	};

	/omit-if-no-ref/ i2c1_scl_pb2: i2c1_scl_pb2 {
		pinmux = <MSP_PINMUX(15, MSPM0_PIN_FUNCTION_4)>;
		input-enable;
		drive-open-drain;
		bias-disable;
	};

	/omit-if-no-ref/ tima0_ccp3_pb2: tima0_ccp3_pb2 {
		pinmux = <MSP_PINMUX(15, MSPM0_PIN_FUNCTION_5)>;
	};

	/omit-if-no-ref/ uart1_cts_pb2: uart1_cts_pb2 {
		pinmux = <MSP_PINMUX(15, MSPM0_PIN_FUNCTION_6)>;
		input-enable;
	};

	/omit-if-no-ref/ timg6_ccp0_pb2: timg6_ccp0_pb2 {
		pinmux = <MSP_PINMUX(15, MSPM0_PIN_FUNCTION_7)>;
	};

	/omit-if-no-ref/ tima1_ccp0_pb2: tima1_ccp0_pb2 {
		pinmux = <MSP_PINMUX(15, MSPM0_PIN_FUNCTION_8)>;
	};

	/omit-if-no-ref/ analog_pb3: analog_pb3 {
		pinmux = <MSP_PINMUX(16, MSPM0_PIN_FUNCTION_ANALOG)>;
	};

	/omit-if-no-ref/ gpio_pb3: gpio_pb3 {
		pinmux = <MSP_PINMUX(16, MSPM0_PIN_FUNCTION_GPIO)>;
	};

	/omit-if-no-ref/ uart3_rx_pb3: uart3_rx_pb3 {
		pinmux = <MSP_PINMUX(16, MSPM0_PIN_FUNCTION_2)>;
		input-enable;
	};

	/omit-if-no-ref/ uart2_rts_pb3: uart2_rts_pb3 {
		pinmux = <MSP_PINMUX(16, MSPM0_PIN_FUNCTION_3)>;
	};

	/omit-if-no-ref/ i2c1_sda_pb3: i2c1_sda_pb3 {
		pinmux = <MSP_PINMUX(16, MSPM0_PIN_FUNCTION_4)>;
		input-enable;
		drive-open-drain;
		bias-disable;
	};

	/omit-if-no-ref/ tima0_ccp3_cmpl_pb3: tima0_ccp3_cmpl_pb3 {
		pinmux = <MSP_PINMUX(16, MSPM0_PIN_FUNCTION_5)>;
	};

	/omit-if-no-ref/ uart1_rts_pb3: uart1_rts_pb3 {
		pinmux = <MSP_PINMUX(16, MSPM0_PIN_FUNCTION_6)>;
	};

	/omit-if-no-ref/ timg6_ccp1_pb3: timg6_ccp1_pb3 {
		pinmux = <MSP_PINMUX(16, MSPM0_PIN_FUNCTION_7)>;
	};

	/omit-if-no-ref/ tima1_ccp1_pb3: tima1_ccp1_pb3 {
		pinmux = <MSP_PINMUX(16, MSPM0_PIN_FUNCTION_8)>;
	};

	/omit-if-no-ref/ analog_pb4: analog_pb4 {
		pinmux = <MSP_PINMUX(17, MSPM0_PIN_FUNCTION_ANALOG)>;
	};

	/omit-if-no-ref/ gpio_pb4: gpio_pb4 {
		pinmux = <MSP_PINMUX(17, MSPM0_PIN_FUNCTION_GPIO)>;
	};

	/omit-if-no-ref/ uart1_tx_pb4: uart1_tx_pb4 {
		pinmux = <MSP_PINMUX(17, MSPM0_PIN_FUNCTION_2)>;
	};

	/omit-if-no-ref/ uart3_cts_pb4: uart3_cts_pb4 {
		pinmux = <MSP_PINMUX(17, MSPM0_PIN_FUNCTION_3)>;
		input-enable;
	};

	/omit-if-no-ref/ tima1_ccp0_pb4: tima1_ccp0_pb4 {
		pinmux = <MSP_PINMUX(17, MSPM0_PIN_FUNCTION_4)>;
	};

	/omit-if-no-ref/ tima0_ccp2_pb4: tima0_ccp2_pb4 {
		pinmux = <MSP_PINMUX(17, MSPM0_PIN_FUNCTION_5)>;
	};

	/omit-if-no-ref/ tima1_ccp0_cmpl_pb4: tima1_ccp0_cmpl_pb4 {
		pinmux = <MSP_PINMUX(17, MSPM0_PIN_FUNCTION_6)>;
	};

	/omit-if-no-ref/ analog_pb5: analog_pb5 {
		pinmux = <MSP_PINMUX(18, MSPM0_PIN_FUNCTION_ANALOG)>;
	};

	/omit-if-no-ref/ gpio_pb5: gpio_pb5 {
		pinmux = <MSP_PINMUX(18, MSPM0_PIN_FUNCTION_GPIO)>;
	};

	/omit-if-no-ref/ uart1_rx_pb5: uart1_rx_pb5 {
		pinmux = <MSP_PINMUX(18, MSPM0_PIN_FUNCTION_2)>;
		input-enable;
	};

	/omit-if-no-ref/ uart3_rts_pb5: uart3_rts_pb5 {
		pinmux = <MSP_PINMUX(18, MSPM0_PIN_FUNCTION_3)>;
	};

	/omit-if-no-ref/ tima1_ccp1_pb5: tima1_ccp1_pb5 {
		pinmux = <MSP_PINMUX(18, MSPM0_PIN_FUNCTION_4)>;
	};

	/omit-if-no-ref/ tima0_ccp2_cmpl_pb5: tima0_ccp2_cmpl_pb5 {
		pinmux = <MSP_PINMUX(18, MSPM0_PIN_FUNCTION_5)>;
	};

	/omit-if-no-ref/ tima1_ccp1_cmpl_pb5: tima1_ccp1_cmpl_pb5 {
		pinmux = <MSP_PINMUX(18, MSPM0_PIN_FUNCTION_6)>;
	};

	/omit-if-no-ref/ analog_pa8: analog_pa8 {
		pinmux = <MSP_PINMUX(19, MSPM0_PIN_FUNCTION_ANALOG)>;
	};

	/omit-if-no-ref/ gpio_pa8: gpio_pa8 {
		pinmux = <MSP_PINMUX(19, MSPM0_PIN_FUNCTION_GPIO)>;
	};

	/omit-if-no-ref/ uart1_tx_pa8: uart1_tx_pa8 {
		pinmux = <MSP_PINMUX(19, MSPM0_PIN_FUNCTION_2)>;
	};

	/omit-if-no-ref/ spi0_cs0_pa8: spi0_cs0_pa8 {
		pinmux = <MSP_PINMUX(19, MSPM0_PIN_FUNCTION_3)>;
	};

	/omit-if-no-ref/ uart0_rts_pa8: uart0_rts_pa8 {
		pinmux = <MSP_PINMUX(19, MSPM0_PIN_FUNCTION_4)>;
	};

	/omit-if-no-ref/ tima0_ccp0_pa8: tima0_ccp0_pa8 {
		pinmux = <MSP_PINMUX(19, MSPM0_PIN_FUNCTION_5)>;
	};

	/omit-if-no-ref/ tima1_ccp0_cmpl_pa8: tima1_ccp0_cmpl_pa8 {
		pinmux = <MSP_PINMUX(19, MSPM0_PIN_FUNCTION_6)>;
	};

	/omit-if-no-ref/ analog_pa9: analog_pa9 {
		pinmux = <MSP_PINMUX(20, MSPM0_PIN_FUNCTION_ANALOG)>;
	};

	/omit-if-no-ref/ gpio_pa9: gpio_pa9 {
		pinmux = <MSP_PINMUX(20, MSPM0_PIN_FUNCTION_GPIO)>;
	};

	/omit-if-no-ref/ uart1_rx_pa9: uart1_rx_pa9 {
		pinmux = <MSP_PINMUX(20, MSPM0_PIN_FUNCTION_2)>;
		input-enable;
	};

	/omit-if-no-ref/ spi0_pico_pa9: spi0_pico_pa9 {
		pinmux = <MSP_PINMUX(20, MSPM0_PIN_FUNCTION_3)>;
	};

	/omit-if-no-ref/ uart0_cts_pa9: uart0_cts_pa9 {
		pinmux = <MSP_PINMUX(20, MSPM0_PIN_FUNCTION_4)>;
		input-enable;
	};

	/omit-if-no-ref/ tima0_ccp1_pa9: tima0_ccp1_pa9 {
		pinmux = <MSP_PINMUX(20, MSPM0_PIN_FUNCTION_5)>;
	};

	/omit-if-no-ref/ rtc_rtc_out_pa9: rtc_rtc_out_pa9 {
		pinmux = <MSP_PINMUX(20, MSPM0_PIN_FUNCTION_6)>;
	};

	/omit-if-no-ref/ tima0_ccp0_cmpl_pa9: tima0_ccp0_cmpl_pa9 {
		pinmux = <MSP_PINMUX(20, MSPM0_PIN_FUNCTION_7)>;
	};

	/omit-if-no-ref/ tima1_ccp1_cmpl_pa9: tima1_ccp1_cmpl_pa9 {
		pinmux = <MSP_PINMUX(20, MSPM0_PIN_FUNCTION_8)>;
	};

	/omit-if-no-ref/ sysctl_clk_out_pa9: sysctl_clk_out_pa9 {
		pinmux = <MSP_PINMUX(20, MSPM0_PIN_FUNCTION_9)>;
	};

	/omit-if-no-ref/ analog_pa10: analog_pa10 {
		pinmux = <MSP_PINMUX(21, MSPM0_PIN_FUNCTION_ANALOG)>;
	};

	/omit-if-no-ref/ gpio_pa10: gpio_pa10 {
		pinmux = <MSP_PINMUX(21, MSPM0_PIN_FUNCTION_GPIO)>;
	};

	/omit-if-no-ref/ uart0_tx_pa10: uart0_tx_pa10 {
		pinmux = <MSP_PINMUX(21, MSPM0_PIN_FUNCTION_2)>;
	};

	/omit-if-no-ref/ spi0_poci_pa10: spi0_poci_pa10 {
		pinmux = <MSP_PINMUX(21, MSPM0_PIN_FUNCTION_3)>;
		input-enable;
	};

	/omit-if-no-ref/ i2c0_sda_pa10: i2c0_sda_pa10 {
		pinmux = <MSP_PINMUX(21, MSPM0_PIN_FUNCTION_4)>;
		input-enable;
		drive-open-drain;
		bias-disable;
	};

	/omit-if-no-ref/ tima1_ccp0_pa10: tima1_ccp0_pa10 {
		pinmux = <MSP_PINMUX(21, MSPM0_PIN_FUNCTION_5)>;
	};

	/omit-if-no-ref/ timg12_ccp0_pa10: timg12_ccp0_pa10 {
		pinmux = <MSP_PINMUX(21, MSPM0_PIN_FUNCTION_6)>;
	};

	/omit-if-no-ref/ tima0_ccp2_pa10: tima0_ccp2_pa10 {
		pinmux = <MSP_PINMUX(21, MSPM0_PIN_FUNCTION_7)>;
	};

	/omit-if-no-ref/ i2c1_sda_pa10: i2c1_sda_pa10 {
		pinmux = <MSP_PINMUX(21, MSPM0_PIN_FUNCTION_8)>;
		input-enable;
		drive-open-drain;
		bias-disable;
	};

	/omit-if-no-ref/ sysctl_clk_out_pa10: sysctl_clk_out_pa10 {
		pinmux = <MSP_PINMUX(21, MSPM0_PIN_FUNCTION_9)>;
	};

	/omit-if-no-ref/ analog_pa11: analog_pa11 {
		pinmux = <MSP_PINMUX(22, MSPM0_PIN_FUNCTION_ANALOG)>;
	};

	/omit-if-no-ref/ gpio_pa11: gpio_pa11 {
		pinmux = <MSP_PINMUX(22, MSPM0_PIN_FUNCTION_GPIO)>;
	};

	/omit-if-no-ref/ uart0_rx_pa11: uart0_rx_pa11 {
		pinmux = <MSP_PINMUX(22, MSPM0_PIN_FUNCTION_2)>;
		input-enable;
	};

	/omit-if-no-ref/ spi0_sclk_pa11: spi0_sclk_pa11 {
		pinmux = <MSP_PINMUX(22, MSPM0_PIN_FUNCTION_3)>;
	};

	/omit-if-no-ref/ i2c0_scl_pa11: i2c0_scl_pa11 {
		pinmux = <MSP_PINMUX(22, MSPM0_PIN_FUNCTION_4)>;
		input-enable;
		drive-open-drain;
		bias-disable;
	};

	/omit-if-no-ref/ tima1_ccp1_pa11: tima1_ccp1_pa11 {
		pinmux = <MSP_PINMUX(22, MSPM0_PIN_FUNCTION_5)>;
	};

	/omit-if-no-ref/ comp0_out_pa11: comp0_out_pa11 {
		pinmux = <MSP_PINMUX(22, MSPM0_PIN_FUNCTION_6)>;
	};

	/omit-if-no-ref/ tima0_ccp2_cmpl_pa11: tima0_ccp2_cmpl_pa11 {
		pinmux = <MSP_PINMUX(22, MSPM0_PIN_FUNCTION_7)>;
	};

	/omit-if-no-ref/ i2c1_scl_pa11: i2c1_scl_pa11 {
		pinmux = <MSP_PINMUX(22, MSPM0_PIN_FUNCTION_8)>;
		input-enable;
		drive-open-drain;
		bias-disable;
	};

	/omit-if-no-ref/ analog_pb6: analog_pb6 {
		pinmux = <MSP_PINMUX(23, MSPM0_PIN_FUNCTION_ANALOG)>;
	};

	/omit-if-no-ref/ gpio_pb6: gpio_pb6 {
		pinmux = <MSP_PINMUX(23, MSPM0_PIN_FUNCTION_GPIO)>;
	};

	/omit-if-no-ref/ uart1_tx_pb6: uart1_tx_pb6 {
		pinmux = <MSP_PINMUX(23, MSPM0_PIN_FUNCTION_2)>;
	};

	/omit-if-no-ref/ spi1_cs0_pb6: spi1_cs0_pb6 {
		pinmux = <MSP_PINMUX(23, MSPM0_PIN_FUNCTION_3)>;
	};

	/omit-if-no-ref/ spi0_cs1_poci1_pb6: spi0_cs1_poci1_pb6 {
		pinmux = <MSP_PINMUX(23, MSPM0_PIN_FUNCTION_4)>;
		input-enable;
	};

	/omit-if-no-ref/ timg8_ccp0_pb6: timg8_ccp0_pb6 {
		pinmux = <MSP_PINMUX(23, MSPM0_PIN_FUNCTION_5)>;
	};

	/omit-if-no-ref/ uart2_cts_pb6: uart2_cts_pb6 {
		pinmux = <MSP_PINMUX(23, MSPM0_PIN_FUNCTION_6)>;
		input-enable;
	};

	/omit-if-no-ref/ timg6_ccp0_pb6: timg6_ccp0_pb6 {
		pinmux = <MSP_PINMUX(23, MSPM0_PIN_FUNCTION_7)>;
	};

	/omit-if-no-ref/ tima1_ccp0_cmpl_pb6: tima1_ccp0_cmpl_pb6 {
		pinmux = <MSP_PINMUX(23, MSPM0_PIN_FUNCTION_8)>;
	};

	/omit-if-no-ref/ analog_pb7: analog_pb7 {
		pinmux = <MSP_PINMUX(24, MSPM0_PIN_FUNCTION_ANALOG)>;
	};

	/omit-if-no-ref/ gpio_pb7: gpio_pb7 {
		pinmux = <MSP_PINMUX(24, MSPM0_PIN_FUNCTION_GPIO)>;
	};

	/omit-if-no-ref/ uart1_rx_pb7: uart1_rx_pb7 {
		pinmux = <MSP_PINMUX(24, MSPM0_PIN_FUNCTION_2)>;
		input-enable;
	};

	/omit-if-no-ref/ spi1_poci_pb7: spi1_poci_pb7 {
		pinmux = <MSP_PINMUX(24, MSPM0_PIN_FUNCTION_3)>;
		input-enable;
	};

	/omit-if-no-ref/ spi0_cs2_poci2_pb7: spi0_cs2_poci2_pb7 {
		pinmux = <MSP_PINMUX(24, MSPM0_PIN_FUNCTION_4)>;
		input-enable;
	};

	/omit-if-no-ref/ timg8_ccp1_pb7: timg8_ccp1_pb7 {
		pinmux = <MSP_PINMUX(24, MSPM0_PIN_FUNCTION_5)>;
	};

	/omit-if-no-ref/ uart2_rts_pb7: uart2_rts_pb7 {
		pinmux = <MSP_PINMUX(24, MSPM0_PIN_FUNCTION_6)>;
	};

	/omit-if-no-ref/ timg6_ccp1_pb7: timg6_ccp1_pb7 {
		pinmux = <MSP_PINMUX(24, MSPM0_PIN_FUNCTION_7)>;
	};

	/omit-if-no-ref/ tima1_ccp1_cmpl_pb7: tima1_ccp1_cmpl_pb7 {
		pinmux = <MSP_PINMUX(24, MSPM0_PIN_FUNCTION_8)>;
	};

	/omit-if-no-ref/ analog_pb8: analog_pb8 {
		pinmux = <MSP_PINMUX(25, MSPM0_PIN_FUNCTION_ANALOG)>;
	};

	/omit-if-no-ref/ gpio_pb8: gpio_pb8 {
		pinmux = <MSP_PINMUX(25, MSPM0_PIN_FUNCTION_GPIO)>;
	};

	/omit-if-no-ref/ uart1_cts_pb8: uart1_cts_pb8 {
		pinmux = <MSP_PINMUX(25, MSPM0_PIN_FUNCTION_2)>;
		input-enable;
	};

	/omit-if-no-ref/ spi1_pico_pb8: spi1_pico_pb8 {
		pinmux = <MSP_PINMUX(25, MSPM0_PIN_FUNCTION_3)>;
	};

	/omit-if-no-ref/ tima0_ccp0_pb8: tima0_ccp0_pb8 {
		pinmux = <MSP_PINMUX(25, MSPM0_PIN_FUNCTION_4)>;
	};

	/omit-if-no-ref/ comp1_out_pb8: comp1_out_pb8 {
		pinmux = <MSP_PINMUX(25, MSPM0_PIN_FUNCTION_5)>;
	};

	/omit-if-no-ref/ analog_pb9: analog_pb9 {
		pinmux = <MSP_PINMUX(26, MSPM0_PIN_FUNCTION_ANALOG)>;
	};

	/omit-if-no-ref/ gpio_pb9: gpio_pb9 {
		pinmux = <MSP_PINMUX(26, MSPM0_PIN_FUNCTION_GPIO)>;
	};

	/omit-if-no-ref/ uart1_rts_pb9: uart1_rts_pb9 {
		pinmux = <MSP_PINMUX(26, MSPM0_PIN_FUNCTION_2)>;
	};

	/omit-if-no-ref/ spi1_sclk_pb9: spi1_sclk_pb9 {
		pinmux = <MSP_PINMUX(26, MSPM0_PIN_FUNCTION_3)>;
	};

	/omit-if-no-ref/ tima0_ccp1_pb9: tima0_ccp1_pb9 {
		pinmux = <MSP_PINMUX(26, MSPM0_PIN_FUNCTION_4)>;
	};

	/omit-if-no-ref/ tima0_ccp0_cmpl_pb9: tima0_ccp0_cmpl_pb9 {
		pinmux = <MSP_PINMUX(26, MSPM0_PIN_FUNCTION_5)>;
	};

	/omit-if-no-ref/ analog_pb10: analog_pb10 {
		pinmux = <MSP_PINMUX(27, MSPM0_PIN_FUNCTION_ANALOG)>;
	};

	/omit-if-no-ref/ gpio_pb10: gpio_pb10 {
		pinmux = <MSP_PINMUX(27, MSPM0_PIN_FUNCTION_GPIO)>;
	};

	/omit-if-no-ref/ timg0_ccp0_pb10: timg0_ccp0_pb10 {
		pinmux = <MSP_PINMUX(27, MSPM0_PIN_FUNCTION_2)>;
	};

	/omit-if-no-ref/ timg8_ccp0_pb10: timg8_ccp0_pb10 {
		pinmux = <MSP_PINMUX(27, MSPM0_PIN_FUNCTION_3)>;
	};

	/omit-if-no-ref/ comp1_out_pb10: comp1_out_pb10 {
		pinmux = <MSP_PINMUX(27, MSPM0_PIN_FUNCTION_4)>;
	};

	/omit-if-no-ref/ timg6_ccp0_pb10: timg6_ccp0_pb10 {
		pinmux = <MSP_PINMUX(27, MSPM0_PIN_FUNCTION_5)>;
	};

	/omit-if-no-ref/ analog_pb11: analog_pb11 {
		pinmux = <MSP_PINMUX(28, MSPM0_PIN_FUNCTION_ANALOG)>;
	};

	/omit-if-no-ref/ gpio_pb11: gpio_pb11 {
		pinmux = <MSP_PINMUX(28, MSPM0_PIN_FUNCTION_GPIO)>;
	};

	/omit-if-no-ref/ timg0_ccp1_pb11: timg0_ccp1_pb11 {
		pinmux = <MSP_PINMUX(28, MSPM0_PIN_FUNCTION_2)>;
	};

	/omit-if-no-ref/ timg8_ccp1_pb11: timg8_ccp1_pb11 {
		pinmux = <MSP_PINMUX(28, MSPM0_PIN_FUNCTION_3)>;
	};

	/omit-if-no-ref/ sysctl_clk_out_pb11: sysctl_clk_out_pb11 {
		pinmux = <MSP_PINMUX(28, MSPM0_PIN_FUNCTION_4)>;
	};

	/omit-if-no-ref/ timg6_ccp1_pb11: timg6_ccp1_pb11 {
		pinmux = <MSP_PINMUX(28, MSPM0_PIN_FUNCTION_5)>;
	};

	/omit-if-no-ref/ analog_pb12: analog_pb12 {
		pinmux = <MSP_PINMUX(29, MSPM0_PIN_FUNCTION_ANALOG)>;
	};

	/omit-if-no-ref/ gpio_pb12: gpio_pb12 {
		pinmux = <MSP_PINMUX(29, MSPM0_PIN_FUNCTION_GPIO)>;
	};

	/omit-if-no-ref/ uart3_tx_pb12: uart3_tx_pb12 {
		pinmux = <MSP_PINMUX(29, MSPM0_PIN_FUNCTION_2)>;
	};

	/omit-if-no-ref/ tima0_ccp2_pb12: tima0_ccp2_pb12 {
		pinmux = <MSP_PINMUX(29, MSPM0_PIN_FUNCTION_3)>;
	};

	/omit-if-no-ref/ tima_fault1_pb12: tima_fault1_pb12 {
		pinmux = <MSP_PINMUX(29, MSPM0_PIN_FUNCTION_4)>;
	};

	/omit-if-no-ref/ tima0_ccp1_pb12: tima0_ccp1_pb12 {
		pinmux = <MSP_PINMUX(29, MSPM0_PIN_FUNCTION_5)>;
	};

	/omit-if-no-ref/ analog_pb13: analog_pb13 {
		pinmux = <MSP_PINMUX(30, MSPM0_PIN_FUNCTION_ANALOG)>;
	};

	/omit-if-no-ref/ gpio_pb13: gpio_pb13 {
		pinmux = <MSP_PINMUX(30, MSPM0_PIN_FUNCTION_GPIO)>;
	};

	/omit-if-no-ref/ uart3_rx_pb13: uart3_rx_pb13 {
		pinmux = <MSP_PINMUX(30, MSPM0_PIN_FUNCTION_2)>;
		input-enable;
	};

	/omit-if-no-ref/ tima0_ccp3_pb13: tima0_ccp3_pb13 {
		pinmux = <MSP_PINMUX(30, MSPM0_PIN_FUNCTION_3)>;
	};

	/omit-if-no-ref/ timg12_ccp0_pb13: timg12_ccp0_pb13 {
		pinmux = <MSP_PINMUX(30, MSPM0_PIN_FUNCTION_4)>;
	};

	/omit-if-no-ref/ tima0_ccp1_cmpl_pb13: tima0_ccp1_cmpl_pb13 {
		pinmux = <MSP_PINMUX(30, MSPM0_PIN_FUNCTION_5)>;
	};

	/omit-if-no-ref/ analog_pb14: analog_pb14 {
		pinmux = <MSP_PINMUX(31, MSPM0_PIN_FUNCTION_ANALOG)>;
	};

	/omit-if-no-ref/ gpio_pb14: gpio_pb14 {
		pinmux = <MSP_PINMUX(31, MSPM0_PIN_FUNCTION_GPIO)>;
	};

	/omit-if-no-ref/ spi1_cs3_cd_poci3_pb14: spi1_cs3_cd_poci3_pb14 {
		pinmux = <MSP_PINMUX(31, MSPM0_PIN_FUNCTION_2)>;
		input-enable;
	};

	/omit-if-no-ref/ spi1_poci_pb14: spi1_poci_pb14 {
		pinmux = <MSP_PINMUX(31, MSPM0_PIN_FUNCTION_3)>;
		input-enable;
	};

	/omit-if-no-ref/ spi0_cs3_cd_poci3_pb14: spi0_cs3_cd_poci3_pb14 {
		pinmux = <MSP_PINMUX(31, MSPM0_PIN_FUNCTION_4)>;
		input-enable;
	};

	/omit-if-no-ref/ timg12_ccp1_pb14: timg12_ccp1_pb14 {
		pinmux = <MSP_PINMUX(31, MSPM0_PIN_FUNCTION_5)>;
	};

	/omit-if-no-ref/ timg8_idx_pb14: timg8_idx_pb14 {
		pinmux = <MSP_PINMUX(31, MSPM0_PIN_FUNCTION_6)>;
	};

	/omit-if-no-ref/ tima0_ccp0_pb14: tima0_ccp0_pb14 {
		pinmux = <MSP_PINMUX(31, MSPM0_PIN_FUNCTION_7)>;
	};

	/omit-if-no-ref/ analog_pb15: analog_pb15 {
		pinmux = <MSP_PINMUX(32, MSPM0_PIN_FUNCTION_ANALOG)>;
	};

	/omit-if-no-ref/ gpio_pb15: gpio_pb15 {
		pinmux = <MSP_PINMUX(32, MSPM0_PIN_FUNCTION_GPIO)>;
	};

	/omit-if-no-ref/ uart2_tx_pb15: uart2_tx_pb15 {
		pinmux = <MSP_PINMUX(32, MSPM0_PIN_FUNCTION_2)>;
	};

	/omit-if-no-ref/ spi1_pico_pb15: spi1_pico_pb15 {
		pinmux = <MSP_PINMUX(32, MSPM0_PIN_FUNCTION_3)>;
	};

	/omit-if-no-ref/ uart3_cts_pb15: uart3_cts_pb15 {
		pinmux = <MSP_PINMUX(32, MSPM0_PIN_FUNCTION_4)>;
		input-enable;
	};

	/omit-if-no-ref/ timg8_ccp0_pb15: timg8_ccp0_pb15 {
		pinmux = <MSP_PINMUX(32, MSPM0_PIN_FUNCTION_5)>;
	};

	/omit-if-no-ref/ timg7_ccp0_pb15: timg7_ccp0_pb15 {
		pinmux = <MSP_PINMUX(32, MSPM0_PIN_FUNCTION_6)>;
	};

	/omit-if-no-ref/ analog_pb16: analog_pb16 {
		pinmux = <MSP_PINMUX(33, MSPM0_PIN_FUNCTION_ANALOG)>;
	};

	/omit-if-no-ref/ gpio_pb16: gpio_pb16 {
		pinmux = <MSP_PINMUX(33, MSPM0_PIN_FUNCTION_GPIO)>;
	};

	/omit-if-no-ref/ uart2_rx_pb16: uart2_rx_pb16 {
		pinmux = <MSP_PINMUX(33, MSPM0_PIN_FUNCTION_2)>;
		input-enable;
	};

	/omit-if-no-ref/ spi1_sclk_pb16: spi1_sclk_pb16 {
		pinmux = <MSP_PINMUX(33, MSPM0_PIN_FUNCTION_3)>;
	};

	/omit-if-no-ref/ uart3_rts_pb16: uart3_rts_pb16 {
		pinmux = <MSP_PINMUX(33, MSPM0_PIN_FUNCTION_4)>;
	};

	/omit-if-no-ref/ timg8_ccp1_pb16: timg8_ccp1_pb16 {
		pinmux = <MSP_PINMUX(33, MSPM0_PIN_FUNCTION_5)>;
	};

	/omit-if-no-ref/ timg7_ccp1_pb16: timg7_ccp1_pb16 {
		pinmux = <MSP_PINMUX(33, MSPM0_PIN_FUNCTION_6)>;
	};

	/omit-if-no-ref/ analog_pa12: analog_pa12 {
		pinmux = <MSP_PINMUX(34, MSPM0_PIN_FUNCTION_ANALOG)>;
	};

	/omit-if-no-ref/ gpio_pa12: gpio_pa12 {
		pinmux = <MSP_PINMUX(34, MSPM0_PIN_FUNCTION_GPIO)>;
	};

	/omit-if-no-ref/ uart3_cts_pa12: uart3_cts_pa12 {
		pinmux = <MSP_PINMUX(34, MSPM0_PIN_FUNCTION_2)>;
		input-enable;
	};

	/omit-if-no-ref/ spi0_sclk_pa12: spi0_sclk_pa12 {
		pinmux = <MSP_PINMUX(34, MSPM0_PIN_FUNCTION_3)>;
	};

	/omit-if-no-ref/ timg0_ccp0_pa12: timg0_ccp0_pa12 {
		pinmux = <MSP_PINMUX(34, MSPM0_PIN_FUNCTION_4)>;
	};

	/omit-if-no-ref/ canfd0_cantx_pa12: canfd0_cantx_pa12 {
		pinmux = <MSP_PINMUX(34, MSPM0_PIN_FUNCTION_5)>;
	};

	/omit-if-no-ref/ tima0_ccp3_pa12: tima0_ccp3_pa12 {
		pinmux = <MSP_PINMUX(34, MSPM0_PIN_FUNCTION_6)>;
	};

	/omit-if-no-ref/ sysctl_fcc_in_pa12: sysctl_fcc_in_pa12 {
		pinmux = <MSP_PINMUX(34, MSPM0_PIN_FUNCTION_7)>;
		input-enable;
	};

	/omit-if-no-ref/ analog_pa13: analog_pa13 {
		pinmux = <MSP_PINMUX(35, MSPM0_PIN_FUNCTION_ANALOG)>;
	};

	/omit-if-no-ref/ gpio_pa13: gpio_pa13 {
		pinmux = <MSP_PINMUX(35, MSPM0_PIN_FUNCTION_GPIO)>;
	};

	/omit-if-no-ref/ uart3_rts_pa13: uart3_rts_pa13 {
		pinmux = <MSP_PINMUX(35, MSPM0_PIN_FUNCTION_2)>;
	};

	/omit-if-no-ref/ spi0_poci_pa13: spi0_poci_pa13 {
		pinmux = <MSP_PINMUX(35, MSPM0_PIN_FUNCTION_3)>;
		input-enable;
	};

	/omit-if-no-ref/ uart3_rx_pa13: uart3_rx_pa13 {
		pinmux = <MSP_PINMUX(35, MSPM0_PIN_FUNCTION_4)>;
		input-enable;
	};

	/omit-if-no-ref/ timg0_ccp1_pa13: timg0_ccp1_pa13 {
		pinmux = <MSP_PINMUX(35, MSPM0_PIN_FUNCTION_5)>;
	};

	/omit-if-no-ref/ canfd0_canrx_pa13: canfd0_canrx_pa13 {
		pinmux = <MSP_PINMUX(35, MSPM0_PIN_FUNCTION_6)>;
		input-enable;
	};

	/omit-if-no-ref/ tima0_ccp3_cmpl_pa13: tima0_ccp3_cmpl_pa13 {
		pinmux = <MSP_PINMUX(35, MSPM0_PIN_FUNCTION_7)>;
	};

	/omit-if-no-ref/ analog_pa14: analog_pa14 {
		pinmux = <MSP_PINMUX(36, MSPM0_PIN_FUNCTION_ANALOG)>;
	};

	/omit-if-no-ref/ gpio_pa14: gpio_pa14 {
		pinmux = <MSP_PINMUX(36, MSPM0_PIN_FUNCTION_GPIO)>;
	};

	/omit-if-no-ref/ uart0_cts_pa14: uart0_cts_pa14 {
		pinmux = <MSP_PINMUX(36, MSPM0_PIN_FUNCTION_2)>;
		input-enable;
	};

	/omit-if-no-ref/ spi0_pico_pa14: spi0_pico_pa14 {
		pinmux = <MSP_PINMUX(36, MSPM0_PIN_FUNCTION_3)>;
	};

	/omit-if-no-ref/ uart3_tx_pa14: uart3_tx_pa14 {
		pinmux = <MSP_PINMUX(36, MSPM0_PIN_FUNCTION_4)>;
	};

	/omit-if-no-ref/ timg12_ccp0_pa14: timg12_ccp0_pa14 {
		pinmux = <MSP_PINMUX(36, MSPM0_PIN_FUNCTION_5)>;
	};

	/omit-if-no-ref/ sysctl_clk_out_pa14: sysctl_clk_out_pa14 {
		pinmux = <MSP_PINMUX(36, MSPM0_PIN_FUNCTION_6)>;
	};

	/omit-if-no-ref/ analog_pa15: analog_pa15 {
		pinmux = <MSP_PINMUX(37, MSPM0_PIN_FUNCTION_ANALOG)>;
	};

	/omit-if-no-ref/ gpio_pa15: gpio_pa15 {
		pinmux = <MSP_PINMUX(37, MSPM0_PIN_FUNCTION_GPIO)>;
	};

	/omit-if-no-ref/ uart0_rts_pa15: uart0_rts_pa15 {
		pinmux = <MSP_PINMUX(37, MSPM0_PIN_FUNCTION_2)>;
	};

	/omit-if-no-ref/ spi1_cs2_poci2_pa15: spi1_cs2_poci2_pa15 {
		pinmux = <MSP_PINMUX(37, MSPM0_PIN_FUNCTION_3)>;
		input-enable;
	};

	/omit-if-no-ref/ i2c1_scl_pa15: i2c1_scl_pa15 {
		pinmux = <MSP_PINMUX(37, MSPM0_PIN_FUNCTION_4)>;
		input-enable;
		drive-open-drain;
		bias-disable;
	};

	/omit-if-no-ref/ tima1_ccp0_pa15: tima1_ccp0_pa15 {
		pinmux = <MSP_PINMUX(37, MSPM0_PIN_FUNCTION_5)>;
	};

	/omit-if-no-ref/ timg8_idx_pa15: timg8_idx_pa15 {
		pinmux = <MSP_PINMUX(37, MSPM0_PIN_FUNCTION_6)>;
	};

	/omit-if-no-ref/ tima1_ccp0_cmpl_pa15: tima1_ccp0_cmpl_pa15 {
		pinmux = <MSP_PINMUX(37, MSPM0_PIN_FUNCTION_7)>;
	};

	/omit-if-no-ref/ tima0_ccp2_pa15: tima0_ccp2_pa15 {
		pinmux = <MSP_PINMUX(37, MSPM0_PIN_FUNCTION_8)>;
	};

	/omit-if-no-ref/ analog_pa16: analog_pa16 {
		pinmux = <MSP_PINMUX(38, MSPM0_PIN_FUNCTION_ANALOG)>;
	};

	/omit-if-no-ref/ gpio_pa16: gpio_pa16 {
		pinmux = <MSP_PINMUX(38, MSPM0_PIN_FUNCTION_GPIO)>;
	};

	/omit-if-no-ref/ comp2_out_pa16: comp2_out_pa16 {
		pinmux = <MSP_PINMUX(38, MSPM0_PIN_FUNCTION_2)>;
	};

	/omit-if-no-ref/ spi1_poci_pa16: spi1_poci_pa16 {
		pinmux = <MSP_PINMUX(38, MSPM0_PIN_FUNCTION_3)>;
		input-enable;
	};

	/omit-if-no-ref/ i2c1_sda_pa16: i2c1_sda_pa16 {
		pinmux = <MSP_PINMUX(38, MSPM0_PIN_FUNCTION_4)>;
		input-enable;
		drive-open-drain;
		bias-disable;
	};

	/omit-if-no-ref/ tima1_ccp1_pa16: tima1_ccp1_pa16 {
		pinmux = <MSP_PINMUX(38, MSPM0_PIN_FUNCTION_5)>;
	};

	/omit-if-no-ref/ tima1_ccp1_cmpl_pa16: tima1_ccp1_cmpl_pa16 {
		pinmux = <MSP_PINMUX(38, MSPM0_PIN_FUNCTION_6)>;
	};

	/omit-if-no-ref/ tima0_ccp2_cmpl_pa16: tima0_ccp2_cmpl_pa16 {
		pinmux = <MSP_PINMUX(38, MSPM0_PIN_FUNCTION_7)>;
	};

	/omit-if-no-ref/ sysctl_fcc_in_pa16: sysctl_fcc_in_pa16 {
		pinmux = <MSP_PINMUX(38, MSPM0_PIN_FUNCTION_8)>;
		input-enable;
	};

	/omit-if-no-ref/ analog_pa17: analog_pa17 {
		pinmux = <MSP_PINMUX(39, MSPM0_PIN_FUNCTION_ANALOG)>;
	};

	/omit-if-no-ref/ gpio_pa17: gpio_pa17 {
		pinmux = <MSP_PINMUX(39, MSPM0_PIN_FUNCTION_GPIO)>;
	};

	/omit-if-no-ref/ uart1_tx_pa17: uart1_tx_pa17 {
		pinmux = <MSP_PINMUX(39, MSPM0_PIN_FUNCTION_2)>;
	};

	/omit-if-no-ref/ spi1_sclk_pa17: spi1_sclk_pa17 {
		pinmux = <MSP_PINMUX(39, MSPM0_PIN_FUNCTION_3)>;
	};

	/omit-if-no-ref/ i2c1_scl_pa17: i2c1_scl_pa17 {
		pinmux = <MSP_PINMUX(39, MSPM0_PIN_FUNCTION_4)>;
		input-enable;
		drive-open-drain;
		bias-disable;
	};

	/omit-if-no-ref/ tima0_ccp3_pa17: tima0_ccp3_pa17 {
		pinmux = <MSP_PINMUX(39, MSPM0_PIN_FUNCTION_5)>;
	};

	/omit-if-no-ref/ timg7_ccp0_pa17: timg7_ccp0_pa17 {
		pinmux = <MSP_PINMUX(39, MSPM0_PIN_FUNCTION_6)>;
	};

	/omit-if-no-ref/ tima1_ccp0_pa17: tima1_ccp0_pa17 {
		pinmux = <MSP_PINMUX(39, MSPM0_PIN_FUNCTION_7)>;
	};

	/omit-if-no-ref/ analog_pa18: analog_pa18 {
		pinmux = <MSP_PINMUX(40, MSPM0_PIN_FUNCTION_ANALOG)>;
	};

	/omit-if-no-ref/ gpio_pa18: gpio_pa18 {
		pinmux = <MSP_PINMUX(40, MSPM0_PIN_FUNCTION_GPIO)>;
	};

	/omit-if-no-ref/ uart1_rx_pa18: uart1_rx_pa18 {
		pinmux = <MSP_PINMUX(40, MSPM0_PIN_FUNCTION_2)>;
		input-enable;
	};

	/omit-if-no-ref/ spi1_pico_pa18: spi1_pico_pa18 {
		pinmux = <MSP_PINMUX(40, MSPM0_PIN_FUNCTION_3)>;
	};

	/omit-if-no-ref/ i2c1_sda_pa18: i2c1_sda_pa18 {
		pinmux = <MSP_PINMUX(40, MSPM0_PIN_FUNCTION_4)>;
		input-enable;
		drive-open-drain;
		bias-disable;
	};

	/omit-if-no-ref/ tima0_ccp3_cmpl_pa18: tima0_ccp3_cmpl_pa18 {
		pinmux = <MSP_PINMUX(40, MSPM0_PIN_FUNCTION_5)>;
	};

	/omit-if-no-ref/ timg7_ccp1_pa18: timg7_ccp1_pa18 {
		pinmux = <MSP_PINMUX(40, MSPM0_PIN_FUNCTION_6)>;
	};

	/omit-if-no-ref/ tima1_ccp1_pa18: tima1_ccp1_pa18 {
		pinmux = <MSP_PINMUX(40, MSPM0_PIN_FUNCTION_7)>;
	};

	/omit-if-no-ref/ analog_pa19: analog_pa19 {
		pinmux = <MSP_PINMUX(41, MSPM0_PIN_FUNCTION_ANALOG)>;
	};

	/omit-if-no-ref/ gpio_pa19: gpio_pa19 {
		pinmux = <MSP_PINMUX(41, MSPM0_PIN_FUNCTION_GPIO)>;
	};

	/omit-if-no-ref/ debugss_swdio_pa19: debugss_swdio_pa19 {
		pinmux = <MSP_PINMUX(41, MSPM0_PIN_FUNCTION_2)>;
		input-enable;
	};

	/omit-if-no-ref/ analog_pa20: analog_pa20 {
		pinmux = <MSP_PINMUX(42, MSPM0_PIN_FUNCTION_ANALOG)>;
	};

	/omit-if-no-ref/ gpio_pa20: gpio_pa20 {
		pinmux = <MSP_PINMUX(42, MSPM0_PIN_FUNCTION_GPIO)>;
	};

	/omit-if-no-ref/ debugss_swclk_pa20: debugss_swclk_pa20 {
		pinmux = <MSP_PINMUX(42, MSPM0_PIN_FUNCTION_2)>;
	};

	/omit-if-no-ref/ analog_pb17: analog_pb17 {
		pinmux = <MSP_PINMUX(43, MSPM0_PIN_FUNCTION_ANALOG)>;
	};

	/omit-if-no-ref/ gpio_pb17: gpio_pb17 {
		pinmux = <MSP_PINMUX(43, MSPM0_PIN_FUNCTION_GPIO)>;
	};

	/omit-if-no-ref/ uart2_tx_pb17: uart2_tx_pb17 {
		pinmux = <MSP_PINMUX(43, MSPM0_PIN_FUNCTION_2)>;
	};

	/omit-if-no-ref/ spi0_pico_pb17: spi0_pico_pb17 {
		pinmux = <MSP_PINMUX(43, MSPM0_PIN_FUNCTION_3)>;
	};

	/omit-if-no-ref/ spi1_cs1_poci1_pb17: spi1_cs1_poci1_pb17 {
		pinmux = <MSP_PINMUX(43, MSPM0_PIN_FUNCTION_4)>;
		input-enable;
	};

	/omit-if-no-ref/ tima1_ccp0_pb17: tima1_ccp0_pb17 {
		pinmux = <MSP_PINMUX(43, MSPM0_PIN_FUNCTION_5)>;
	};

	/omit-if-no-ref/ tima0_ccp2_pb17: tima0_ccp2_pb17 {
		pinmux = <MSP_PINMUX(43, MSPM0_PIN_FUNCTION_6)>;
	};

	/omit-if-no-ref/ analog_pb18: analog_pb18 {
		pinmux = <MSP_PINMUX(44, MSPM0_PIN_FUNCTION_ANALOG)>;
	};

	/omit-if-no-ref/ gpio_pb18: gpio_pb18 {
		pinmux = <MSP_PINMUX(44, MSPM0_PIN_FUNCTION_GPIO)>;
	};

	/omit-if-no-ref/ uart2_rx_pb18: uart2_rx_pb18 {
		pinmux = <MSP_PINMUX(44, MSPM0_PIN_FUNCTION_2)>;
		input-enable;
	};

	/omit-if-no-ref/ spi0_sclk_pb18: spi0_sclk_pb18 {
		pinmux = <MSP_PINMUX(44, MSPM0_PIN_FUNCTION_3)>;
	};

	/omit-if-no-ref/ spi1_cs2_poci2_pb18: spi1_cs2_poci2_pb18 {
		pinmux = <MSP_PINMUX(44, MSPM0_PIN_FUNCTION_4)>;
		input-enable;
	};

	/omit-if-no-ref/ tima1_ccp1_pb18: tima1_ccp1_pb18 {
		pinmux = <MSP_PINMUX(44, MSPM0_PIN_FUNCTION_5)>;
	};

	/omit-if-no-ref/ tima0_ccp2_cmpl_pb18: tima0_ccp2_cmpl_pb18 {
		pinmux = <MSP_PINMUX(44, MSPM0_PIN_FUNCTION_6)>;
	};

	/omit-if-no-ref/ analog_pb19: analog_pb19 {
		pinmux = <MSP_PINMUX(45, MSPM0_PIN_FUNCTION_ANALOG)>;
	};

	/omit-if-no-ref/ gpio_pb19: gpio_pb19 {
		pinmux = <MSP_PINMUX(45, MSPM0_PIN_FUNCTION_GPIO)>;
	};

	/omit-if-no-ref/ comp2_out_pb19: comp2_out_pb19 {
		pinmux = <MSP_PINMUX(45, MSPM0_PIN_FUNCTION_2)>;
	};

	/omit-if-no-ref/ spi0_poci_pb19: spi0_poci_pb19 {
		pinmux = <MSP_PINMUX(45, MSPM0_PIN_FUNCTION_3)>;
		input-enable;
	};

	/omit-if-no-ref/ timg8_ccp1_pb19: timg8_ccp1_pb19 {
		pinmux = <MSP_PINMUX(45, MSPM0_PIN_FUNCTION_4)>;
	};

	/omit-if-no-ref/ uart0_cts_pb19: uart0_cts_pb19 {
		pinmux = <MSP_PINMUX(45, MSPM0_PIN_FUNCTION_5)>;
		input-enable;
	};

	/omit-if-no-ref/ timg7_ccp1_pb19: timg7_ccp1_pb19 {
		pinmux = <MSP_PINMUX(45, MSPM0_PIN_FUNCTION_6)>;
	};

	/omit-if-no-ref/ analog_pa21: analog_pa21 {
		pinmux = <MSP_PINMUX(46, MSPM0_PIN_FUNCTION_ANALOG)>;
	};

	/omit-if-no-ref/ gpio_pa21: gpio_pa21 {
		pinmux = <MSP_PINMUX(46, MSPM0_PIN_FUNCTION_GPIO)>;
	};

	/omit-if-no-ref/ uart2_tx_pa21: uart2_tx_pa21 {
		pinmux = <MSP_PINMUX(46, MSPM0_PIN_FUNCTION_2)>;
	};

	/omit-if-no-ref/ timg8_ccp0_pa21: timg8_ccp0_pa21 {
		pinmux = <MSP_PINMUX(46, MSPM0_PIN_FUNCTION_3)>;
	};

	/omit-if-no-ref/ uart1_cts_pa21: uart1_cts_pa21 {
		pinmux = <MSP_PINMUX(46, MSPM0_PIN_FUNCTION_4)>;
		input-enable;
	};

	/omit-if-no-ref/ tima0_ccp0_pa21: tima0_ccp0_pa21 {
		pinmux = <MSP_PINMUX(46, MSPM0_PIN_FUNCTION_5)>;
	};

	/omit-if-no-ref/ timg6_ccp0_pa21: timg6_ccp0_pa21 {
		pinmux = <MSP_PINMUX(46, MSPM0_PIN_FUNCTION_6)>;
	};

	/omit-if-no-ref/ analog_pa22: analog_pa22 {
		pinmux = <MSP_PINMUX(47, MSPM0_PIN_FUNCTION_ANALOG)>;
	};

	/omit-if-no-ref/ gpio_pa22: gpio_pa22 {
		pinmux = <MSP_PINMUX(47, MSPM0_PIN_FUNCTION_GPIO)>;
	};

	/omit-if-no-ref/ uart2_rx_pa22: uart2_rx_pa22 {
		pinmux = <MSP_PINMUX(47, MSPM0_PIN_FUNCTION_2)>;
		input-enable;
	};

	/omit-if-no-ref/ timg8_ccp1_pa22: timg8_ccp1_pa22 {
		pinmux = <MSP_PINMUX(47, MSPM0_PIN_FUNCTION_3)>;
	};

	/omit-if-no-ref/ uart1_rts_pa22: uart1_rts_pa22 {
		pinmux = <MSP_PINMUX(47, MSPM0_PIN_FUNCTION_4)>;
	};

	/omit-if-no-ref/ tima0_ccp1_pa22: tima0_ccp1_pa22 {
		pinmux = <MSP_PINMUX(47, MSPM0_PIN_FUNCTION_5)>;
	};

	/omit-if-no-ref/ sysctl_clk_out_pa22: sysctl_clk_out_pa22 {
		pinmux = <MSP_PINMUX(47, MSPM0_PIN_FUNCTION_6)>;
	};

	/omit-if-no-ref/ tima0_ccp0_cmpl_pa22: tima0_ccp0_cmpl_pa22 {
		pinmux = <MSP_PINMUX(47, MSPM0_PIN_FUNCTION_7)>;
	};

	/omit-if-no-ref/ timg6_ccp1_pa22: timg6_ccp1_pa22 {
		pinmux = <MSP_PINMUX(47, MSPM0_PIN_FUNCTION_8)>;
	};

	/omit-if-no-ref/ analog_pb20: analog_pb20 {
		pinmux = <MSP_PINMUX(48, MSPM0_PIN_FUNCTION_ANALOG)>;
	};

	/omit-if-no-ref/ gpio_pb20: gpio_pb20 {
		pinmux = <MSP_PINMUX(48, MSPM0_PIN_FUNCTION_GPIO)>;
	};

	/omit-if-no-ref/ spi0_cs2_poci2_pb20: spi0_cs2_poci2_pb20 {
		pinmux = <MSP_PINMUX(48, MSPM0_PIN_FUNCTION_2)>;
		input-enable;
	};

	/omit-if-no-ref/ spi1_cs0_pb20: spi1_cs0_pb20 {
		pinmux = <MSP_PINMUX(48, MSPM0_PIN_FUNCTION_3)>;
	};

	/omit-if-no-ref/ tima0_ccp2_pb20: tima0_ccp2_pb20 {
		pinmux = <MSP_PINMUX(48, MSPM0_PIN_FUNCTION_4)>;
	};

	/omit-if-no-ref/ timg12_ccp0_pb20: timg12_ccp0_pb20 {
		pinmux = <MSP_PINMUX(48, MSPM0_PIN_FUNCTION_5)>;
	};

	/omit-if-no-ref/ tima_fault1_pb20: tima_fault1_pb20 {
		pinmux = <MSP_PINMUX(48, MSPM0_PIN_FUNCTION_6)>;
	};

	/omit-if-no-ref/ tima0_ccp1_pb20: tima0_ccp1_pb20 {
		pinmux = <MSP_PINMUX(48, MSPM0_PIN_FUNCTION_7)>;
	};

	/omit-if-no-ref/ tima1_ccp1_cmpl_pb20: tima1_ccp1_cmpl_pb20 {
		pinmux = <MSP_PINMUX(48, MSPM0_PIN_FUNCTION_8)>;
	};

	/omit-if-no-ref/ analog_pb21: analog_pb21 {
		pinmux = <MSP_PINMUX(49, MSPM0_PIN_FUNCTION_ANALOG)>;
	};

	/omit-if-no-ref/ gpio_pb21: gpio_pb21 {
		pinmux = <MSP_PINMUX(49, MSPM0_PIN_FUNCTION_GPIO)>;
	};

	/omit-if-no-ref/ spi1_poci_pb21: spi1_poci_pb21 {
		pinmux = <MSP_PINMUX(49, MSPM0_PIN_FUNCTION_2)>;
		input-enable;
	};

	/omit-if-no-ref/ timg8_ccp0_pb21: timg8_ccp0_pb21 {
		pinmux = <MSP_PINMUX(49, MSPM0_PIN_FUNCTION_3)>;
	};

	/omit-if-no-ref/ analog_pb22: analog_pb22 {
		pinmux = <MSP_PINMUX(50, MSPM0_PIN_FUNCTION_ANALOG)>;
	};

	/omit-if-no-ref/ gpio_pb22: gpio_pb22 {
		pinmux = <MSP_PINMUX(50, MSPM0_PIN_FUNCTION_GPIO)>;
	};

	/omit-if-no-ref/ spi1_pico_pb22: spi1_pico_pb22 {
		pinmux = <MSP_PINMUX(50, MSPM0_PIN_FUNCTION_2)>;
	};

	/omit-if-no-ref/ timg8_ccp1_pb22: timg8_ccp1_pb22 {
		pinmux = <MSP_PINMUX(50, MSPM0_PIN_FUNCTION_3)>;
	};

	/omit-if-no-ref/ analog_pb23: analog_pb23 {
		pinmux = <MSP_PINMUX(51, MSPM0_PIN_FUNCTION_ANALOG)>;
	};

	/omit-if-no-ref/ gpio_pb23: gpio_pb23 {
		pinmux = <MSP_PINMUX(51, MSPM0_PIN_FUNCTION_GPIO)>;
	};

	/omit-if-no-ref/ spi1_sclk_pb23: spi1_sclk_pb23 {
		pinmux = <MSP_PINMUX(51, MSPM0_PIN_FUNCTION_2)>;
	};

	/omit-if-no-ref/ comp0_out_pb23: comp0_out_pb23 {
		pinmux = <MSP_PINMUX(51, MSPM0_PIN_FUNCTION_3)>;
	};

	/omit-if-no-ref/ tima_fault0_pb23: tima_fault0_pb23 {
		pinmux = <MSP_PINMUX(51, MSPM0_PIN_FUNCTION_4)>;
	};

	/omit-if-no-ref/ analog_pb24: analog_pb24 {
		pinmux = <MSP_PINMUX(52, MSPM0_PIN_FUNCTION_ANALOG)>;
	};

	/omit-if-no-ref/ gpio_pb24: gpio_pb24 {
		pinmux = <MSP_PINMUX(52, MSPM0_PIN_FUNCTION_GPIO)>;
	};

	/omit-if-no-ref/ spi0_cs3_cd_poci3_pb24: spi0_cs3_cd_poci3_pb24 {
		pinmux = <MSP_PINMUX(52, MSPM0_PIN_FUNCTION_2)>;
		input-enable;
	};

	/omit-if-no-ref/ spi0_cs1_poci1_pb24: spi0_cs1_poci1_pb24 {
		pinmux = <MSP_PINMUX(52, MSPM0_PIN_FUNCTION_3)>;
		input-enable;
	};

	/omit-if-no-ref/ tima0_ccp3_pb24: tima0_ccp3_pb24 {
		pinmux = <MSP_PINMUX(52, MSPM0_PIN_FUNCTION_4)>;
	};

	/omit-if-no-ref/ timg12_ccp1_pb24: timg12_ccp1_pb24 {
		pinmux = <MSP_PINMUX(52, MSPM0_PIN_FUNCTION_5)>;
	};

	/omit-if-no-ref/ tima0_ccp1_cmpl_pb24: tima0_ccp1_cmpl_pb24 {
		pinmux = <MSP_PINMUX(52, MSPM0_PIN_FUNCTION_6)>;
	};

	/omit-if-no-ref/ tima1_ccp0_cmpl_pb24: tima1_ccp0_cmpl_pb24 {
		pinmux = <MSP_PINMUX(52, MSPM0_PIN_FUNCTION_7)>;
	};

	/omit-if-no-ref/ analog_pa23: analog_pa23 {
		pinmux = <MSP_PINMUX(53, MSPM0_PIN_FUNCTION_ANALOG)>;
	};

	/omit-if-no-ref/ gpio_pa23: gpio_pa23 {
		pinmux = <MSP_PINMUX(53, MSPM0_PIN_FUNCTION_GPIO)>;
	};

	/omit-if-no-ref/ uart2_tx_pa23: uart2_tx_pa23 {
		pinmux = <MSP_PINMUX(53, MSPM0_PIN_FUNCTION_2)>;
	};

	/omit-if-no-ref/ spi0_cs3_cd_poci3_pa23: spi0_cs3_cd_poci3_pa23 {
		pinmux = <MSP_PINMUX(53, MSPM0_PIN_FUNCTION_3)>;
		input-enable;
	};

	/omit-if-no-ref/ tima0_ccp3_pa23: tima0_ccp3_pa23 {
		pinmux = <MSP_PINMUX(53, MSPM0_PIN_FUNCTION_4)>;
	};

	/omit-if-no-ref/ timg0_ccp0_pa23: timg0_ccp0_pa23 {
		pinmux = <MSP_PINMUX(53, MSPM0_PIN_FUNCTION_5)>;
	};

	/omit-if-no-ref/ uart3_cts_pa23: uart3_cts_pa23 {
		pinmux = <MSP_PINMUX(53, MSPM0_PIN_FUNCTION_6)>;
		input-enable;
	};

	/omit-if-no-ref/ timg7_ccp0_pa23: timg7_ccp0_pa23 {
		pinmux = <MSP_PINMUX(53, MSPM0_PIN_FUNCTION_7)>;
	};

	/omit-if-no-ref/ timg8_ccp0_pa23: timg8_ccp0_pa23 {
		pinmux = <MSP_PINMUX(53, MSPM0_PIN_FUNCTION_8)>;
	};

	/omit-if-no-ref/ analog_pa24: analog_pa24 {
		pinmux = <MSP_PINMUX(54, MSPM0_PIN_FUNCTION_ANALOG)>;
	};

	/omit-if-no-ref/ gpio_pa24: gpio_pa24 {
		pinmux = <MSP_PINMUX(54, MSPM0_PIN_FUNCTION_GPIO)>;
	};

	/omit-if-no-ref/ uart2_rx_pa24: uart2_rx_pa24 {
		pinmux = <MSP_PINMUX(54, MSPM0_PIN_FUNCTION_2)>;
		input-enable;
	};

	/omit-if-no-ref/ spi0_cs2_poci2_pa24: spi0_cs2_poci2_pa24 {
		pinmux = <MSP_PINMUX(54, MSPM0_PIN_FUNCTION_3)>;
		input-enable;
	};

	/omit-if-no-ref/ tima0_ccp3_cmpl_pa24: tima0_ccp3_cmpl_pa24 {
		pinmux = <MSP_PINMUX(54, MSPM0_PIN_FUNCTION_4)>;
	};

	/omit-if-no-ref/ timg0_ccp1_pa24: timg0_ccp1_pa24 {
		pinmux = <MSP_PINMUX(54, MSPM0_PIN_FUNCTION_5)>;
	};

	/omit-if-no-ref/ uart3_rts_pa24: uart3_rts_pa24 {
		pinmux = <MSP_PINMUX(54, MSPM0_PIN_FUNCTION_6)>;
	};

	/omit-if-no-ref/ timg7_ccp1_pa24: timg7_ccp1_pa24 {
		pinmux = <MSP_PINMUX(54, MSPM0_PIN_FUNCTION_7)>;
	};

	/omit-if-no-ref/ tima1_ccp1_pa24: tima1_ccp1_pa24 {
		pinmux = <MSP_PINMUX(54, MSPM0_PIN_FUNCTION_8)>;
	};

	/omit-if-no-ref/ analog_pa25: analog_pa25 {
		pinmux = <MSP_PINMUX(55, MSPM0_PIN_FUNCTION_ANALOG)>;
	};

	/omit-if-no-ref/ gpio_pa25: gpio_pa25 {
		pinmux = <MSP_PINMUX(55, MSPM0_PIN_FUNCTION_GPIO)>;
	};

	/omit-if-no-ref/ uart3_rx_pa25: uart3_rx_pa25 {
		pinmux = <MSP_PINMUX(55, MSPM0_PIN_FUNCTION_2)>;
		input-enable;
	};

	/omit-if-no-ref/ spi1_cs3_cd_poci3_pa25: spi1_cs3_cd_poci3_pa25 {
		pinmux = <MSP_PINMUX(55, MSPM0_PIN_FUNCTION_3)>;
		input-enable;
	};

	/omit-if-no-ref/ timg12_ccp1_pa25: timg12_ccp1_pa25 {
		pinmux = <MSP_PINMUX(55, MSPM0_PIN_FUNCTION_4)>;
	};

	/omit-if-no-ref/ tima0_ccp3_pa25: tima0_ccp3_pa25 {
		pinmux = <MSP_PINMUX(55, MSPM0_PIN_FUNCTION_5)>;
	};

	/omit-if-no-ref/ tima0_ccp1_cmpl_pa25: tima0_ccp1_cmpl_pa25 {
		pinmux = <MSP_PINMUX(55, MSPM0_PIN_FUNCTION_6)>;
	};

	/omit-if-no-ref/ analog_pb25: analog_pb25 {
		pinmux = <MSP_PINMUX(56, MSPM0_PIN_FUNCTION_ANALOG)>;
	};

	/omit-if-no-ref/ gpio_pb25: gpio_pb25 {
		pinmux = <MSP_PINMUX(56, MSPM0_PIN_FUNCTION_GPIO)>;
	};

	/omit-if-no-ref/ uart0_cts_pb25: uart0_cts_pb25 {
		pinmux = <MSP_PINMUX(56, MSPM0_PIN_FUNCTION_2)>;
		input-enable;
	};

	/omit-if-no-ref/ spi0_cs0_pb25: spi0_cs0_pb25 {
		pinmux = <MSP_PINMUX(56, MSPM0_PIN_FUNCTION_3)>;
	};

	/omit-if-no-ref/ tima_fault2_pb25: tima_fault2_pb25 {
		pinmux = <MSP_PINMUX(56, MSPM0_PIN_FUNCTION_4)>;
	};

	/omit-if-no-ref/ analog_pb26: analog_pb26 {
		pinmux = <MSP_PINMUX(57, MSPM0_PIN_FUNCTION_ANALOG)>;
	};

	/omit-if-no-ref/ gpio_pb26: gpio_pb26 {
		pinmux = <MSP_PINMUX(57, MSPM0_PIN_FUNCTION_GPIO)>;
	};

	/omit-if-no-ref/ uart0_rts_pb26: uart0_rts_pb26 {
		pinmux = <MSP_PINMUX(57, MSPM0_PIN_FUNCTION_2)>;
	};

	/omit-if-no-ref/ spi0_cs1_poci1_pb26: spi0_cs1_poci1_pb26 {
		pinmux = <MSP_PINMUX(57, MSPM0_PIN_FUNCTION_3)>;
		input-enable;
	};

	/omit-if-no-ref/ tima0_ccp3_pb26: tima0_ccp3_pb26 {
		pinmux = <MSP_PINMUX(57, MSPM0_PIN_FUNCTION_4)>;
	};

	/omit-if-no-ref/ timg6_ccp0_pb26: timg6_ccp0_pb26 {
		pinmux = <MSP_PINMUX(57, MSPM0_PIN_FUNCTION_5)>;
	};

	/omit-if-no-ref/ tima1_ccp0_pb26: tima1_ccp0_pb26 {
		pinmux = <MSP_PINMUX(57, MSPM0_PIN_FUNCTION_6)>;
	};

	/omit-if-no-ref/ analog_pb27: analog_pb27 {
		pinmux = <MSP_PINMUX(58, MSPM0_PIN_FUNCTION_ANALOG)>;
	};

	/omit-if-no-ref/ gpio_pb27: gpio_pb27 {
		pinmux = <MSP_PINMUX(58, MSPM0_PIN_FUNCTION_GPIO)>;
	};

	/omit-if-no-ref/ comp2_out_pb27: comp2_out_pb27 {
		pinmux = <MSP_PINMUX(58, MSPM0_PIN_FUNCTION_2)>;
	};

	/omit-if-no-ref/ spi1_cs1_poci1_pb27: spi1_cs1_poci1_pb27 {
		pinmux = <MSP_PINMUX(58, MSPM0_PIN_FUNCTION_3)>;
		input-enable;
	};

	/omit-if-no-ref/ tima0_ccp3_cmpl_pb27: tima0_ccp3_cmpl_pb27 {
		pinmux = <MSP_PINMUX(58, MSPM0_PIN_FUNCTION_4)>;
	};

	/omit-if-no-ref/ timg6_ccp1_pb27: timg6_ccp1_pb27 {
		pinmux = <MSP_PINMUX(58, MSPM0_PIN_FUNCTION_5)>;
	};

	/omit-if-no-ref/ tima1_ccp1_pb27: tima1_ccp1_pb27 {
		pinmux = <MSP_PINMUX(58, MSPM0_PIN_FUNCTION_6)>;
	};

	/omit-if-no-ref/ analog_pa26: analog_pa26 {
		pinmux = <MSP_PINMUX(59, MSPM0_PIN_FUNCTION_ANALOG)>;
	};

	/omit-if-no-ref/ gpio_pa26: gpio_pa26 {
		pinmux = <MSP_PINMUX(59, MSPM0_PIN_FUNCTION_GPIO)>;
	};

	/omit-if-no-ref/ uart3_tx_pa26: uart3_tx_pa26 {
		pinmux = <MSP_PINMUX(59, MSPM0_PIN_FUNCTION_2)>;
	};

	/omit-if-no-ref/ spi1_cs0_pa26: spi1_cs0_pa26 {
		pinmux = <MSP_PINMUX(59, MSPM0_PIN_FUNCTION_3)>;
	};

	/omit-if-no-ref/ timg8_ccp0_pa26: timg8_ccp0_pa26 {
		pinmux = <MSP_PINMUX(59, MSPM0_PIN_FUNCTION_4)>;
	};

	/omit-if-no-ref/ tima_fault0_pa26: tima_fault0_pa26 {
		pinmux = <MSP_PINMUX(59, MSPM0_PIN_FUNCTION_5)>;
	};

	/omit-if-no-ref/ canfd0_cantx_pa26: canfd0_cantx_pa26 {
		pinmux = <MSP_PINMUX(59, MSPM0_PIN_FUNCTION_6)>;
	};

	/omit-if-no-ref/ timg7_ccp0_pa26: timg7_ccp0_pa26 {
		pinmux = <MSP_PINMUX(59, MSPM0_PIN_FUNCTION_7)>;
	};

	/omit-if-no-ref/ analog_pa27: analog_pa27 {
		pinmux = <MSP_PINMUX(60, MSPM0_PIN_FUNCTION_ANALOG)>;
	};

	/omit-if-no-ref/ gpio_pa27: gpio_pa27 {
		pinmux = <MSP_PINMUX(60, MSPM0_PIN_FUNCTION_GPIO)>;
	};

	/omit-if-no-ref/ rtc_rtc_out_pa27: rtc_rtc_out_pa27 {
		pinmux = <MSP_PINMUX(60, MSPM0_PIN_FUNCTION_2)>;
	};

	/omit-if-no-ref/ spi1_cs1_poci1_pa27: spi1_cs1_poci1_pa27 {
		pinmux = <MSP_PINMUX(60, MSPM0_PIN_FUNCTION_3)>;
		input-enable;
	};

	/omit-if-no-ref/ timg8_ccp1_pa27: timg8_ccp1_pa27 {
		pinmux = <MSP_PINMUX(60, MSPM0_PIN_FUNCTION_4)>;
	};

	/omit-if-no-ref/ tima_fault2_pa27: tima_fault2_pa27 {
		pinmux = <MSP_PINMUX(60, MSPM0_PIN_FUNCTION_5)>;
	};

	/omit-if-no-ref/ canfd0_canrx_pa27: canfd0_canrx_pa27 {
		pinmux = <MSP_PINMUX(60, MSPM0_PIN_FUNCTION_6)>;
		input-enable;
	};

	/omit-if-no-ref/ timg7_ccp1_pa27: timg7_ccp1_pa27 {
		pinmux = <MSP_PINMUX(60, MSPM0_PIN_FUNCTION_7)>;
	};
};
