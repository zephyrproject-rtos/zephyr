/*
 * SPDX-FileCopyrightText: 2026 Texas Instruments Incorporated
 *
 * SPDX-License-Identifier: Apache-2.0
 */

#include <ti/mspm0/g/mspm0g.dtsi>

&uart3 {
	zephyr,disabling-power-states = <&stop0 &stop1 &stop2 &stdby0 &stdby1>;
};
