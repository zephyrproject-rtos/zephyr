/*
 * Copyright (c) 2026 Texas Instruments
 * Copyright (c) 2026 Linumiz
 *
 * SPDX-License-Identifier: Apache-2.0
 */

#include <mem.h>
#include <ti/mspm0/g/mspm0g310x.dtsi>

/ {
	soc {
		sram0: memory@20000000 {
			reg = <0x20000000 DT_SIZE_K(32)>;
		};
	};
};

&flash0 {
	reg = <0x0 DT_SIZE_K(128)>;
};
