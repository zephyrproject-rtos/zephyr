/*
 * Copyright (c) 2025 Texas Instruments Incorporated
 * Copyright (c) 2025 Linumiz GmbH
 *
 * SPDX-License-Identifier: Apache-2.0
 */

#include <mem.h>
#include <ti/mspm0/g/mspm0g350x.dtsi>

/ {
	soc {
		/* Parity checked alias, no ECC */
		sram0: memory@20100000 {
			compatible = "mmio-sram";
			reg = <0x20100000 DT_SIZE_K(32)>;
		};
	};
};

&flash0 {
	reg = <0x0 DT_SIZE_K(128)>;
	ranges = <0x0 0x0 DT_SIZE_K(128)>;
};
