/*
 * Copyright (c) 2025 Bang & Olufsen A/S, Denmark
 *
 * SPDX-License-Identifier: Apache-2.0
 */

/{
	soc {
		uart2: uart@40102000 {
			compatible = "ti,mspm0-uart";
			reg = <0x40102000 0x2000>;
			interrupts = <14 0>;
			current-speed = <115200>;
			clocks = <&ckm MSPM0_CLOCK_ULPCLK>;
			clk-div = <1>;
			status = "disabled";
		};

		uart3: uart@40500000 {
			compatible = "ti,mspm0-uart";
			reg = <0x40500000 0x2000>;
			interrupts = <3 0>;
			current-speed = <115200>;
			clocks = <&ckm MSPM0_CLOCK_ULPCLK>;
			clk-div = <1>;
			status = "disabled";
		};
	};
};
