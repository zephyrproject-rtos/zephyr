/*
 * Copyright (c) 2025 Texas Instruments
 * Copyright (c) 2025 Linumiz GmbH
 *
 * SPDX-License-Identifier: Apache-2.0
 */

#include <mem.h>
#include <ti/mspm0/l/mspm0l110x.dtsi>

/ {
	soc {
		flash0: flash@0 {
			reg = <0x0 DT_SIZE_K(32)>;
			ranges = <0x0 0x0 DT_SIZE_K(32)>;
			#address-cells = <1>;
			#size-cells = <1>;
		};
	};
};
