/*
 * Copyright (c) 2025 Texas Instruments
 * Copyright (c) 2025 Linumiz GmbH
 *
 * SPDX-License-Identifier: Apache-2.0
 */

#include <mem.h>
#include <ti/mspm0/l/mspm0l13x3.dtsi>

/ {
	soc {
		comp0: comp@40008000 {
			compatible = "ti,mspm0-comparator";
			reg = <0x40008000 0x2000>;
			interrupts = <1 0>;
			status = "disabled";
		};
	};
};
