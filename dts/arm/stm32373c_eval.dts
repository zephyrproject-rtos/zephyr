/*
 * Copyright (c) 2017 Linaro Limited
 *
 * SPDX-License-Identifier: Apache-2.0
 */

/dts-v1/;
#include <st/stm32f373.dtsi>

/ {
	model = "STMicroelectronics STM32373C-EVAL board";
	compatible = "st,stm32373c-eval", "st,stm32f373";

	chosen {
		zephyr,console = &usart2;
		zephyr,sram = &sram0;
		zephyr,flash = &flash0;
	};
};

&usart2 {
	current-speed = <115200>;
	pinctrl-0 = <&usart2_pins_d>;
	pinctrl-names = "default";
	status = "ok";
};
