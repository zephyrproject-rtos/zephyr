/*
 * Copyright (c) 2026 Qingsong Gou <gouqs@hotmail.com>
 * SPDX-License-Identifier: Apache-2.0
 */

#include <mem.h>

/ {
	chosen {
		zephyr,sram = &ram012;
	};

	soc {
		ram012: memory@20000000 {
			compatible = "mmio-sram";
			reg = <0x20000000 DT_SIZE_K(2048)>;
		};
	};
};
