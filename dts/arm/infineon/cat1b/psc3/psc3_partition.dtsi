/*
 * SPDX-FileCopyrightText: Copyright (c) 2026 Infineon Technologies AG,
 * SPDX-FileCopyrightText: or an affiliate of Infineon Technologies AG. All rights reserved.
 *
 * SPDX-License-Identifier: Apache-2.0
 */

&flash0 {
	partitions {
		#address-cells = <1>;
		#size-cells = <1>;
		ranges;

		slot0_partition: partition@0 {
			compatible = "zephyr,mapped-partition";
			label = "slot0_s";
			reg = <0x0 DT_SIZE_K(128)>;
		};
	};
};
