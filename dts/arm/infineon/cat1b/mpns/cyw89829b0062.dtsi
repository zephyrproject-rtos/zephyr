/*
 * SPDX-FileCopyrightText: <text>Copyright (c) 2026 Infineon Technologies AG,
 * or an affiliate of Infineon Technologies AG. All rights reserved.</text>
 *
 * SPDX-License-Identifier: Apache-2.0
 */

#include "../cyw20829/cyw20829.48-qfn.dtsi"

&bluetooth {
	compatible = "infineon,cyw208xx-hci", "infineon,cyw20829-b0";
};
