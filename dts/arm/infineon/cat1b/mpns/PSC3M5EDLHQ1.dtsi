/*
 * copyright (c) (2016-2025), Cypress Semiconductor Corporation
 * (an Infineon company) or an affiliate of Cypress Semiconductor Corporation.
 *
 * SPDX-License-Identifier: Apache-2.0
 *
 * Licensed under the Apache License, Version 2.0 (the "License");
 * you may not use this file except in compliance with the License.
 * You may obtain a copy of the License at
 *
 *     http://www.apache.org/licenses/LICENSE-2.0
 *
 * Unless required by applicable law or agreed to in writing, software
 * distributed under the License is distributed on an "AS IS" BASIS,
 * WITHOUT WARRANTIES OR CONDITIONS OF ANY KIND, either express or implied.
 * See the License for the specific language governing permissions and
 * limitations under the License.
 */

#include "../psc3/psc3.vqfn-64.dtsi"

/ {
	flash-controller@42150000 {
		compatible = "infineon,cat1-flash-controller";
		reg = < 0x42150000 0x10000 >;
		#address-cells = <1>;
		#size-cells = <1>;

		flash0: flash@2000000 {
			compatible = "soc-nv-flash";
			reg = <0x2000000 DT_SIZE_K(128)>;
			write-block-size = <512>;
			erase-block-size = <512>;
		};
	};

};
