/*
 * SPDX-FileCopyrightText: Copyright (c) 2026 Infineon Technologies AG,
 * SPDX-FileCopyrightText: or an affiliate of Infineon Technologies AG. All rights reserved.
 *
 * SPDX-License-Identifier: Apache-2.0
 */

#include <arm/armv7-m.dtsi>
#include "../psoc6_04/psoc6_04.80-m-csp.dtsi"

/delete-node/ &adc1;

&nvic {
	arm,num-irq-priority-bits = <3>;
};
