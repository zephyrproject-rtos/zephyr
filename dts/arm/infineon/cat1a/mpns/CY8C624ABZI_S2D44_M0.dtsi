/*
 * Copyright (c) 2022 Cypress Semiconductor Corporation (an Infineon company) or
 * an affiliate of Cypress Semiconductor Corporation
 *
 * SPDX-License-Identifier: Apache-2.0
 */

#include <arm/armv6-m.dtsi>
#include "../psoc6_02/psoc6_02.124-bga.dtsi"

#define PSOC6_02_DEFAULT_IRQ_PRIORITY 3

&nvic {
	arm,num-irq-priority-bits = <2>;
};
