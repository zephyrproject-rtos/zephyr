/*
 * Copyright (c) 2022 Cypress Semiconductor Corporation (an Infineon company) or
 * an affiliate of Cypress Semiconductor Corporation
 *
 * SPDX-License-Identifier: Apache-2.0
 */

#include <arm/armv7-m.dtsi>
#define PSOC6_02_DEFAULT_IRQ_PRIORITY 6
#include "../psoc6_02/psoc6_02.124-bga.dtsi"

&nvic {
	arm,num-irq-priority-bits = <3>;
};
