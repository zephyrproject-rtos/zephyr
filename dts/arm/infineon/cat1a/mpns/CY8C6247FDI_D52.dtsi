/*
 * Copyright (c) 2022 Cypress Semiconductor Corporation (an Infineon company) or
 * an affiliate of Cypress Semiconductor Corporation
 *
 * SPDX-License-Identifier: Apache-2.0
 */

#include <arm/armv7-m.dtsi>
#include "../psoc6_01/psoc6_01.80-wlcsp.dtsi"

&nvic {
	arm,num-irq-priority-bits = <3>;
};
