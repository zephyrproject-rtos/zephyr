/*
 * Copyright (c) 2022 Cypress Semiconductor Corporation (an Infineon company) or
 * an affiliate of Cypress Semiconductor Corporation
 *
 * SPDX-License-Identifier: Apache-2.0
 */

#include <arm/armv7-m.dtsi>
#include "../psoc6_01/psoc6_01.116-bga-ble.dtsi"

&flash0 {
	reg = <0x10000000 0x80000>;
};

&sram0 {
	reg = <0x8000000 0x20000>;
};

&nvic {
	arm,num-irq-priority-bits = <3>;
};
