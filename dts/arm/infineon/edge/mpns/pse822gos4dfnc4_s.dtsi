/*
 * SPDX-FileCopyrightText: Copyright (c) 2026 Infineon Technologies AG,
 * SPDX-FileCopyrightText: or an affiliate of Infineon Technologies AG. All rights reserved.
 *
 * SPDX-License-Identifier: Apache-2.0
 */

#include "../pse8x/pse8x.wlb-154_s.dtsi"
#include "../pse8x/pse8x.socmem-4m_s.dtsi"
