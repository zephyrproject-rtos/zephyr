/*
 * Copyright (c) 2025 Infineon Technologies AG,
 * or an affiliate of Infineon Technologies AG.
 *
 * SPDX-License-Identifier: Apache-2.0
 */

#include <mem.h>
#include "psoc4100tp.cm0p.dtsi"

/ {
	sram0: memory@20000000 {
		compatible = "mmio-sram";
		reg = <0x20000000 0x8000>;  /* 32 KB SRAM */
	};

	soc {};
};
