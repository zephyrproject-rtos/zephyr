/*
 * Copyright (c) 2022 Cypress Semiconductor Corporation (an Infineon company) or
 * an affiliate of Cypress Semiconductor Corporation
 *
 * SPDX-License-Identifier: Apache-2.0
 */

#include <arm/armv7-m.dtsi>
#include "../psoc6_02/psoc6_02.68-qfn.dtsi"

/delete-node/ &scb3;

/delete-node/ &scb7;

/delete-node/ &scb10;

/delete-node/ &scb11;

/delete-node/ &scb12;

&nvic {
	arm,num-irq-priority-bits = <3>;
};
