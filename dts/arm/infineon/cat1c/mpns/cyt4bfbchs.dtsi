/*
 *==================================================================================================
 * Copyright (c) 2025 Cypress Semiconductor Corporation (an Infineon company) or
 * an affiliate of Cypress Semiconductor Corporation
 *
 * SPDX-License-Identifier: Apache-2.0
 *==================================================================================================
 */

#include "../xmc7200/xmc7200.272-bga.dtsi"
