/*
 * SPDX-FileCopyrightText: Karl Palsson 2026 <karl.palsson@marel.com>
 * SPDX-License-Identifier: Apache-2.0
 */

#include <mem.h>
#include <infineon/cat3/xmc/xmc4xxx.dtsi>
#include <infineon/cat3/xmc/xmc4700_F144x2048.dtsi>

&pinctrl {
	gpio7: gpio@48028700 {
		compatible = "infineon,xmc4xxx-gpio";
		gpio-controller;
		#gpio-cells = <2>;
		reg = <0x48028700 0x100>;
		ngpios = <12>;
		status = "disabled";
	};

	gpio8: gpio@48028800 {
		compatible = "infineon,xmc4xxx-gpio";
		gpio-controller;
		#gpio-cells = <2>;
		reg = <0x48028800 0x100>;
		ngpios = <12>;
		status = "disabled";
	};

	gpio9: gpio@48028900 {
		compatible = "infineon,xmc4xxx-gpio";
		gpio-controller;
		#gpio-cells = <2>;
		reg = <0x48028900 0x100>;
		ngpios = <12>;
		status = "disabled";
	};
};
