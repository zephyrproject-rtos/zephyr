/*
 * SPDX-FileCopyrightText: <text>Copyright (c) 2026 Infineon Technologies AG,
 * or an affiliate of Infineon Technologies AG. All rights reserved.</text>
 *
 * SPDX-License-Identifier: Apache-2.0
 */

#include "../psoc4100tp/psoc4100tp.48-tqfp.dtsi"

&flash0 {
	reg = <0x00000000 0x20000>;
};

&sram0 {
	reg = <0x20000000 0x8000>;
};
