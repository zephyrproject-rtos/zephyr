/*
 * Copyright (c) 2021 Linumiz
 * Author: Parthiban Nallathambi <parthiban@linumiz.com>
 *
 * SPDX-License-Identifier: Apache-2.0
 */

#include <mem.h>
#include <infineon/xmc1xxx.dtsi>

&sram0 {
	reg = <0x20000000 DT_SIZE_K(16)>;
};

&flash0 {
	reg = <0x10001000 DT_SIZE_K(200)>;
};
