/*
 * Copyright (c) 2021 Linaro Limited
 *
 * SPDX-License-Identifier: Apache-2.0
 */

#include <skeleton.dtsi>

/ {
	soc {
		compatible = "simple-bus";
		ranges;
		#address-cells = <1>;
		#size-cells = <1>;
		interrupt-parent = <&nvic>;

		nvic: interrupt-controller@e000e100 {
			compatible = "arm,v8.1m-nvic";
			reg = <0xe000e100 0xc00>;
			#address-cells = <1>;
			interrupt-controller;
			#interrupt-cells = <2>;
		};

		systick: timer@e000e010 {
			compatible = "arm,armv8.1m-systick";
			reg = <0xe000e010 0x10>;
		};
	};
};
