/*
 * Copyright (c) 2021 Guðni Már Gilbert
 *
 * SPDX-License-Identifier: Apache-2.0
 */

#include <st/g4/stm32g473.dtsi>

&sram0 {
	reg = <0x20000000 DT_SIZE_K(128)>;
};

&flash0 {
	reg = <0x08000000 DT_SIZE_K(256)>;
	ranges = <0x0 0x8000000 DT_SIZE_K(256)>;
	#address-cells = <1>;
	#size-cells = <1>;
};
