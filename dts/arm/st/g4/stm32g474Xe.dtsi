/*
 * Copyright (c) 2019 STMicroelectronics.
 *
 * SPDX-License-Identifier: Apache-2.0
 */

#include <mem.h>
#include <st/g4/stm32g474.dtsi>

&sram0 {
	reg = <0x20000000 DT_SIZE_K(128)>;
};

&flash0 {
	reg = <0x08000000 DT_SIZE_K(512)>;
};
