/*
 * Copyright (c) 2021 Guðni Már Gilbert
 *
 * SPDX-License-Identifier: Apache-2.0
 */

#include <st/g4/stm32g431.dtsi>

/ {
	soc {
		compatible = "st,stm32g441", "st,stm32g4", "simple-bus";
	};
};
