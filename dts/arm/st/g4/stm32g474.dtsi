/*
 * Copyright (c) 2019 STMicroelectronics.
 *
 * SPDX-License-Identifier: Apache-2.0
 */

#include <st/g4/stm32g473.dtsi>

/ {
	soc {
		compatible = "st,stm32g474", "st,stm32g4", "simple-bus";
	};
};
