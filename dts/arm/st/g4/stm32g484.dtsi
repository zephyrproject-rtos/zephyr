/*
 * Copyright (c) 2021 Guðni Már Gilbert
 *
 * SPDX-License-Identifier: Apache-2.0
 */

#include <st/g4/stm32g474.dtsi>

/ {
	soc {
		compatible = "st,stm32g484", "st,stm32g4", "simple-bus";
	};
};
