/*
 * Copyright (c) 2026 The Zephyr Project Contributors
 *
 * SPDX-License-Identifier: Apache-2.0
 */

#include <st/n6/stm32n6.dtsi>

/ {
	soc {
		compatible = "st,stm32n647", "st,stm32n6", "simple-bus";
	};
};
