/*
 * Copyright (c) 2026 STMicroelectronics
 *
 * SPDX-License-Identifier: Apache-2.0
 */

#include <st/n6/stm32n6.dtsi>

/ {
	soc {
		compatible = "st,stm32n655", "st,stm32n6", "simple-bus";

		cryp: crypto@54020800 {
			compatible = "st,stm32-cryp";
			reg = <0x54020800 0x400>;
			clocks = <&rcc STM32_CLOCK(AHB3, 2)>;
			resets = <&rctl STM32_RESET(AHB3, 2)>;
			interrupts = <37 0>;
			status = "disabled";
		};
	};
};
