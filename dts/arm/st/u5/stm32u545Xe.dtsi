/*
 * Copyright (c) 2024 Opito
 *
 * SPDX-License-Identifier: Apache-2.0
 */
#include <st/u5/stm32u545.dtsi>

/ {
	soc {
		flash-controller@40022000 {
			flash0: flash@8000000 {
				reg = <0x08000000 DT_SIZE_K(512)>;
			};
		};
	};
};
