/*
 * Copyright (c) 2025 Harris Tomy
 *
 * SPDX-License-Identifier: Apache-2.0
 */

/ {
	soc {
		aes: aes@420c0000 {
			compatible = "st,stm32-aes";
			reg = <0x420c0000 0x400>;
			clocks = <&rcc STM32_CLOCK(AHB2, 16)>;
			resets = <&rctl STM32_RESET(AHB2L, 16)>;
			interrupts = <93 0>;
			status = "disabled";
		};

		saes: saes@420c0c00 {
			compatible = "st,stm32-saes";
			reg = <0x420c0c00 0x400>;
			clocks = <&rcc STM32_CLOCK(AHB2, 20)>;
			resets = <&rctl STM32_RESET(AHB2L, 20)>;
			interrupts = <28 0>;
			status = "disabled";
		};
	};
};
