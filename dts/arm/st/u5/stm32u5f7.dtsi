/*
 * Copyright (c) 2026 STMicroelectronics
 *
 * SPDX-License-Identifier: Apache-2.0
 */

/* STM32U5F7 is same die as STM32U5F9, but different package */
#include <st/u5/stm32u5f9.dtsi>

/ {
	soc {
		compatible = "st,stm32u5f7", "st,stm32u5", "simple-bus";
	};
};
