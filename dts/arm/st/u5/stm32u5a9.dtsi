/*
 * Copyright (c) 2023 STMicroelectronics
 * Copyright (c) 2025 Harris Tomy
 *
 * SPDX-License-Identifier: Apache-2.0
 */

#include <st/u5/stm32u599.dtsi>
#include <st/u5/stm32u5_crypt.dtsi>

/ {
	soc {
		compatible = "st,stm32u5a9", "st,stm32u5", "simple-bus";
	};
};
