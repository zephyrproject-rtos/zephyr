/*
 * Copyright (c) 2026 STMicroelectronics
 *
 * SPDX-License-Identifier: Apache-2.0
 */

/* STM32U5G7 is same die as STM32U5G9, but different package */
#include <st/u5/stm32u5g9.dtsi>

/ {
	soc {
		compatible = "st,stm32u5g7", "st,stm32u5", "simple-bus";
	};
};
