/*
 * Copyright (c) 2024 Opito
 *
 * SPDX-License-Identifier: Apache-2.0
 */

#include <st/u5/stm32u535.dtsi>
#include <st/u5/stm32u5_crypt.dtsi>

/ {
	soc {
		compatible = "st,stm32u545", "st,stm32u5", "simple-bus";
	};
};
