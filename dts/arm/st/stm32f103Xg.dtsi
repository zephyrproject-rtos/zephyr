/*
 * Copyright (c) 2017 Linaro Limited
 *
 * SoC device tree include for STM32F103xG SoCs
 * where 'x' is replaced for specific SoCs like {R,V,Z}
 *
 * SPDX-License-Identifier: Apache-2.0
 */

#include <st/stm32f103Xb.dtsi>
