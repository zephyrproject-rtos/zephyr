/*
 * Copyright (c) 2026 STMicroelectronics
 *
 * SPDX-License-Identifier: Apache-2.0
 */

#include <st/g5/stm32g5.dtsi>

/ {
	soc {
		compatible = "st,stm32g534", "st,stm32g5", "simple-bus";

		dma@40020000 {
			interrupts = <35 0>, <36 0>, <37 0>, <38 0>, <39 0>, <40 0>;
			dma-channels = <6>;
		};

		dma@40021000 {
			interrupts = <97 0>, <98 0>, <99 0>, <100 0>, <101 0>, <102 0>;
			dma-channels = <6>;
		};
	};
};
