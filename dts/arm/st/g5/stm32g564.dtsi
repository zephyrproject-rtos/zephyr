/*
 * Copyright (c) 2026 STMicroelectronics
 *
 * SPDX-License-Identifier: Apache-2.0
 */

#include <st/g5/stm32g554.dtsi>

/ {
	soc {
		compatible = "st,stm32g564", "st,stm32g5", "simple-bus";

		uart6: serial@40006400 {
			compatible = "st,stm32-uart";
			reg = <0x40006400 0x400>;
			clocks = <&rcc STM32_CLOCK(APB1, 25)>;
			resets = <&rctl STM32_RESET(APB1L, 25)>;
			interrupts = <92 0>;
			interrupt-names = "global";
			status = "disabled";
		};
	};
};
