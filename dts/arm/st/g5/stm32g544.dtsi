/*
 * Copyright (c) 2026 STMicroelectronics
 *
 * SPDX-License-Identifier: Apache-2.0
 */

#include <st/g5/stm32g534.dtsi>

/ {
	soc {
		compatible = "st,stm32g544", "st,stm32g5", "simple-bus";
	};
};
