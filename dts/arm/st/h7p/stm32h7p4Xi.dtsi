/*
 * SPDX-FileCopyrightText: Copyright (c) 2026 STMicroelectronics
 *
 * SPDX-License-Identifier: Apache-2.0
 */

#include <st/h7p/stm32h7p4.dtsi>

/ {
	soc {
		flash-controller@52002000 {
			flash0: flash@8000000 {
				reg = <0x08000000 DT_SIZE_M(2)>;
				ranges = <0 0x08000000 DT_SIZE_M(2)>;
			};
		};
	};
};
