/*
 * Copyright (c) 2024 STMicroelectronics
 * Copyright (c) 2026 Anders Frandsen <anfran@anfran.dk>
 *
 * SPDX-License-Identifier: Apache-2.0
 */

#include <st/wl3/stm32wl3x.dtsi>

/ {
	soc {
		compatible = "st,stm32wl31", "st,stm32wl3", "simple-bus";
	};
};
