/*
 * Copyright (c) 2024 STMicroelectronics
 * Copyright (c) 2026 Anders Frandsen <anfran@anfran.dk>
 *
 * SPDX-License-Identifier: Apache-2.0
 */

#include <st/wl3/stm32wl31xx.dtsi>

/ {
	soc {
		compatible = "st,stm32wl33", "st,stm32wl3", "simple-bus";

		i2c2: i2c@41001000 {
			compatible = "st,stm32-i2c-v2";
			reg = <0x41001000 DT_SIZE_K(1)>;
			clock-frequency = <I2C_BITRATE_STANDARD>;
			#address-cells = <1>;
			#size-cells = <0>;
			clocks = <&rcc STM32_CLOCK(APB1, 23)>,
				 <&rcc STM32_SRC_CLK_ROOT_DIV NO_SEL>;
			interrupts = <4 0>;
			interrupt-names = "combined";
			status = "disabled";
		};
	};
};
