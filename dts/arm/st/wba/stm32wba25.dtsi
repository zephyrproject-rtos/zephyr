/*
 * Copyright (c) 2026 STMicroelectronics
 *
 * SPDX-License-Identifier: Apache-2.0
 */
#include <st/wba/stm32wba23.dtsi>

/ {
	soc {
		compatible = "st,stm32wba25", "st,stm32wba", "simple-bus";
	};
};
