/*
 * Copyright (c) 2018 Philémon Jaermann
 *
 * SPDX-License-Identifier: Apache-2.0
 */

#include <st/stm32f401.dtsi>

/ {
	soc {
		usbotg_fs: usb@50000000 {
			num-bidir-endpoints = <6>;
		};

		usbotg_hs: usb@40040000 {
			compatible = "st,stm32-otghs", "st,stm32-otgfs";
			reg = <0x40040000 0x40000>;
			interrupts = <77 0>, <74 0>, <75 0>;
			interrupt-names = "otghs", "ep1_out", "ep1_in";
			num-bidir-endpoints = <9>;
			ram-size = <4096>;
			status = "disabled";
			label= "OTGHS";
		};
	};
};
