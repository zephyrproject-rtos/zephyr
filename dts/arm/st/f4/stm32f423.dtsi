/*
 * Copyright (c) 2022 Richard Osterloh
 *
 * SPDX-License-Identifier: Apache-2.0
 */

#include <st/f4/stm32f413.dtsi>

/ {
	soc {
		compatible = "st,stm32f423", "st,stm32f4", "simple-bus";

		aes: aes@50060000 {
			compatible = "st,stm32-aes";
			reg = <0x50060000 0x400>;
			clocks = <&rcc STM32_CLOCK(AHB2, 4)>;
			resets = <&rctl STM32_RESET(AHB2, 4U)>;
			interrupts = <79 0>;
			status = "disabled";
		};
	};
};
