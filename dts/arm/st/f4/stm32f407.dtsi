/*
 * Copyright (c) 2017 Erwin Rol <erwin@erwinrol.com>
 *
 * SPDX-License-Identifier: Apache-2.0
 */

#include <st/f4/stm32f405.dtsi>

/ {
	soc {
		compatible = "st,stm32f407", "st,stm32f4", "simple-bus";

		mac: ethernet@40028000 {
			compatible = "st,stm32-ethernet";
			reg = <0x40028000 0x8000>;
			clock-names = "stm-eth", "mac-clk-tx", "mac-clk-rx", "mac-clk-ptp";
			clocks = <&rcc STM32_CLOCK(AHB1, 25)>,
				 <&rcc STM32_CLOCK(AHB1, 26)>,
				 <&rcc STM32_CLOCK(AHB1, 27)>,
				 <&rcc STM32_CLOCK(AHB1, 28)>;
			interrupts = <61 0>;
			#address-cells = <1>;
			#size-cells = <0>;
			status = "disabled";
		};
	};
};
