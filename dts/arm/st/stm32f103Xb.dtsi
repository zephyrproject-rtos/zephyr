/*
 * Copyright (c) 2017 I-SENSE group of ICCS
 *
 * SoC device tree include for STM32F103xB SoCs
 * where 'x' is replaced for specific SoCs like {C,R,T,V}
 *
 * SPDX-License-Identifier: Apache-2.0
 */

#include <st/stm32f1.dtsi>

/ {
	soc {
		/* spi2 is present on all STM32F103xB SoCs except
		 * STM32F103TB. Delete node in stm32f103tb.dtsi.
		 */
		spi2: spi@40003800 {
			compatible = "st,stm32-spi";
			#address-cells = <1>;
			#size-cells = <0>;
			reg = <0x40003800 0x400>;
			clocks = <&rcc STM32_CLOCK_BUS_APB1 0x00004000>;
			interrupts = <36 5>;
			status = "disabled";
			label = "SPI_2";
		};

		usb: usb@40005c00 {
			compatible = "st,stm32-usb";
			reg = <0x40005c00 0x400>;
			interrupts = <20 0>;
			interrupt-names = "usb";
			num-bidir-endpoints = <8>;
			ram-size = <512>;
			status = "disabled";
			label= "USB";
		};
	};
};
