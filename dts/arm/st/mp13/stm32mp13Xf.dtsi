/*
 * Copyright (c) 2026 STMicroelectronics
 *
 * SPDX-License-Identifier: Apache-2.0
 */

/*
 * The STM32MP13XF part number embeds following specific characteristics:
 *
 *   Cortex-A7 frequency | Security IPs
 *   --------------------+-----------------
 *     1 GHz             |  yes
 */

#include <st/mp13/stm32mp13Xd.dtsi>
#include <st/mp13/stm32mp13_crypt.dtsi>
