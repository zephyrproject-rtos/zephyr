/*
 * Copyright (c) 2026 STMicroelectronics
 *
 * SPDX-License-Identifier: Apache-2.0
 */

/*
 * The STM32MP13XC part number embeds following specific characteristics:
 *
 *   Cortex-A7 frequency | Security IPs
 *   --------------------+-----------------
 *     650 MHz           |  yes
 */

#include <st/mp13/stm32mp13Xa.dtsi>
#include <st/mp13/stm32mp13_crypt.dtsi>
