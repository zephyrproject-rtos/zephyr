/*
 * Copyright (c) 2024 STMicroelectronics
 *
 * SPDX-License-Identifier: Apache-2.0
 */

#include <st/u0/stm32u0.dtsi>

/ {
	soc {
		compatible = "st,stm32u031", "st,stm32u0", "simple-bus";
	};
};

&sram1 {
	reg = <0x20000000 DT_SIZE_K(8)>;
};

&sram2 {
	reg = <0x20080000 DT_SIZE_K(4)>;
};
