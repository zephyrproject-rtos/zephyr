/*
 * Copyright (c) 2026 STMicroelectronics
 *
 * SPDX-License-Identifier: Apache-2.0
 */

#include <st/f7/stm32f777.dtsi>

/ {
	soc {
		flash-controller@40023c00 {
			flash0: flash@8000000 {
				reg = <0x08000000 DT_SIZE_M(2)>;
				ranges = <0 0x8000000 DT_SIZE_M(2)>;
			};
		};
	};
};
