/*
 * Copyright (c) 2018 Yurii Hamann
 *
 * SPDX-License-Identifier: Apache-2.0
 */

#include <st/f7/stm32f745.dtsi>
#include <zephyr/dt-bindings/display/panel.h>

/ {
	soc {
		compatible = "st,stm32f746", "st,stm32f7", "simple-bus";

		ltdc: display-controller@40016800 {
			compatible = "st,stm32-ltdc";
			reg = <0x40016800 0x200>;
			interrupts = <88 0>, <89 0>;
			interrupt-names = "ltdc", "ltdc_err";
			clocks = <&rcc STM32_CLOCK(APB2, 26)>;
			resets = <&rctl STM32_RESET(APB2, 26)>;
			status = "disabled";
		};

		dcmi: dcmi@50050000 {
			compatible = "st,stm32-dcmi";
			reg = <0x50050000 0x400>;
			interrupts = <85 0>;
			interrupt-names = "dcmi";
			clocks = <&rcc STM32_CLOCK(AHB2, 0)>;
			dmas = <&dma2 1 1 (STM32_DMA_16BITS | STM32_DMA_PRIORITY_HIGH) 0>;
			status = "disabled";
		};
	};
};
