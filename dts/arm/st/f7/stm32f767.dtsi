/*
 * Copyright (c) 2019 Roland Ma
 * Copyright (c) 2023 Rahul Arasikere
 *
 * SPDX-License-Identifier: Apache-2.0
 */

#include <st/f7/stm32f765.dtsi>
#include <zephyr/dt-bindings/display/panel.h>

/ {
	soc {
		compatible = "st,stm32f767", "st,stm32f7", "simple-bus";

		ltdc: display-controller@40016800 {
			compatible = "st,stm32-ltdc";
			reg = <0x40016800 0x200>;
			interrupts = <88 0>, <89 0>;
			interrupt-names = "ltdc", "ltdc_err";
			clocks = <&rcc STM32_CLOCK(APB2, 26)>;
			resets = <&rctl STM32_RESET(APB2, 26U)>;
			status = "disabled";
		};

		mipi_dsi: dsihost@40016c00 {
			compatible = "st,stm32-mipi-dsi";
			#address-cells = <1>;
			#size-cells = <0>;
			reg = <0x40016c00 0x800>;
			clock-names = "dsiclk", "refclk", "pixelclk";
			clocks = <&rcc STM32_CLOCK(APB2,  27)>,
				 <&rcc STM32_SRC_HSE NO_SEL>,
				 <&rcc STM32_SRC_PLLSAI_DIVR NO_SEL>;
			resets = <&rctl STM32_RESET(APB2, 27)>;
			status = "disabled";
		};
	};
};
