/*
 * SPDX-FileCopyrightText: Copyright The Zephyr Project Contributors
 * SPDX-License-Identifier: Apache-2.0
 */

#include <mem.h>
#include <st/f7/stm32f723.dtsi>

/ {
	soc {
		compatible = "st,stm32f730", "st,stm32f7", "simple-bus";
	};
};
