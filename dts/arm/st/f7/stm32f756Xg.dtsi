/*
 * Copyright (c) 2018 AJ Palmer
 *
 * SPDX-License-Identifier: Apache-2.0
 */

#include <mem.h>
#include <st/f7/stm32f756.dtsi>

/ {
	sram0: memory@20000000 {
		reg = <0x20000000 DT_SIZE_K(320)>;
	};

	flash0: flash@8000000 {
		reg = <0x08000000 DT_SIZE_K(1024)>;
	};
};
