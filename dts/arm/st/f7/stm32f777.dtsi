/*
 * Copyright (c) 2026 Anand Kumar
 *
 * SPDX-License-Identifier: Apache-2.0
 */

#include <st/f7/stm32f767.dtsi>

/ {
	soc {
		compatible = "st,stm32f777", "st,stm32f7", "simple-bus";

		cryp: crypto@50060000 {
			compatible = "st,stm32-cryp";
			reg = <0x50060000 0x400>;
			clocks = <&rcc STM32_CLOCK(AHB2, 4)>;
			resets = <&rctl STM32_RESET(AHB2, 4)>;
			interrupts = <79 0>;
			status = "disabled";
		};

		hash: crypto@50060400 {
			compatible = "st,stm32-hash";
			reg = <0x50060400 0x400>;
			clocks = <&rcc STM32_CLOCK(AHB2, 5)>;
			resets = <&rctl STM32_RESET(AHB2, 5)>;
			/* HASH interrupt is shared with RNG, but not yet supported.
			 * interrupts = <80 0>;
			 */
			status = "disabled";
		};
	};
};
