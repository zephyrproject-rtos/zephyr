/*
 * Copyright (c) 2018 Georgij Cernysiov
 *
 * SPDX-License-Identifier: Apache-2.0
 */

#include <st/l4/stm32l451.dtsi>

/ {
	soc {
		compatible = "st,stm32l452", "st,stm32l4", "simple-bus";

		usb: usb@40006800 {
			compatible = "st,stm32-usb";
			reg = <0x40006800 0x40000>;
			interrupts = <67 0>;
			interrupt-names = "usb";
			num-bidir-endpoints = <8>;
			ram-size = <1024>;
			maximum-speed = "full-speed";
			phys = <&usb_fs_phy>;
			clocks = <&rcc STM32_CLOCK(APB1, 26)>,
				 <&rcc STM32_SRC_HSI48 CLK48_SEL(0)>;
			status = "disabled";
		};
	};

	usb_fs_phy: usbphy {
		compatible = "usb-nop-xceiv";
		#phy-cells = <0>;
	};
};
