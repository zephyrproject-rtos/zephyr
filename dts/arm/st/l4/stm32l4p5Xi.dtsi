/*
 * Copyright (c) 2023 STMicroelectronics
 *
 * SPDX-License-Identifier: Apache-2.0
 */

#include <st/l4/stm32l4p5.dtsi>

/ {
	soc {
		flash-controller@40022000 {
			flash0: flash@8000000 {
				reg = <0x08000000 DT_SIZE_K(1024)>;
				ranges = <0x0 0x8000000 DT_SIZE_K(1024)>;
				#address-cells = <1>;
				#size-cells = <1>;
			};
		};
	};
};
