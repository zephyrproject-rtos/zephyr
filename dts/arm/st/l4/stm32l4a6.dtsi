/*
 * Copyright (c) 2022 Tomislav Milkovic
 *
 * SPDX-License-Identifier: Apache-2.0
 */

#include <st/l4/stm32l496.dtsi>
#include <st/l4/stm32l4_crypt.dtsi>

/ {
	soc {
		compatible = "st,stm32l4a6", "st,stm32l4", "simple-bus";

		hash: crypto@50060400 {
			compatible = "st,stm32-hash";
			reg = <0x50060400 0x400>;
			clocks = <&rcc STM32_CLOCK(AHB2, 17)>;
			resets = <&rctl STM32_RESET(AHB2, 17)>;
			status = "disabled";
		};
	};
};
