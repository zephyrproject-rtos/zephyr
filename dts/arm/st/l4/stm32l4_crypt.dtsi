/*
 * Copyright (c) 2026 STMicroelectronics
 *
 * SPDX-License-Identifier: Apache-2.0
 */

/ {
	soc {
		aes: aes@50060000 {
			compatible = "st,stm32l4-aes", "st,stm32-aes";
			reg = <0x50060000 0x400>;
			clocks = <&rcc STM32_CLOCK(AHB2, 16)>;
			resets = <&rctl STM32_RESET(AHB2, 16)>;
			interrupts = <79 0>;
			interrupt-names = "aes";
			status = "disabled";
		};
	};
};
