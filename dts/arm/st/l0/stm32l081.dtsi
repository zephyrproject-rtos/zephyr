/*
 * Copyright (c) 2023 Caspar Friedrich <c.s.w.friedrich@gmail.com>
 *
 * SPDX-License-Identifier: Apache-2.0
 */

#include <st/l0/stm32l071.dtsi>

/ {
	soc {
		compatible = "st,stm32l081", "st,stm32l0", "simple-bus";
	};
};
