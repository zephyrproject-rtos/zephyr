/*
 * Copyright (c) 2021 Thomas Stranger
 *
 * SPDX-License-Identifier: Apache-2.0
 */

#include <st/l5/stm32l5.dtsi>

/ {
	soc {
		compatible = "st,stm32l562", "st,stm32l5", "simple-bus";

		aes: aes@420c0000 {
			compatible = "st,stm32-aes";
			reg = <0x420c0000 0x400>;
			clocks = <&rcc STM32_CLOCK(AHB2, 16)>;
			resets = <&rctl STM32_RESET(AHB2, 16U)>;
			interrupts = <93 0>;
			status = "disabled";
		};
	};
};
