/*
 * Copyright (c) 2024 STMicroelectronics
 *
 * SPDX-License-Identifier: Apache-2.0
 */

#include <st/h7rs/stm32h7r7.dtsi>

/*
 * STM32H7S7 line contains the same peripherals as STM32H7R7.
 */
/ {
	soc {
		compatible = "st,stm32h7s7", "st,stm32h7rs", "simple-bus";

		cryp: crypto@48020800 {
			compatible = "st,stm32-cryp";
			reg = <0x48020800 0x400>;
			clocks = <&rcc STM32_CLOCK(AHB3, 2)>;
			resets = <&rctl STM32_RESET(AHB3, 2)>;
			interrupts = <34 0>;
			status = "disabled";
		};
	};
};

&mac {
	memory-regions = <&sram1>;
};
