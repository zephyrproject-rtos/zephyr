/*
 * Copyright (c) 2024 STMicroelectronics
 *
 * SPDX-License-Identifier: Apache-2.0
 */

#include <st/h7rs/stm32h7r3.dtsi>

/ {
	soc {
		flash-controller@52002000 {
			flash0: flash@8000000 {
				reg = <0x08000000 DT_SIZE_K(64)>;
				ranges = <0x0 0x8000000 DT_SIZE_K(64)>;
				#address-cells = <1>;
				#size-cells = <1>;
			};
		};
	};
};
