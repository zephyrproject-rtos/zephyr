/*
 * Copyright (C) 2025 Savoir-faire Linux, Inc.
 *
 * SPDX-License-Identifier: Apache-2.0
 */

#include <st/mp2/stm32mp251_m33.dtsi>

/ {
	soc {
		compatible = "st,stm32mp253", "st,stm32mp2", "simple-bus";
	};
};
