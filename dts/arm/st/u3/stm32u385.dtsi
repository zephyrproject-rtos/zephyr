/*
 * Copyright (c) 2025 STMicroelectronics
 *
 * SPDX-License-Identifier: Apache-2.0
 */

#include <st/u3/stm32u3.dtsi>

/ {
	soc {
		compatible = "st,stm32u385", "st,stm32u3", "simple-bus";

		aes: crypto@420c0000 {
			compatible = "st,stm32-aes";
			reg = <0x420c0000 0x400>;
			clocks = <&rcc STM32_CLOCK(AHB2, 16)>;
			resets = <&rctl STM32_RESET(AHB2L, 16)>;
			interrupts = <93 0>;
			status = "disabled";
		};

		hash: crypto@420c0400 {
			compatible = "st,stm32-hash";
			reg = <0x420c0400 0x400>;
			clocks = <&rcc STM32_CLOCK(AHB2, 17)>;
			resets = <&rctl STM32_RESET(AHB2L, 17)>;
			interrupts = <61 0>;
			status = "disabled";
		};
	};
};
