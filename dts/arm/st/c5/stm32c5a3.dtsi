/*
 * Copyright (c) 2026 STMicroelectronics
 *
 * SPDX-License-Identifier: Apache-2.0
 */

#include <st/c5/stm32c593.dtsi>
#include <st/c5/stm32c5_crypt.dtsi>

/ {
	soc {
		compatible = "st,stm32c5a3", "st,stm32c5", "simple-bus";
	};
};
