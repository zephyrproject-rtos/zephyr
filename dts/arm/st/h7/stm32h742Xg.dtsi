/*
 * Copyright (c) 2025 Brill Power
 *
 * SPDX-License-Identifier: Apache-2.0
 */

#include <st/h7/stm32h742.dtsi>

/ {
	soc {
		flash-controller@52002000 {
			flash0: flash@8000000 {
				reg = <0x08000000 DT_SIZE_K(1024)>;
				ranges = <0x0 0x8000000 DT_SIZE_K(1024)>;
				#address-cells = <1>;
				#size-cells = <1>;
			};
		};
	};
};
