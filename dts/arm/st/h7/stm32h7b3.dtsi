/*
 * Copyright (c) 2022 Byte-Lab d.o.o <dev@byte-lab.com>
 *
 * SPDX-License-Identifier: Apache-2.0
 */

#include <mem.h>
#include <st/h7/stm32h7b0.dtsi>

/*
 * STM32H7B3 line contains the same peripherals as STM32H7B0.
 */
/ {
	soc {
		compatible = "st,stm32h7b3", "st,stm32h7", "simple-bus";
	};
};
