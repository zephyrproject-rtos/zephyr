/*
 * Copyright (c) 2021 SILA Embedded Solutions GmbH
 *
 * SPDX-License-Identifier: Apache-2.0
 */

#include <st/h7/stm32h730.dtsi>

/ {
	soc {
		compatible = "st,stm32h735", "st,stm32h7", "simple-bus";
	};
};
