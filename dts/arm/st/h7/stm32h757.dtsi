/*
 * Copyright (C) 2024 Grinn sp. z o.o.
 *
 * SPDX-License-Identifier: Apache-2.0
 */

#include <st/h7/stm32h747.dtsi>

/ {
	soc {
		compatible = "st,stm32h757", "st,stm32h7", "simple-bus";

		cryp: cryp@48021000 {
			compatible = "st,stm32-cryp";
			reg = <0x48021000 0x400>;
			clocks = <&rcc STM32_CLOCK(AHB2, 4U)>;
			interrupts = <79 0>;
			status = "disabled";
		};
	};
};
