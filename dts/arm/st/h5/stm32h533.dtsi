/*
 * Copyright (c) 2024 STMicroelectronics
 *
 * SPDX-License-Identifier: Apache-2.0
 */

#include <st/h5/stm32h523.dtsi>

/ {
	soc {
		compatible = "st,stm32h533", "st,stm32h5", "simple-bus";
	};
};
