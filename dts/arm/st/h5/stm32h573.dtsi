/*
 * Copyright (c) 2023 STMicroelectronics
 *
 * SPDX-License-Identifier: Apache-2.0
 */

#include <st/h5/stm32h563.dtsi>
#include <st/h5/stm32h5_crypt.dtsi>

/ {
	soc {
		compatible = "st,stm32h573", "st,stm32h5", "simple-bus";
	};
};
