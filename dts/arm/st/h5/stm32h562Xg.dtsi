/*
 * Copyright (c) 2025 Kacper Brzostowski
 *
 * SPDX-License-Identifier: Apache-2.0
 */
#include <mem.h>
#include <st/h5/stm32h562.dtsi>

/ {
	soc {
		flash-controller@40022000 {
			flash0: flash@8000000 {
				reg = <0x08000000 DT_SIZE_M(1)>;
			};
		};
	};
};
