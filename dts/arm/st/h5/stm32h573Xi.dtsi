/*
 * Copyright (c) 2023 STMicroelectronics
 *
 * SPDX-License-Identifier: Apache-2.0
 */
#include <mem.h>
#include <st/h5/stm32h573.dtsi>

/ {
	soc {
		flash-controller@40022000 {
			flash0: flash@8000000 {
				reg = <0x08000000 DT_SIZE_M(2)>;
			};
		};
	};
};
