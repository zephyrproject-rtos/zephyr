/*
 * Copyright (c) 2026 STMicroelctronics
 *
 * SPDX-License-Identifier: Apache-2.0
 */

/ {
	soc {
		aes: aes@420c0000 {
			compatible = "st,stm32-aes";
			reg = <0x420c0000 0x400>;
			clocks = <&rcc STM32_CLOCK(AHB2, 16)>;
			resets = <&rctl STM32_RESET(AHB2, 16)>;
			interrupts = <116 0>;
			status = "disabled";
		};
	};
};
