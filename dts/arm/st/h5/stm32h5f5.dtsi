/*
 * Copyright (c) 2026 STMicroelectronics
 *
 * SPDX-License-Identifier: Apache-2.0
 */

#include <st/h5/stm32h5e5.dtsi>
#include <st/h5/stm32h5_crypt.dtsi>

/ {
	soc {
		compatible = "st,stm32h5f5", "st,stm32h5", "simple-bus";
	};
};
