/*
 * Copyright (c) 2026 Filip Stojanovic <filipembedded@gmail.com>
 *
 * SPDX-License-Identifier: Apache-2.0
 */

#include <st/l1/stm32l152.dtsi>

/ {
	soc {
		compatible = "st,stm32l162", "st,stm32l1", "simple-bus";
	};
};
