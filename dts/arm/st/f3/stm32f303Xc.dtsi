/*
 * Copyright (c) 2023 Martin Gritzan
 *
 * SPDX-License-Identifier: Apache-2.0
 */

#include <mem.h>
#include <st/f3/stm32f303Xb.dtsi>

&sram0 {
	reg = <0x20000000 DT_SIZE_K(40)>;
};

&flash0 {
	reg = <0x08000000 DT_SIZE_K(256)>;
};
