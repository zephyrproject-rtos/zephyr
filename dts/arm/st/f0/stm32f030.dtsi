/*
 * Copyright (c) 2017 Linaro Limited
 *
 * SPDX-License-Identifier: Apache-2.0
 */

#include <st/f0/stm32f0.dtsi>

/ {
	soc {
		compatible = "st,stm32f030", "st,stm32f0", "simple-bus";
	};

	die_temp: dietemp {
		compatible = "st,stm32c0-temp-cal";
		ts-cal1-addr = <0x1FFFF7B8>;
		ts-cal1-temp = <30>;
		ts-cal-vrefanalog = <3300>;
		avgslope = "4.3";
		io-channels = <&adc1 16>;
		ntc;
		status = "disabled";
	};
};
