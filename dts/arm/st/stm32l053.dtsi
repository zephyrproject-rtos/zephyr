/*
 * Copyright (c) 2018 Anthony Kreft <anthony.kreft@gmail.com>
 *
 * SPDX-License-Identifier: Apache-2.0
 */

#include <st/stm32l0.dtsi>

/ {
	soc {
		i2c2: i2c@40005800 {
			compatible = "st,stm32-i2c-v2";
			clock-frequency = <I2C_BITRATE_STANDARD>;
			#address-cells = <1>;
			#size-cells = <0>;
			reg = <0x40005800 0x400>;
			clocks = <&rcc STM32_CLOCK_BUS_APB1 0x00400000>;
			interrupts = <24 0>;
			interrupt-names = "combined";
			status = "disabled";
			label= "I2C_2";
		};

		spi2: spi@40003800 {
			compatible = "st,stm32-spi";
			#address-cells = <1>;
			#size-cells = <0>;
			reg = <0x40003800 0x400>;
			clocks = <&rcc STM32_CLOCK_BUS_APB1 0x00004000>;
			interrupts = <26 3>;
			status = "disabled";
			label = "SPI_2";
		};
	};
};
