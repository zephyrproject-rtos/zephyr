/*
 * Copyright (c) 2017 Linaro Limited
 *
 * SPDX-License-Identifier: Apache-2.0
 */

#include <st/stm32l475.dtsi>


/ {
	soc {
		lpuart1: serial@40008000 {
			compatible = "st,stm32-lpuart";
			reg = <0x40008000 0x400>;
			clocks = <&rcc STM32_CLOCK_BUS_APB1_2 0x00000001>;
			interrupts = <70 0>;
			status = "disabled";
			label = "LPUART_1";
		};
	};
};
