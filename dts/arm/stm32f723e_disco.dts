/*
 * Copyright (c) 2017 Linaro Limited
 * Copyright (c) 2017 BayLibre, SAS
 *
 * SPDX-License-Identifier: Apache-2.0
 */

/dts-v1/;
#include <st/stm32f723.dtsi>

/ {
	model = "STMicroelectronics STM32F723E-DISCO board";
	compatible = "st,stm32f723e-disco", "st,stm32f723";

	chosen {
		zephyr,console = &usart6;
		zephyr,sram = &sram0;
		zephyr,flash = &flash0;
	};
};

&usart6 {
	current-speed = <115200>;
	status = "ok";
};
