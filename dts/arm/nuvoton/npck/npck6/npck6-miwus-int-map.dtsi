/*
 * Copyright (c) 2026 Nuvoton Technology Corporation.
 *
 * SPDX-License-Identifier: Apache-2.0
 */

/* Common MIWU group-interrupt mapping configurations in npck */
#include <nuvoton/npck/npck-miwus-int-map.dtsi>

/* Specific MIWU group-interrupt mapping configurations in npck6 series */
/ {
	/* Mapping between MIWU group and interrupts */
	npcx-miwus-int-map {
		map_miwu1_groups: map-miwu1-groups {
			compatible = "nuvoton,npcx-miwu-int-map";
			parent = <&miwu1>;

			group_e1: group-e1-map {
				irq = <82>;
				irq-prio = <2>;
				group-mask = <0x10>;
			};
		};
	};
};
