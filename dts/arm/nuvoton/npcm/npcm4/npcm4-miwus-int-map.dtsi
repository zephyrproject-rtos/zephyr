/*
 * Copyright (c) 2024 Nuvoton Technology Corporation.
 *
 * SPDX-License-Identifier: Apache-2.0
 */

/* Common MIWU group-interrupt mapping configurations in npcm family */
#include <nuvoton/npcm/npcm-miwus-int-map.dtsi>
