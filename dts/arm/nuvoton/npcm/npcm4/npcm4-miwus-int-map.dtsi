/*
 * Copyright (c) 2026 Nuvoton Technology Corporation.
 *
 * SPDX-License-Identifier: Apache-2.0
 */

/* Common MIWU group-interrupt mapping configurations in npcm family */
#include <nuvoton/npcm/npcm-miwus-int-map.dtsi>

/*
 * Specific MIWU group-interrupt mapping configurations in npcm4 series:
 * none, the npcm4 series uses the common mapping as is.
 */
