/*
 * Copyright (c) 2025 Nuvoton Technology Corporation.
 *
 * SPDX-License-Identifier: Apache-2.0
 */

/* Common MIWU group-interrupt mapping configurations in nct family */
#include <nuvoton/nct/nct-miwus-int-map.dtsi>
