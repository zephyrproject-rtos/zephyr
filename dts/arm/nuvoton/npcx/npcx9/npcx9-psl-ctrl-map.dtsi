/*
 * Copyright (c) 2021 Nuvoton Technology Corporation.
 *
 * SPDX-License-Identifier: Apache-2.0
 */

/* Common Power Switch Logic (PSL) pads configurations in npcx family */
#include <nuvoton/npcx/npcx-psl-ctrl-map.dtsi>

/* Specific Power Switch Logic (PSL) pads configurations in npcx9 series */
