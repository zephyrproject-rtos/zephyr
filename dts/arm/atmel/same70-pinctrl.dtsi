/*
 * Copyright (c) 2020 Linaro Limited
 *
 * SPDX-License-Identifier: Apache-2.0
 */

#include "pinctrl_atmel_sam.h"

/ {
	soc {
		pinctrl@400e0e00 {
			/* instance, signal, pio, pin, peripheral */
			DT_ATMEL_PIN(afec0, adtrg, a, 8, b);
			DT_ATMEL_PIN(afec1, adtrg, d, 9, c);
			DT_ATMEL_PIN(gmac, gcol, d, 13, a);
			DT_ATMEL_PIN(gmac, gcrs, d, 10, a);
			DT_ATMEL_PIN(gmac, gmdc, d, 8, a);
			DT_ATMEL_PIN(gmac, gmdio, d, 9, a);
			DT_ATMEL_PIN(gmac, grxck, d, 14, a);
			DT_ATMEL_PIN(gmac, grxdv, d, 4, a);
			DT_ATMEL_PIN(gmac, grxer, d, 7, a);
			DT_ATMEL_PIN(gmac, grx0, d, 5, a);
			DT_ATMEL_PIN(gmac, grx1, d, 6, a);
			DT_ATMEL_PIN(gmac, grx2, d, 11, a);
			DT_ATMEL_PIN(gmac, grx3, d, 12, a);
			DT_ATMEL_PIN(gmac, gtsucomp, b, 1, b);
			DT_ATMEL_PIN(gmac, gtsucomp, b, 12, b);
			DT_ATMEL_PIN(gmac, gtsucomp, d, 11, c);
			DT_ATMEL_PIN(gmac, gtsucomp, d, 20, c);
			DT_ATMEL_PIN(gmac, gtxck, d, 0, a);
			DT_ATMEL_PIN(gmac, gtxen, d, 1, a);
			DT_ATMEL_PIN(gmac, gtxer, d, 17, a);
			DT_ATMEL_PIN(gmac, gtx0, d, 2, a);
			DT_ATMEL_PIN(gmac, gtx1, d, 3, a);
			DT_ATMEL_PIN(gmac, gtx2, d, 15, a);
			DT_ATMEL_PIN(gmac, gtx3, d, 16, a);
			DT_ATMEL_PIN(spi0, miso, d, 20, b);
			DT_ATMEL_PIN(spi0, mosi, d, 21, b);
			DT_ATMEL_PIN(spi0, npcs0, b, 2, d);
			DT_ATMEL_PIN(spi0, npcs1, a, 31, a);
			DT_ATMEL_PIN(spi0, npcs1, d, 25, b);
			DT_ATMEL_PIN(spi0, npcs2, d, 12, c);
			DT_ATMEL_PIN(spi0, npcs3, d, 27, b);
			DT_ATMEL_PIN(spi0, spck, d, 22, b);
			DT_ATMEL_PIN(spi1, miso, c, 26, c);
			DT_ATMEL_PIN(spi1, mosi, c, 27, c);
			DT_ATMEL_PIN(spi1, npcs0, c, 25, c);
			DT_ATMEL_PIN(spi1, npcs1, c, 28, c);
			DT_ATMEL_PIN(spi1, npcs1, d, 0, c);
			DT_ATMEL_PIN(spi1, npcs2, c, 29, c);
			DT_ATMEL_PIN(spi1, npcs2, d, 1, c);
			DT_ATMEL_PIN(spi1, npcs3, c, 30, c);
			DT_ATMEL_PIN(spi1, npcs3, d, 2, c);
			DT_ATMEL_PIN(spi1, spck, c, 24, c);
			DT_ATMEL_PIN(ssc, rd, a, 10, c);
			DT_ATMEL_PIN(ssc, rf, d, 24, b);
			DT_ATMEL_PIN(ssc, rk, a, 22, a);
			DT_ATMEL_PIN(ssc, td, b, 5, d);
			DT_ATMEL_PIN(ssc, td, d, 10, c);
			DT_ATMEL_PIN(ssc, td, d, 26, b);
			DT_ATMEL_PIN(ssc, tf, b, 0, d);
			DT_ATMEL_PIN(ssc, tk, b, 1, d);
			DT_ATMEL_PIN(twihs0, twck0, a, 4, a);
			DT_ATMEL_PIN(twihs0, twd0, a, 3, a);
			DT_ATMEL_PIN(twihs1, twck1, b, 5, a);
			DT_ATMEL_PIN(twihs1, twd1, b, 4, a);
			DT_ATMEL_PIN(twihs2, twck2, d, 28, c);
			DT_ATMEL_PIN(twihs2, twd2, d, 27, c);
			DT_ATMEL_PIN(uart0, urxd0, a, 9, a);
			DT_ATMEL_PIN(uart0, utxd0, a, 10, a);
			DT_ATMEL_PIN(uart1, urxd1, a, 5, c);
			DT_ATMEL_PIN(uart1, utxd1, a, 4, c);
			DT_ATMEL_PIN(uart1, utxd1, a, 6, c);
			DT_ATMEL_PIN(uart1, utxd1, d, 26, d);
			DT_ATMEL_PIN(uart2, urxd2, d, 25, c);
			DT_ATMEL_PIN(uart2, utxd2, d, 26, c);
			DT_ATMEL_PIN(uart3, urxd3, d, 28, a);
			DT_ATMEL_PIN(uart3, utxd3, d, 30, a);
			DT_ATMEL_PIN(uart3, utxd3, d, 31, b);
			DT_ATMEL_PIN(uart4, urxd4, d, 18, c);
			DT_ATMEL_PIN(uart4, utxd4, d, 3, c);
			DT_ATMEL_PIN(uart4, utxd4, d, 19, c);
			DT_ATMEL_PIN(usart0, cts0, b, 2, c);
			DT_ATMEL_PIN(usart0, dcd0, d, 0, d);
			DT_ATMEL_PIN(usart0, dsr0, d, 2, d);
			DT_ATMEL_PIN(usart0, dtr0, d, 1, d);
			DT_ATMEL_PIN(usart0, ri0, d, 3, d);
			DT_ATMEL_PIN(usart0, rts0, b, 3, c);
			DT_ATMEL_PIN(usart0, rxd0, b, 0, c);
			DT_ATMEL_PIN(usart0, sck0, b, 13, c);
			DT_ATMEL_PIN(usart0, txd0, b, 1, c);
			DT_ATMEL_PIN(usart1, cts1, a, 25, a);
			DT_ATMEL_PIN(usart1, dcd1, a, 26, a);
			DT_ATMEL_PIN(usart1, dsr1, a, 28, a);
			DT_ATMEL_PIN(usart1, dtr1, a, 27, a);
			DT_ATMEL_PIN(usart1, loncol1, a, 3, b);
			DT_ATMEL_PIN(usart1, ri1, a, 29, a);
			DT_ATMEL_PIN(usart1, rts1, a, 24, a);
			DT_ATMEL_PIN(usart1, rxd1, a, 21, a);
			DT_ATMEL_PIN(usart1, sck1, a, 23, a);
			DT_ATMEL_PIN(usart1, txd1, b, 4, d);
			DT_ATMEL_PIN(usart2, cts2, d, 19, b);
			DT_ATMEL_PIN(usart2, dcd2, d, 4, d);
			DT_ATMEL_PIN(usart2, dsr2, d, 6, d);
			DT_ATMEL_PIN(usart2, dtr2, d, 5, d);
			DT_ATMEL_PIN(usart2, ri2, d, 7, d);
			DT_ATMEL_PIN(usart2, rts2, d, 18, b);
			DT_ATMEL_PIN(usart2, rxd2, d, 15, b);
			DT_ATMEL_PIN(usart2, sck2, d, 17, b);
			DT_ATMEL_PIN(usart2, txd2, d, 16, b);
			DT_ATMEL_PIN(tc0, tclk0, a, 4, b);
			DT_ATMEL_PIN(tc0, tclk1, a, 28, b);
			DT_ATMEL_PIN(tc0, tclk2, a, 29, b);
			DT_ATMEL_PIN(tc0, tioa0, a, 0, b);
			DT_ATMEL_PIN(tc0, tioa1, a, 15, b);
			DT_ATMEL_PIN(tc0, tioa2, a, 26, b);
			DT_ATMEL_PIN(tc0, tiob0, a, 1, b);
			DT_ATMEL_PIN(tc0, tiob1, a, 16, b);
			DT_ATMEL_PIN(tc0, tiob2, a, 27, b);
			DT_ATMEL_PIN(tc1, tclk3, c, 25, b);
			DT_ATMEL_PIN(tc1, tclk4, c, 28, b);
			DT_ATMEL_PIN(tc1, tclk5, c, 31, b);
			DT_ATMEL_PIN(tc1, tioa3, c, 23, b);
			DT_ATMEL_PIN(tc1, tioa4, c, 26, b);
			DT_ATMEL_PIN(tc1, tioa5, c, 29, b);
			DT_ATMEL_PIN(tc1, tiob3, c, 24, b);
			DT_ATMEL_PIN(tc1, tiob4, c, 27, b);
			DT_ATMEL_PIN(tc1, tiob5, c, 30, b);
			DT_ATMEL_PIN(tc2, tclk6, c, 7, b);
			DT_ATMEL_PIN(tc2, tclk7, c, 10, b);
			DT_ATMEL_PIN(tc2, tclk8, c, 14, b);
			DT_ATMEL_PIN(tc2, tioa6, c, 5, b);
			DT_ATMEL_PIN(tc2, tioa7, c, 8, b);
			DT_ATMEL_PIN(tc2, tioa8, c, 11, b);
			DT_ATMEL_PIN(tc2, tiob6, c, 6, b);
			DT_ATMEL_PIN(tc2, tiob7, c, 9, b);
			DT_ATMEL_PIN(tc2, tiob8, c, 12, b);
			DT_ATMEL_PIN(tc3, tclk9, e, 2, b);
			DT_ATMEL_PIN(tc3, tclk10, e, 5, b);
			DT_ATMEL_PIN(tc3, tclk11, d, 24, c);
			DT_ATMEL_PIN(tc3, tioa9, e, 0, b);
			DT_ATMEL_PIN(tc3, tioa10, e, 3, b);
			DT_ATMEL_PIN(tc3, tioa11, d, 21, c);
			DT_ATMEL_PIN(tc3, tiob9, e, 1, b);
			DT_ATMEL_PIN(tc3, tiob10, e, 4, b);
			DT_ATMEL_PIN(tc3, tiob11, d, 22, c);
			DT_ATMEL_PIN(can0, rx0, b, 3, a);
			DT_ATMEL_PIN(can0, tx0, b, 2, a);
			DT_ATMEL_PIN(can1, rx1, c, 12, c);
			DT_ATMEL_PIN(can1, tx1, c, 14, c);
		};
	};
};
