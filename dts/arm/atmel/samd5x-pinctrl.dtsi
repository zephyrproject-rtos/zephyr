/*
 * Copyright (c) 2021 Gerson Fernando Budke
 *
 * SPDX-License-Identifier: Apache-2.0
 */

#include "pinctrl_atmel_sam.h"

/ {
	soc {
		pinctrl@41008000 {
			/* instance, signal, port, pin, peripheral [, flags] */
			DT_ATMEL_PORT(sercom0, pad0, a,  8, c, pinmux-enable);
			DT_ATMEL_PORT(sercom0, pad1, a,  9, c, pinmux-enable);
			DT_ATMEL_PORT(sercom0, pad2, a, 10, c, pinmux-enable);
			DT_ATMEL_PORT(sercom0, pad3, a, 11, c, pinmux-enable);
			DT_ATMEL_PORT(sercom0, pad0, b, 24, c, pinmux-enable);
			DT_ATMEL_PORT(sercom0, pad1, b, 25, c, pinmux-enable);
			DT_ATMEL_PORT(sercom0, pad2, c, 24, c, pinmux-enable);
			DT_ATMEL_PORT(sercom0, pad3, c, 25, c, pinmux-enable);
			DT_ATMEL_PORT(sercom0, pad0, a,  4, d, pinmux-enable);
			DT_ATMEL_PORT(sercom0, pad1, a,  5, d, pinmux-enable);
			DT_ATMEL_PORT(sercom0, pad2, a,  6, d, pinmux-enable);
			DT_ATMEL_PORT(sercom0, pad3, a,  7, d, pinmux-enable);
			DT_ATMEL_PORT(sercom0, pad0, c, 17, d, pinmux-enable);
			DT_ATMEL_PORT(sercom0, pad1, c, 16, d, pinmux-enable);
			DT_ATMEL_PORT(sercom0, pad2, c, 18, d, pinmux-enable);
			DT_ATMEL_PORT(sercom0, pad3, c, 19, d, pinmux-enable);
			DT_ATMEL_PORT(sercom1, pad0, a, 16, c, pinmux-enable);
			DT_ATMEL_PORT(sercom1, pad1, a, 17, c, pinmux-enable);
			DT_ATMEL_PORT(sercom1, pad2, a, 18, c, pinmux-enable);
			DT_ATMEL_PORT(sercom1, pad3, a, 19, c, pinmux-enable);
			DT_ATMEL_PORT(sercom1, pad0, c, 22, c, pinmux-enable);
			DT_ATMEL_PORT(sercom1, pad1, c, 23, c, pinmux-enable);
			DT_ATMEL_PORT(sercom1, pad2, d, 20, c, pinmux-enable);
			DT_ATMEL_PORT(sercom1, pad3, d, 21, c, pinmux-enable);
			DT_ATMEL_PORT(sercom1, pad0, c, 27, c, pinmux-enable);
			DT_ATMEL_PORT(sercom1, pad1, c, 28, c, pinmux-enable);
			DT_ATMEL_PORT(sercom1, pad2, b, 22, c, pinmux-enable);
			DT_ATMEL_PORT(sercom1, pad3, b, 23, c, pinmux-enable);
			DT_ATMEL_PORT(sercom1, pad0, a,  0, d, pinmux-enable);
			DT_ATMEL_PORT(sercom1, pad1, a,  1, d, pinmux-enable);
			DT_ATMEL_PORT(sercom1, pad2, a, 30, d, pinmux-enable);
			DT_ATMEL_PORT(sercom1, pad3, a, 31, d, pinmux-enable);
			DT_ATMEL_PORT(sercom2, pad0, a, 12, c, pinmux-enable);
			DT_ATMEL_PORT(sercom2, pad1, a, 13, c, pinmux-enable);
			DT_ATMEL_PORT(sercom2, pad2, a, 14, c, pinmux-enable);
			DT_ATMEL_PORT(sercom2, pad3, a, 15, c, pinmux-enable);
			DT_ATMEL_PORT(sercom2, pad0, b, 26, c, pinmux-enable);
			DT_ATMEL_PORT(sercom2, pad1, b, 27, c, pinmux-enable);
			DT_ATMEL_PORT(sercom2, pad2, b, 28, c, pinmux-enable);
			DT_ATMEL_PORT(sercom2, pad3, b, 29, c, pinmux-enable);
			DT_ATMEL_PORT(sercom2, pad0, a,  8, d, pinmux-enable);
			DT_ATMEL_PORT(sercom2, pad1, a,  9, d, pinmux-enable);
			DT_ATMEL_PORT(sercom2, pad2, a, 10, d, pinmux-enable);
			DT_ATMEL_PORT(sercom2, pad3, a, 11, d, pinmux-enable);
			DT_ATMEL_PORT(sercom2, pad0, b, 24, d, pinmux-enable);
			DT_ATMEL_PORT(sercom2, pad1, b, 25, d, pinmux-enable);
			DT_ATMEL_PORT(sercom2, pad2, c, 24, d, pinmux-enable);
			DT_ATMEL_PORT(sercom2, pad3, c, 25, d, pinmux-enable);
			DT_ATMEL_PORT(sercom3, pad0, a, 22, c, pinmux-enable);
			DT_ATMEL_PORT(sercom3, pad1, a, 23, c, pinmux-enable);
			DT_ATMEL_PORT(sercom3, pad2, a, 24, c, pinmux-enable);
			DT_ATMEL_PORT(sercom3, pad3, a, 25, c, pinmux-enable);
			DT_ATMEL_PORT(sercom3, pad0, b, 20, c, pinmux-enable);
			DT_ATMEL_PORT(sercom3, pad1, b, 21, c, pinmux-enable);
			DT_ATMEL_PORT(sercom3, pad2, a, 20, d, pinmux-enable);
			DT_ATMEL_PORT(sercom3, pad3, a, 21, d, pinmux-enable);
			DT_ATMEL_PORT(sercom3, pad0, a, 17, d, pinmux-enable);
			DT_ATMEL_PORT(sercom3, pad1, a, 16, d, pinmux-enable);
			DT_ATMEL_PORT(sercom3, pad2, a, 18, d, pinmux-enable);
			DT_ATMEL_PORT(sercom3, pad3, a, 19, d, pinmux-enable);
			DT_ATMEL_PORT(sercom3, pad0, c, 23, d, pinmux-enable);
			DT_ATMEL_PORT(sercom3, pad1, c, 22, d, pinmux-enable);
			DT_ATMEL_PORT(sercom3, pad2, d, 20, d, pinmux-enable);
			DT_ATMEL_PORT(sercom3, pad3, d, 21, d, pinmux-enable);
			DT_ATMEL_PORT(sercom4, pad0, b, 12, c, pinmux-enable);
			DT_ATMEL_PORT(sercom4, pad1, b, 13, c, pinmux-enable);
			DT_ATMEL_PORT(sercom4, pad2, b, 14, c, pinmux-enable);
			DT_ATMEL_PORT(sercom4, pad3, b, 15, c, pinmux-enable);
			DT_ATMEL_PORT(sercom4, pad0, b,  8, d, pinmux-enable);
			DT_ATMEL_PORT(sercom4, pad1, b,  9, d, pinmux-enable);
			DT_ATMEL_PORT(sercom4, pad2, b, 10, d, pinmux-enable);
			DT_ATMEL_PORT(sercom4, pad3, b, 11, d, pinmux-enable);
			DT_ATMEL_PORT(sercom4, pad0, a, 13, d, pinmux-enable);
			DT_ATMEL_PORT(sercom4, pad1, a, 12, d, pinmux-enable);
			DT_ATMEL_PORT(sercom4, pad2, a, 14, d, pinmux-enable);
			DT_ATMEL_PORT(sercom4, pad3, a, 15, d, pinmux-enable);
			DT_ATMEL_PORT(sercom4, pad0, b, 27, d, pinmux-enable);
			DT_ATMEL_PORT(sercom4, pad1, b, 26, d, pinmux-enable);
			DT_ATMEL_PORT(sercom4, pad2, b, 28, d, pinmux-enable);
			DT_ATMEL_PORT(sercom4, pad3, b, 29, d, pinmux-enable);
			DT_ATMEL_PORT(sercom5, pad0, b, 16, c, pinmux-enable);
			DT_ATMEL_PORT(sercom5, pad1, b, 17, c, pinmux-enable);
			DT_ATMEL_PORT(sercom5, pad2, b, 18, c, pinmux-enable);
			DT_ATMEL_PORT(sercom5, pad3, b, 19, c, pinmux-enable);
			DT_ATMEL_PORT(sercom5, pad0, a, 23, d, pinmux-enable);
			DT_ATMEL_PORT(sercom5, pad1, a, 22, d, pinmux-enable);
			DT_ATMEL_PORT(sercom5, pad2, a, 20, c, pinmux-enable);
			DT_ATMEL_PORT(sercom5, pad3, a, 21, c, pinmux-enable);
			DT_ATMEL_PORT(sercom5, pad2, a, 24, d, pinmux-enable);
			DT_ATMEL_PORT(sercom5, pad3, a, 25, d, pinmux-enable);
			DT_ATMEL_PORT(sercom5, pad2, b, 22, d, pinmux-enable);
			DT_ATMEL_PORT(sercom5, pad3, b, 23, d, pinmux-enable);
			DT_ATMEL_PORT(sercom5, pad0, b, 31, d, pinmux-enable);
			DT_ATMEL_PORT(sercom5, pad1, b, 30, d, pinmux-enable);
			DT_ATMEL_PORT(sercom5, pad2, b,  0, d, pinmux-enable);
			DT_ATMEL_PORT(sercom5, pad3, b,  1, d, pinmux-enable);
			DT_ATMEL_PORT(sercom5, pad0, b,  2, d, pinmux-enable);
			DT_ATMEL_PORT(sercom5, pad1, b,  3, d, pinmux-enable);
			DT_ATMEL_PORT(sercom6, pad0, c, 16, c, pinmux-enable);
			DT_ATMEL_PORT(sercom6, pad1, c, 17, c, pinmux-enable);
			DT_ATMEL_PORT(sercom6, pad2, c, 18, c, pinmux-enable);
			DT_ATMEL_PORT(sercom6, pad3, c, 19, c, pinmux-enable);
			DT_ATMEL_PORT(sercom6, pad0, c,  4, c, pinmux-enable);
			DT_ATMEL_PORT(sercom6, pad1, c,  5, c, pinmux-enable);
			DT_ATMEL_PORT(sercom6, pad2, c,  6, c, pinmux-enable);
			DT_ATMEL_PORT(sercom6, pad3, c,  7, c, pinmux-enable);
			DT_ATMEL_PORT(sercom6, pad0, d,  9, d, pinmux-enable);
			DT_ATMEL_PORT(sercom6, pad1, d,  8, d, pinmux-enable);
			DT_ATMEL_PORT(sercom6, pad2, d, 10, d, pinmux-enable);
			DT_ATMEL_PORT(sercom6, pad3, d, 11, d, pinmux-enable);
			DT_ATMEL_PORT(sercom6, pad0, c, 13, d, pinmux-enable);
			DT_ATMEL_PORT(sercom6, pad1, c, 12, d, pinmux-enable);
			DT_ATMEL_PORT(sercom6, pad2, c, 14, d, pinmux-enable);
			DT_ATMEL_PORT(sercom6, pad3, c, 15, d, pinmux-enable);
			DT_ATMEL_PORT(sercom6, pad2, c, 10, c, pinmux-enable);
			DT_ATMEL_PORT(sercom6, pad3, c, 11, c, pinmux-enable);
			DT_ATMEL_PORT(sercom7, pad0, c, 12, c, pinmux-enable);
			DT_ATMEL_PORT(sercom7, pad1, c, 13, c, pinmux-enable);
			DT_ATMEL_PORT(sercom7, pad2, c, 14, c, pinmux-enable);
			DT_ATMEL_PORT(sercom7, pad3, c, 15, c, pinmux-enable);
			DT_ATMEL_PORT(sercom7, pad0, d,  8, c, pinmux-enable);
			DT_ATMEL_PORT(sercom7, pad1, d,  9, c, pinmux-enable);
			DT_ATMEL_PORT(sercom7, pad2, d, 10, c, pinmux-enable);
			DT_ATMEL_PORT(sercom7, pad3, d, 11, c, pinmux-enable);
			DT_ATMEL_PORT(sercom7, pad0, c, 12, d, pinmux-enable);
			DT_ATMEL_PORT(sercom7, pad1, c, 13, d, pinmux-enable);
			DT_ATMEL_PORT(sercom7, pad2, c, 10, d, pinmux-enable);
			DT_ATMEL_PORT(sercom7, pad3, c, 11, d, pinmux-enable);
			DT_ATMEL_PORT(sercom7, pad0, b, 21, d, pinmux-enable);
			DT_ATMEL_PORT(sercom7, pad1, b, 20, d, pinmux-enable);
			DT_ATMEL_PORT(sercom7, pad2, b, 18, d, pinmux-enable);
			DT_ATMEL_PORT(sercom7, pad3, b, 19, d, pinmux-enable);
			DT_ATMEL_PORT(sercom7, pad0, b, 30, d, pinmux-enable);
			DT_ATMEL_PORT(sercom7, pad1, b, 31, d, pinmux-enable);
			DT_ATMEL_PORT(sercom7, pad2, a, 30, d, pinmux-enable);
			DT_ATMEL_PORT(sercom7, pad3, a, 31, d, pinmux-enable);

			DT_ATMEL_PORT(tcc0, wo0, a,  8, f, pinmux-enable);
			DT_ATMEL_PORT(tcc0, wo0, a, 20, g, pinmux-enable);
			DT_ATMEL_PORT(tcc0, wo0, b, 12, g, pinmux-enable);
			DT_ATMEL_PORT(tcc0, wo0, c,  4, f, pinmux-enable);
			DT_ATMEL_PORT(tcc0, wo0, c, 10, f, pinmux-enable);
			DT_ATMEL_PORT(tcc0, wo0, c, 16, f, pinmux-enable);
			DT_ATMEL_PORT(tcc0, wo1, a,  9, f, pinmux-enable);
			DT_ATMEL_PORT(tcc0, wo1, a, 21, g, pinmux-enable);
			DT_ATMEL_PORT(tcc0, wo1, b, 13, g, pinmux-enable);
			DT_ATMEL_PORT(tcc0, wo1, c, 11, f, pinmux-enable);
			DT_ATMEL_PORT(tcc0, wo1, c, 17, f, pinmux-enable);
			DT_ATMEL_PORT(tcc0, wo1, d,  8, f, pinmux-enable);
			DT_ATMEL_PORT(tcc0, wo2, a, 10, f, pinmux-enable);
			DT_ATMEL_PORT(tcc0, wo2, a, 22, g, pinmux-enable);
			DT_ATMEL_PORT(tcc0, wo2, b, 14, g, pinmux-enable);
			DT_ATMEL_PORT(tcc0, wo2, c, 12, f, pinmux-enable);
			DT_ATMEL_PORT(tcc0, wo2, c, 18, f, pinmux-enable);
			DT_ATMEL_PORT(tcc0, wo2, d,  9, f, pinmux-enable);
			DT_ATMEL_PORT(tcc0, wo3, a, 11, f, pinmux-enable);
			DT_ATMEL_PORT(tcc0, wo3, a, 23, g, pinmux-enable);
			DT_ATMEL_PORT(tcc0, wo3, b, 15, g, pinmux-enable);
			DT_ATMEL_PORT(tcc0, wo3, c, 13, f, pinmux-enable);
			DT_ATMEL_PORT(tcc0, wo3, c, 19, f, pinmux-enable);
			DT_ATMEL_PORT(tcc0, wo3, d, 10, f, pinmux-enable);
			DT_ATMEL_PORT(tcc0, wo4, a, 16, g, pinmux-enable);
			DT_ATMEL_PORT(tcc0, wo4, b, 10, f, pinmux-enable);
			DT_ATMEL_PORT(tcc0, wo4, b, 16, g, pinmux-enable);
			DT_ATMEL_PORT(tcc0, wo4, c, 14, f, pinmux-enable);
			DT_ATMEL_PORT(tcc0, wo4, c, 20, f, pinmux-enable);
			DT_ATMEL_PORT(tcc0, wo4, d, 11, f, pinmux-enable);
			DT_ATMEL_PORT(tcc0, wo5, a, 17, g, pinmux-enable);
			DT_ATMEL_PORT(tcc0, wo5, b, 11, f, pinmux-enable);
			DT_ATMEL_PORT(tcc0, wo5, b, 17, g, pinmux-enable);
			DT_ATMEL_PORT(tcc0, wo5, c, 15, f, pinmux-enable);
			DT_ATMEL_PORT(tcc0, wo5, c, 21, f, pinmux-enable);
			DT_ATMEL_PORT(tcc0, wo5, d, 12, f, pinmux-enable);
			DT_ATMEL_PORT(tcc0, wo6, a, 12, f, pinmux-enable);
			DT_ATMEL_PORT(tcc0, wo6, a, 18, g, pinmux-enable);
			DT_ATMEL_PORT(tcc0, wo6, b, 30, g, pinmux-enable);
			DT_ATMEL_PORT(tcc0, wo6, c, 22, f, pinmux-enable);
			DT_ATMEL_PORT(tcc0, wo7, a, 13, f, pinmux-enable);
			DT_ATMEL_PORT(tcc0, wo7, a, 19, g, pinmux-enable);
			DT_ATMEL_PORT(tcc0, wo7, b, 31, g, pinmux-enable);
			DT_ATMEL_PORT(tcc0, wo7, c, 23, f, pinmux-enable);
			DT_ATMEL_PORT(tcc1, wo0, a, 16, f, pinmux-enable);
			DT_ATMEL_PORT(tcc1, wo0, b, 10, g, pinmux-enable);
			DT_ATMEL_PORT(tcc1, wo0, b, 18, f, pinmux-enable);
			DT_ATMEL_PORT(tcc1, wo0, c, 14, g, pinmux-enable);
			DT_ATMEL_PORT(tcc1, wo0, d, 20, f, pinmux-enable);
			DT_ATMEL_PORT(tcc1, wo1, a, 17, f, pinmux-enable);
			DT_ATMEL_PORT(tcc1, wo1, b, 11, g, pinmux-enable);
			DT_ATMEL_PORT(tcc1, wo1, b, 19, f, pinmux-enable);
			DT_ATMEL_PORT(tcc1, wo1, c, 15, g, pinmux-enable);
			DT_ATMEL_PORT(tcc1, wo1, d, 21, f, pinmux-enable);
			DT_ATMEL_PORT(tcc1, wo2, a, 12, g, pinmux-enable);
			DT_ATMEL_PORT(tcc1, wo2, a, 14, g, pinmux-enable);
			DT_ATMEL_PORT(tcc1, wo2, a, 18, f, pinmux-enable);
			DT_ATMEL_PORT(tcc1, wo2, b, 20, f, pinmux-enable);
			DT_ATMEL_PORT(tcc1, wo2, b, 26, f, pinmux-enable);
			DT_ATMEL_PORT(tcc1, wo3, a, 13, g, pinmux-enable);
			DT_ATMEL_PORT(tcc1, wo3, a, 15, g, pinmux-enable);
			DT_ATMEL_PORT(tcc1, wo3, a, 19, f, pinmux-enable);
			DT_ATMEL_PORT(tcc1, wo3, b, 21, f, pinmux-enable);
			DT_ATMEL_PORT(tcc1, wo3, b, 27, f, pinmux-enable);
			DT_ATMEL_PORT(tcc1, wo4, a,  8, g, pinmux-enable);
			DT_ATMEL_PORT(tcc1, wo4, a, 20, f, pinmux-enable);
			DT_ATMEL_PORT(tcc1, wo4, b, 28, f, pinmux-enable);
			DT_ATMEL_PORT(tcc1, wo4, c, 10, g, pinmux-enable);
			DT_ATMEL_PORT(tcc1, wo5, a,  9, g, pinmux-enable);
			DT_ATMEL_PORT(tcc1, wo5, a, 21, f, pinmux-enable);
			DT_ATMEL_PORT(tcc1, wo5, b, 29, f, pinmux-enable);
			DT_ATMEL_PORT(tcc1, wo5, c, 11, g, pinmux-enable);
			DT_ATMEL_PORT(tcc1, wo6, a, 10, g, pinmux-enable);
			DT_ATMEL_PORT(tcc1, wo6, a, 22, f, pinmux-enable);
			DT_ATMEL_PORT(tcc1, wo6, c, 12, g, pinmux-enable);
			DT_ATMEL_PORT(tcc1, wo7, a, 11, g, pinmux-enable);
			DT_ATMEL_PORT(tcc1, wo7, a, 23, f, pinmux-enable);
			DT_ATMEL_PORT(tcc1, wo7, c, 13, g, pinmux-enable);
			DT_ATMEL_PORT(tcc2, wo0, a, 14, f, pinmux-enable);
			DT_ATMEL_PORT(tcc2, wo0, a, 30, f, pinmux-enable);
			DT_ATMEL_PORT(tcc2, wo1, a, 15, f, pinmux-enable);
			DT_ATMEL_PORT(tcc2, wo1, a, 31, f, pinmux-enable);
			DT_ATMEL_PORT(tcc2, wo2, a, 24, f, pinmux-enable);
			DT_ATMEL_PORT(tcc2, wo2, b,  2, f, pinmux-enable);
			DT_ATMEL_PORT(tcc3, wo0, b, 12, f, pinmux-enable);
			DT_ATMEL_PORT(tcc3, wo0, b, 16, f, pinmux-enable);
			DT_ATMEL_PORT(tcc3, wo1, b, 13, f, pinmux-enable);
			DT_ATMEL_PORT(tcc3, wo1, b, 17, f, pinmux-enable);
			DT_ATMEL_PORT(tcc4, wo0, b, 14, f, pinmux-enable);
			DT_ATMEL_PORT(tcc4, wo0, b, 30, f, pinmux-enable);
			DT_ATMEL_PORT(tcc4, wo1, b, 15, f, pinmux-enable);
			DT_ATMEL_PORT(tcc4, wo1, b, 31, f, pinmux-enable);

		};
	};
};
