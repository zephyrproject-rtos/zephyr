/*
 * Copyright (c) 2019 Gerson Fernando Budke
 * Copyright (c) 2020 Stephanos Ioannidis <root@stephanos.io>
 *
 * SPDX-License-Identifier: Apache-2.0
 */

#include <atmel/samv71b.dtsi>
#include <atmel/samx7xx19.dtsi>
