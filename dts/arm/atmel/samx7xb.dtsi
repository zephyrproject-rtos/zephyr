/*
 * Copyright (c) 2020 Stephanos Ioannidis <root@stephanos.io>
 *
 * SPDX-License-Identifier: Apache-2.0
 */

#include <atmel/samx7x.dtsi>

&gmac {
	interrupts = <39 0>, <66 0>, <67 0>, <71 0>, <72 0>, <73 0>;
	interrupt-names = "gmac", "q1", "q2", "q3", "q4", "q5";
	num-queues = <6>;
};
