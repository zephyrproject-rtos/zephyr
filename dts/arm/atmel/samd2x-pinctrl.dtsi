/*
 * Copyright (c) 2021 Gerson Fernando Budke
 *
 * SPDX-License-Identifier: Apache-2.0
 */

#include "pinctrl_atmel_sam.h"

/ {
	soc {
		pinctrl@41004400 {
			/* instance, signal, port, pin, peripheral [, flags] */
			DT_ATMEL_PORT(sercom0, pad0, a,  4, d, pinmux-enable);
			DT_ATMEL_PORT(sercom0, pad1, a,  5, d, pinmux-enable);
			DT_ATMEL_PORT(sercom0, pad2, a,  6, d, pinmux-enable);
			DT_ATMEL_PORT(sercom0, pad3, a,  7, d, pinmux-enable);
			DT_ATMEL_PORT(sercom0, pad0, a,  8, c, pinmux-enable);
			DT_ATMEL_PORT(sercom0, pad1, a,  9, c, pinmux-enable);
			DT_ATMEL_PORT(sercom0, pad2, a, 10, c, pinmux-enable);
			DT_ATMEL_PORT(sercom0, pad3, a, 11, c, pinmux-enable);
			DT_ATMEL_PORT(sercom1, pad0, a,  0, d, pinmux-enable);
			DT_ATMEL_PORT(sercom1, pad1, a,  1, d, pinmux-enable);
			DT_ATMEL_PORT(sercom1, pad2, a, 30, d, pinmux-enable);
			DT_ATMEL_PORT(sercom1, pad3, a, 31, d, pinmux-enable);
			DT_ATMEL_PORT(sercom1, pad0, a, 16, c, pinmux-enable);
			DT_ATMEL_PORT(sercom1, pad1, a, 17, c, pinmux-enable);
			DT_ATMEL_PORT(sercom1, pad2, a, 18, c, pinmux-enable);
			DT_ATMEL_PORT(sercom1, pad3, a, 19, c, pinmux-enable);
			DT_ATMEL_PORT(sercom2, pad0, a,  8, d, pinmux-enable);
			DT_ATMEL_PORT(sercom2, pad1, a,  9, d, pinmux-enable);
			DT_ATMEL_PORT(sercom2, pad2, a, 10, d, pinmux-enable);
			DT_ATMEL_PORT(sercom2, pad3, a, 11, d, pinmux-enable);
			DT_ATMEL_PORT(sercom2, pad0, a, 12, c, pinmux-enable);
			DT_ATMEL_PORT(sercom2, pad1, a, 13, c, pinmux-enable);
			DT_ATMEL_PORT(sercom2, pad2, a, 14, c, pinmux-enable);
			DT_ATMEL_PORT(sercom2, pad3, a, 15, c, pinmux-enable);
			DT_ATMEL_PORT(sercom3, pad0, a, 16, d, pinmux-enable);
			DT_ATMEL_PORT(sercom3, pad1, a, 17, d, pinmux-enable);
			DT_ATMEL_PORT(sercom3, pad2, a, 18, d, pinmux-enable);
			DT_ATMEL_PORT(sercom3, pad3, a, 19, d, pinmux-enable);
			DT_ATMEL_PORT(sercom3, pad2, a, 20, d, pinmux-enable);
			DT_ATMEL_PORT(sercom3, pad3, a, 21, d, pinmux-enable);
			DT_ATMEL_PORT(sercom3, pad0, a, 22, c, pinmux-enable);
			DT_ATMEL_PORT(sercom3, pad1, a, 23, c, pinmux-enable);
			DT_ATMEL_PORT(sercom3, pad2, a, 24, c, pinmux-enable);
			DT_ATMEL_PORT(sercom3, pad3, a, 25, c, pinmux-enable);
			DT_ATMEL_PORT(sercom4, pad0, b,  8, d, pinmux-enable);
			DT_ATMEL_PORT(sercom4, pad1, b,  9, d, pinmux-enable);
			DT_ATMEL_PORT(sercom4, pad2, b, 10, d, pinmux-enable);
			DT_ATMEL_PORT(sercom4, pad3, b, 11, d, pinmux-enable);
			DT_ATMEL_PORT(sercom4, pad0, b, 12, c, pinmux-enable);
			DT_ATMEL_PORT(sercom4, pad1, b, 13, c, pinmux-enable);
			DT_ATMEL_PORT(sercom4, pad2, b, 14, c, pinmux-enable);
			DT_ATMEL_PORT(sercom4, pad3, b, 15, c, pinmux-enable);
			DT_ATMEL_PORT(sercom4, pad0, a, 12, d, pinmux-enable);
			DT_ATMEL_PORT(sercom4, pad1, a, 13, d, pinmux-enable);
			DT_ATMEL_PORT(sercom4, pad2, a, 14, d, pinmux-enable);
			DT_ATMEL_PORT(sercom4, pad3, a, 15, d, pinmux-enable);
			DT_ATMEL_PORT(sercom5, pad0, b, 16, c, pinmux-enable);
			DT_ATMEL_PORT(sercom5, pad1, b, 17, c, pinmux-enable);
			DT_ATMEL_PORT(sercom5, pad2, a, 20, c, pinmux-enable);
			DT_ATMEL_PORT(sercom5, pad3, a, 21, c, pinmux-enable);
			DT_ATMEL_PORT(sercom5, pad0, a, 22, d, pinmux-enable);
			DT_ATMEL_PORT(sercom5, pad1, a, 23, d, pinmux-enable);
			DT_ATMEL_PORT(sercom5, pad2, a, 24, d, pinmux-enable);
			DT_ATMEL_PORT(sercom5, pad3, a, 25, d, pinmux-enable);
			DT_ATMEL_PORT(sercom5, pad2, b, 22, d, pinmux-enable);
			DT_ATMEL_PORT(sercom5, pad3, b, 23, d, pinmux-enable);
			DT_ATMEL_PORT(sercom5, pad0, b, 30, d, pinmux-enable);
			DT_ATMEL_PORT(sercom5, pad1, b, 31, d, pinmux-enable);
			DT_ATMEL_PORT(sercom5, pad2, b,  0, d, pinmux-enable);
			DT_ATMEL_PORT(sercom5, pad3, b,  1, d, pinmux-enable);
			DT_ATMEL_PORT(sercom5, pad0, b,  2, d, pinmux-enable);
			DT_ATMEL_PORT(sercom5, pad1, b,  3, d, pinmux-enable);

			DT_ATMEL_PORT(tcc2, wo0, a,  0, e, pinmux-enable);
			DT_ATMEL_PORT(tcc2, wo1, a,  1, e, pinmux-enable);
			DT_ATMEL_PORT(tcc3, wo0, a,  2, f, pinmux-enable);
			DT_ATMEL_PORT(tcc3, wo1, a,  3, f, pinmux-enable);
			DT_ATMEL_PORT(tcc3, wo6, b,  8, f, pinmux-enable);
			DT_ATMEL_PORT(tcc3, wo7, b,  9, f, pinmux-enable);
			DT_ATMEL_PORT(tcc0, wo0, a,  4, e, pinmux-enable);
			DT_ATMEL_PORT(tcc3, wo2, a,  4, f, pinmux-enable);
			DT_ATMEL_PORT(tcc0, wo1, a,  5, e, pinmux-enable);
			DT_ATMEL_PORT(tcc3, wo3, a,  5, f, pinmux-enable);
			DT_ATMEL_PORT(tcc1, wo0, a,  6, e, pinmux-enable);
			DT_ATMEL_PORT(tcc3, wo4, a,  6, f, pinmux-enable);
			DT_ATMEL_PORT(tcc1, wo1, a,  7, e, pinmux-enable);
			DT_ATMEL_PORT(tcc3, wo5, a,  7, f, pinmux-enable);
			DT_ATMEL_PORT(tcc0, wo0, a,  8, e, pinmux-enable);
			DT_ATMEL_PORT(tcc1, wo2, a,  8, f, pinmux-enable);
			DT_ATMEL_PORT(tcc0, wo1, a,  9, e, pinmux-enable);
			DT_ATMEL_PORT(tcc1, wo3, a,  9, f, pinmux-enable);
			DT_ATMEL_PORT(tcc1, wo0, a, 10, e, pinmux-enable);
			DT_ATMEL_PORT(tcc0, wo2, a, 10, f, pinmux-enable);
			DT_ATMEL_PORT(tcc1, wo1, a, 11, e, pinmux-enable);
			DT_ATMEL_PORT(tcc0, wo3, a, 11, f, pinmux-enable);
			DT_ATMEL_PORT(tcc0, wo4, b, 10, f, pinmux-enable);
			DT_ATMEL_PORT(tcc0, wo5, b, 11, f, pinmux-enable);
			DT_ATMEL_PORT(tcc0, wo6, b, 12, f, pinmux-enable);
			DT_ATMEL_PORT(tcc0, wo7, b, 13, f, pinmux-enable);
			DT_ATMEL_PORT(tcc2, wo0, a, 12, e, pinmux-enable);
			DT_ATMEL_PORT(tcc0, wo6, a, 12, f, pinmux-enable);
			DT_ATMEL_PORT(tcc2, wo1, a, 13, e, pinmux-enable);
			DT_ATMEL_PORT(tcc0, wo7, a, 13, f, pinmux-enable);
			DT_ATMEL_PORT(tcc0, wo4, a, 14, f, pinmux-enable);
			DT_ATMEL_PORT(tcc0, wo5, a, 15, f, pinmux-enable);
			DT_ATMEL_PORT(tcc2, wo0, a, 16, e, pinmux-enable);
			DT_ATMEL_PORT(tcc0, wo6, a, 16, f, pinmux-enable);
			DT_ATMEL_PORT(tcc2, wo1, a, 17, e, pinmux-enable);
			DT_ATMEL_PORT(tcc0, wo7, a, 17, f, pinmux-enable);
			DT_ATMEL_PORT(tcc0, wo2, a, 18, f, pinmux-enable);
			DT_ATMEL_PORT(tcc0, wo3, a, 19, f, pinmux-enable);
			DT_ATMEL_PORT(tcc0, wo4, b, 16, f, pinmux-enable);
			DT_ATMEL_PORT(tcc0, wo5, b, 17, f, pinmux-enable);
			DT_ATMEL_PORT(tcc0, wo6, a, 20, f, pinmux-enable);
			DT_ATMEL_PORT(tcc0, wo7, a, 21, f, pinmux-enable);
			DT_ATMEL_PORT(tcc0, wo4, a, 22, f, pinmux-enable);
			DT_ATMEL_PORT(tcc0, wo5, a, 23, f, pinmux-enable);
			DT_ATMEL_PORT(tcc1, wo2, a, 24, f, pinmux-enable);
			DT_ATMEL_PORT(tcc1, wo3, a, 25, f, pinmux-enable);
			DT_ATMEL_PORT(tcc3, wo0, b, 22, f, pinmux-enable);
			DT_ATMEL_PORT(tcc3, wo1, b, 23, f, pinmux-enable);
			DT_ATMEL_PORT(tcc3, wo6, a, 27, f, pinmux-enable);
			DT_ATMEL_PORT(tcc3, wo7, a, 27, f, pinmux-enable);
			DT_ATMEL_PORT(tcc1, wo0, a, 30, e, pinmux-enable);
			DT_ATMEL_PORT(tcc3, wo4, a, 30, f, pinmux-enable);
			DT_ATMEL_PORT(tcc1, wo1, a, 31, e, pinmux-enable);
			DT_ATMEL_PORT(tcc3, wo5, a, 31, f, pinmux-enable);
			DT_ATMEL_PORT(tcc0, wo0, b, 30, e, pinmux-enable);
			DT_ATMEL_PORT(tcc1, wo2, b, 30, f, pinmux-enable);
			DT_ATMEL_PORT(tcc0, wo1, b, 31, e, pinmux-enable);
			DT_ATMEL_PORT(tcc1, wo3, b, 31, f, pinmux-enable);
			DT_ATMEL_PORT(tcc3, wo2, b,  2, f, pinmux-enable);
			DT_ATMEL_PORT(tcc3, wo3, b,  3, f, pinmux-enable);
		};
	};
};
