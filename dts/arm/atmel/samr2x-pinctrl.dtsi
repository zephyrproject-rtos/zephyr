/*
 * Copyright (c) 2021 Gerson Fernando Budke
 *
 * SPDX-License-Identifier: Apache-2.0
 */

/delete-node/ &pa4f_tcc3_wo2;
/delete-node/ &pa5f_tcc3_wo3;
/delete-node/ &pa6f_tcc3_wo4;
/delete-node/ &pa7f_tcc3_wo5;
/delete-node/ &pa8f_tcc1_wo2;
/delete-node/ &pa9f_tcc1_wo3;
/delete-node/ &pa12f_tcc0_wo6;
/delete-node/ &pa13f_tcc0_wo7;
/delete-node/ &pb22f_tcc3_wo0;
/delete-node/ &pb23f_tcc3_wo1;
/delete-node/ &pa27f_tcc3_wo6;
/delete-node/ &pa30f_tcc3_wo4;
/delete-node/ &pa31f_tcc3_wo5;
/delete-node/ &pb2f_tcc3_wo2;
/delete-node/ &pb3f_tcc3_wo3;

/ {
	soc {
		pinctrl@41004400 {
			/* instance, signal, port, pin, peripheral [, flags] */
			DT_ATMEL_PORT(sercom3, pad0, a, 27, f, pinmux-enable);
			DT_ATMEL_PORT(sercom3, pad1, a, 28, f, pinmux-enable);
			DT_ATMEL_PORT(sercom4, pad0, c, 19, f, pinmux-enable);
			DT_ATMEL_PORT(sercom4, pad1, b, 31, f, pinmux-enable);
			DT_ATMEL_PORT(sercom4, pad2, b, 30, f, pinmux-enable);
			DT_ATMEL_PORT(sercom4, pad3, c, 18, f, pinmux-enable);
		};
	};
};
