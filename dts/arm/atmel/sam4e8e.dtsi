/*
 * Copyright (c) 2019 Gerson Fernando Budke
 *
 * SPDX-License-Identifier: Apache-2.0
 */

#include <mem.h>
#include <atmel/sam4e.dtsi>

/ {
	flash0: flash@400000 {
		reg = <0x00400000 DT_SIZE_K(512)>;
	};

	sram0: memory@20000000 {
		reg = <0x20000000 DT_SIZE_K(128)>;
	};
};
