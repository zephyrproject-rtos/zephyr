/dts-v1/;

#include <ti/cc32xx.dtsi>

/ {
	model = "TI CC3200 LaunchXL";
	compatible = "ti,cc3200-launchxl","ti,cc3200","ti,cc32xx";

	aliases {
		uart_0 = &uart0;
		uart_1 = &uart1;
	};

	chosen {
		zephyr,sram = &sram0;
		zephyr,flash = &flash0;
		zephyr,console = &uart0;
	};
};

&uart0 {
	status = "ok";
	current-speed = <115200>;
};
