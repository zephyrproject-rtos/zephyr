/*
 * Copyright (c) 2017 Linaro Limited
 *
 * SPDX-License-Identifier: Apache-2.0
 */

/dts-v1/;
#include <nordic/nrf51822.dtsi>

/ {
	model = "Seeed Studio Carbon nRF51 96board";
	compatible = "seeed,carbon_nrf51", "nordic,nrf51822-qfac",
		     "nordic,nrf51822";

	chosen {
		zephyr,console = &uart0;
		zephyr,sram = &sram0;
		zephyr,flash = &flash0;
	};
};

&uart0 {
	current-speed = <115200>;
	status = "ok";
};
