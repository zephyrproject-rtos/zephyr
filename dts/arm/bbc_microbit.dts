/*
 * Copyright (c) 2017 Linaro Limited
 *
 * SPDX-License-Identifier: Apache-2.0
 */

/dts-v1/;
#include <nordic/nrf51822.dtsi>

/ {
	model = "BBC Micro:bit";
	compatible = "bbc,microbit", "nordic,nrf51822-qfaa", "nordic,nrf51822";

	chosen {
		zephyr,console = &uart0;
		zephyr,sram = &sram0;
		zephyr,flash = &flash0;
	};
};

&uart0 {
	status = "ok";
	current-speed = <115200>;
};
