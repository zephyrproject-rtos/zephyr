/*
 * Copyright (c) 2022, TOKITA Hiroshi <tokita.hiroshi@gmail.com>
 *
 * SPDX-License-Identifier: Apache-2.0
 */

#include <gigadevice/gd32f4xx/gd32f4xx.dtsi>

&cpu0 {
	clock-frequency = <168000000>;
};
