/*
 * SPDX-FileCopyrightText: Copyright Alif Semiconductor
 * SPDX-License-Identifier: Apache-2.0
 */

/*
 * NVIC interrupt-routing information for AE402FA0E5597LE0: pulls in the
 * _nvic_irq layer for each resource layer composed by ae402fa0e5597le0.dtsi.
 * A board that uses this SoC includes this for RTSS (NVIC) cores.
 */

#include <alif/ensemble/common/ensemble_common_nvic_irq.dtsi>
