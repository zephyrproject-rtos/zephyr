/*
 * SPDX-FileCopyrightText: Copyright Alif Semiconductor
 * SPDX-License-Identifier: Apache-2.0
 */

/*
 * GIC interrupt-routing information for AE822FA0E5597LS0: pulls in the
 * _gic_irq layer for each resource layer composed by ae822fa0e5597ls0.dtsi.
 * A board that uses this SoC includes this for APSS (GIC) cores.
 */

#include <alif/ensemble/common/ensemble_common_gic_irq.dtsi>
