/*
 * SPDX-FileCopyrightText: Copyright Alif Semiconductor
 * SPDX-License-Identifier: Apache-2.0
 */

/*
 * NVIC interrupt-routing information for AE822FA0E5597BS0: pulls in the
 * _nvic_irq layer for each resource layer composed by ae822fa0e5597bs0.dtsi.
 * A board that uses this SoC includes this for RTSS (NVIC) cores.
 */

#include <alif/ensemble/common/ensemble_e4_e6_e8_nvic_irq.dtsi>
