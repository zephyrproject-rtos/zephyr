/*
 * Copyright (c) 2017 I-SENSE group of ICCS
 *
 * SPDX-License-Identifier: Apache-2.0
 */

/dts-v1/;
#include <st/stm32f103Xb.dtsi>
#include <i2c.h>

/ {
	model = "Olimex OLIMEXINO-STM32 board";
	compatible = "st,olimexino_stm32", "st,stm32f103rb";

	chosen {
		zephyr,console = &usart1;
		zephyr,sram = &sram0;
		zephyr,flash = &flash0;
	};
};

&usart1 {
	current-speed = <115200>;
	status = "ok";
};

&i2c2 {
	status = "ok";
	zephyr,speed = <I2C_SPEED_FAST>;
};
