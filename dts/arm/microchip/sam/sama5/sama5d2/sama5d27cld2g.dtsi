/*
 * Copyright (C) 2025-2026 Microchip Technology Inc. and its subsidiaries
 *
 * SPDX-License-Identifier: Apache-2.0
 *
 */

#include <microchip/sam/sama5/sama5d2/sama5d27.dtsi>

/ {
	ddram: ddram@20000000 {
		compatible = "ddram";
		reg = <0x20000000 DT_SIZE_M(256)>;
	};
};
