/*
 * Copyright (c) 2026 Microchip Technology Inc.
 *
 * SPDX-License-Identifier: Apache-2.0
 */

/ {
	soc {
		gmac: ethernet@42000800 {
			compatible = "microchip,gmac-g1-eth";
			reg = <0x42000800 0x400>;
			interrupts = <84 0>;
			interrupt-names = "gmac";
			num-queues = <1>;
			clocks = <&mclkperiph CLOCK_MCHP_MCLKPERIPH_ID_AHB_GMAC>,
				 <&mclkperiph CLOCK_MCHP_MCLKPERIPH_ID_APBC_GMAC>;
			clock-names = "mclk-ahb", "mclk-apb";
			status = "disabled";

			mdio: mdio {
				compatible = "microchip,gmac-g1-mdio";
				#address-cells = <1>;
				#size-cells = <0>;
				status = "disabled";
			};
		};
	};
};
