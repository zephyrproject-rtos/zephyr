/*
 * Copyright (c) 2025 Microchip Technology Inc.
 *
 * SPDX-License-Identifier: Apache-2.0
 */

#include <mem.h>
#include <microchip/sam/sam_d5x_e5x/common/samd5xe5x.dtsi>
#include <microchip/sam/sam_d5x_e5x/common/samd5xe5x_18.dtsi>
