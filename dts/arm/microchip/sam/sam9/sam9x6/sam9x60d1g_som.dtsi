/*
 * Copyright (C) 2025-2026 Microchip Technology Inc.
 *
 * SPDX-License-Identifier: Apache-2.0
 *
 */

#include <microchip/sam/sam9/sam9x6/sam9x60d1g.dtsi>

/ {
	clocks {
		main_xtal {
			clock-frequency = <DT_FREQ_M(24)>;
		};

		slow_xtal {
			clock-frequency = <32768>;
		};
	};
};
