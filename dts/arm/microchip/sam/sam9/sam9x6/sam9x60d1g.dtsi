/*
 * Copyright (C) 2026 Microchip Technology Inc.
 *
 * SPDX-License-Identifier: Apache-2.0
 *
 */

#include <microchip/sam/sam9/sam9x6/sam9x60.dtsi>

/ {
	/* 1-Gbit DDR2-SDRAM */
	ddr2_sdram: ddr2_sdram@20000000 {
		compatible = "mmio-sram";
		device_type = "memory";
		reg = <0x20000000 DT_SIZE_M(128)>;
	};
};
