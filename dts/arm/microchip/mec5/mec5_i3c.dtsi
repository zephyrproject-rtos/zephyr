/*
 * Copyright (c) 2024 Microchip Technology Inc.
 *
 * SPDX-License-Identifier: Apache-2.0
 */

/* Microchip MEC5 SoC's Improved I2C(I3C).
 * Include this file in the soc {} section in the relevant chip DTSI files.
 */
i3c0: i3c@40010800 {
	compatible = "microchip,mec5-i3c";
	#address-cells = <3>;
	#size-cells = <0>;
	reg = <0x40010800 0x800>;
	interrupts = <181 2>;
	input-clock-frequency = <192000000>;
	i3c-scl-hz = <12500000>;
	i2c-scl-hz = <400000>;
	status = "disabled";
};

i3c1: i3c@40010000 {
	compatible = "microchip,mec5-i3c";
	#address-cells = <3>;
	#size-cells = <0>;
	reg = <0x40010000 0x800>;
	interrupts = <182 2>;
	input-clock-frequency = <192000000>;
	i3c-scl-hz = <12500000>;
	i2c-scl-hz = <400000>;
	status = "disabled";
};
