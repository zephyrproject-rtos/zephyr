/*
 * Copyright (c) 2024 Microchip Technology Inc.
 *
 * SPDX-License-Identifier: Apache-2.0
 */

/* MEC5 central DMA controller with 16 channels */
dmac: dmac@40002400 {
	reg = <0x40002400 0xc00>;
	interrupts = <24 1>, <25 1>, <26 1>, <27 1>,
		     <28 1>, <29 1>, <30 1>, <31 1>,
		     <32 1>, <33 1>, <34 1>, <35 1>,
		     <36 1>, <37 1>, <38 1>, <39 1>;
	#dma-cells = <2>;
	dma-channels = <16>;
	dma-requests = <16>;
	status = "disabled";
};
