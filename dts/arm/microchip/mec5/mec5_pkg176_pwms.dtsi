/*
 * Copyright (c) 2024 Microchip Technology Inc.
 *
 * SPDX-License-Identifier: Apache-2.0
 */

/* So far all Microchip MEC5 family of SoC's so add three more PWM's
 * in the 176-pin (LJ) package.
 * Include this file in the soc {} section in all MEC5 LJ chip DTSI files.
 */
pwm9: pwm@40005890 {
	reg = <0x40005890 0x10>;
	status = "disabled";
	#pwm-cells = <3>;
};
pwm10: pwm@400058a0 {
	reg = <0x400058a0 0x10>;
	status = "disabled";
	#pwm-cells = <3>;
};
pwm11: pwm@400058b0 {
	reg = <0x400058b0 0x10>;
	status = "disabled";
	#pwm-cells = <3>;
};
