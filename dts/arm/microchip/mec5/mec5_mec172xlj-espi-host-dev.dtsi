/*
 * Copyright (c) 2024 Microchip Technology Inc.
 *
 * SPDX-License-Identifier: Apache-2.0
 */

#include <zephyr/dt-bindings/espi/mchp-mec5-espi.h>

/ {
	mchp-mec5-espi-host-dev {
		compatible = "microchip,mec5-espi-host-dev";

		#include "mec5-espi-host-dev-common.dtsi"
	};
};
