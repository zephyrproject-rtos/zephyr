/*
 * Copyright (c) 2024 Microchip Technology Inc.
 *
 * SPDX-License-Identifier: Apache-2.0
 */

/* MEC5 EEPROM controller with internal 8 kilobyte EEPROM */
eeprom: eeprom@40002c00 {
	compatible = "microchip,xec-eeprom";
	reg = <0x40002c00 0x400>;
	interrupts = <155 2>;
	size = <8192>;
	girqs = <MCHP_XEC_ECIA_GIRQ_ENC(18, 13)>;
	pcr-scr = <MCHP_XEC_SCR_ENCODE(4, 14)>;
	status = "disabled";
};
