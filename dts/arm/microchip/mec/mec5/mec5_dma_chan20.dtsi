/*
 * Copyright (c) 2024 Microchip Technology Inc.
 *
 * SPDX-License-Identifier: Apache-2.0
 */

/* MEC5 central DMA controller with 20 channels */
dmac: dmac@40002400 {
	compatible = "microchip,xec-dmac";
	#dma-cells = <2>;
	reg = <0x40002400 0xc00>;
	interrupts = <24 1>, <25 1>, <26 1>, <27 1>,
		     <28 1>, <29 1>, <30 1>, <31 1>,
		     <32 1>, <33 1>, <34 1>, <35 1>,
		     <36 1>, <37 1>, <38 1>, <39 1>,
		     <194 1>, <195 1>, <196 1>, <197 1>;
	interrupt-names = "chan0", "chan1", "chan2", "chan3",
			  "chan4", "chan5", "chan6", "chan7",
			  "chan8", "chan9", "chan10", "chan11",
			  "chan12", "chan13", "chan14", "chan15",
			  "chan16", "chan17", "chan18", "chan19";
	girqs = <MCHP_XEC_ECIA_GIRQ_ENC(14, 0) MCHP_XEC_ECIA_GIRQ_ENC(14, 1)
		 MCHP_XEC_ECIA_GIRQ_ENC(14, 2) MCHP_XEC_ECIA_GIRQ_ENC(14, 3)
		 MCHP_XEC_ECIA_GIRQ_ENC(14, 4) MCHP_XEC_ECIA_GIRQ_ENC(14, 5)
		 MCHP_XEC_ECIA_GIRQ_ENC(14, 6) MCHP_XEC_ECIA_GIRQ_ENC(14, 7)
		 MCHP_XEC_ECIA_GIRQ_ENC(14, 8) MCHP_XEC_ECIA_GIRQ_ENC(14, 9)
		 MCHP_XEC_ECIA_GIRQ_ENC(14, 10) MCHP_XEC_ECIA_GIRQ_ENC(14, 11)
		 MCHP_XEC_ECIA_GIRQ_ENC(14, 12) MCHP_XEC_ECIA_GIRQ_ENC(14, 13)
		 MCHP_XEC_ECIA_GIRQ_ENC(14, 14) MCHP_XEC_ECIA_GIRQ_ENC(14, 15)
		 MCHP_XEC_ECIA_GIRQ_ENC(14, 16) MCHP_XEC_ECIA_GIRQ_ENC(14, 17)
		 MCHP_XEC_ECIA_GIRQ_ENC(14, 18) MCHP_XEC_ECIA_GIRQ_ENC(14, 19)>;
	dma-channels = <20>;
	dma-requests = <20>;
	pcr-scr = <MCHP_XEC_SCR_ENCODE(1, 6)>;
	status = "disabled";
};
