/*
 * Copyright (c) 2025 Microchip Technology Inc.
 *
 * SPDX-License-Identifier: Apache-2.0
 */

#include <mem.h>
#include <microchip/pic32c/pic32cm_jh/common/pic32cm_jh_48.dtsi>
#include <microchip/pic32c/pic32cm_jh/common/pic32cm_5164_jh.dtsi>
