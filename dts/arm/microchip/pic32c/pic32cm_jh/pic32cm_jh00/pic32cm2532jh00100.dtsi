/*
 * Copyright (c) 2025 Microchip Technology Inc.
 *
 * SPDX-License-Identifier: Apache-2.0
 */

#include <mem.h>
#include <microchip/pic32c/pic32cm_jh/common/pic32cm_jh_100.dtsi>
#include <microchip/pic32c/pic32cm_jh/common/pic32cm_2532_jh.dtsi>
