/*
 * Copyright (c) 2025 Microchip Technology Inc.
 *
 * SPDX-License-Identifier: Apache-2.0
 */

/* Device-tree nodes specific to 32-pin package variants */

#include <microchip/pic32c/pic32cm_jh/common/pic32cm_jh.dtsi>
