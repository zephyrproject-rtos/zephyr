/*
 * Copyright (c) 2025 Microchip Technology Inc.
 *
 * SPDX-License-Identifier: Apache-2.0
 */

/* Device-tree nodes specific to 64-pin package variants */

#include <microchip/pic32c/pic32cx_sg/common/pic32cx_sg.dtsi>
