/*
 * Copyright (c) 2025 Microchip Technology Inc.
 *
 * SPDX-License-Identifier: Apache-2.0
 */

#include <mem.h>
#include <microchip/pic32c/pic32cz_ca/common/pic32cz_ca_100.dtsi>
#include <microchip/pic32c/pic32cz_ca/common/pic32cz_4010_ca.dtsi>
