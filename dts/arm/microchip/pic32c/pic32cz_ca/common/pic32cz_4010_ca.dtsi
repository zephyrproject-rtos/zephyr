/*
 * Copyright (c) 2025-2026 Microchip Technology Inc.
 *
 * SPDX-License-Identifier: Apache-2.0
 */

/ {
	soc {
		flash0: flash@8000000 {
			reg = <0x08000000 DT_SIZE_M(4)>;
			ranges = <0x0 0x8000000 DT_SIZE_M(4)>;
		};

		sram0: memory@20000000 {
			reg = <0x20000000 DT_SIZE_M(1)>;
		};
	};
};
