/*
 * Copyright (c) 2026 Microchip Technology Inc.
 *
 * SPDX-License-Identifier: Apache-2.0
 */

#include <mem.h>
#include <microchip/pic32c/pic32cm_sg_gc/common/pic32cm_sg_gc_64.dtsi>
#include <microchip/pic32c/pic32cm_sg_gc/common/pic32cm_5112_sg_gc.dtsi>
