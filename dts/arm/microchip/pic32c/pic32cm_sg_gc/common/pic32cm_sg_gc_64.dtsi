/*
 * Copyright (c) 2026 Microchip Technology Inc.
 *
 * SPDX-License-Identifier: Apache-2.0
 */

#include <microchip/pic32c/pic32cm_sg_gc/common/pic32cm_sg_gc.dtsi>

&eic {
	porta-unsupported-pins = <0xffffc000>; /*14..31*/
	portb-unsupported-pins = <0xfffff800>; /*11..31*/
	portc-unsupported-pins = <0xfffff980>; /*7|8|11..31*/
	portd-supported-pins = <0x00003fb2>; /*1|4|5|7..13*/
};
