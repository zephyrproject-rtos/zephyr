/*
 * Copyright (c) 2026 Microchip Technology Inc.
 *
 * SPDX-License-Identifier: Apache-2.0
 */

#include <microchip/pic32c/pic32cm_sg_gc/common/pic32cm_sg_gc.dtsi>

&eic {
	porta-unsupported-pins = <0xffe00000>; /*21..31*/
	portb-unsupported-pins = <0xfffc0000>; /*18..31*/
	portc-unsupported-pins = <0xfff00180>; /*7|8|20..31*/
	portd-supported-pins = <0x001fffb2>; /*1|4|5|7..20*/
};
