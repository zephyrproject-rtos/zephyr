/*
 * Copyright (c) 2025 Microchip Technology Inc.
 *
 * SPDX-License-Identifier: Apache-2.0
 */

#include <mem.h>
#include <microchip/pic32c/pic32cx_bz/bz6x/common/pic32cxxbz6x.dtsi>

/ {
	soc {
		sram0: memory@20000000 {
			reg = <0x20000000 DT_SIZE_K(512)>;
		};
	};
};
