/*
 * SPDX-FileCopyrightText: Copyright (c) 2026 Microchip Technology Inc.
 *
 * SPDX-License-Identifier: Apache-2.0
 */

#include <mem.h>
#include <microchip/pic32c/pic32cx_bz/bz6x/common/pic32cxxbz6x.dtsi>

/ {
	soc {
		retention: memory@20000000 {
			reg = <0x20000000 DT_SIZE_K(16)>;
		};

		sram0: memory@20004000 {
			reg = <0x20004000 (DT_SIZE_K(512) - DT_SIZE_K(16))>;
		};
	};
};
