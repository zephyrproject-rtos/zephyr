/*
 * Copyright (c) 2026 Microchip Technology Inc.
 *
 * SPDX-License-Identifier: Apache-2.0
 */

/ {
	soc {
		flash0: flash@c000000 {
			reg = <0x0c000000 DT_SIZE_K(128)>;
			ranges = <0x0 0x0c000000 DT_SIZE_K(128)>;
		};

		sram0: memory@20000000 {
			reg = <0x20000000 DT_SIZE_K(16)>;
		};
	};
};
