/*
 * Copyright (c) 2026 Microchip Technology Inc.
 *
 * SPDX-License-Identifier: Apache-2.0
 */

#include <arm/armv8-m.dtsi>
#include <zephyr/dt-bindings/gpio/gpio.h>
#include <zephyr/dt-bindings/clock/mchp_pic32ck_sg_gc_clock.h>

/ {
	soc {
		gmac: ethernet@45022000 {
			compatible = "microchip,gmac-g1-eth";
			reg = <0x45022000 0x400>;
			interrupts = <145 0>;
			interrupt-names = "gmac";
			num-queues = <1>;
			clocks = <&mclkperiph CLOCK_MCHP_MCLKPERIPH_ID_ETH_AHB>,
				 <&mclkperiph CLOCK_MCHP_MCLKPERIPH_ID_ETH_APB>,
				 <&gclkperiph CLOCK_MCHP_GCLKPERIPH_ID_ETH_TX>,
				 <&gclkperiph CLOCK_MCHP_GCLKPERIPH_ID_ETH_TSU>;
			clock-names = "mclk-ahb", "mclk-apb", "gclk-tx", "gclk-tsu";
			status = "disabled";

			mdio: mdio {
				compatible = "microchip,gmac-g1-mdio";
				#address-cells = <1>;
				#size-cells = <0>;
				status = "disabled";
			};
		};
	};
};
