/*
 * Copyright (c) 2026, Realtek Semiconductor Corporation
 *
 * SPDX-License-Identifier: Apache-2.0
 */

#include <realtek/bee/rtl87x2g.dtsi>

/ {
	soc {
		flash-controller@40022000 {
			flash@4000000 {
				reg = <0x4000000 DT_SIZE_K(1024)>;
				ranges = <0x0 0x4000000 DT_SIZE_K(1024)>;
			};
		};
	};
};
