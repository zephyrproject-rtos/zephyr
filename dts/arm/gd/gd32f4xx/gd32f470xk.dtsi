/*
 * Copyright (c) 2022, Rtone.
 *
 * SPDX-License-Identifier: Apache-2.0
 */

#include <mem.h>
#include <gd/gd32f4xx/gd32f470.dtsi>

&flash0 {
	reg = <0x08000000 DT_SIZE_K(3072)>;
	ranges = <0x0 0x08000000 DT_SIZE_K(3072)>;
};

&sram0 {
	reg = <0x20000000 DT_SIZE_K(192)>;
};
