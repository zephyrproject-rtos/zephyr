/*
 * Copyright (c) 2021 Teslabs Engineering S.L.
 *
 * SPDX-License-Identifier: Apache-2.0
 */

#include <mem.h>
#include <gd/gd32f4xx/gd32f450.dtsi>

&flash0 {
	reg = <0x08000000 DT_SIZE_K(3072)>;
};
