/*
 * Copyright (c) 2022 YuLong Yao <feilongphone@gmail.com>
 *
 * SPDX-License-Identifier: Apache-2.0
 */

#include <mem.h>
#include <gd/gd32a50x/gd32a50x.dtsi>

&flash0 {
	reg = <0x08000000 DT_SIZE_K(384)>;
};

&sram0 {
	reg = <0x20000000 DT_SIZE_K(48)>;
};
