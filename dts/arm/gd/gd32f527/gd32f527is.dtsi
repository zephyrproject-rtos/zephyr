/*
 * Copyright (c) 2026 GigaDevice Semiconductor Inc.
 *
 * SPDX-License-Identifier: Apache-2.0
 */

#include <mem.h>
#include <gd/gd32f527/gd32f527.dtsi>

&flash0 {
	reg = <0x08000000 DT_SIZE_K(4096)>;
	ranges = <0x0 0x08000000 DT_SIZE_K(4096)>;
};

&flash1 {
	status = "okay";
};
