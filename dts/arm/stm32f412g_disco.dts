/*
 * Copyright (c) 2017 Powersoft
 *
 * SPDX-License-Identifier: Apache-2.0
 */

/dts-v1/;
#include <st/stm32f412.dtsi>

/ {
	model = "STMicroelectronics STM32F412G-DISCO board";
	compatible = "st,stm32f412g-disco", "st,stm32f412";

	chosen {
		zephyr,console = &usart2;
		zephyr,sram = &sram0;
		zephyr,flash = &flash0;
	};
};

&usart2 {
	current-speed = <115200>;
	pinctrl-0 = <&usart2_pins_a>;
	pinctrl-names = "default";
	status = "ok";
};
