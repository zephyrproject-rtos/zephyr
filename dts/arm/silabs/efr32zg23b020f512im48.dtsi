/*
 * Copyright (c) 2024 Yishai Jaffe
 *
 * SPDX-License-Identifier: Apache-2.0
 */

#include <mem.h>
#include <silabs/efr32xg23.dtsi>

/ {
	sram0: memory@20000000 {
		reg = <0x20000000 DT_SIZE_K(64)>;
	};

	soc {
		compatible = "silabs,efr32zg23b020f512im48",
					"silabs,efr32zg23", "silabs,efr32",
					"simple-bus";
	};
};

&flash0 {
	reg = <0x08000000 DT_SIZE_K(512)>;
};
