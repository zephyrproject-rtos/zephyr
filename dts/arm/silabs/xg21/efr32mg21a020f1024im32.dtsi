/*
 * Copyright (c) 2019 Steven Lemaire
 *
 * SPDX-License-Identifier: Apache-2.0
 */

#include <mem.h>
#include <silabs/xg21/efr32mg21.dtsi>

/ {
	soc {
		compatible = "silabs,efr32mg21a020f1024im32", "silabs,efr32mg21", "silabs,efr32", "simple-bus";
	};
};

&flash0 {
	reg = <0 DT_SIZE_K(1024)>;
};

&sram0 {
	reg = <0x20000000 DT_SIZE_K(96)>;
};
