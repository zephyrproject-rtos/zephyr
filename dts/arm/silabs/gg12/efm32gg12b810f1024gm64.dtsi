/*
 * Copyright (c) 2023 Antmicro <www.antmicro.com>
 *
 * SPDX-License-Identifier: Apache-2.0
 */

#include <mem.h>
#include <silabs/gg12/efm32gg12.dtsi>

/ {
	soc {
		compatible = "silabs,efm32gg12b", "silabs,efm32gg12", "silabs,efm32", "simple-bus";
	};
};

&flash0 {
	reg = <0 DT_SIZE_K(1024)>;
};

&sram0 {
	reg = <0x20000000 DT_SIZE_K(192)>;
};
