/*
 * Copyright (c) 2025 Silicon Laboratories Inc.
 *
 * SPDX-License-Identifier: Apache-2.0
 */

#include <silabs/xg22/xg22.dtsi>

/ {
	soc {
		radio: radio@b0000000 {
			compatible = "silabs,series2-radio";
			reg = <0xb0000000 0x01000000>;
			interrupt-names = "agc", "bufc", "frc_pri", "frc", "modem", "protimer",
					  "rac_rsm", "rac_seq", "rdmailbox", "rfsense", "prortc",
					  "synth";
			interrupts = <31 1>, <32 1>, <33 1>, <34 1>, <35 1>, <36 1>, <37 1>,
				     <38 1>, <39 1>, <40 1>, <41 1>, <42 1>;
			pa-2p4ghz = "highest";
			pa-initial-power-dbm = <10>;
			pa-ramp-time-us = <2>;
			pa-voltage-mv = <3300>;
			ble-2mbps-supported;
			ble-coded-phy-supported;
			ble-cte-tx-supported;
			ble-cte-rx-supported;
			radio-tx-high-power-supported;

			pti: pti {
				compatible = "silabs,pti";
				clock-frequency = <DT_FREQ_K(1600)>;
				mode = "uart";
				status = "disabled";
			};
		};
	};
};
