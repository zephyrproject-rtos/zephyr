/*
 * Copyright (c) 2021 Sateesh Kotapati
 * Copyright (c) 2025 Silicon Laboratories Inc.
 *
 * SPDX-License-Identifier: Apache-2.0
 */

#include <mem.h>
#include <silabs/xg22/efr32bg22.dtsi>

/ {
	soc {
		compatible = "silabs,efr32bg22c222f352gn32", "silabs,efr32bg22", "silabs,xg22",
			     "silabs,efr32", "simple-bus";
	};
};

&flash0 {
	reg = <0x00000000 DT_SIZE_K(352)>;
};

&sram0 {
	reg = <0x20000000 DT_SIZE_K(32)>;
};
