/*
 * Copyright (c) 2018 Linaro Limited
 *
 * SPDX-License-Identifier: Apache-2.0
 */

#include <mem.h>
#include <silabs/xg1/xg1.dtsi>

/ {
	soc {
		compatible = "silabs,efr32fg1p133f256gm48", "silabs,efr32fg1p", "silabs,efr32", "simple-bus";
	};
};

&flash0 {
	reg = <0 DT_SIZE_K(256)>;
};

&sram0 {
	reg = <0x20000000 DT_SIZE_K(32)>;
};
