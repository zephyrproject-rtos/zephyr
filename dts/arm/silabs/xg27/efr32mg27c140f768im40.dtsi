/*
 * Copyright (c) 2025 Silicon Laboratories Inc.
 *
 * SPDX-License-Identifier: Apache-2.0
 */

#include <mem.h>
#include <silabs/xg27/efr32mg27.dtsi>

/ {
	soc {
		compatible = "silabs,efr32mg27c140f768im40", "silabs,efr32mg27", "silabs,xg27",
			     "silabs,efr32", "simple-bus";
	};
};

&flash0 {
	reg = <0x08000000 DT_SIZE_K(768)>;
};

&sram0 {
	reg = <0x20000000 DT_SIZE_K(64)>;
};
