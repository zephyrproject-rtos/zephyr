/*
 * Copyright (c) 2018 Linaro Limited
 *
 * SPDX-License-Identifier: Apache-2.0
 */

#include <mem.h>
#include <silabs/efm32wg.dtsi>

/ {
	soc {
		compatible = "silabs,efm32wg990f256", "silabs,efm32wg", "silabs,efm32", "simple-bus";
	};
};

&flash0 {
	reg = <0 DT_SIZE_K(256)>;
};

&sram0 {
	reg = <0x20000000 DT_SIZE_K(32)>;
};
