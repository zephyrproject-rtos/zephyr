/*
 * Copyright (c) 2021 Sateesh Kotapati
 *
 * SPDX-License-Identifier: Apache-2.0
 */

#include <mem.h>
#include <silabs/efr32bg22.dtsi>

/ {
	soc {
		compatible = "silabs,efr32bg22c224f512im40", "silabs,efr32bg22",
						   "silabs,efr32", "simple-bus";
	};
};

&sram0 {
	reg = <0x20000000 DT_SIZE_K(32)>;
};

&flash0 {
	reg = <0 DT_SIZE_K(512)>;
};
