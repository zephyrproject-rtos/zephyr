/*
 * Copyright (c) 2020 Piotr Mienkowski
 *
 * SPDX-License-Identifier: Apache-2.0
 */

#include <mem.h>
#include <silabs/xg13/efr32xg13.dtsi>

/ {
	soc {
		compatible = "silabs,efr32mg13p732f512gm48", "silabs,efr32mg13p", "silabs,efr32",
			     "simple-bus";
	};
};

&flash0 {
	reg = <0 DT_SIZE_K(512)>;
	ranges = <0 0 DT_SIZE_K(512)>;
};

&sram0 {
	reg = <0x20000000 DT_SIZE_K(64)>;
};
