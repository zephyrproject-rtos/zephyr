/*
 * Copyright (c) 2025 Silicon Laboratories Inc.
 *
 * SPDX-License-Identifier: Apache-2.0
 */

#include <silabs/xg26/efr32xg26.dtsi>

&radio {
	pa-2p4ghz = "highest";

	bt_hci_silabs: bt_hci_silabs {
		compatible = "silabs,bt-hci-efr32";
		status = "disabled";
	};

	ieee802154: ieee802154 {
		compatible = "silabs,efr32-ieee802154";
		status = "disabled";
	};
};
