/*
 * Copyright (c) 2025 Silicon Laboratories Inc.
 *
 * SPDX-License-Identifier: Apache-2.0
 */

#include <mem.h>
#include <silabs/xg26/efr32mg26.dtsi>

/ {
	soc {
		compatible = "silabs,efr32mg26b211f3200im48", "silabs,efr32mg26", "silabs,xg26",
			     "silabs,efr32", "simple-bus";
	};
};

&flash0 {
	reg = <0x08000000 DT_SIZE_K(3200)>;
};

&sram0 {
	reg = <0x20000000 DT_SIZE_K(256)>;
};
