/*
 * Copyright (c) 2025 Silicon Laboratories Inc.
 *
 * SPDX-License-Identifier: Apache-2.0
 */

#include <mem.h>
#include <silabs/xg26/efm32pg26.dtsi>

/ {
	soc {
		compatible = "silabs,efm32pg26b301f2048im68", "silabs,efm32pg26", "silabs,xg26",
			     "silabs,efm32", "simple-bus";
	};
};

&flash0 {
	reg = <0x08000000 DT_SIZE_K(2048)>;
};

&sram0 {
	reg = <0x20000000 DT_SIZE_K(256)>;
};
