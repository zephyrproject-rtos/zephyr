/*
 * Copyright (c) 2025 Silicon Laboratories Inc.
 *
 * SPDX-License-Identifier: Apache-2.0
 */

#include <mem.h>
#include <silabs/xg26/efm32pg26.dtsi>

/ {
	soc {
		compatible = "silabs,efm32pg26b500f3200im68", "silabs,efm32pg26", "silabs,xg26",
			     "silabs,efm32", "simple-bus";
	};
};

&flash0 {
	reg = <0x08000000 DT_SIZE_K(3200)>;
};

&sram0 {
	reg = <0x20000000 DT_SIZE_K(512)>;
};
