/*
 * Copyright (c) 2018 Christian Taedcke
 *
 * SPDX-License-Identifier: Apache-2.0
 */

#include <mem.h>
#include <silabs/efm32hg.dtsi>

/ {
	soc {
		compatible = "silabs,efm32hg322f64", "silabs,efm32hg", "silabs,efm32", "simple-bus";
	};
};

&flash0 {
	reg = <0 DT_SIZE_K(64)>;
};

&sram0 {
	reg = <0x20000000 DT_SIZE_K(8)>;
};
