/*
 * Copyright (c) 2019 Steven Lemaire
 *
 * SPDX-License-Identifier: Apache-2.0
 */

#include <mem.h>
#include <silabs/xg24/efr32mg24.dtsi>

/ {
	soc {
		compatible = "silabs,efr32mg24b310f1536im48", "silabs,efr32mg24", "silabs,xg24",
			     "silabs,efr32", "simple-bus";
	};
};

&flash0 {
	reg = <0x08000000 DT_SIZE_K(1536)>;
};

&sram0 {
	reg = <0x20000000 DT_SIZE_K(256)>;
};
