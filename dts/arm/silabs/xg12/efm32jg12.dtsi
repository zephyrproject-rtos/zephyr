/*
 * Copyright (c) 2018 Christian Taedcke <hacking@taedcke.com>
 * Copyright (c) 2019 Lemonbeat GmbH
 *
 * SPDX-License-Identifier: Apache-2.0
 */

#include <silabs/xg12/xg12.dtsi>

&cpu0 {
	compatible = "arm,cortex-m3";
	reg = <0>;
};
