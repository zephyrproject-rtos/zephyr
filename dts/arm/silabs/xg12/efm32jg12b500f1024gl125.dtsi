/*
 * Copyright (c) 2019 Lemonbeat GmbH
 *
 * SPDX-License-Identifier: Apache-2.0
 */

#include <mem.h>
#include <silabs/xg12/efm32jg12.dtsi>

/ {
	soc {
		compatible = "silabs,efm32jg12b500f1024gl125", "silabs,efm32jg12b", "silabs,efm32", "simple-bus";
	};
};

&flash0 {
	reg = <0 DT_SIZE_K(1024)>;
};

&sram0 {
	reg = <0x20000000 DT_SIZE_K(256)>;
};
