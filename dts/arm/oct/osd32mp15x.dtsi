/*
 * Copyright (c) 2024 Antmicro <www.antmicro.com>
 *
 * SPDX-License-Identifier: Apache-2.0
 */

#include <st/mp1/stm32mp157.dtsi>
#include <st/mp1/stm32mp157facx-pinctrl.dtsi>

&mailbox {
	status = "okay";
};

&rcc {
	clock-frequency = <DT_FREQ_M(209)>;
};

&spi4 {
	pinctrl-0 = <&spi4_nss_pe11 &spi4_sck_pe12
		     &spi4_miso_pe13 &spi4_mosi_pe14>;
	pinctrl-names = "default";
	status = "okay";
};
