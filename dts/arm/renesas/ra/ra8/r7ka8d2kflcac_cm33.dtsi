/*
 * Copyright (c) 2026 Renesas Electronics Corporation
 *
 * SPDX-License-Identifier: Apache-2.0
 */

#include <arm/armv8-m.dtsi>
#include <arm/renesas/ra/ra8/r7ka8d2kflcac.dtsi>

/delete-node/ &cpu0;

/delete-node/ &option_setting_ofs_conf_sec;
/delete-node/ &option_setting_ofs_otp_sec;
