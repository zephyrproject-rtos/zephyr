/*
 * Copyright (c) 2024 Ian Morris
 *
 * SPDX-License-Identifier: Apache-2.0
 */

#define RA_SOC_PINS 100
#define RA_SOC_HAS_MSTPCRE 1
#define RA_SOC_MSTPD5_CHANNELS 1

#include <zephyr/dt-bindings/clock/r7fa4m1xxxxxx-clock.h>
#include <renesas/ra/ra4-cm4-common.dtsi>
