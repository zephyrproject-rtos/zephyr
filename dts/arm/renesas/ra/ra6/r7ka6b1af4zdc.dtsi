/*
 * SPDX-FileCopyrightText: 2026 Renesas Electronics Corporation
 * SPDX-License-Identifier: Apache-2.0
 */

#include <renesas/ra/ra6/r7ka6b1-common.dtsi>

&sram0 {
	reg = <0x23000000 DT_SIZE_K(256)>;
};

&flash0 {
	reg = <0x04000000 DT_SIZE_K(1024)>;
	ranges = <0x0 0x04000000 DT_SIZE_K(1024)>;
};

&gpio0 {
	ngpios = <24>;
	status = "okay";
};

/delete-node/ &gpio1;
/delete-node/ &gpio2;
