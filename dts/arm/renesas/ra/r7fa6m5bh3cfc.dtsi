/*
 * Copyright (c) 2024 Piotr Rak <piotr.rak@gmail.com>
 *
 * SPDX-License-Identifier: Apache-2.0
 */

#define RA_SOC_PINS 176

#include <renesas/ra/ra6mxxh-common-sp-flash-2MB.dtsi>
#include <renesas/ra/ra6m-cm33-common.dtsi>
