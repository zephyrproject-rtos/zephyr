/*
 * Copyright (c) 2023 TOKITA Hiroshi <tokita.hiroshi@fujitsu.com>
 *
 * SPDX-License-Identifier: Apache-2.0
 */

#define RA_SOC_PINS 64
#define RA_SOC_HAS_MSTPCRE 1
#define RA_SOC_MSTPD5_CHANNELS 1

#include <renesas/ra/ra4-cm4-common.dtsi>
