/*
 * Copyright (c) 2018 Linaro Limited
 *
 * SPDX-License-Identifier: Apache-2.0
 */

#include <mem.h>
#include <nordic/nrf52832.dtsi>

&flash0 {
	reg = <0x00000000 DT_SIZE_K(512)>;
};

&sram0 {
	reg = <0x20000000 DT_SIZE_K(64)>;
};

/ {
	soc {
		compatible = "nordic,nrf52832-qfaa", "nordic,nrf52832",
			     "nordic,nrf52", "simple-bus";
	};
};
