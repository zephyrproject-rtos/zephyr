/*
 * Copyright (c) 2020 Nordic Semiconductor ASA
 *
 * SPDX-License-Identifier: Apache-2.0
 */

#include <mem.h>
#include <nordic/nrf52805.dtsi>

&flash0 {
	reg = <0x00000000 DT_SIZE_K(192)>;
};

&sram0 {
	reg = <0x20000000 DT_SIZE_K(24)>;
	ranges = <0x0 0x20000000 DT_SIZE_K(24)>;
};

/ {
	soc {
		compatible = "simple-bus";
	};
};
