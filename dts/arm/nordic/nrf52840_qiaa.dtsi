/*
 * Copyright (c) 2018 Linaro Limited
 *
 * SPDX-License-Identifier: Apache-2.0
 */

#include <mem.h>
#include <nordic/nrf52840.dtsi>

&power {
	reg0: regulator@40000580 {
		compatible = "nordic,nrf52x-regulator-hv";
		reg = <0x40000580 0x1>;
		regulator-name = "REG0";
		status = "disabled";
	};
};
