/*
 * Copyright (c) 2018 Linaro Limited
 *
 * SPDX-License-Identifier: Apache-2.0
 */

#include <mem.h>
#include <nordic/nrf51822.dtsi>

&flash0 {
	reg = <0x00000000 DT_SIZE_K(128)>;
};

&sram0 {
	reg = <0x20000000 DT_SIZE_K(16)>;
	ranges = <0x0 0x20000000 DT_SIZE_K(16)>;
};

/ {
	soc {
		compatible = "simple-bus";
	};
};
