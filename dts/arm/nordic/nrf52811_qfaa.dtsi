/*
 * Copyright (c) 2019 Nordic Semiconductor ASA
 *
 * SPDX-License-Identifier: Apache-2.0
 */

#include <mem.h>
#include <nordic/nrf52811.dtsi>

&flash0 {
	reg = <0x00000000 DT_SIZE_K(192)>;
};

&sram0 {
	reg = <0x20000000 DT_SIZE_K(24)>;
};

/ {
	soc {
		compatible = "nordic,nrf52811-qfaa", "nordic,nrf52811",
			     "nordic,nrf52", "simple-bus";
	};
};
