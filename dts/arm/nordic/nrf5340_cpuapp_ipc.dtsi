/*
 * Copyright (c) 2022 Nordic Semiconductor ASA
 *
 * SPDX-License-Identifier: Apache-2.0
 */

ipc0: ipc0 {
	compatible = "zephyr,ipc-openamp-static-vrings";
	memory-region = <&sram0_shared>;
	mboxes = <&mbox 0>, <&mbox 1>;
	mbox-names = "tx", "rx";
	role = "host";
	status = "okay";

	bt_hci_ipc0: bt_hci_ipc0 {
		compatible = "zephyr,bt-hci-ipc";
		status = "okay";
	};
};
