/*
 * Copyright (c) 2018 Linaro Limited
 *
 * SPDX-License-Identifier: Apache-2.0
 */

#include <mem.h>
#include <nordic/nrf52810.dtsi>

&sram0 {
	reg = <0x20000000 DT_SIZE_K(24)>;
	ranges = <0x0 0x20000000 DT_SIZE_K(24)>;
};
