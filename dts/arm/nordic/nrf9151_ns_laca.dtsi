/*
 * Copyright (c) 2023 Nordic Semiconductor ASA
 *
 * SPDX-License-Identifier: Apache-2.0
 */

#include <mem.h>
#include <arm/nordic/nrf91_ns.dtsi>

&sram0 {
	reg = <0x20000000 DT_SIZE_K(256)>;
	ranges = <0x0 0x20000000 DT_SIZE_K(256)>;
};
