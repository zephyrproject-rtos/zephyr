/*
 * Copyright (c) 2024 Nordic Semiconductor ASA
 *
 * SPDX-License-Identifier: Apache-2.0
 */

#include <arm/nordic/nrf54l15_cpuapp.dtsi>

/delete-node/ &pdm20;
/delete-node/ &pdm21;

&cpuapp_vevif_rx {
	nordic,events-mask = <0x00008000>;
};

&cpuapp_vevif_tx {
	nordic,tasks-mask = <0x0003f800>;
};
