/*
 * Copyright (c) 2019 - 2020 Nordic Semiconductor ASA
 *
 * SPDX-License-Identifier: Apache-2.0
 */

#include <mem.h>
#include <nordic/nrf5340_cpunet.dtsi>

&sram0 {
	reg = <0x20000000 DT_SIZE_K(512)>;
	ranges = <0x0 0x20000000 DT_SIZE_K(512)>;
};

&sram1 {
	reg = <0x21000000 DT_SIZE_K(64)>;
	ranges = <0x0 0x21000000 DT_SIZE_K(64)>;
};
