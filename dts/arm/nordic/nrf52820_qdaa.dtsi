/*
 * Copyright (c) 2020 Nordic Semiconductor ASA
 *
 * SPDX-License-Identifier: Apache-2.0
 */

#include <mem.h>
#include <nordic/nrf52820.dtsi>

&flash0 {
	reg = <0x00000000 DT_SIZE_K(256)>;
};

&sram0 {
	reg = <0x20000000 DT_SIZE_K(32)>;
};

/ {
	soc {
		compatible = "nordic,nrf52820-qdaa", "nordic,nrf52820",
			     "nordic,nrf52", "simple-bus";
	};
};
