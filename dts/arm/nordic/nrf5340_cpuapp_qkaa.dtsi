/*
 * Copyright (c) 2020 Nordic Semiconductor ASA
 *
 * SPDX-License-Identifier: Apache-2.0
 */

#include <mem.h>
#include <nordic/nrf5340_cpuapp.dtsi>

&sram0 {
	reg = <0x20000000 DT_SIZE_K(512)>;
	ranges = <0x0 0x20000000 DT_SIZE_K(512)>;
};
