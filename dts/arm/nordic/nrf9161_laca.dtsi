/*
 * Copyright (c) 2023 Nordic Semiconductor ASA
 *
 * SPDX-License-Identifier: Apache-2.0
 */

#include <mem.h>
#include <nordic/nrf91.dtsi>

&flash0 {
	reg = <0x00000000 DT_SIZE_K(1024)>;
};

&sram0 {
	reg = <0x20000000 DT_SIZE_K(256)>;
};

/ {
	soc {
		compatible = "nordic,nrf9161-laca", "nordic,nrf9120",
			     "nordic,nrf91", "simple-bus";
	};
};
