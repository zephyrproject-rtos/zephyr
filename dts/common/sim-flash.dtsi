/*
 * Copyright (c) 2018 Nordic Semiconductor ASA.
 *
 * SPDX-License-Identifier: Apache-2.0
 */

/*
 * Basic Device Tree file for simulated flash entry declaration.
 */

/ {
	sim_flash {
		compatible = "sim-flash";
		label = "FLASH_SIMULATOR";

		#address-cells = <1>;
		#size-cells = <1>;

		flash_sim0: flash_sim@0 {
			compatible = "soc-nv-flash";
			reg = <0x00000000 DT_FLASH_SIZE>;

			erase-block-size = <1024>;
			write-block-size = <4>;
		};
	};
};
