/*
 * Copyright (c) 2026 Renesas Electronics Corporation
 *
 * SPDX-License-Identifier: Apache-2.0
 */

#include <rh850/renesas/rh850u2b/r7f7025xx.dtsi>

/* Peripheral definition following RH850/U2B6 devices */
/ {
	cpus {
		cpu1: cpu@1 {
			status = "disabled";
		};

		cpu2: cpu@2 {
			status = "disabled";
		};
	};
};
