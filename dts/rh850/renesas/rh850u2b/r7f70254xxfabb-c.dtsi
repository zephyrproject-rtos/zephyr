/*
 * Copyright (c) 2026 Renesas Electronics Corporation
 *
 * SPDX-License-Identifier: Apache-2.0
 */

#include <rh850/renesas/rh850u2b/r7f70254.dtsi>

/* Peripheral definition following RH850/U2B10 292pin devices */
/ {
	soc {
		flash0: flash@0 {
			reg = <0x0 DT_SIZE_M(10)>;
		};

		sram0: memory@fe000000 {
			reg = <0xfe000000 DT_SIZE_K(480)>;
		};

		/* Delete gpio node P15, P24, P30, P31 */
		/delete-node/ gpio@ffd903c0;
		/delete-node/ gpio@ffd90600;
		/delete-node/ gpio@ffd90780;
		/delete-node/ gpio@ffd907c0;
	};
};
