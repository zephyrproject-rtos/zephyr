/*
 * Copyright (c) 2025 marrowbuster <info@marrowbuster.com>
 *
 * SPDX-License-Identifier: Apache-2.0
 */

 /dts-v1/;

#include <skeleton.dtsi>

/ {
    cpus {
        #address-cells = <1>;
		#size-cells = <0>;

        cpu0: cpu@0 {
            device_type = "cpu";
            compatible = "hazard3,cpu", "riscv";
            riscv,isa = "rv32imac_zicsr_zifencei_zba_zbb_zbc_zbs_zbkb_zcb_zcmp";
            reg = <0>;

            xh3irq: interrupt-controller@be0 {
                compatible = "hazard3,interrupt-controller";
                reg = <0xbe0 0x18>;
                interrupt-controller;
                #interrupt-cells = <1>;
            }
        };
    };
};