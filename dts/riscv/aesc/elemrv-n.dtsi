/*
 * Copyright (c) 2025 Aesc Silicon
 *
 * SPDX-License-Identifier: Apache-2.0
 */

#include <aesc/nitrogen.dtsi>

/ {
	#address-cells = <1>;
	#size-cells = <1>;

	soc {
		#address-cells = <1>;
		#size-cells = <1>;
		compatible = "aesc,elemrv-n-soc", "simple-bus";
		ranges;

		gpio0: gpio@f0000000 {
			compatible = "aesc,gpio";
			reg = <0xf0000000 0x1000>;
			gpio-controller;
			#gpio-cells = <2>;
			ngpios = <12>;
			status = "disabled";
		};

		uart0: uart0@f0006000 {
			compatible = "aesc,uart";
			reg = <0xf0006000 0x1000>;
			status = "disabled";
		};
	};
};
