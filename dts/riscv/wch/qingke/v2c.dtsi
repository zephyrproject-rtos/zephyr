/*
 * Copyright (c) 2026 Mike Kasprzak (distraction.engineer)
 *
 * SPDX-License-Identifier: Apache-2.0
 */

#include "common.dtsi"

/ {
	#address-cells = <1>;
	#size-cells = <1>;

	cpus {
		#address-cells = <1>;
		#size-cells = <0>;

		cpu0: cpu@0 {
			device_type = "cpu";
			compatible = "wch,qingke-v2c", "riscv";
			reg = <0>;
			riscv,isa-base = "rv32e";
			riscv,isa-extensions = "e", "c", "zicsr", "zifencei", "zmmul";
		};
	};
};
