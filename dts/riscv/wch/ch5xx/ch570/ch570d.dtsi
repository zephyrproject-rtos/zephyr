/*
 * Copyright (c) 2026 Mike Kasprzak (distraction.engineer)
 *
 * SPDX-License-Identifier: Apache-2.0
 */

#define SOC_CODEFLASH_SIZE	DT_SIZE_K(240)
#define SOC_SRAM_SIZE		DT_SIZE_K(12)

#include "../ch572.dtsi"
