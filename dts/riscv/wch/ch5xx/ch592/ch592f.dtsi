/*
 * Copyright (c) 2026 Mike Kasprzak (distraction.engineer)
 *
 * SPDX-License-Identifier: Apache-2.0
 */

#include <mem.h>

#define SOC_CODEFLASH_SIZE	DT_SIZE_K(448)
#define SOC_SRAM_SIZE		DT_SIZE_K(24)

#include "../ch592.dtsi"
