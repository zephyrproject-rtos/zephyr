/*
 * Copyright (c) 2025 Paul Wedeck
 *
 * SPDX-License-Identifier: Apache-2.0
 */

#include <wch/ch32l103/ch32l103.dtsi>

&gpioa {
        gpio-reserved-ranges = <15, 1>;
};

&gpiob {
        gpio-reserved-ranges = <2, 4>, <8, 2>, <12, 1>;
};
