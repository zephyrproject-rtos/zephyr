/*
 * Copyright (c) 2025 Paul Wedeck
 *
 * SPDX-License-Identifier: Apache-2.0
 */

#include <wch/ch32l103/ch32l103.dtsi>

&gpioa {
        gpio-reserved-ranges = <9, 3>, <15, 1>;
};

&gpiob {
        gpio-reserved-ranges = <0, 1>, <2, 4>, <9, 7>;
};
