/*
 * Copyright (c) 2022 TOKITA Hiroshi <tokita.hiroshi@gmail.com>
 *
 * SPDX-License-Identifier: Apache-2.0
 */

#include <mem.h>
#include <wch/ch32v.dtsi>

&sram0 {
	reg = <0x20000000 DT_SIZE_K(64)>;
};

&flash0 {
	reg = <0x00000000 DT_SIZE_K(256)>;
};
