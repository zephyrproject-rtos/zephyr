/*
 * Copyright (c) 2024 Michael Hope
 *
 * SPDX-License-Identifier: Apache-2.0
 */

#include <wch/ch32v0/ch32v003.dtsi>

&gpioc {
	gpio-reserved-ranges = <0 1>, <3 1>, <5 3>;
};

&gpiod {
	gpio-reserved-ranges = <0 1>, <2 2>, <7 1>;
};
