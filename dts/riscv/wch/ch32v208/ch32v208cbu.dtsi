/*
 * Copyright (c) 2025 MASSDRIVER EI (massdriver.space)
 *
 * SPDX-License-Identifier: Apache-2.0
 */

#include <wch/ch32v208/ch32v208.dtsi>

&gpioc {
	gpio-reserved-ranges = <0 13>;
};

&gpiod {
	gpio-reserved-ranges = <0 16>;
};
