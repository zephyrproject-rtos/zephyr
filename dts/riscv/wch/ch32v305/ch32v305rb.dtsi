/*
 * Copyright (c) 2026 James Bennion-Pedley
 *
 * SPDX-License-Identifier: Apache-2.0
 */

#include <wch/ch32v305/ch32v305.dtsi>

&gpiod {
	gpio-reserved-ranges = <3 13>;
};

&gpioe {
	gpio-reserved-ranges = <0 16>;
};
