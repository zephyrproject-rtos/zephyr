/*
 * Copyright (c) 2026 Andes Technology Corporation
 *
 * SPDX-License-Identifier: Apache-2.0
 */

#include <riscv/andes/andes_v5_ae350.dtsi>

&cpu0 {
	compatible = "andestech,a25", "andestech,andescore-v5", "riscv";
	riscv,isa-extensions = "i", "m", "a", "f", "d", "c", "zicsr", "zifencei",
			       "zba", "zbb", "zbc", "zbs", "xandes";
};
