/*
 * Copyright (c) 2026 Andes Technology Corporation
 *
 * SPDX-License-Identifier: Apache-2.0
 */

#include <riscv/andes/andes_v5_ae350.dtsi>

&cpu0 {
	compatible = "andestech,ax27", "andestech,andescore-v5", "riscv";
	mmu-type = "riscv,sv39";
	riscv,isa-base = "rv64i";
};
