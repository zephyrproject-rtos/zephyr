/*
 * Copyright (c) 2025 ITE Corporation. All Rights Reserved.
 *
 * SPDX-License-Identifier: Apache-2.0
 */

/ {
	cpus {
		cpu0: cpu@0 {
			compatible = "ite,riscv-ite", "riscv";
			riscv,isa-base = "rv32i";
			riscv,isa-extensions = "i", "m", "zba", "zbb", "zbs", "zicsr", "zifencei";
			device_type = "cpu";
			reg = <0>;
			clock-frequency = <32768>;
			cpu-power-states = <&standby>;
		};
	};
};
