/*
 * Copyright (c) 2024 Pratik Farkase <pratik.farkase@wsisweden.com>
 * Copyright (c) 2024 Sigma Connectivity WSI AB
 *
 * SPDX-License-Identifier: Apache-2.0
 */

/ {
	apb2clk: apb2clk {
		compatible = "fixed-clock";
		#clock-cells = <0>;
		clock-frequency = <125000000>;
	};

	uartclk: uartclk {
		compatible = "fixed-clock";
		#clock-cells = <0>;
		clock-frequency = <100000000>;
	};
};
