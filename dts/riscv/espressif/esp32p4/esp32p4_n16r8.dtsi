/*
 * Copyright (c) 2026 Espressif Systems (Shanghai) Co., Ltd.
 *
 * SPDX-License-Identifier: Apache-2.0
 */

#include "esp32p4_common.dtsi"

/* 16MB flash */
&flash0 {
	reg = <0x0 DT_SIZE_M(16)>;
	ranges = <0x0 0x0 DT_SIZE_M(16)>;
};

/* 8MB PSRAM */
&psram0 {
	size = <DT_SIZE_M(8)>;
};
