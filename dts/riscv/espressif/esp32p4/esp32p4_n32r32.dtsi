/*
 * Copyright (c) 2026 Hongquan Li
 *
 * SPDX-License-Identifier: Apache-2.0
 */

#include "esp32p4_common.dtsi"

/* 32MB flash */
&flash0 {
	reg = <0x0 DT_SIZE_M(32)>;
	ranges = <0x0 0x0 DT_SIZE_M(32)>;
};

/* 32MB PSRAM */
&psram0 {
	size = <DT_SIZE_M(32)>;
};
