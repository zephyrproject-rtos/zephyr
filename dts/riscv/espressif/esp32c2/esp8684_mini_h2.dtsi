/*
 * Copyright (c) 2024 Espressif Systems (Shanghai) Co., Ltd.
 *
 * SPDX-License-Identifier: Apache-2.0
 */

#include "esp32c2_common.dtsi"

&cpu0 {
	xtal-freq = <DT_FREQ_M(26)>;
};

/* 2MB flash */
&flash0 {
	reg = <0x0 DT_SIZE_M(2)>;
};
