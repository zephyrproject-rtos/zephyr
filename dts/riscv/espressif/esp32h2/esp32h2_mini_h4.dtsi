/*
 * Copyright (c) 2025 Espressif Systems (Shanghai) Co., Ltd.
 *
 * SPDX-License-Identifier: Apache-2.0
 */

#include "esp32h2_common.dtsi"

/* 4MB flash */
&flash0 {
	reg = <0x0 DT_SIZE_M(4)>;
	ranges = <0x0 0x0 DT_SIZE_M(4)>;
};
