/*
 * Copyright (c) 2025 Espressif Systems (Shanghai) Co., Ltd.
 *
 * SPDX-License-Identifier: Apache-2.0
 */

 #include "esp32h2_common.dtsi"

/* 2MB flash */
&flash0 {
	reg = <0x0 DT_SIZE_M(2)>;
};
