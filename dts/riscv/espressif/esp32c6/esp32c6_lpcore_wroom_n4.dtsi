/*
 * Copyright (c) 2025 Espressif Systems (Shanghai) Co., Ltd.
 *
 * SPDX-License-Identifier: Apache-2.0
 */

 #include "esp32c6_lpcore.dtsi"

/* 4MB flash */
&flash0 {
	reg = <0x0 DT_SIZE_M(4)>;
};
