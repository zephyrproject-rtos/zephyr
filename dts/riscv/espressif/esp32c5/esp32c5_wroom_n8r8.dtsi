/*
 * Copyright (c) 2026 Espressif Systems (Shanghai) Co., Ltd.
 *
 * SPDX-License-Identifier: Apache-2.0
 */

#include "esp32c5_common.dtsi"

/* 8MB flash */
&flash0 {
	reg = <0x0 DT_SIZE_M(8)>;
	ranges = <0x0 0x0 DT_SIZE_M(8)>;
};

/* 8MB psram */
&psram0 {
	size = <DT_SIZE_M(8)>;
};
