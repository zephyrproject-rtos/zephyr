/*
 * Copyright (c) 2021 Tokita, Hiroshi <tokita.hiroshi@gmail.com>
 *
 * SPDX-License-Identifier: Apache-2.0
 */

#include <mem.h>
#include <gigadevice/gd32vf103.dtsi>

&sram0 {
	reg = <0x20000000 DT_SIZE_K(20)>;
};

&flash0 {
	reg = <0x08000000 DT_SIZE_K(64)>;
};
