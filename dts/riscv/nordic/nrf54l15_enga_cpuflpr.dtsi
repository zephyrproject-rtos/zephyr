/*
 * Copyright (c) 2024 Nordic Semiconductor ASA
 *
 * SPDX-License-Identifier: Apache-2.0
 */

#include <riscv/nordic/nrf54l15_cpuflpr.dtsi>

/delete-node/ &pdm20;
/delete-node/ &pdm21;

&cpuflpr_vevif_rx {
	nordic,tasks-mask = <0x0003f800>;
	interrupts = <11 NRF_DEFAULT_IRQ_PRIORITY>,
			     <12 NRF_DEFAULT_IRQ_PRIORITY>,
			     <13 NRF_DEFAULT_IRQ_PRIORITY>,
			     <14 NRF_DEFAULT_IRQ_PRIORITY>,
			     <15 NRF_DEFAULT_IRQ_PRIORITY>,
			     <16 NRF_DEFAULT_IRQ_PRIORITY>,
			     <17 NRF_DEFAULT_IRQ_PRIORITY>;
};

&cpuflpr_vevif_tx {
		nordic,events-mask = <0x00008000>;
};
