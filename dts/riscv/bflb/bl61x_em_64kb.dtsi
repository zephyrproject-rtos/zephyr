/*
 * Copyright The Zephyr Project Contributors
 *
 * SPDX-License-Identifier: Apache-2.0
 */

/*
 * When BLE is enabled, the hardware reserves 64 KB of
 * exchange memory (EM) at the top of WRAM
 * (GLB_EM_SEL=0xF set in soc_prep_hook), reducing
 * usable RAM from 160 KB to 96 KB.
 */

&wram {
	reg = <0x50000 DT_SIZE_K(96)>;
	ranges = <0x0 0x50000 DT_SIZE_K(96)>;
};

&all_ram {
	reg = <0x62fc0000 DT_SIZE_K(416)>;
	ranges = <0x0 0x62fc0000 DT_SIZE_K(416)>;
};
