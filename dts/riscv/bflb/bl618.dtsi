/*
 * Copyright (c) 2024-2025 MASSDRIVER EI (massdriver.space)
 *
 * SPDX-License-Identifier: Apache-2.0
 */

#include <bflb/bl61x.dtsi>
#include <zephyr/dt-bindings/pinctrl/bl618x-pinctrl.h>

&psram {
	reg = <0xa8000000 DT_SIZE_M(4)>;
	status = "okay";
};
