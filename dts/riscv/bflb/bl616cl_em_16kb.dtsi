/*
 * Copyright The Zephyr Project Contributors
 *
 * SPDX-License-Identifier: Apache-2.0
 */

/*
 * When BLE is enabled, the hardware reserves 16 KB of
 * exchange memory (EM) at the top of WRAM
 * (GLB_EM_SEL=0x1 set in soc_prep_hook), reducing
 * usable RAM from 160 KB to 144 KB.
 */

&wram {
	reg = <0x38000 DT_SIZE_K(144)>;
	ranges = <0x0 0x38000 DT_SIZE_K(144)>;
};

&all_ram {
	reg = <0x60fc0000 DT_SIZE_K(368)>;
	ranges = <0x0 0x60fc0000 DT_SIZE_K(368)>;
};
