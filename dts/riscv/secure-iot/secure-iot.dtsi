/dts-v1/;

#include <riscv64-secure-iot.dtsi>

/ {
	model = "shakti,spike-bare";
	compatible = "shakti,spike-bare-dev";

chosen {
		zephyr,console = &uart0;
	};


};

&uart0 {
	status = "ok";
	current-speed = <19200>;
	clock-frequency = <40000000>;
};

gpio0: gpio@40200 {
          compatible = "shakti,gpio0";
          reg = < 0x0 0x40200 0x0 0x08>;
};

pwm0: pwm@30000 {
  compatible = "shakti,pwm0";
         reg= < 0x0 0x30000 0x0 0x100>;
         status = "okay";
};


