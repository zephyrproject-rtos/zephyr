/*
 * SPDX-FileCopyrightText: Copyright The Zephyr Project Contributors
 *
 * SPDX-License-Identifier: Apache-2.0
 */

/dts-v1/;

#include <qemu/virt-riscv32.dtsi>
#include <qemu/virt-riscv-aia.dtsi>

/ {
	cpus {
		riscv,isa-extensions = "i", "m", "a", "f", "d", "c", "zicsr",
				       "zifencei", "zkr", "smcsrind", "smaia", "ssaia";
	};
};
