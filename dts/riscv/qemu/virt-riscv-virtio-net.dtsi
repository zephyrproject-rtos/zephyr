/*
 * SPDX-FileCopyrightText: Copyright The Zephyr Project Contributors
 *
 * SPDX-License-Identifier: Apache-2.0
 */

&virtio_mmio0 {
	status = "okay";

	virtio_net: virtio-net {
		compatible = "virtio,net";
		zephyr,random-mac-address;
		status = "okay";
	};
};
