/*
 * Copyright (c) 2023 Espressif Systems (Shanghai) Co., Ltd.
 *
 * SPDX-License-Identifier: Apache-2.0
 */

#include "esp32_common.dtsi"

/* Reserved GPIO pins */
&gpio0 {
	gpio-reserved-ranges = <6 6>, // flash
			<24 2>, <28 4>; // NC
};

/* 8MB flash */
&flash0 {
	reg = <0x0 DT_SIZE_M(8)>;
};

/* 2MB psram */
&psram0 {
	size = <DT_SIZE_M(2)>;
};
