/*
 * Copyright (c) 2023 Espressif Systems (Shanghai) Co., Ltd.
 *
 * SPDX-License-Identifier: Apache-2.0
 */

#include "esp32_common.dtsi"

/* Reserved GPIO pins */
&gpio0 {
	gpio-reserved-ranges = <6 11>,<16 17>,  // flash&psram
			<20>,<24>,<28 31>; // NC
};

&gpio1 {
	gpio-reserved-ranges = <6>,<7>; // GPIO37-38 NC
};

/* 4MB flash */
&flash0 {
	reg = <0x0 DT_SIZE_M(4)>;
};

/* 8MB psram */
&psram0 {
	reg = <0x3f800000 DT_SIZE_M(8)>;
	status = "okay";
};
