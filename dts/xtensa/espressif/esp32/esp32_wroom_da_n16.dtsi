/*
 * Copyright (c) 2023 Espressif Systems (Shanghai) Co., Ltd.
 *
 * SPDX-License-Identifier: Apache-2.0
 */

#include "esp32_common.dtsi"

/* Reserved GPIO pins */
&gpio0 {
	gpio-reserved-ranges = <2>,<25>, // NC/test
				<6 11>, // flash
				<20>,<24>,<28 31>; // NC
};

&gpio1 {
	gpio-reserved-ranges = <6>,<7>; // GPIO37-38 NC
};

/* 16MB flash */
&flash0 {
	reg = <0x0 DT_SIZE_M(16)>;
};
