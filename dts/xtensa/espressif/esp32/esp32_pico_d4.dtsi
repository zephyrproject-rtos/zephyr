/*
 * Copyright (c) 2023 Espressif Systems (Shanghai) Co., Ltd.
 *
 * SPDX-License-Identifier: Apache-2.0
 */

#include "esp32_common.dtsi"

/* Reserved GPIO pins */
&gpio0 {
	gpio-reserved-ranges = <6 3>, <11 1>, <16 2>, // embedded flash
			       <20 1>, <24 1>, <28 4>; // NC
};

/* 4MB flash */
&flash0 {
	reg = <0x0 DT_SIZE_M(4)>;
};
