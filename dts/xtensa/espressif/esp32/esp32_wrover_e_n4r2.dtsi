/*
 * Copyright (c) 2023 Espressif Systems (Shanghai) Co., Ltd.
 *
 * SPDX-License-Identifier: Apache-2.0
 */

#include "esp32_common.dtsi"

/* Reserved GPIO pins */
&gpio0 {
	gpio-reserved-ranges = <6 6>, <16 2>,  // flash&psram
			<20 1>, <24 1>, <28 4>; // NC
};

&gpio1 {
	gpio-reserved-ranges = <6 1>, <7 1>; // GPIO37-38 NC
};

/* 4MB flash */
&flash0 {
	reg = <0x0 DT_SIZE_M(4)>;
};

/* 2MB psram */
&psram0 {
	reg = <0x3f800000 DT_SIZE_M(2)>;
	status = "okay";
};
