/*
 * Copyright (c) 2023 Espressif Systems (Shanghai) Co., Ltd.
 *
 * SPDX-License-Identifier: Apache-2.0
 */

#include "esp32_common.dtsi"

/* Reserved GPIO pins */
&gpio0 {
	gpio-reserved-ranges = <16 18>,<23>,	// limitations
				<24>,<28 31>;	// NC
};

/* 4MB flash */
&flash0 {
	reg = <0x0 DT_SIZE_M(4)>;
};
