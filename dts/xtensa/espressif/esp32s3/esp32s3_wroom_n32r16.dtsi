/*
 * Copyright (c) 2023 Espressif Systems (Shanghai) Co., Ltd.
 *
 * SPDX-License-Identifier: Apache-2.0
 */

#include "esp32s3_common.dtsi"

/* 32MB flash */
&flash0 {
	reg = <0x0 DT_SIZE_M(32)>;
};

/* 16MB psram */
&psram0 {
	size = <DT_SIZE_M(16)>;
};
