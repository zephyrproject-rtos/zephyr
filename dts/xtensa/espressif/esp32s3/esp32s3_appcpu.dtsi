/*
 * Copyright (c) 2023 Espressif Systems (Shanghai) Co., Ltd.
 *
 * SPDX-License-Identifier: Apache-2.0
 */

#include "esp32s3_common.dtsi"

&sram1 {
	reg = <0x3fc88000 DT_SIZE_K(416)>;
	status = "okay";
};
