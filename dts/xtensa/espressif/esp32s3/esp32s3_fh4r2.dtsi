/*
 * Copyright (c) 2023 marrowbuster <info@marrowbuster.com>
 *
 * SPDX-License-Identifier: Apache-2.0
 */

#include "esp32s3_common.dtsi"
#include "esp32s3_r2.dtsi"

/* 4MB flash */
&flash0 {
	size = <0x0 DT_SIZE_M(4)>;
};
