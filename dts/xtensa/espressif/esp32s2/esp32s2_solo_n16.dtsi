/*
 * Copyright (c) 2023 Espressif Systems (Shanghai) Co., Ltd.
 *
 * SPDX-License-Identifier: Apache-2.0
 */

#include "esp32s2_common.dtsi"

/* 16 MB flash */
&flash0 {
	reg = <0x0 DT_SIZE_M(16)>;
};
