/*
 * Copyright (c) 2023 Espressif Systems (Shanghai) Co., Ltd.
 *
 * SPDX-License-Identifier: Apache-2.0
 */

#include "esp32s2_common.dtsi"

/* 4MB flash */
&flash0 {
	reg = <0x0 DT_SIZE_M(4)>;
};

/* 2MB psram */
&psram0 {
	size = <DT_SIZE_M(2)>;
};
