/*
 * SPDX-FileCopyrightText: Copyright (c) 2024 Infineon Technologies AG,
 * SPDX-FileCopyrightText: or an affiliate of Infineon Technologies AG. All rights reserved.
 * SPDX-FileCopyrightText: Copyright (c) 2026 Linumiz
 *
 * SPDX-License-Identifier: Apache-2.0
 */

/*
 * Generated by soc/infineon/aurix/tools/gen_pinctrl.py from the port function
 * tables of TC37xAA_DS_v1.1.pdf, pages 113-193
 * (sha256 6ebe484239d9a532249f21e82b66ad760f516111d75793df466d1f82ae60680a).
 *
 * Do not edit this file manually: regenerate it with the script.
 */

#include <zephyr/dt-bindings/pinctrl/infineon-aurix-pinctrl.h>

&pinctrl {
	/omit-if-no-ref/ asclin0_actsa_p14_9: asclin0_actsa_p14_9 {
		pinmux = <AURIX_PINMUX(14, 9, 0)>;
	};

	/omit-if-no-ref/ asclin0_arts_p14_7: asclin0_arts_p14_7 {
		pinmux = <AURIX_PINMUX(14, 7, 2)>;
		output-enable;
	};

	/omit-if-no-ref/ asclin0_arxa_p14_1: asclin0_arxa_p14_1 {
		pinmux = <AURIX_PINMUX(14, 1, 0)>;
	};

	/omit-if-no-ref/ asclin0_arxb_p15_3: asclin0_arxb_p15_3 {
		pinmux = <AURIX_PINMUX(15, 3, 1)>;
	};

	/omit-if-no-ref/ asclin0_arxd_p33_10: asclin0_arxd_p33_10 {
		pinmux = <AURIX_PINMUX(33, 10, 3)>;
	};

	/omit-if-no-ref/ asclin0_asclk_p14_0: asclin0_asclk_p14_0 {
		pinmux = <AURIX_PINMUX(14, 0, 6)>;
		output-enable;
	};

	/omit-if-no-ref/ asclin0_asclk_p15_2: asclin0_asclk_p15_2 {
		pinmux = <AURIX_PINMUX(15, 2, 6)>;
		output-enable;
	};

	/omit-if-no-ref/ asclin0_atx_p14_0: asclin0_atx_p14_0 {
		pinmux = <AURIX_PINMUX(14, 0, 2)>;
		output-enable;
	};

	/omit-if-no-ref/ asclin0_atx_p14_1: asclin0_atx_p14_1 {
		pinmux = <AURIX_PINMUX(14, 1, 2)>;
		output-enable;
	};

	/omit-if-no-ref/ asclin0_atx_p15_2: asclin0_atx_p15_2 {
		pinmux = <AURIX_PINMUX(15, 2, 2)>;
		output-enable;
	};

	/omit-if-no-ref/ asclin0_atx_p15_3: asclin0_atx_p15_3 {
		pinmux = <AURIX_PINMUX(15, 3, 2)>;
		output-enable;
	};

	/omit-if-no-ref/ asclin0_atx_p33_9: asclin0_atx_p33_9 {
		pinmux = <AURIX_PINMUX(33, 9, 6)>;
		output-enable;
	};

	/omit-if-no-ref/ asclin10_arxa_p0_4: asclin10_arxa_p0_4 {
		pinmux = <AURIX_PINMUX(0, 4, 0)>;
	};

	/omit-if-no-ref/ asclin10_arxb_p0_8: asclin10_arxb_p0_8 {
		pinmux = <AURIX_PINMUX(0, 8, 1)>;
	};

	/omit-if-no-ref/ asclin10_arxc_p13_0: asclin10_arxc_p13_0 {
		pinmux = <AURIX_PINMUX(13, 0, 2)>;
	};

	/omit-if-no-ref/ asclin10_arxd_p13_1: asclin10_arxd_p13_1 {
		pinmux = <AURIX_PINMUX(13, 1, 3)>;
	};

	/omit-if-no-ref/ asclin10_asclk_p13_2: asclin10_asclk_p13_2 {
		pinmux = <AURIX_PINMUX(13, 2, 2)>;
		output-enable;
	};

	/omit-if-no-ref/ asclin10_aslso_p13_3: asclin10_aslso_p13_3 {
		pinmux = <AURIX_PINMUX(13, 3, 2)>;
		output-enable;
	};

	/omit-if-no-ref/ asclin10_atx_p0_8: asclin10_atx_p0_8 {
		pinmux = <AURIX_PINMUX(0, 8, 3)>;
		output-enable;
	};

	/omit-if-no-ref/ asclin10_atx_p13_0: asclin10_atx_p13_0 {
		pinmux = <AURIX_PINMUX(13, 0, 2)>;
		output-enable;
	};

	/omit-if-no-ref/ asclin11_arxa_p10_0: asclin11_arxa_p10_0 {
		pinmux = <AURIX_PINMUX(10, 0, 0)>;
	};

	/omit-if-no-ref/ asclin11_arxb_p10_4: asclin11_arxb_p10_4 {
		pinmux = <AURIX_PINMUX(10, 4, 1)>;
	};

	/omit-if-no-ref/ asclin11_arxc_p21_0: asclin11_arxc_p21_0 {
		pinmux = <AURIX_PINMUX(21, 0, 2)>;
	};

	/omit-if-no-ref/ asclin11_arxd_p21_1: asclin11_arxd_p21_1 {
		pinmux = <AURIX_PINMUX(21, 1, 3)>;
	};

	/omit-if-no-ref/ asclin11_arxe_p21_2: asclin11_arxe_p21_2 {
		pinmux = <AURIX_PINMUX(21, 2, 4)>;
	};

	/omit-if-no-ref/ asclin11_arxf_p21_5: asclin11_arxf_p21_5 {
		pinmux = <AURIX_PINMUX(21, 5, 5)>;
	};

	/omit-if-no-ref/ asclin11_asclk_p21_3: asclin11_asclk_p21_3 {
		pinmux = <AURIX_PINMUX(21, 3, 2)>;
		output-enable;
	};

	/omit-if-no-ref/ asclin11_aslso_p21_4: asclin11_aslso_p21_4 {
		pinmux = <AURIX_PINMUX(21, 4, 2)>;
		output-enable;
	};

	/omit-if-no-ref/ asclin11_atx_p10_0: asclin11_atx_p10_0 {
		pinmux = <AURIX_PINMUX(10, 0, 2)>;
		output-enable;
	};

	/omit-if-no-ref/ asclin11_atx_p21_0: asclin11_atx_p21_0 {
		pinmux = <AURIX_PINMUX(21, 0, 2)>;
		output-enable;
	};

	/omit-if-no-ref/ asclin11_atx_p21_5: asclin11_atx_p21_5 {
		pinmux = <AURIX_PINMUX(21, 5, 3)>;
		output-enable;
	};

	/omit-if-no-ref/ asclin1_actsa_p20_7: asclin1_actsa_p20_7 {
		pinmux = <AURIX_PINMUX(20, 7, 0)>;
	};

	/omit-if-no-ref/ asclin1_actsb_p32_4: asclin1_actsb_p32_4 {
		pinmux = <AURIX_PINMUX(32, 4, 1)>;
	};

	/omit-if-no-ref/ asclin1_arts_p20_6: asclin1_arts_p20_6 {
		pinmux = <AURIX_PINMUX(20, 6, 2)>;
		output-enable;
	};

	/omit-if-no-ref/ asclin1_arts_p23_1: asclin1_arts_p23_1 {
		pinmux = <AURIX_PINMUX(23, 1, 2)>;
		output-enable;
	};

	/omit-if-no-ref/ asclin1_arxa_p15_1: asclin1_arxa_p15_1 {
		pinmux = <AURIX_PINMUX(15, 1, 0)>;
	};

	/omit-if-no-ref/ asclin1_arxb_p15_5: asclin1_arxb_p15_5 {
		pinmux = <AURIX_PINMUX(15, 5, 1)>;
	};

	/omit-if-no-ref/ asclin1_arxc_p20_9: asclin1_arxc_p20_9 {
		pinmux = <AURIX_PINMUX(20, 9, 2)>;
	};

	/omit-if-no-ref/ asclin1_arxd_p14_8: asclin1_arxd_p14_8 {
		pinmux = <AURIX_PINMUX(14, 8, 3)>;
	};

	/omit-if-no-ref/ asclin1_arxe_p11_10: asclin1_arxe_p11_10 {
		pinmux = <AURIX_PINMUX(11, 10, 4)>;
	};

	/omit-if-no-ref/ asclin1_arxf_p33_13: asclin1_arxf_p33_13 {
		pinmux = <AURIX_PINMUX(33, 13, 5)>;
	};

	/omit-if-no-ref/ asclin1_arxg_p2_3: asclin1_arxg_p2_3 {
		pinmux = <AURIX_PINMUX(2, 3, 6)>;
	};

	/omit-if-no-ref/ asclin1_asclk_p15_0: asclin1_asclk_p15_0 {
		pinmux = <AURIX_PINMUX(15, 0, 6)>;
		output-enable;
	};

	/omit-if-no-ref/ asclin1_asclk_p20_10: asclin1_asclk_p20_10 {
		pinmux = <AURIX_PINMUX(20, 10, 6)>;
		output-enable;
	};

	/omit-if-no-ref/ asclin1_asclk_p33_11: asclin1_asclk_p33_11 {
		pinmux = <AURIX_PINMUX(33, 11, 2)>;
		output-enable;
	};

	/omit-if-no-ref/ asclin1_asclk_p33_12: asclin1_asclk_p33_12 {
		pinmux = <AURIX_PINMUX(33, 12, 4)>;
		output-enable;
	};

	/omit-if-no-ref/ asclin1_aslso_p14_3: asclin1_aslso_p14_3 {
		pinmux = <AURIX_PINMUX(14, 3, 4)>;
		output-enable;
	};

	/omit-if-no-ref/ asclin1_aslso_p20_8: asclin1_aslso_p20_8 {
		pinmux = <AURIX_PINMUX(20, 8, 2)>;
		output-enable;
	};

	/omit-if-no-ref/ asclin1_aslso_p33_10: asclin1_aslso_p33_10 {
		pinmux = <AURIX_PINMUX(33, 10, 4)>;
		output-enable;
	};

	/omit-if-no-ref/ asclin1_atx_p11_12: asclin1_atx_p11_12 {
		pinmux = <AURIX_PINMUX(11, 12, 2)>;
		output-enable;
	};

	/omit-if-no-ref/ asclin1_atx_p14_10: asclin1_atx_p14_10 {
		pinmux = <AURIX_PINMUX(14, 10, 4)>;
		output-enable;
	};

	/omit-if-no-ref/ asclin1_atx_p15_0: asclin1_atx_p15_0 {
		pinmux = <AURIX_PINMUX(15, 0, 2)>;
		output-enable;
	};

	/omit-if-no-ref/ asclin1_atx_p15_1: asclin1_atx_p15_1 {
		pinmux = <AURIX_PINMUX(15, 1, 2)>;
		output-enable;
	};

	/omit-if-no-ref/ asclin1_atx_p15_4: asclin1_atx_p15_4 {
		pinmux = <AURIX_PINMUX(15, 4, 2)>;
		output-enable;
	};

	/omit-if-no-ref/ asclin1_atx_p15_5: asclin1_atx_p15_5 {
		pinmux = <AURIX_PINMUX(15, 5, 2)>;
		output-enable;
	};

	/omit-if-no-ref/ asclin1_atx_p20_10: asclin1_atx_p20_10 {
		pinmux = <AURIX_PINMUX(20, 10, 2)>;
		output-enable;
	};

	/omit-if-no-ref/ asclin1_atx_p2_2: asclin1_atx_p2_2 {
		pinmux = <AURIX_PINMUX(2, 2, 2)>;
		output-enable;
	};

	/omit-if-no-ref/ asclin1_atx_p33_12: asclin1_atx_p33_12 {
		pinmux = <AURIX_PINMUX(33, 12, 2)>;
		output-enable;
	};

	/omit-if-no-ref/ asclin1_atx_p33_13: asclin1_atx_p33_13 {
		pinmux = <AURIX_PINMUX(33, 13, 2)>;
		output-enable;
	};

	/omit-if-no-ref/ asclin2_actsa_p10_7: asclin2_actsa_p10_7 {
		pinmux = <AURIX_PINMUX(10, 7, 0)>;
	};

	/omit-if-no-ref/ asclin2_actsb_p33_5: asclin2_actsb_p33_5 {
		pinmux = <AURIX_PINMUX(33, 5, 1)>;
	};

	/omit-if-no-ref/ asclin2_arts_p10_8: asclin2_arts_p10_8 {
		pinmux = <AURIX_PINMUX(10, 8, 2)>;
		output-enable;
	};

	/omit-if-no-ref/ asclin2_arts_p33_4: asclin2_arts_p33_4 {
		pinmux = <AURIX_PINMUX(33, 4, 2)>;
		output-enable;
	};

	/omit-if-no-ref/ asclin2_arxa_p14_3: asclin2_arxa_p14_3 {
		pinmux = <AURIX_PINMUX(14, 3, 0)>;
	};

	/omit-if-no-ref/ asclin2_arxb_p2_1: asclin2_arxb_p2_1 {
		pinmux = <AURIX_PINMUX(2, 1, 1)>;
	};

	/omit-if-no-ref/ asclin2_arxd_p10_6: asclin2_arxd_p10_6 {
		pinmux = <AURIX_PINMUX(10, 6, 3)>;
	};

	/omit-if-no-ref/ asclin2_arxe_p33_8: asclin2_arxe_p33_8 {
		pinmux = <AURIX_PINMUX(33, 8, 4)>;
	};

	/omit-if-no-ref/ asclin2_arxg_p2_0: asclin2_arxg_p2_0 {
		pinmux = <AURIX_PINMUX(2, 0, 6)>;
	};

	/omit-if-no-ref/ asclin2_asclk_p10_6: asclin2_asclk_p10_6 {
		pinmux = <AURIX_PINMUX(10, 6, 2)>;
		output-enable;
	};

	/omit-if-no-ref/ asclin2_asclk_p14_2: asclin2_asclk_p14_2 {
		pinmux = <AURIX_PINMUX(14, 2, 6)>;
		output-enable;
	};

	/omit-if-no-ref/ asclin2_asclk_p2_4: asclin2_asclk_p2_4 {
		pinmux = <AURIX_PINMUX(2, 4, 2)>;
		output-enable;
	};

	/omit-if-no-ref/ asclin2_asclk_p33_7: asclin2_asclk_p33_7 {
		pinmux = <AURIX_PINMUX(33, 7, 2)>;
		output-enable;
	};

	/omit-if-no-ref/ asclin2_asclk_p33_9: asclin2_asclk_p33_9 {
		pinmux = <AURIX_PINMUX(33, 9, 4)>;
		output-enable;
	};

	/omit-if-no-ref/ asclin2_aslso_p10_5: asclin2_aslso_p10_5 {
		pinmux = <AURIX_PINMUX(10, 5, 6)>;
		output-enable;
	};

	/omit-if-no-ref/ asclin2_aslso_p2_3: asclin2_aslso_p2_3 {
		pinmux = <AURIX_PINMUX(2, 3, 2)>;
		output-enable;
	};

	/omit-if-no-ref/ asclin2_aslso_p33_6: asclin2_aslso_p33_6 {
		pinmux = <AURIX_PINMUX(33, 6, 2)>;
		output-enable;
	};

	/omit-if-no-ref/ asclin2_atx_p10_5: asclin2_atx_p10_5 {
		pinmux = <AURIX_PINMUX(10, 5, 2)>;
		output-enable;
	};

	/omit-if-no-ref/ asclin2_atx_p14_2: asclin2_atx_p14_2 {
		pinmux = <AURIX_PINMUX(14, 2, 2)>;
		output-enable;
	};

	/omit-if-no-ref/ asclin2_atx_p14_3: asclin2_atx_p14_3 {
		pinmux = <AURIX_PINMUX(14, 3, 2)>;
		output-enable;
	};

	/omit-if-no-ref/ asclin2_atx_p2_0: asclin2_atx_p2_0 {
		pinmux = <AURIX_PINMUX(2, 0, 2)>;
		output-enable;
	};

	/omit-if-no-ref/ asclin2_atx_p33_8: asclin2_atx_p33_8 {
		pinmux = <AURIX_PINMUX(33, 8, 2)>;
		output-enable;
	};

	/omit-if-no-ref/ asclin2_atx_p33_9: asclin2_atx_p33_9 {
		pinmux = <AURIX_PINMUX(33, 9, 2)>;
		output-enable;
	};

	/omit-if-no-ref/ asclin3_actsa_p0_12: asclin3_actsa_p0_12 {
		pinmux = <AURIX_PINMUX(0, 12, 0)>;
	};

	/omit-if-no-ref/ asclin3_arts_p0_9: asclin3_arts_p0_9 {
		pinmux = <AURIX_PINMUX(0, 9, 3)>;
		output-enable;
	};

	/omit-if-no-ref/ asclin3_arxa_p15_7: asclin3_arxa_p15_7 {
		pinmux = <AURIX_PINMUX(15, 7, 0)>;
	};

	/omit-if-no-ref/ asclin3_arxc_p20_3: asclin3_arxc_p20_3 {
		pinmux = <AURIX_PINMUX(20, 3, 2)>;
	};

	/omit-if-no-ref/ asclin3_arxd_p32_2: asclin3_arxd_p32_2 {
		pinmux = <AURIX_PINMUX(32, 2, 3)>;
	};

	/omit-if-no-ref/ asclin3_arxe_p0_1: asclin3_arxe_p0_1 {
		pinmux = <AURIX_PINMUX(0, 1, 4)>;
	};

	/omit-if-no-ref/ asclin3_arxf_p21_6: asclin3_arxf_p21_6 {
		pinmux = <AURIX_PINMUX(21, 6, 5)>;
	};

	/omit-if-no-ref/ asclin3_arxgn_p21_2: asclin3_arxgn_p21_2 {
		pinmux = <AURIX_PINMUX(21, 2, 6)>;
	};

	/omit-if-no-ref/ asclin3_arxgp_p21_3: asclin3_arxgp_p21_3 {
		pinmux = <AURIX_PINMUX(21, 3, 6)>;
	};

	/omit-if-no-ref/ asclin3_asclk_p0_0: asclin3_asclk_p0_0 {
		pinmux = <AURIX_PINMUX(0, 0, 2)>;
		output-enable;
	};

	/omit-if-no-ref/ asclin3_asclk_p0_2: asclin3_asclk_p0_2 {
		pinmux = <AURIX_PINMUX(0, 2, 2)>;
		output-enable;
	};

	/omit-if-no-ref/ asclin3_asclk_p15_6: asclin3_asclk_p15_6 {
		pinmux = <AURIX_PINMUX(15, 6, 6)>;
		output-enable;
	};

	/omit-if-no-ref/ asclin3_asclk_p15_8: asclin3_asclk_p15_8 {
		pinmux = <AURIX_PINMUX(15, 8, 6)>;
		output-enable;
	};

	/omit-if-no-ref/ asclin3_asclk_p20_0: asclin3_asclk_p20_0 {
		pinmux = <AURIX_PINMUX(20, 0, 3)>;
		output-enable;
	};

	/omit-if-no-ref/ asclin3_asclk_p21_5: asclin3_asclk_p21_5 {
		pinmux = <AURIX_PINMUX(21, 5, 2)>;
		output-enable;
	};

	/omit-if-no-ref/ asclin3_asclk_p21_7: asclin3_asclk_p21_7 {
		pinmux = <AURIX_PINMUX(21, 7, 3)>;
		output-enable;
	};

	/omit-if-no-ref/ asclin3_asclk_p32_3: asclin3_asclk_p32_3 {
		pinmux = <AURIX_PINMUX(32, 3, 4)>;
		output-enable;
	};

	/omit-if-no-ref/ asclin3_asclk_p33_2: asclin3_asclk_p33_2 {
		pinmux = <AURIX_PINMUX(33, 2, 2)>;
		output-enable;
	};

	/omit-if-no-ref/ asclin3_aslso_p0_3: asclin3_aslso_p0_3 {
		pinmux = <AURIX_PINMUX(0, 3, 2)>;
		output-enable;
	};

	/omit-if-no-ref/ asclin3_aslso_p14_3: asclin3_aslso_p14_3 {
		pinmux = <AURIX_PINMUX(14, 3, 5)>;
		output-enable;
	};

	/omit-if-no-ref/ asclin3_aslso_p21_2: asclin3_aslso_p21_2 {
		pinmux = <AURIX_PINMUX(21, 2, 2)>;
		output-enable;
	};

	/omit-if-no-ref/ asclin3_aslso_p21_6: asclin3_aslso_p21_6 {
		pinmux = <AURIX_PINMUX(21, 6, 2)>;
		output-enable;
	};

	/omit-if-no-ref/ asclin3_aslso_p33_1: asclin3_aslso_p33_1 {
		pinmux = <AURIX_PINMUX(33, 1, 2)>;
		output-enable;
	};

	/omit-if-no-ref/ asclin3_atx_p0_0: asclin3_atx_p0_0 {
		pinmux = <AURIX_PINMUX(0, 0, 3)>;
		output-enable;
	};

	/omit-if-no-ref/ asclin3_atx_p0_1: asclin3_atx_p0_1 {
		pinmux = <AURIX_PINMUX(0, 1, 2)>;
		output-enable;
	};

	/omit-if-no-ref/ asclin3_atx_p15_6: asclin3_atx_p15_6 {
		pinmux = <AURIX_PINMUX(15, 6, 2)>;
		output-enable;
	};

	/omit-if-no-ref/ asclin3_atx_p15_7: asclin3_atx_p15_7 {
		pinmux = <AURIX_PINMUX(15, 7, 2)>;
		output-enable;
	};

	/omit-if-no-ref/ asclin3_atx_p20_0: asclin3_atx_p20_0 {
		pinmux = <AURIX_PINMUX(20, 0, 2)>;
		output-enable;
	};

	/omit-if-no-ref/ asclin3_atx_p20_3: asclin3_atx_p20_3 {
		pinmux = <AURIX_PINMUX(20, 3, 2)>;
		output-enable;
	};

	/omit-if-no-ref/ asclin3_atx_p21_7: asclin3_atx_p21_7 {
		pinmux = <AURIX_PINMUX(21, 7, 2)>;
		output-enable;
	};

	/omit-if-no-ref/ asclin3_atx_p32_2: asclin3_atx_p32_2 {
		pinmux = <AURIX_PINMUX(32, 2, 2)>;
		output-enable;
	};

	/omit-if-no-ref/ asclin3_atx_p32_3: asclin3_atx_p32_3 {
		pinmux = <AURIX_PINMUX(32, 3, 2)>;
		output-enable;
	};

	/omit-if-no-ref/ asclin3_atxn_p22_0: asclin3_atxn_p22_0 {
		pinmux = <AURIX_PINMUX(22, 0, 2)>;
		output-enable;
	};

	/omit-if-no-ref/ asclin3_atxp_p22_1: asclin3_atxp_p22_1 {
		pinmux = <AURIX_PINMUX(22, 1, 2)>;
		output-enable;
	};

	/omit-if-no-ref/ asclin4_arxa_p0_12: asclin4_arxa_p0_12 {
		pinmux = <AURIX_PINMUX(0, 12, 0)>;
	};

	/omit-if-no-ref/ asclin4_asclk_p0_10: asclin4_asclk_p0_10 {
		pinmux = <AURIX_PINMUX(0, 10, 2)>;
		output-enable;
	};

	/omit-if-no-ref/ asclin4_aslso_p0_11: asclin4_aslso_p0_11 {
		pinmux = <AURIX_PINMUX(0, 11, 2)>;
		output-enable;
	};

	/omit-if-no-ref/ asclin4_atx_p0_9: asclin4_atx_p0_9 {
		pinmux = <AURIX_PINMUX(0, 9, 5)>;
		output-enable;
	};

	/omit-if-no-ref/ asclin5_arxa_p0_6: asclin5_arxa_p0_6 {
		pinmux = <AURIX_PINMUX(0, 6, 0)>;
	};

	/omit-if-no-ref/ asclin5_arxb_p33_4: asclin5_arxb_p33_4 {
		pinmux = <AURIX_PINMUX(33, 4, 1)>;
	};

	/omit-if-no-ref/ asclin5_arxc_p22_3: asclin5_arxc_p22_3 {
		pinmux = <AURIX_PINMUX(22, 3, 2)>;
	};

	/omit-if-no-ref/ asclin5_asclk_p33_3: asclin5_asclk_p33_3 {
		pinmux = <AURIX_PINMUX(33, 3, 2)>;
		output-enable;
	};

	/omit-if-no-ref/ asclin5_aslso_p14_8: asclin5_aslso_p14_8 {
		pinmux = <AURIX_PINMUX(14, 8, 2)>;
		output-enable;
	};

	/omit-if-no-ref/ asclin5_aslso_p33_5: asclin5_aslso_p33_5 {
		pinmux = <AURIX_PINMUX(33, 5, 7)>;
		output-enable;
	};

	/omit-if-no-ref/ asclin5_atx_p0_7: asclin5_atx_p0_7 {
		pinmux = <AURIX_PINMUX(0, 7, 2)>;
		output-enable;
	};

	/omit-if-no-ref/ asclin5_atx_p22_2: asclin5_atx_p22_2 {
		pinmux = <AURIX_PINMUX(22, 2, 2)>;
		output-enable;
	};

	/omit-if-no-ref/ asclin5_atx_p33_0: asclin5_atx_p33_0 {
		pinmux = <AURIX_PINMUX(33, 0, 2)>;
		output-enable;
	};

	/omit-if-no-ref/ asclin6_arxa_p23_3: asclin6_arxa_p23_3 {
		pinmux = <AURIX_PINMUX(23, 3, 0)>;
	};

	/omit-if-no-ref/ asclin6_arxe_p22_0: asclin6_arxe_p22_0 {
		pinmux = <AURIX_PINMUX(22, 0, 4)>;
	};

	/omit-if-no-ref/ asclin6_arxf_p23_1: asclin6_arxf_p23_1 {
		pinmux = <AURIX_PINMUX(23, 1, 5)>;
	};

	/omit-if-no-ref/ asclin6_asclk_p23_1: asclin6_asclk_p23_1 {
		pinmux = <AURIX_PINMUX(23, 1, 7)>;
		output-enable;
	};

	/omit-if-no-ref/ asclin6_aslso_p23_4: asclin6_aslso_p23_4 {
		pinmux = <AURIX_PINMUX(23, 4, 2)>;
		output-enable;
	};

	/omit-if-no-ref/ asclin6_atx_p22_0: asclin6_atx_p22_0 {
		pinmux = <AURIX_PINMUX(22, 0, 7)>;
		output-enable;
	};

	/omit-if-no-ref/ asclin6_atx_p23_5: asclin6_atx_p23_5 {
		pinmux = <AURIX_PINMUX(23, 5, 2)>;
		output-enable;
	};

	/omit-if-no-ref/ asclin7_arxc_p23_2: asclin7_arxc_p23_2 {
		pinmux = <AURIX_PINMUX(23, 2, 2)>;
	};

	/omit-if-no-ref/ asclin7_arxe_p22_1: asclin7_arxe_p22_1 {
		pinmux = <AURIX_PINMUX(22, 1, 4)>;
	};

	/omit-if-no-ref/ asclin7_aslso_p14_8: asclin7_aslso_p14_8 {
		pinmux = <AURIX_PINMUX(14, 8, 3)>;
		output-enable;
	};

	/omit-if-no-ref/ asclin7_atx_p22_1: asclin7_atx_p22_1 {
		pinmux = <AURIX_PINMUX(22, 1, 7)>;
		output-enable;
	};

	/omit-if-no-ref/ asclin7_atx_p23_3: asclin7_atx_p23_3 {
		pinmux = <AURIX_PINMUX(23, 3, 2)>;
		output-enable;
	};

	/omit-if-no-ref/ asclin8_arxc_p33_1: asclin8_arxc_p33_1 {
		pinmux = <AURIX_PINMUX(33, 1, 2)>;
	};

	/omit-if-no-ref/ asclin8_arxd_p33_6: asclin8_arxd_p33_6 {
		pinmux = <AURIX_PINMUX(33, 6, 3)>;
	};

	/omit-if-no-ref/ asclin8_asclk_p2_8: asclin8_asclk_p2_8 {
		pinmux = <AURIX_PINMUX(2, 8, 3)>;
		output-enable;
	};

	/omit-if-no-ref/ asclin8_atx_p33_7: asclin8_atx_p33_7 {
		pinmux = <AURIX_PINMUX(33, 7, 4)>;
		output-enable;
	};

	/omit-if-no-ref/ asclin9_arxc_p14_7: asclin9_arxc_p14_7 {
		pinmux = <AURIX_PINMUX(14, 7, 2)>;
	};

	/omit-if-no-ref/ asclin9_arxd_p14_9: asclin9_arxd_p14_9 {
		pinmux = <AURIX_PINMUX(14, 9, 3)>;
	};

	/omit-if-no-ref/ asclin9_arxe_p20_6: asclin9_arxe_p20_6 {
		pinmux = <AURIX_PINMUX(20, 6, 4)>;
	};

	/omit-if-no-ref/ asclin9_arxf_p20_7: asclin9_arxf_p20_7 {
		pinmux = <AURIX_PINMUX(20, 7, 5)>;
	};

	/omit-if-no-ref/ asclin9_atx_p14_7: asclin9_atx_p14_7 {
		pinmux = <AURIX_PINMUX(14, 7, 4)>;
		output-enable;
	};

	/omit-if-no-ref/ asclin9_atx_p20_7: asclin9_atx_p20_7 {
		pinmux = <AURIX_PINMUX(20, 7, 2)>;
		output-enable;
	};

	/omit-if-no-ref/ can00_rxda_p2_1: can00_rxda_p2_1 {
		pinmux = <AURIX_PINMUX(2, 1, 0)>;
	};

	/omit-if-no-ref/ can00_rxdb_p20_7: can00_rxdb_p20_7 {
		pinmux = <AURIX_PINMUX(20, 7, 1)>;
	};

	/omit-if-no-ref/ can00_rxdd_p33_12: can00_rxdd_p33_12 {
		pinmux = <AURIX_PINMUX(33, 12, 3)>;
	};

	/omit-if-no-ref/ can00_rxde_p33_7: can00_rxde_p33_7 {
		pinmux = <AURIX_PINMUX(33, 7, 4)>;
	};

	/omit-if-no-ref/ can00_txd_p20_8: can00_txd_p20_8 {
		pinmux = <AURIX_PINMUX(20, 8, 5)>;
		output-enable;
	};

	/omit-if-no-ref/ can00_txd_p2_0: can00_txd_p2_0 {
		pinmux = <AURIX_PINMUX(2, 0, 5)>;
		output-enable;
	};

	/omit-if-no-ref/ can00_txd_p33_13: can00_txd_p33_13 {
		pinmux = <AURIX_PINMUX(33, 13, 5)>;
		output-enable;
	};

	/omit-if-no-ref/ can00_txd_p33_8: can00_txd_p33_8 {
		pinmux = <AURIX_PINMUX(33, 8, 5)>;
		output-enable;
	};

	/omit-if-no-ref/ can01_rxda_p15_3: can01_rxda_p15_3 {
		pinmux = <AURIX_PINMUX(15, 3, 0)>;
	};

	/omit-if-no-ref/ can01_rxdb_p14_1: can01_rxdb_p14_1 {
		pinmux = <AURIX_PINMUX(14, 1, 1)>;
	};

	/omit-if-no-ref/ can01_rxdd_p33_10: can01_rxdd_p33_10 {
		pinmux = <AURIX_PINMUX(33, 10, 3)>;
	};

	/omit-if-no-ref/ can01_txd_p14_0: can01_txd_p14_0 {
		pinmux = <AURIX_PINMUX(14, 0, 5)>;
		output-enable;
	};

	/omit-if-no-ref/ can01_txd_p15_2: can01_txd_p15_2 {
		pinmux = <AURIX_PINMUX(15, 2, 5)>;
		output-enable;
	};

	/omit-if-no-ref/ can01_txd_p33_9: can01_txd_p33_9 {
		pinmux = <AURIX_PINMUX(33, 9, 5)>;
		output-enable;
	};

	/omit-if-no-ref/ can02_rxda_p15_1: can02_rxda_p15_1 {
		pinmux = <AURIX_PINMUX(15, 1, 0)>;
	};

	/omit-if-no-ref/ can02_rxdb_p2_3: can02_rxdb_p2_3 {
		pinmux = <AURIX_PINMUX(2, 3, 1)>;
	};

	/omit-if-no-ref/ can02_rxdd_p14_8: can02_rxdd_p14_8 {
		pinmux = <AURIX_PINMUX(14, 8, 3)>;
	};

	/omit-if-no-ref/ can02_rxde_p10_2: can02_rxde_p10_2 {
		pinmux = <AURIX_PINMUX(10, 2, 4)>;
	};

	/omit-if-no-ref/ can02_txd_p10_3: can02_txd_p10_3 {
		pinmux = <AURIX_PINMUX(10, 3, 6)>;
		output-enable;
	};

	/omit-if-no-ref/ can02_txd_p14_10: can02_txd_p14_10 {
		pinmux = <AURIX_PINMUX(14, 10, 5)>;
		output-enable;
	};

	/omit-if-no-ref/ can02_txd_p15_0: can02_txd_p15_0 {
		pinmux = <AURIX_PINMUX(15, 0, 5)>;
		output-enable;
	};

	/omit-if-no-ref/ can02_txd_p2_2: can02_txd_p2_2 {
		pinmux = <AURIX_PINMUX(2, 2, 5)>;
		output-enable;
	};

	/omit-if-no-ref/ can03_rxda_p0_3: can03_rxda_p0_3 {
		pinmux = <AURIX_PINMUX(0, 3, 0)>;
	};

	/omit-if-no-ref/ can03_rxdb_p32_2: can03_rxdb_p32_2 {
		pinmux = <AURIX_PINMUX(32, 2, 1)>;
	};

	/omit-if-no-ref/ can03_rxdc_p20_0: can03_rxdc_p20_0 {
		pinmux = <AURIX_PINMUX(20, 0, 2)>;
	};

	/omit-if-no-ref/ can03_rxdd_p11_10: can03_rxdd_p11_10 {
		pinmux = <AURIX_PINMUX(11, 10, 3)>;
	};

	/omit-if-no-ref/ can03_rxde_p20_9: can03_rxde_p20_9 {
		pinmux = <AURIX_PINMUX(20, 9, 4)>;
	};

	/omit-if-no-ref/ can03_txd_p0_2: can03_txd_p0_2 {
		pinmux = <AURIX_PINMUX(0, 2, 5)>;
		output-enable;
	};

	/omit-if-no-ref/ can03_txd_p11_12: can03_txd_p11_12 {
		pinmux = <AURIX_PINMUX(11, 12, 5)>;
		output-enable;
	};

	/omit-if-no-ref/ can03_txd_p20_10: can03_txd_p20_10 {
		pinmux = <AURIX_PINMUX(20, 10, 5)>;
		output-enable;
	};

	/omit-if-no-ref/ can03_txd_p20_3: can03_txd_p20_3 {
		pinmux = <AURIX_PINMUX(20, 3, 5)>;
		output-enable;
	};

	/omit-if-no-ref/ can03_txd_p32_3: can03_txd_p32_3 {
		pinmux = <AURIX_PINMUX(32, 3, 5)>;
		output-enable;
	};

	/omit-if-no-ref/ can10_rxda_p0_1: can10_rxda_p0_1 {
		pinmux = <AURIX_PINMUX(0, 1, 0)>;
	};

	/omit-if-no-ref/ can10_rxdb_p14_7: can10_rxdb_p14_7 {
		pinmux = <AURIX_PINMUX(14, 7, 1)>;
	};

	/omit-if-no-ref/ can10_rxdc_p23_0: can10_rxdc_p23_0 {
		pinmux = <AURIX_PINMUX(23, 0, 2)>;
	};

	/omit-if-no-ref/ can10_rxdd_p13_1: can10_rxdd_p13_1 {
		pinmux = <AURIX_PINMUX(13, 1, 3)>;
	};

	/omit-if-no-ref/ can10_txd_p0_0: can10_txd_p0_0 {
		pinmux = <AURIX_PINMUX(0, 0, 5)>;
		output-enable;
	};

	/omit-if-no-ref/ can10_txd_p13_0: can10_txd_p13_0 {
		pinmux = <AURIX_PINMUX(13, 0, 7)>;
		output-enable;
	};

	/omit-if-no-ref/ can10_txd_p14_9: can10_txd_p14_9 {
		pinmux = <AURIX_PINMUX(14, 9, 4)>;
		output-enable;
	};

	/omit-if-no-ref/ can10_txd_p23_1: can10_txd_p23_1 {
		pinmux = <AURIX_PINMUX(23, 1, 5)>;
		output-enable;
	};

	/omit-if-no-ref/ can11_rxda_p2_4: can11_rxda_p2_4 {
		pinmux = <AURIX_PINMUX(2, 4, 0)>;
	};

	/omit-if-no-ref/ can11_rxdb_p0_5: can11_rxdb_p0_5 {
		pinmux = <AURIX_PINMUX(0, 5, 1)>;
	};

	/omit-if-no-ref/ can11_txd_p0_4: can11_txd_p0_4 {
		pinmux = <AURIX_PINMUX(0, 4, 3)>;
		output-enable;
	};

	/omit-if-no-ref/ can11_txd_p2_5: can11_txd_p2_5 {
		pinmux = <AURIX_PINMUX(2, 5, 2)>;
		output-enable;
	};

	/omit-if-no-ref/ can12_rxda_p20_6: can12_rxda_p20_6 {
		pinmux = <AURIX_PINMUX(20, 6, 0)>;
	};

	/omit-if-no-ref/ can12_rxdb_p10_8: can12_rxdb_p10_8 {
		pinmux = <AURIX_PINMUX(10, 8, 1)>;
	};

	/omit-if-no-ref/ can12_rxdc_p23_3: can12_rxdc_p23_3 {
		pinmux = <AURIX_PINMUX(23, 3, 2)>;
	};

	/omit-if-no-ref/ can12_txd_p10_7: can12_txd_p10_7 {
		pinmux = <AURIX_PINMUX(10, 7, 6)>;
		output-enable;
	};

	/omit-if-no-ref/ can12_txd_p20_7: can12_txd_p20_7 {
		pinmux = <AURIX_PINMUX(20, 7, 5)>;
		output-enable;
	};

	/omit-if-no-ref/ can12_txd_p23_2: can12_txd_p23_2 {
		pinmux = <AURIX_PINMUX(23, 2, 5)>;
		output-enable;
	};

	/omit-if-no-ref/ can13_rxda_p14_7: can13_rxda_p14_7 {
		pinmux = <AURIX_PINMUX(14, 7, 0)>;
	};

	/omit-if-no-ref/ can13_rxdb_p33_5: can13_rxdb_p33_5 {
		pinmux = <AURIX_PINMUX(33, 5, 1)>;
	};

	/omit-if-no-ref/ can13_txd_p14_6: can13_txd_p14_6 {
		pinmux = <AURIX_PINMUX(14, 6, 4)>;
		output-enable;
	};

	/omit-if-no-ref/ can13_txd_p33_4: can13_txd_p33_4 {
		pinmux = <AURIX_PINMUX(33, 4, 7)>;
		output-enable;
	};

	/omit-if-no-ref/ ccu60_cc60_p11_12: ccu60_cc60_p11_12 {
		pinmux = <AURIX_PINMUX(11, 12, 7)>;
		output-enable;
	};

	/omit-if-no-ref/ ccu60_cc60_p15_6: ccu60_cc60_p15_6 {
		pinmux = <AURIX_PINMUX(15, 6, 7)>;
		output-enable;
	};

	/omit-if-no-ref/ ccu60_cc60_p2_0: ccu60_cc60_p2_0 {
		pinmux = <AURIX_PINMUX(2, 0, 7)>;
		output-enable;
	};

	/omit-if-no-ref/ ccu60_cc60_p2_6: ccu60_cc60_p2_6 {
		pinmux = <AURIX_PINMUX(2, 6, 7)>;
		output-enable;
	};

	/omit-if-no-ref/ ccu60_cc60ina_p2_0: ccu60_cc60ina_p2_0 {
		pinmux = <AURIX_PINMUX(2, 0, 0)>;
	};

	/omit-if-no-ref/ ccu60_cc60inb_p0_1: ccu60_cc60inb_p0_1 {
		pinmux = <AURIX_PINMUX(0, 1, 1)>;
	};

	/omit-if-no-ref/ ccu60_cc60inc_p2_6: ccu60_cc60inc_p2_6 {
		pinmux = <AURIX_PINMUX(2, 6, 2)>;
	};

	/omit-if-no-ref/ ccu60_cc61_p11_11: ccu60_cc61_p11_11 {
		pinmux = <AURIX_PINMUX(11, 11, 7)>;
		output-enable;
	};

	/omit-if-no-ref/ ccu60_cc61_p15_5: ccu60_cc61_p15_5 {
		pinmux = <AURIX_PINMUX(15, 5, 7)>;
		output-enable;
	};

	/omit-if-no-ref/ ccu60_cc61_p2_2: ccu60_cc61_p2_2 {
		pinmux = <AURIX_PINMUX(2, 2, 7)>;
		output-enable;
	};

	/omit-if-no-ref/ ccu60_cc61_p2_7: ccu60_cc61_p2_7 {
		pinmux = <AURIX_PINMUX(2, 7, 7)>;
		output-enable;
	};

	/omit-if-no-ref/ ccu60_cc61ina_p2_2: ccu60_cc61ina_p2_2 {
		pinmux = <AURIX_PINMUX(2, 2, 0)>;
	};

	/omit-if-no-ref/ ccu60_cc61inb_p0_3: ccu60_cc61inb_p0_3 {
		pinmux = <AURIX_PINMUX(0, 3, 1)>;
	};

	/omit-if-no-ref/ ccu60_cc61inc_p2_7: ccu60_cc61inc_p2_7 {
		pinmux = <AURIX_PINMUX(2, 7, 2)>;
	};

	/omit-if-no-ref/ ccu60_cc62_p11_10: ccu60_cc62_p11_10 {
		pinmux = <AURIX_PINMUX(11, 10, 7)>;
		output-enable;
	};

	/omit-if-no-ref/ ccu60_cc62_p15_4: ccu60_cc62_p15_4 {
		pinmux = <AURIX_PINMUX(15, 4, 7)>;
		output-enable;
	};

	/omit-if-no-ref/ ccu60_cc62_p2_4: ccu60_cc62_p2_4 {
		pinmux = <AURIX_PINMUX(2, 4, 7)>;
		output-enable;
	};

	/omit-if-no-ref/ ccu60_cc62_p2_8: ccu60_cc62_p2_8 {
		pinmux = <AURIX_PINMUX(2, 8, 7)>;
		output-enable;
	};

	/omit-if-no-ref/ ccu60_cc62ina_p2_4: ccu60_cc62ina_p2_4 {
		pinmux = <AURIX_PINMUX(2, 4, 0)>;
	};

	/omit-if-no-ref/ ccu60_cc62inb_p0_5: ccu60_cc62inb_p0_5 {
		pinmux = <AURIX_PINMUX(0, 5, 1)>;
	};

	/omit-if-no-ref/ ccu60_cc62inc_p2_8: ccu60_cc62inc_p2_8 {
		pinmux = <AURIX_PINMUX(2, 8, 2)>;
	};

	/omit-if-no-ref/ ccu60_ccpos0a_p2_6: ccu60_ccpos0a_p2_6 {
		pinmux = <AURIX_PINMUX(2, 6, 0)>;
	};

	/omit-if-no-ref/ ccu60_ccpos0c_p10_4: ccu60_ccpos0c_p10_4 {
		pinmux = <AURIX_PINMUX(10, 4, 2)>;
	};

	/omit-if-no-ref/ ccu60_ccpos0d_p40_0: ccu60_ccpos0d_p40_0 {
		pinmux = <AURIX_PINMUX(40, 0, 3)>;
	};

	/omit-if-no-ref/ ccu60_ccpos1a_p2_7: ccu60_ccpos1a_p2_7 {
		pinmux = <AURIX_PINMUX(2, 7, 0)>;
	};

	/omit-if-no-ref/ ccu60_ccpos1b_p40_1: ccu60_ccpos1b_p40_1 {
		pinmux = <AURIX_PINMUX(40, 1, 1)>;
	};

	/omit-if-no-ref/ ccu60_ccpos1c_p10_7: ccu60_ccpos1c_p10_7 {
		pinmux = <AURIX_PINMUX(10, 7, 2)>;
	};

	/omit-if-no-ref/ ccu60_ccpos1d_p40_2: ccu60_ccpos1d_p40_2 {
		pinmux = <AURIX_PINMUX(40, 2, 3)>;
	};

	/omit-if-no-ref/ ccu60_ccpos2a_p2_8: ccu60_ccpos2a_p2_8 {
		pinmux = <AURIX_PINMUX(2, 8, 0)>;
	};

	/omit-if-no-ref/ ccu60_ccpos2b_p40_3: ccu60_ccpos2b_p40_3 {
		pinmux = <AURIX_PINMUX(40, 3, 1)>;
	};

	/omit-if-no-ref/ ccu60_ccpos2c_p10_8: ccu60_ccpos2c_p10_8 {
		pinmux = <AURIX_PINMUX(10, 8, 2)>;
	};

	/omit-if-no-ref/ ccu60_ccpos2d_p40_4: ccu60_ccpos2d_p40_4 {
		pinmux = <AURIX_PINMUX(40, 4, 3)>;
	};

	/omit-if-no-ref/ ccu60_cout60_p11_9: ccu60_cout60_p11_9 {
		pinmux = <AURIX_PINMUX(11, 9, 7)>;
		output-enable;
	};

	/omit-if-no-ref/ ccu60_cout60_p15_7: ccu60_cout60_p15_7 {
		pinmux = <AURIX_PINMUX(15, 7, 7)>;
		output-enable;
	};

	/omit-if-no-ref/ ccu60_cout60_p2_1: ccu60_cout60_p2_1 {
		pinmux = <AURIX_PINMUX(2, 1, 7)>;
		output-enable;
	};

	/omit-if-no-ref/ ccu60_cout61_p11_6: ccu60_cout61_p11_6 {
		pinmux = <AURIX_PINMUX(11, 6, 7)>;
		output-enable;
	};

	/omit-if-no-ref/ ccu60_cout61_p15_8: ccu60_cout61_p15_8 {
		pinmux = <AURIX_PINMUX(15, 8, 7)>;
		output-enable;
	};

	/omit-if-no-ref/ ccu60_cout61_p2_3: ccu60_cout61_p2_3 {
		pinmux = <AURIX_PINMUX(2, 3, 7)>;
		output-enable;
	};

	/omit-if-no-ref/ ccu60_cout62_p11_3: ccu60_cout62_p11_3 {
		pinmux = <AURIX_PINMUX(11, 3, 7)>;
		output-enable;
	};

	/omit-if-no-ref/ ccu60_cout62_p14_0: ccu60_cout62_p14_0 {
		pinmux = <AURIX_PINMUX(14, 0, 7)>;
		output-enable;
	};

	/omit-if-no-ref/ ccu60_cout62_p2_5: ccu60_cout62_p2_5 {
		pinmux = <AURIX_PINMUX(2, 5, 7)>;
		output-enable;
	};

	/omit-if-no-ref/ ccu60_cout63_p0_0: ccu60_cout63_p0_0 {
		pinmux = <AURIX_PINMUX(0, 0, 7)>;
		output-enable;
	};

	/omit-if-no-ref/ ccu60_cout63_p11_2: ccu60_cout63_p11_2 {
		pinmux = <AURIX_PINMUX(11, 2, 7)>;
		output-enable;
	};

	/omit-if-no-ref/ ccu60_cout63_p14_1: ccu60_cout63_p14_1 {
		pinmux = <AURIX_PINMUX(14, 1, 7)>;
		output-enable;
	};

	/omit-if-no-ref/ ccu60_cout63_p32_4: ccu60_cout63_p32_4 {
		pinmux = <AURIX_PINMUX(32, 4, 7)>;
		output-enable;
	};

	/omit-if-no-ref/ ccu60_ctrapa_p0_11: ccu60_ctrapa_p0_11 {
		pinmux = <AURIX_PINMUX(0, 11, 0)>;
	};

	/omit-if-no-ref/ ccu60_t12hrb_p0_7: ccu60_t12hrb_p0_7 {
		pinmux = <AURIX_PINMUX(0, 7, 1)>;
	};

	/omit-if-no-ref/ ccu60_t12hrc_p0_9: ccu60_t12hrc_p0_9 {
		pinmux = <AURIX_PINMUX(0, 9, 2)>;
	};

	/omit-if-no-ref/ ccu60_t12hre_p0_0: ccu60_t12hre_p0_0 {
		pinmux = <AURIX_PINMUX(0, 0, 4)>;
	};

	/omit-if-no-ref/ ccu60_t13hrb_p0_8: ccu60_t13hrb_p0_8 {
		pinmux = <AURIX_PINMUX(0, 8, 1)>;
	};

	/omit-if-no-ref/ ccu60_t13hrc_p0_9: ccu60_t13hrc_p0_9 {
		pinmux = <AURIX_PINMUX(0, 9, 2)>;
	};

	/omit-if-no-ref/ ccu61_cc60_p0_1: ccu61_cc60_p0_1 {
		pinmux = <AURIX_PINMUX(0, 1, 7)>;
		output-enable;
	};

	/omit-if-no-ref/ ccu61_cc60_p0_7: ccu61_cc60_p0_7 {
		pinmux = <AURIX_PINMUX(0, 7, 7)>;
		output-enable;
	};

	/omit-if-no-ref/ ccu61_cc60_p20_8: ccu61_cc60_p20_8 {
		pinmux = <AURIX_PINMUX(20, 8, 7)>;
		output-enable;
	};

	/omit-if-no-ref/ ccu61_cc60_p33_13: ccu61_cc60_p33_13 {
		pinmux = <AURIX_PINMUX(33, 13, 7)>;
		output-enable;
	};

	/omit-if-no-ref/ ccu61_cc60ina_p0_1: ccu61_cc60ina_p0_1 {
		pinmux = <AURIX_PINMUX(0, 1, 0)>;
	};

	/omit-if-no-ref/ ccu61_cc60inb_p2_0: ccu61_cc60inb_p2_0 {
		pinmux = <AURIX_PINMUX(2, 0, 1)>;
	};

	/omit-if-no-ref/ ccu61_cc60inc_p0_7: ccu61_cc60inc_p0_7 {
		pinmux = <AURIX_PINMUX(0, 7, 2)>;
	};

	/omit-if-no-ref/ ccu61_cc61_p0_3: ccu61_cc61_p0_3 {
		pinmux = <AURIX_PINMUX(0, 3, 7)>;
		output-enable;
	};

	/omit-if-no-ref/ ccu61_cc61_p0_8: ccu61_cc61_p0_8 {
		pinmux = <AURIX_PINMUX(0, 8, 7)>;
		output-enable;
	};

	/omit-if-no-ref/ ccu61_cc61_p20_9: ccu61_cc61_p20_9 {
		pinmux = <AURIX_PINMUX(20, 9, 7)>;
		output-enable;
	};

	/omit-if-no-ref/ ccu61_cc61_p33_11: ccu61_cc61_p33_11 {
		pinmux = <AURIX_PINMUX(33, 11, 7)>;
		output-enable;
	};

	/omit-if-no-ref/ ccu61_cc61ina_p0_3: ccu61_cc61ina_p0_3 {
		pinmux = <AURIX_PINMUX(0, 3, 0)>;
	};

	/omit-if-no-ref/ ccu61_cc61inb_p2_2: ccu61_cc61inb_p2_2 {
		pinmux = <AURIX_PINMUX(2, 2, 1)>;
	};

	/omit-if-no-ref/ ccu61_cc61inc_p0_8: ccu61_cc61inc_p0_8 {
		pinmux = <AURIX_PINMUX(0, 8, 2)>;
	};

	/omit-if-no-ref/ ccu61_cc62_p0_5: ccu61_cc62_p0_5 {
		pinmux = <AURIX_PINMUX(0, 5, 7)>;
		output-enable;
	};

	/omit-if-no-ref/ ccu61_cc62_p0_9: ccu61_cc62_p0_9 {
		pinmux = <AURIX_PINMUX(0, 9, 7)>;
		output-enable;
	};

	/omit-if-no-ref/ ccu61_cc62_p20_10: ccu61_cc62_p20_10 {
		pinmux = <AURIX_PINMUX(20, 10, 7)>;
		output-enable;
	};

	/omit-if-no-ref/ ccu61_cc62_p33_9: ccu61_cc62_p33_9 {
		pinmux = <AURIX_PINMUX(33, 9, 7)>;
		output-enable;
	};

	/omit-if-no-ref/ ccu61_cc62ina_p0_5: ccu61_cc62ina_p0_5 {
		pinmux = <AURIX_PINMUX(0, 5, 0)>;
	};

	/omit-if-no-ref/ ccu61_cc62inb_p2_4: ccu61_cc62inb_p2_4 {
		pinmux = <AURIX_PINMUX(2, 4, 1)>;
	};

	/omit-if-no-ref/ ccu61_cc62inc_p0_9: ccu61_cc62inc_p0_9 {
		pinmux = <AURIX_PINMUX(0, 9, 2)>;
	};

	/omit-if-no-ref/ ccu61_ccpos0a_p0_7: ccu61_ccpos0a_p0_7 {
		pinmux = <AURIX_PINMUX(0, 7, 0)>;
	};

	/omit-if-no-ref/ ccu61_ccpos0c_p33_7: ccu61_ccpos0c_p33_7 {
		pinmux = <AURIX_PINMUX(33, 7, 2)>;
	};

	/omit-if-no-ref/ ccu61_ccpos0d_p40_5: ccu61_ccpos0d_p40_5 {
		pinmux = <AURIX_PINMUX(40, 5, 3)>;
	};

	/omit-if-no-ref/ ccu61_ccpos1a_p0_8: ccu61_ccpos1a_p0_8 {
		pinmux = <AURIX_PINMUX(0, 8, 0)>;
	};

	/omit-if-no-ref/ ccu61_ccpos1b_p40_6: ccu61_ccpos1b_p40_6 {
		pinmux = <AURIX_PINMUX(40, 6, 1)>;
	};

	/omit-if-no-ref/ ccu61_ccpos1c_p33_6: ccu61_ccpos1c_p33_6 {
		pinmux = <AURIX_PINMUX(33, 6, 2)>;
	};

	/omit-if-no-ref/ ccu61_ccpos1d_p40_7: ccu61_ccpos1d_p40_7 {
		pinmux = <AURIX_PINMUX(40, 7, 3)>;
	};

	/omit-if-no-ref/ ccu61_ccpos2a_p0_9: ccu61_ccpos2a_p0_9 {
		pinmux = <AURIX_PINMUX(0, 9, 0)>;
	};

	/omit-if-no-ref/ ccu61_ccpos2b_p40_8: ccu61_ccpos2b_p40_8 {
		pinmux = <AURIX_PINMUX(40, 8, 1)>;
	};

	/omit-if-no-ref/ ccu61_ccpos2c_p33_5: ccu61_ccpos2c_p33_5 {
		pinmux = <AURIX_PINMUX(33, 5, 2)>;
	};

	/omit-if-no-ref/ ccu61_ccpos2d_p40_9: ccu61_ccpos2d_p40_9 {
		pinmux = <AURIX_PINMUX(40, 9, 3)>;
	};

	/omit-if-no-ref/ ccu61_cout60_p0_2: ccu61_cout60_p0_2 {
		pinmux = <AURIX_PINMUX(0, 2, 7)>;
		output-enable;
	};

	/omit-if-no-ref/ ccu61_cout60_p20_11: ccu61_cout60_p20_11 {
		pinmux = <AURIX_PINMUX(20, 11, 7)>;
		output-enable;
	};

	/omit-if-no-ref/ ccu61_cout60_p33_12: ccu61_cout60_p33_12 {
		pinmux = <AURIX_PINMUX(33, 12, 7)>;
		output-enable;
	};

	/omit-if-no-ref/ ccu61_cout61_p0_4: ccu61_cout61_p0_4 {
		pinmux = <AURIX_PINMUX(0, 4, 7)>;
		output-enable;
	};

	/omit-if-no-ref/ ccu61_cout61_p20_12: ccu61_cout61_p20_12 {
		pinmux = <AURIX_PINMUX(20, 12, 7)>;
		output-enable;
	};

	/omit-if-no-ref/ ccu61_cout61_p33_10: ccu61_cout61_p33_10 {
		pinmux = <AURIX_PINMUX(33, 10, 7)>;
		output-enable;
	};

	/omit-if-no-ref/ ccu61_cout62_p0_6: ccu61_cout62_p0_6 {
		pinmux = <AURIX_PINMUX(0, 6, 7)>;
		output-enable;
	};

	/omit-if-no-ref/ ccu61_cout62_p20_13: ccu61_cout62_p20_13 {
		pinmux = <AURIX_PINMUX(20, 13, 7)>;
		output-enable;
	};

	/omit-if-no-ref/ ccu61_cout62_p33_8: ccu61_cout62_p33_8 {
		pinmux = <AURIX_PINMUX(33, 8, 7)>;
		output-enable;
	};

	/omit-if-no-ref/ ccu61_cout63_p0_10: ccu61_cout63_p0_10 {
		pinmux = <AURIX_PINMUX(0, 10, 7)>;
		output-enable;
	};

	/omit-if-no-ref/ ccu61_cout63_p0_12: ccu61_cout63_p0_12 {
		pinmux = <AURIX_PINMUX(0, 12, 7)>;
		output-enable;
	};

	/omit-if-no-ref/ ccu61_cout63_p20_7: ccu61_cout63_p20_7 {
		pinmux = <AURIX_PINMUX(20, 7, 7)>;
		output-enable;
	};

	/omit-if-no-ref/ ccu61_ctrapa_p0_0: ccu61_ctrapa_p0_0 {
		pinmux = <AURIX_PINMUX(0, 0, 0)>;
	};

	/omit-if-no-ref/ ccu61_ctrapc_p33_4: ccu61_ctrapc_p33_4 {
		pinmux = <AURIX_PINMUX(33, 4, 2)>;
	};

	/omit-if-no-ref/ ccu61_t12hrb_p2_6: ccu61_t12hrb_p2_6 {
		pinmux = <AURIX_PINMUX(2, 6, 1)>;
	};

	/omit-if-no-ref/ ccu61_t12hrc_p2_8: ccu61_t12hrc_p2_8 {
		pinmux = <AURIX_PINMUX(2, 8, 2)>;
	};

	/omit-if-no-ref/ ccu61_t12hre_p0_11: ccu61_t12hre_p0_11 {
		pinmux = <AURIX_PINMUX(0, 11, 4)>;
	};

	/omit-if-no-ref/ ccu61_t13hrb_p2_7: ccu61_t13hrb_p2_7 {
		pinmux = <AURIX_PINMUX(2, 7, 1)>;
	};

	/omit-if-no-ref/ ccu61_t13hrc_p2_8: ccu61_t13hrc_p2_8 {
		pinmux = <AURIX_PINMUX(2, 8, 2)>;
	};

	/omit-if-no-ref/ ccu_extclk0_p23_1: ccu_extclk0_p23_1 {
		pinmux = <AURIX_PINMUX(23, 1, 6)>;
		output-enable;
	};

	/omit-if-no-ref/ ccu_extclk1_p11_12: ccu_extclk1_p11_12 {
		pinmux = <AURIX_PINMUX(11, 12, 6)>;
		output-enable;
	};

	/omit-if-no-ref/ ccu_extclk1_p32_4: ccu_extclk1_p32_4 {
		pinmux = <AURIX_PINMUX(32, 4, 6)>;
		output-enable;
	};

	/omit-if-no-ref/ edsadc_cgpwmn_p0_5: edsadc_cgpwmn_p0_5 {
		pinmux = <AURIX_PINMUX(0, 5, 2)>;
		output-enable;
	};

	/omit-if-no-ref/ edsadc_cgpwmn_p2_0: edsadc_cgpwmn_p2_0 {
		pinmux = <AURIX_PINMUX(2, 0, 4)>;
		output-enable;
	};

	/omit-if-no-ref/ edsadc_cgpwmn_p33_11: edsadc_cgpwmn_p33_11 {
		pinmux = <AURIX_PINMUX(33, 11, 6)>;
		output-enable;
	};

	/omit-if-no-ref/ edsadc_cgpwmp_p0_6: edsadc_cgpwmp_p0_6 {
		pinmux = <AURIX_PINMUX(0, 6, 2)>;
		output-enable;
	};

	/omit-if-no-ref/ edsadc_cgpwmp_p2_1: edsadc_cgpwmp_p2_1 {
		pinmux = <AURIX_PINMUX(2, 1, 4)>;
		output-enable;
	};

	/omit-if-no-ref/ edsadc_cgpwmp_p33_12: edsadc_cgpwmp_p33_12 {
		pinmux = <AURIX_PINMUX(33, 12, 6)>;
		output-enable;
	};

	/omit-if-no-ref/ edsadc_dscin0a_p0_11: edsadc_dscin0a_p0_11 {
		pinmux = <AURIX_PINMUX(0, 11, 0)>;
	};

	/omit-if-no-ref/ edsadc_dscin0b_p33_5: edsadc_dscin0b_p33_5 {
		pinmux = <AURIX_PINMUX(33, 5, 1)>;
	};

	/omit-if-no-ref/ edsadc_dscin1a_p0_9: edsadc_dscin1a_p0_9 {
		pinmux = <AURIX_PINMUX(0, 9, 0)>;
	};

	/omit-if-no-ref/ edsadc_dscin1b_p33_3: edsadc_dscin1b_p33_3 {
		pinmux = <AURIX_PINMUX(33, 3, 1)>;
	};

	/omit-if-no-ref/ edsadc_dscin2a_p0_5: edsadc_dscin2a_p0_5 {
		pinmux = <AURIX_PINMUX(0, 5, 0)>;
	};

	/omit-if-no-ref/ edsadc_dscin2b_p33_1: edsadc_dscin2b_p33_1 {
		pinmux = <AURIX_PINMUX(33, 1, 1)>;
	};

	/omit-if-no-ref/ edsadc_dscin3a_p0_3: edsadc_dscin3a_p0_3 {
		pinmux = <AURIX_PINMUX(0, 3, 0)>;
	};

	/omit-if-no-ref/ edsadc_dscin3b_p2_7: edsadc_dscin3b_p2_7 {
		pinmux = <AURIX_PINMUX(2, 7, 1)>;
	};

	/omit-if-no-ref/ edsadc_dscin4a_p0_7: edsadc_dscin4a_p0_7 {
		pinmux = <AURIX_PINMUX(0, 7, 0)>;
	};

	/omit-if-no-ref/ edsadc_dscin4b_p2_5: edsadc_dscin4b_p2_5 {
		pinmux = <AURIX_PINMUX(2, 5, 1)>;
	};

	/omit-if-no-ref/ edsadc_dscin5a_p0_1: edsadc_dscin5a_p0_1 {
		pinmux = <AURIX_PINMUX(0, 1, 0)>;
	};

	/omit-if-no-ref/ edsadc_dscin5b_p2_3: edsadc_dscin5b_p2_3 {
		pinmux = <AURIX_PINMUX(2, 3, 1)>;
	};

	/omit-if-no-ref/ edsadc_dscout0_p0_11: edsadc_dscout0_p0_11 {
		pinmux = <AURIX_PINMUX(0, 11, 4)>;
		output-enable;
	};

	/omit-if-no-ref/ edsadc_dscout0_p33_5: edsadc_dscout0_p33_5 {
		pinmux = <AURIX_PINMUX(33, 5, 4)>;
		output-enable;
	};

	/omit-if-no-ref/ edsadc_dscout1_p0_9: edsadc_dscout1_p0_9 {
		pinmux = <AURIX_PINMUX(0, 9, 4)>;
		output-enable;
	};

	/omit-if-no-ref/ edsadc_dscout1_p33_3: edsadc_dscout1_p33_3 {
		pinmux = <AURIX_PINMUX(33, 3, 4)>;
		output-enable;
	};

	/omit-if-no-ref/ edsadc_dscout2_p0_5: edsadc_dscout2_p0_5 {
		pinmux = <AURIX_PINMUX(0, 5, 4)>;
		output-enable;
	};

	/omit-if-no-ref/ edsadc_dscout2_p33_1: edsadc_dscout2_p33_1 {
		pinmux = <AURIX_PINMUX(33, 1, 4)>;
		output-enable;
	};

	/omit-if-no-ref/ edsadc_dscout3_p0_3: edsadc_dscout3_p0_3 {
		pinmux = <AURIX_PINMUX(0, 3, 4)>;
		output-enable;
	};

	/omit-if-no-ref/ edsadc_dscout3_p2_7: edsadc_dscout3_p2_7 {
		pinmux = <AURIX_PINMUX(2, 7, 4)>;
		output-enable;
	};

	/omit-if-no-ref/ edsadc_dscout4_p0_7: edsadc_dscout4_p0_7 {
		pinmux = <AURIX_PINMUX(0, 7, 4)>;
		output-enable;
	};

	/omit-if-no-ref/ edsadc_dscout4_p2_5: edsadc_dscout4_p2_5 {
		pinmux = <AURIX_PINMUX(2, 5, 4)>;
		output-enable;
	};

	/omit-if-no-ref/ edsadc_dscout5_p0_1: edsadc_dscout5_p0_1 {
		pinmux = <AURIX_PINMUX(0, 1, 4)>;
		output-enable;
	};

	/omit-if-no-ref/ edsadc_dscout5_p2_3: edsadc_dscout5_p2_3 {
		pinmux = <AURIX_PINMUX(2, 3, 4)>;
		output-enable;
	};

	/omit-if-no-ref/ edsadc_dsdin0a_p0_12: edsadc_dsdin0a_p0_12 {
		pinmux = <AURIX_PINMUX(0, 12, 0)>;
	};

	/omit-if-no-ref/ edsadc_dsdin0b_p33_6: edsadc_dsdin0b_p33_6 {
		pinmux = <AURIX_PINMUX(33, 6, 1)>;
	};

	/omit-if-no-ref/ edsadc_dsdin1a_p0_10: edsadc_dsdin1a_p0_10 {
		pinmux = <AURIX_PINMUX(0, 10, 0)>;
	};

	/omit-if-no-ref/ edsadc_dsdin1b_p33_4: edsadc_dsdin1b_p33_4 {
		pinmux = <AURIX_PINMUX(33, 4, 1)>;
	};

	/omit-if-no-ref/ edsadc_dsdin2a_p0_6: edsadc_dsdin2a_p0_6 {
		pinmux = <AURIX_PINMUX(0, 6, 0)>;
	};

	/omit-if-no-ref/ edsadc_dsdin2b_p33_2: edsadc_dsdin2b_p33_2 {
		pinmux = <AURIX_PINMUX(33, 2, 1)>;
	};

	/omit-if-no-ref/ edsadc_dsdin3a_p0_4: edsadc_dsdin3a_p0_4 {
		pinmux = <AURIX_PINMUX(0, 4, 0)>;
	};

	/omit-if-no-ref/ edsadc_dsdin3b_p2_8: edsadc_dsdin3b_p2_8 {
		pinmux = <AURIX_PINMUX(2, 8, 1)>;
	};

	/omit-if-no-ref/ edsadc_dsdin4a_p0_8: edsadc_dsdin4a_p0_8 {
		pinmux = <AURIX_PINMUX(0, 8, 0)>;
	};

	/omit-if-no-ref/ edsadc_dsdin4b_p2_6: edsadc_dsdin4b_p2_6 {
		pinmux = <AURIX_PINMUX(2, 6, 1)>;
	};

	/omit-if-no-ref/ edsadc_dsdin5a_p0_2: edsadc_dsdin5a_p0_2 {
		pinmux = <AURIX_PINMUX(0, 2, 0)>;
	};

	/omit-if-no-ref/ edsadc_dsdin5b_p2_4: edsadc_dsdin5b_p2_4 {
		pinmux = <AURIX_PINMUX(2, 4, 1)>;
	};

	/omit-if-no-ref/ edsadc_itr0e_p33_0: edsadc_itr0e_p33_0 {
		pinmux = <AURIX_PINMUX(33, 0, 4)>;
	};

	/omit-if-no-ref/ edsadc_itr0f_p33_4: edsadc_itr0f_p33_4 {
		pinmux = <AURIX_PINMUX(33, 4, 5)>;
	};

	/omit-if-no-ref/ edsadc_itr1e_p33_1: edsadc_itr1e_p33_1 {
		pinmux = <AURIX_PINMUX(33, 1, 4)>;
	};

	/omit-if-no-ref/ edsadc_itr1f_p33_5: edsadc_itr1f_p33_5 {
		pinmux = <AURIX_PINMUX(33, 5, 5)>;
	};

	/omit-if-no-ref/ edsadc_itr2e_p33_2: edsadc_itr2e_p33_2 {
		pinmux = <AURIX_PINMUX(33, 2, 4)>;
	};

	/omit-if-no-ref/ edsadc_itr2f_p33_6: edsadc_itr2f_p33_6 {
		pinmux = <AURIX_PINMUX(33, 6, 5)>;
	};

	/omit-if-no-ref/ edsadc_itr3e_p2_8: edsadc_itr3e_p2_8 {
		pinmux = <AURIX_PINMUX(2, 8, 4)>;
	};

	/omit-if-no-ref/ edsadc_itr3f_p0_9: edsadc_itr3f_p0_9 {
		pinmux = <AURIX_PINMUX(0, 9, 5)>;
	};

	/omit-if-no-ref/ edsadc_itr4e_p2_7: edsadc_itr4e_p2_7 {
		pinmux = <AURIX_PINMUX(2, 7, 4)>;
	};

	/omit-if-no-ref/ edsadc_itr4f_p0_6: edsadc_itr4f_p0_6 {
		pinmux = <AURIX_PINMUX(0, 6, 5)>;
	};

	/omit-if-no-ref/ edsadc_itr5e_p2_6: edsadc_itr5e_p2_6 {
		pinmux = <AURIX_PINMUX(2, 6, 4)>;
	};

	/omit-if-no-ref/ edsadc_itr5f_p0_3: edsadc_itr5f_p0_3 {
		pinmux = <AURIX_PINMUX(0, 3, 5)>;
	};

	/omit-if-no-ref/ edsadc_sgna_p0_4: edsadc_sgna_p0_4 {
		pinmux = <AURIX_PINMUX(0, 4, 0)>;
	};

	/omit-if-no-ref/ edsadc_sgnb_p33_13: edsadc_sgnb_p33_13 {
		pinmux = <AURIX_PINMUX(33, 13, 1)>;
	};

	/omit-if-no-ref/ eray0_txda_p11_3: eray0_txda_p11_3 {
		pinmux = <AURIX_PINMUX(11, 3, 4)>;
		output-enable;
	};

	/omit-if-no-ref/ eray0_txda_p14_0: eray0_txda_p14_0 {
		pinmux = <AURIX_PINMUX(14, 0, 3)>;
		output-enable;
	};

	/omit-if-no-ref/ eray0_txda_p14_10: eray0_txda_p14_10 {
		pinmux = <AURIX_PINMUX(14, 10, 6)>;
		output-enable;
	};

	/omit-if-no-ref/ eray0_txda_p2_0: eray0_txda_p2_0 {
		pinmux = <AURIX_PINMUX(2, 0, 6)>;
		output-enable;
	};

	/omit-if-no-ref/ eray0_txdb_p11_12: eray0_txdb_p11_12 {
		pinmux = <AURIX_PINMUX(11, 12, 4)>;
		output-enable;
	};

	/omit-if-no-ref/ eray0_txdb_p14_0: eray0_txdb_p14_0 {
		pinmux = <AURIX_PINMUX(14, 0, 4)>;
		output-enable;
	};

	/omit-if-no-ref/ eray0_txdb_p14_5: eray0_txdb_p14_5 {
		pinmux = <AURIX_PINMUX(14, 5, 6)>;
		output-enable;
	};

	/omit-if-no-ref/ eray0_txdb_p2_2: eray0_txdb_p2_2 {
		pinmux = <AURIX_PINMUX(2, 2, 6)>;
		output-enable;
	};

	/omit-if-no-ref/ eray0_txena_p11_6: eray0_txena_p11_6 {
		pinmux = <AURIX_PINMUX(11, 6, 4)>;
		output-enable;
	};

	/omit-if-no-ref/ eray0_txena_p14_9: eray0_txena_p14_9 {
		pinmux = <AURIX_PINMUX(14, 9, 6)>;
		output-enable;
	};

	/omit-if-no-ref/ eray0_txena_p2_4: eray0_txena_p2_4 {
		pinmux = <AURIX_PINMUX(2, 4, 6)>;
		output-enable;
	};

	/omit-if-no-ref/ eray0_txenb_p11_11: eray0_txenb_p11_11 {
		pinmux = <AURIX_PINMUX(11, 11, 6)>;
		output-enable;
	};

	/omit-if-no-ref/ eray0_txenb_p11_6: eray0_txenb_p11_6 {
		pinmux = <AURIX_PINMUX(11, 6, 2)>;
		output-enable;
	};

	/omit-if-no-ref/ eray0_txenb_p14_6: eray0_txenb_p14_6 {
		pinmux = <AURIX_PINMUX(14, 6, 6)>;
		output-enable;
	};

	/omit-if-no-ref/ eray0_txenb_p14_9: eray0_txenb_p14_9 {
		pinmux = <AURIX_PINMUX(14, 9, 5)>;
		output-enable;
	};

	/omit-if-no-ref/ eray0_txenb_p2_5: eray0_txenb_p2_5 {
		pinmux = <AURIX_PINMUX(2, 5, 6)>;
		output-enable;
	};

	/omit-if-no-ref/ evadc_emux00_p2_6: evadc_emux00_p2_6 {
		pinmux = <AURIX_PINMUX(2, 6, 5)>;
		output-enable;
	};

	/omit-if-no-ref/ evadc_emux00_p33_3: evadc_emux00_p33_3 {
		pinmux = <AURIX_PINMUX(33, 3, 5)>;
		output-enable;
	};

	/omit-if-no-ref/ evadc_emux01_p2_7: evadc_emux01_p2_7 {
		pinmux = <AURIX_PINMUX(2, 7, 5)>;
		output-enable;
	};

	/omit-if-no-ref/ evadc_emux01_p33_2: evadc_emux01_p33_2 {
		pinmux = <AURIX_PINMUX(33, 2, 5)>;
		output-enable;
	};

	/omit-if-no-ref/ evadc_emux02_p2_8: evadc_emux02_p2_8 {
		pinmux = <AURIX_PINMUX(2, 8, 5)>;
		output-enable;
	};

	/omit-if-no-ref/ evadc_emux02_p33_1: evadc_emux02_p33_1 {
		pinmux = <AURIX_PINMUX(33, 1, 5)>;
		output-enable;
	};

	/omit-if-no-ref/ evadc_emux10_p0_6: evadc_emux10_p0_6 {
		pinmux = <AURIX_PINMUX(0, 6, 5)>;
		output-enable;
	};

	/omit-if-no-ref/ evadc_emux10_p33_6: evadc_emux10_p33_6 {
		pinmux = <AURIX_PINMUX(33, 6, 5)>;
		output-enable;
	};

	/omit-if-no-ref/ evadc_emux11_p0_7: evadc_emux11_p0_7 {
		pinmux = <AURIX_PINMUX(0, 7, 5)>;
		output-enable;
	};

	/omit-if-no-ref/ evadc_emux11_p33_5: evadc_emux11_p33_5 {
		pinmux = <AURIX_PINMUX(33, 5, 5)>;
		output-enable;
	};

	/omit-if-no-ref/ evadc_emux12_p0_8: evadc_emux12_p0_8 {
		pinmux = <AURIX_PINMUX(0, 8, 5)>;
		output-enable;
	};

	/omit-if-no-ref/ evadc_emux12_p33_4: evadc_emux12_p33_4 {
		pinmux = <AURIX_PINMUX(33, 4, 5)>;
		output-enable;
	};

	/omit-if-no-ref/ evadc_fc0bflout_p0_5: evadc_fc0bflout_p0_5 {
		pinmux = <AURIX_PINMUX(0, 5, 5)>;
		output-enable;
	};

	/omit-if-no-ref/ evadc_fc0bflout_p33_4: evadc_fc0bflout_p33_4 {
		pinmux = <AURIX_PINMUX(33, 4, 6)>;
		output-enable;
	};

	/omit-if-no-ref/ evadc_fc1bflout_p10_1: evadc_fc1bflout_p10_1 {
		pinmux = <AURIX_PINMUX(10, 1, 5)>;
		output-enable;
	};

	/omit-if-no-ref/ evadc_fc1bflout_p33_6: evadc_fc1bflout_p33_6 {
		pinmux = <AURIX_PINMUX(33, 6, 6)>;
		output-enable;
	};

	/omit-if-no-ref/ evadc_fc2bflout_p0_7: evadc_fc2bflout_p0_7 {
		pinmux = <AURIX_PINMUX(0, 7, 3)>;
		output-enable;
	};

	/omit-if-no-ref/ evadc_fc2bflout_p33_0: evadc_fc2bflout_p33_0 {
		pinmux = <AURIX_PINMUX(33, 0, 6)>;
		output-enable;
	};

	/omit-if-no-ref/ evadc_fc2bflout_p33_5: evadc_fc2bflout_p33_5 {
		pinmux = <AURIX_PINMUX(33, 5, 6)>;
		output-enable;
	};

	/omit-if-no-ref/ evadc_fc3bflout_p10_2: evadc_fc3bflout_p10_2 {
		pinmux = <AURIX_PINMUX(10, 2, 5)>;
		output-enable;
	};

	/omit-if-no-ref/ evadc_fc3bflout_p33_2: evadc_fc3bflout_p33_2 {
		pinmux = <AURIX_PINMUX(33, 2, 6)>;
		output-enable;
	};

	/omit-if-no-ref/ evadc_fc3bflout_p33_7: evadc_fc3bflout_p33_7 {
		pinmux = <AURIX_PINMUX(33, 7, 6)>;
		output-enable;
	};

	/omit-if-no-ref/ geth_crsb_p11_11: geth_crsb_p11_11 {
		pinmux = <AURIX_PINMUX(11, 11, 1)>;
	};

	/omit-if-no-ref/ geth_crsdva_p11_11: geth_crsdva_p11_11 {
		pinmux = <AURIX_PINMUX(11, 11, 0)>;
	};

	/omit-if-no-ref/ geth_mdc_p21_2: geth_mdc_p21_2 {
		pinmux = <AURIX_PINMUX(21, 2, 5)>;
		output-enable;
	};

	/omit-if-no-ref/ geth_mdc_p2_8: geth_mdc_p2_8 {
		pinmux = <AURIX_PINMUX(2, 8, 6)>;
		output-enable;
	};

	/omit-if-no-ref/ geth_mdioa_p0_0: geth_mdioa_p0_0 {
		pinmux = <AURIX_PINMUX(0, 0, 0)>;
	};

	/omit-if-no-ref/ geth_mdiod_p21_3: geth_mdiod_p21_3 {
		pinmux = <AURIX_PINMUX(21, 3, 3)>;
	};

	/omit-if-no-ref/ geth_pps_p14_4: geth_pps_p14_4 {
		pinmux = <AURIX_PINMUX(14, 4, 6)>;
		output-enable;
	};

	/omit-if-no-ref/ geth_rctla_p11_11: geth_rctla_p11_11 {
		pinmux = <AURIX_PINMUX(11, 11, 0)>;
	};

	/omit-if-no-ref/ geth_refclka_p11_12: geth_refclka_p11_12 {
		pinmux = <AURIX_PINMUX(11, 12, 0)>;
	};

	/omit-if-no-ref/ geth_rxclka_p11_12: geth_rxclka_p11_12 {
		pinmux = <AURIX_PINMUX(11, 12, 0)>;
	};

	/omit-if-no-ref/ geth_rxd0a_p11_10: geth_rxd0a_p11_10 {
		pinmux = <AURIX_PINMUX(11, 10, 0)>;
	};

	/omit-if-no-ref/ geth_rxd1a_p11_9: geth_rxd1a_p11_9 {
		pinmux = <AURIX_PINMUX(11, 9, 0)>;
	};

	/omit-if-no-ref/ geth_rxdva_p11_11: geth_rxdva_p11_11 {
		pinmux = <AURIX_PINMUX(11, 11, 0)>;
	};

	/omit-if-no-ref/ geth_rxerb_p21_7: geth_rxerb_p21_7 {
		pinmux = <AURIX_PINMUX(21, 7, 1)>;
	};

	/omit-if-no-ref/ geth_rxerc_p10_0: geth_rxerc_p10_0 {
		pinmux = <AURIX_PINMUX(10, 0, 2)>;
	};

	/omit-if-no-ref/ geth_txclkb_p11_12: geth_txclkb_p11_12 {
		pinmux = <AURIX_PINMUX(11, 12, 1)>;
	};

	/omit-if-no-ref/ geth_txd0_p11_3: geth_txd0_p11_3 {
		pinmux = <AURIX_PINMUX(11, 3, 6)>;
		output-enable;
	};

	/omit-if-no-ref/ geth_txd1_p11_2: geth_txd1_p11_2 {
		pinmux = <AURIX_PINMUX(11, 2, 6)>;
		output-enable;
	};

	/omit-if-no-ref/ geth_txen_p11_6: geth_txen_p11_6 {
		pinmux = <AURIX_PINMUX(11, 6, 6)>;
		output-enable;
	};

	/omit-if-no-ref/ gpt120_capina_p13_2: gpt120_capina_p13_2 {
		pinmux = <AURIX_PINMUX(13, 2, 0)>;
	};

	/omit-if-no-ref/ gpt120_t2euda_p0_8: gpt120_t2euda_p0_8 {
		pinmux = <AURIX_PINMUX(0, 8, 0)>;
	};

	/omit-if-no-ref/ gpt120_t2eudb_p33_6: gpt120_t2eudb_p33_6 {
		pinmux = <AURIX_PINMUX(33, 6, 1)>;
	};

	/omit-if-no-ref/ gpt120_t2ina_p0_7: gpt120_t2ina_p0_7 {
		pinmux = <AURIX_PINMUX(0, 7, 0)>;
	};

	/omit-if-no-ref/ gpt120_t2inb_p33_7: gpt120_t2inb_p33_7 {
		pinmux = <AURIX_PINMUX(33, 7, 1)>;
	};

	/omit-if-no-ref/ gpt120_t3euda_p2_7: gpt120_t3euda_p2_7 {
		pinmux = <AURIX_PINMUX(2, 7, 0)>;
	};

	/omit-if-no-ref/ gpt120_t3eudb_p10_7: gpt120_t3eudb_p10_7 {
		pinmux = <AURIX_PINMUX(10, 7, 1)>;
	};

	/omit-if-no-ref/ gpt120_t3ina_p2_6: gpt120_t3ina_p2_6 {
		pinmux = <AURIX_PINMUX(2, 6, 0)>;
	};

	/omit-if-no-ref/ gpt120_t3inb_p10_4: gpt120_t3inb_p10_4 {
		pinmux = <AURIX_PINMUX(10, 4, 1)>;
	};

	/omit-if-no-ref/ gpt120_t3out_p10_6: gpt120_t3out_p10_6 {
		pinmux = <AURIX_PINMUX(10, 6, 4)>;
		output-enable;
	};

	/omit-if-no-ref/ gpt120_t3out_p21_6: gpt120_t3out_p21_6 {
		pinmux = <AURIX_PINMUX(21, 6, 7)>;
		output-enable;
	};

	/omit-if-no-ref/ gpt120_t4euda_p0_9: gpt120_t4euda_p0_9 {
		pinmux = <AURIX_PINMUX(0, 9, 0)>;
	};

	/omit-if-no-ref/ gpt120_t4eudb_p33_5: gpt120_t4eudb_p33_5 {
		pinmux = <AURIX_PINMUX(33, 5, 1)>;
	};

	/omit-if-no-ref/ gpt120_t4ina_p2_8: gpt120_t4ina_p2_8 {
		pinmux = <AURIX_PINMUX(2, 8, 0)>;
	};

	/omit-if-no-ref/ gpt120_t4inb_p10_8: gpt120_t4inb_p10_8 {
		pinmux = <AURIX_PINMUX(10, 8, 1)>;
	};

	/omit-if-no-ref/ gpt120_t5euda_p21_6: gpt120_t5euda_p21_6 {
		pinmux = <AURIX_PINMUX(21, 6, 0)>;
	};

	/omit-if-no-ref/ gpt120_t5eudb_p10_1: gpt120_t5eudb_p10_1 {
		pinmux = <AURIX_PINMUX(10, 1, 1)>;
	};

	/omit-if-no-ref/ gpt120_t5ina_p21_7: gpt120_t5ina_p21_7 {
		pinmux = <AURIX_PINMUX(21, 7, 0)>;
	};

	/omit-if-no-ref/ gpt120_t5inb_p10_3: gpt120_t5inb_p10_3 {
		pinmux = <AURIX_PINMUX(10, 3, 1)>;
	};

	/omit-if-no-ref/ gpt120_t6euda_p20_0: gpt120_t6euda_p20_0 {
		pinmux = <AURIX_PINMUX(20, 0, 0)>;
	};

	/omit-if-no-ref/ gpt120_t6eudb_p10_0: gpt120_t6eudb_p10_0 {
		pinmux = <AURIX_PINMUX(10, 0, 1)>;
	};

	/omit-if-no-ref/ gpt120_t6ina_p20_3: gpt120_t6ina_p20_3 {
		pinmux = <AURIX_PINMUX(20, 3, 0)>;
	};

	/omit-if-no-ref/ gpt120_t6inb_p10_2: gpt120_t6inb_p10_2 {
		pinmux = <AURIX_PINMUX(10, 2, 1)>;
	};

	/omit-if-no-ref/ gpt120_t6out_p10_5: gpt120_t6out_p10_5 {
		pinmux = <AURIX_PINMUX(10, 5, 5)>;
		output-enable;
	};

	/omit-if-no-ref/ gpt120_t6out_p21_7: gpt120_t6out_p21_7 {
		pinmux = <AURIX_PINMUX(21, 7, 7)>;
		output-enable;
	};

	/omit-if-no-ref/ gtm_clk0_p23_1: gtm_clk0_p23_1 {
		pinmux = <AURIX_PINMUX(23, 1, 4)>;
		output-enable;
	};

	/omit-if-no-ref/ gtm_clk1_p32_4: gtm_clk1_p32_4 {
		pinmux = <AURIX_PINMUX(32, 4, 4)>;
		output-enable;
	};

	/omit-if-no-ref/ gtm_clk2_p11_12: gtm_clk2_p11_12 {
		pinmux = <AURIX_PINMUX(11, 12, 3)>;
		output-enable;
	};

	/omit-if-no-ref/ gtm_tout0_p2_0: gtm_tout0_p2_0 {
		pinmux = <AURIX_PINMUX(2, 0, 1)>;
		output-enable;
	};

	/omit-if-no-ref/ gtm_tout100_p11_11: gtm_tout100_p11_11 {
		pinmux = <AURIX_PINMUX(11, 11, 1)>;
		output-enable;
	};

	/omit-if-no-ref/ gtm_tout101_p11_12: gtm_tout101_p11_12 {
		pinmux = <AURIX_PINMUX(11, 12, 1)>;
		output-enable;
	};

	/omit-if-no-ref/ gtm_tout102_p10_0: gtm_tout102_p10_0 {
		pinmux = <AURIX_PINMUX(10, 0, 1)>;
		output-enable;
	};

	/omit-if-no-ref/ gtm_tout103_p10_1: gtm_tout103_p10_1 {
		pinmux = <AURIX_PINMUX(10, 1, 1)>;
		output-enable;
	};

	/omit-if-no-ref/ gtm_tout104_p10_2: gtm_tout104_p10_2 {
		pinmux = <AURIX_PINMUX(10, 2, 1)>;
		output-enable;
	};

	/omit-if-no-ref/ gtm_tout105_p10_3: gtm_tout105_p10_3 {
		pinmux = <AURIX_PINMUX(10, 3, 1)>;
		output-enable;
	};

	/omit-if-no-ref/ gtm_tout106_p10_4: gtm_tout106_p10_4 {
		pinmux = <AURIX_PINMUX(10, 4, 1)>;
		output-enable;
	};

	/omit-if-no-ref/ gtm_tout107_p10_5: gtm_tout107_p10_5 {
		pinmux = <AURIX_PINMUX(10, 5, 1)>;
		output-enable;
	};

	/omit-if-no-ref/ gtm_tout108_p10_6: gtm_tout108_p10_6 {
		pinmux = <AURIX_PINMUX(10, 6, 1)>;
		output-enable;
	};

	/omit-if-no-ref/ gtm_tout109_p10_7: gtm_tout109_p10_7 {
		pinmux = <AURIX_PINMUX(10, 7, 1)>;
		output-enable;
	};

	/omit-if-no-ref/ gtm_tout10_p0_1: gtm_tout10_p0_1 {
		pinmux = <AURIX_PINMUX(0, 1, 1)>;
		output-enable;
	};

	/omit-if-no-ref/ gtm_tout110_p10_8: gtm_tout110_p10_8 {
		pinmux = <AURIX_PINMUX(10, 8, 1)>;
		output-enable;
	};

	/omit-if-no-ref/ gtm_tout11_p0_2: gtm_tout11_p0_2 {
		pinmux = <AURIX_PINMUX(0, 2, 1)>;
		output-enable;
	};

	/omit-if-no-ref/ gtm_tout12_p0_3: gtm_tout12_p0_3 {
		pinmux = <AURIX_PINMUX(0, 3, 1)>;
		output-enable;
	};

	/omit-if-no-ref/ gtm_tout13_p0_4: gtm_tout13_p0_4 {
		pinmux = <AURIX_PINMUX(0, 4, 1)>;
		output-enable;
	};

	/omit-if-no-ref/ gtm_tout14_p0_5: gtm_tout14_p0_5 {
		pinmux = <AURIX_PINMUX(0, 5, 1)>;
		output-enable;
	};

	/omit-if-no-ref/ gtm_tout15_p0_6: gtm_tout15_p0_6 {
		pinmux = <AURIX_PINMUX(0, 6, 1)>;
		output-enable;
	};

	/omit-if-no-ref/ gtm_tout16_p0_7: gtm_tout16_p0_7 {
		pinmux = <AURIX_PINMUX(0, 7, 1)>;
		output-enable;
	};

	/omit-if-no-ref/ gtm_tout17_p0_8: gtm_tout17_p0_8 {
		pinmux = <AURIX_PINMUX(0, 8, 1)>;
		output-enable;
	};

	/omit-if-no-ref/ gtm_tout18_p0_9: gtm_tout18_p0_9 {
		pinmux = <AURIX_PINMUX(0, 9, 1)>;
		output-enable;
	};

	/omit-if-no-ref/ gtm_tout19_p0_10: gtm_tout19_p0_10 {
		pinmux = <AURIX_PINMUX(0, 10, 1)>;
		output-enable;
	};

	/omit-if-no-ref/ gtm_tout1_p2_1: gtm_tout1_p2_1 {
		pinmux = <AURIX_PINMUX(2, 1, 1)>;
		output-enable;
	};

	/omit-if-no-ref/ gtm_tout20_p0_11: gtm_tout20_p0_11 {
		pinmux = <AURIX_PINMUX(0, 11, 1)>;
		output-enable;
	};

	/omit-if-no-ref/ gtm_tout21_p0_12: gtm_tout21_p0_12 {
		pinmux = <AURIX_PINMUX(0, 12, 1)>;
		output-enable;
	};

	/omit-if-no-ref/ gtm_tout22_p33_0: gtm_tout22_p33_0 {
		pinmux = <AURIX_PINMUX(33, 0, 1)>;
		output-enable;
	};

	/omit-if-no-ref/ gtm_tout23_p33_1: gtm_tout23_p33_1 {
		pinmux = <AURIX_PINMUX(33, 1, 1)>;
		output-enable;
	};

	/omit-if-no-ref/ gtm_tout24_p33_2: gtm_tout24_p33_2 {
		pinmux = <AURIX_PINMUX(33, 2, 1)>;
		output-enable;
	};

	/omit-if-no-ref/ gtm_tout25_p33_3: gtm_tout25_p33_3 {
		pinmux = <AURIX_PINMUX(33, 3, 1)>;
		output-enable;
	};

	/omit-if-no-ref/ gtm_tout26_p33_4: gtm_tout26_p33_4 {
		pinmux = <AURIX_PINMUX(33, 4, 1)>;
		output-enable;
	};

	/omit-if-no-ref/ gtm_tout27_p33_5: gtm_tout27_p33_5 {
		pinmux = <AURIX_PINMUX(33, 5, 1)>;
		output-enable;
	};

	/omit-if-no-ref/ gtm_tout28_p33_6: gtm_tout28_p33_6 {
		pinmux = <AURIX_PINMUX(33, 6, 1)>;
		output-enable;
	};

	/omit-if-no-ref/ gtm_tout29_p33_7: gtm_tout29_p33_7 {
		pinmux = <AURIX_PINMUX(33, 7, 1)>;
		output-enable;
	};

	/omit-if-no-ref/ gtm_tout2_p2_2: gtm_tout2_p2_2 {
		pinmux = <AURIX_PINMUX(2, 2, 1)>;
		output-enable;
	};

	/omit-if-no-ref/ gtm_tout30_p33_8: gtm_tout30_p33_8 {
		pinmux = <AURIX_PINMUX(33, 8, 1)>;
		output-enable;
	};

	/omit-if-no-ref/ gtm_tout31_p33_9: gtm_tout31_p33_9 {
		pinmux = <AURIX_PINMUX(33, 9, 1)>;
		output-enable;
	};

	/omit-if-no-ref/ gtm_tout32_p33_10: gtm_tout32_p33_10 {
		pinmux = <AURIX_PINMUX(33, 10, 1)>;
		output-enable;
	};

	/omit-if-no-ref/ gtm_tout33_p33_11: gtm_tout33_p33_11 {
		pinmux = <AURIX_PINMUX(33, 11, 1)>;
		output-enable;
	};

	/omit-if-no-ref/ gtm_tout34_p33_12: gtm_tout34_p33_12 {
		pinmux = <AURIX_PINMUX(33, 12, 1)>;
		output-enable;
	};

	/omit-if-no-ref/ gtm_tout35_p33_13: gtm_tout35_p33_13 {
		pinmux = <AURIX_PINMUX(33, 13, 1)>;
		output-enable;
	};

	/omit-if-no-ref/ gtm_tout36_p32_0: gtm_tout36_p32_0 {
		pinmux = <AURIX_PINMUX(32, 0, 1)>;
		output-enable;
	};

	/omit-if-no-ref/ gtm_tout37_p32_1: gtm_tout37_p32_1 {
		pinmux = <AURIX_PINMUX(32, 1, 1)>;
		output-enable;
	};

	/omit-if-no-ref/ gtm_tout38_p32_2: gtm_tout38_p32_2 {
		pinmux = <AURIX_PINMUX(32, 2, 1)>;
		output-enable;
	};

	/omit-if-no-ref/ gtm_tout39_p32_3: gtm_tout39_p32_3 {
		pinmux = <AURIX_PINMUX(32, 3, 1)>;
		output-enable;
	};

	/omit-if-no-ref/ gtm_tout3_p2_3: gtm_tout3_p2_3 {
		pinmux = <AURIX_PINMUX(2, 3, 1)>;
		output-enable;
	};

	/omit-if-no-ref/ gtm_tout40_p32_4: gtm_tout40_p32_4 {
		pinmux = <AURIX_PINMUX(32, 4, 1)>;
		output-enable;
	};

	/omit-if-no-ref/ gtm_tout41_p23_0: gtm_tout41_p23_0 {
		pinmux = <AURIX_PINMUX(23, 0, 1)>;
		output-enable;
	};

	/omit-if-no-ref/ gtm_tout42_p23_1: gtm_tout42_p23_1 {
		pinmux = <AURIX_PINMUX(23, 1, 1)>;
		output-enable;
	};

	/omit-if-no-ref/ gtm_tout43_p23_2: gtm_tout43_p23_2 {
		pinmux = <AURIX_PINMUX(23, 2, 1)>;
		output-enable;
	};

	/omit-if-no-ref/ gtm_tout44_p23_3: gtm_tout44_p23_3 {
		pinmux = <AURIX_PINMUX(23, 3, 1)>;
		output-enable;
	};

	/omit-if-no-ref/ gtm_tout45_p23_4: gtm_tout45_p23_4 {
		pinmux = <AURIX_PINMUX(23, 4, 1)>;
		output-enable;
	};

	/omit-if-no-ref/ gtm_tout46_p23_5: gtm_tout46_p23_5 {
		pinmux = <AURIX_PINMUX(23, 5, 1)>;
		output-enable;
	};

	/omit-if-no-ref/ gtm_tout47_p22_0: gtm_tout47_p22_0 {
		pinmux = <AURIX_PINMUX(22, 0, 1)>;
		output-enable;
	};

	/omit-if-no-ref/ gtm_tout48_p22_1: gtm_tout48_p22_1 {
		pinmux = <AURIX_PINMUX(22, 1, 1)>;
		output-enable;
	};

	/omit-if-no-ref/ gtm_tout49_p22_2: gtm_tout49_p22_2 {
		pinmux = <AURIX_PINMUX(22, 2, 1)>;
		output-enable;
	};

	/omit-if-no-ref/ gtm_tout4_p2_4: gtm_tout4_p2_4 {
		pinmux = <AURIX_PINMUX(2, 4, 1)>;
		output-enable;
	};

	/omit-if-no-ref/ gtm_tout50_p22_3: gtm_tout50_p22_3 {
		pinmux = <AURIX_PINMUX(22, 3, 1)>;
		output-enable;
	};

	/omit-if-no-ref/ gtm_tout51_p21_0: gtm_tout51_p21_0 {
		pinmux = <AURIX_PINMUX(21, 0, 1)>;
		output-enable;
	};

	/omit-if-no-ref/ gtm_tout52_p21_1: gtm_tout52_p21_1 {
		pinmux = <AURIX_PINMUX(21, 1, 1)>;
		output-enable;
	};

	/omit-if-no-ref/ gtm_tout53_p21_2: gtm_tout53_p21_2 {
		pinmux = <AURIX_PINMUX(21, 2, 1)>;
		output-enable;
	};

	/omit-if-no-ref/ gtm_tout54_p21_3: gtm_tout54_p21_3 {
		pinmux = <AURIX_PINMUX(21, 3, 1)>;
		output-enable;
	};

	/omit-if-no-ref/ gtm_tout55_p21_4: gtm_tout55_p21_4 {
		pinmux = <AURIX_PINMUX(21, 4, 1)>;
		output-enable;
	};

	/omit-if-no-ref/ gtm_tout56_p21_5: gtm_tout56_p21_5 {
		pinmux = <AURIX_PINMUX(21, 5, 1)>;
		output-enable;
	};

	/omit-if-no-ref/ gtm_tout57_p21_6: gtm_tout57_p21_6 {
		pinmux = <AURIX_PINMUX(21, 6, 1)>;
		output-enable;
	};

	/omit-if-no-ref/ gtm_tout58_p21_7: gtm_tout58_p21_7 {
		pinmux = <AURIX_PINMUX(21, 7, 1)>;
		output-enable;
	};

	/omit-if-no-ref/ gtm_tout59_p20_0: gtm_tout59_p20_0 {
		pinmux = <AURIX_PINMUX(20, 0, 1)>;
		output-enable;
	};

	/omit-if-no-ref/ gtm_tout5_p2_5: gtm_tout5_p2_5 {
		pinmux = <AURIX_PINMUX(2, 5, 1)>;
		output-enable;
	};

	/omit-if-no-ref/ gtm_tout60_p20_1: gtm_tout60_p20_1 {
		pinmux = <AURIX_PINMUX(20, 1, 1)>;
		output-enable;
	};

	/omit-if-no-ref/ gtm_tout61_p20_3: gtm_tout61_p20_3 {
		pinmux = <AURIX_PINMUX(20, 3, 1)>;
		output-enable;
	};

	/omit-if-no-ref/ gtm_tout62_p20_6: gtm_tout62_p20_6 {
		pinmux = <AURIX_PINMUX(20, 6, 1)>;
		output-enable;
	};

	/omit-if-no-ref/ gtm_tout63_p20_7: gtm_tout63_p20_7 {
		pinmux = <AURIX_PINMUX(20, 7, 1)>;
		output-enable;
	};

	/omit-if-no-ref/ gtm_tout64_p20_8: gtm_tout64_p20_8 {
		pinmux = <AURIX_PINMUX(20, 8, 1)>;
		output-enable;
	};

	/omit-if-no-ref/ gtm_tout65_p20_9: gtm_tout65_p20_9 {
		pinmux = <AURIX_PINMUX(20, 9, 1)>;
		output-enable;
	};

	/omit-if-no-ref/ gtm_tout66_p20_10: gtm_tout66_p20_10 {
		pinmux = <AURIX_PINMUX(20, 10, 1)>;
		output-enable;
	};

	/omit-if-no-ref/ gtm_tout67_p20_11: gtm_tout67_p20_11 {
		pinmux = <AURIX_PINMUX(20, 11, 1)>;
		output-enable;
	};

	/omit-if-no-ref/ gtm_tout68_p20_12: gtm_tout68_p20_12 {
		pinmux = <AURIX_PINMUX(20, 12, 1)>;
		output-enable;
	};

	/omit-if-no-ref/ gtm_tout69_p20_13: gtm_tout69_p20_13 {
		pinmux = <AURIX_PINMUX(20, 13, 1)>;
		output-enable;
	};

	/omit-if-no-ref/ gtm_tout6_p2_6: gtm_tout6_p2_6 {
		pinmux = <AURIX_PINMUX(2, 6, 1)>;
		output-enable;
	};

	/omit-if-no-ref/ gtm_tout70_p20_14: gtm_tout70_p20_14 {
		pinmux = <AURIX_PINMUX(20, 14, 1)>;
		output-enable;
	};

	/omit-if-no-ref/ gtm_tout71_p15_0: gtm_tout71_p15_0 {
		pinmux = <AURIX_PINMUX(15, 0, 1)>;
		output-enable;
	};

	/omit-if-no-ref/ gtm_tout72_p15_1: gtm_tout72_p15_1 {
		pinmux = <AURIX_PINMUX(15, 1, 1)>;
		output-enable;
	};

	/omit-if-no-ref/ gtm_tout73_p15_2: gtm_tout73_p15_2 {
		pinmux = <AURIX_PINMUX(15, 2, 1)>;
		output-enable;
	};

	/omit-if-no-ref/ gtm_tout74_p15_3: gtm_tout74_p15_3 {
		pinmux = <AURIX_PINMUX(15, 3, 1)>;
		output-enable;
	};

	/omit-if-no-ref/ gtm_tout75_p15_4: gtm_tout75_p15_4 {
		pinmux = <AURIX_PINMUX(15, 4, 1)>;
		output-enable;
	};

	/omit-if-no-ref/ gtm_tout76_p15_5: gtm_tout76_p15_5 {
		pinmux = <AURIX_PINMUX(15, 5, 1)>;
		output-enable;
	};

	/omit-if-no-ref/ gtm_tout77_p15_6: gtm_tout77_p15_6 {
		pinmux = <AURIX_PINMUX(15, 6, 1)>;
		output-enable;
	};

	/omit-if-no-ref/ gtm_tout78_p15_7: gtm_tout78_p15_7 {
		pinmux = <AURIX_PINMUX(15, 7, 1)>;
		output-enable;
	};

	/omit-if-no-ref/ gtm_tout79_p15_8: gtm_tout79_p15_8 {
		pinmux = <AURIX_PINMUX(15, 8, 1)>;
		output-enable;
	};

	/omit-if-no-ref/ gtm_tout7_p2_7: gtm_tout7_p2_7 {
		pinmux = <AURIX_PINMUX(2, 7, 1)>;
		output-enable;
	};

	/omit-if-no-ref/ gtm_tout80_p14_0: gtm_tout80_p14_0 {
		pinmux = <AURIX_PINMUX(14, 0, 1)>;
		output-enable;
	};

	/omit-if-no-ref/ gtm_tout81_p14_1: gtm_tout81_p14_1 {
		pinmux = <AURIX_PINMUX(14, 1, 1)>;
		output-enable;
	};

	/omit-if-no-ref/ gtm_tout82_p14_2: gtm_tout82_p14_2 {
		pinmux = <AURIX_PINMUX(14, 2, 1)>;
		output-enable;
	};

	/omit-if-no-ref/ gtm_tout83_p14_3: gtm_tout83_p14_3 {
		pinmux = <AURIX_PINMUX(14, 3, 1)>;
		output-enable;
	};

	/omit-if-no-ref/ gtm_tout84_p14_4: gtm_tout84_p14_4 {
		pinmux = <AURIX_PINMUX(14, 4, 1)>;
		output-enable;
	};

	/omit-if-no-ref/ gtm_tout85_p14_5: gtm_tout85_p14_5 {
		pinmux = <AURIX_PINMUX(14, 5, 1)>;
		output-enable;
	};

	/omit-if-no-ref/ gtm_tout86_p14_6: gtm_tout86_p14_6 {
		pinmux = <AURIX_PINMUX(14, 6, 1)>;
		output-enable;
	};

	/omit-if-no-ref/ gtm_tout87_p14_7: gtm_tout87_p14_7 {
		pinmux = <AURIX_PINMUX(14, 7, 1)>;
		output-enable;
	};

	/omit-if-no-ref/ gtm_tout88_p14_8: gtm_tout88_p14_8 {
		pinmux = <AURIX_PINMUX(14, 8, 1)>;
		output-enable;
	};

	/omit-if-no-ref/ gtm_tout89_p14_9: gtm_tout89_p14_9 {
		pinmux = <AURIX_PINMUX(14, 9, 1)>;
		output-enable;
	};

	/omit-if-no-ref/ gtm_tout8_p2_8: gtm_tout8_p2_8 {
		pinmux = <AURIX_PINMUX(2, 8, 1)>;
		output-enable;
	};

	/omit-if-no-ref/ gtm_tout90_p14_10: gtm_tout90_p14_10 {
		pinmux = <AURIX_PINMUX(14, 10, 1)>;
		output-enable;
	};

	/omit-if-no-ref/ gtm_tout91_p13_0: gtm_tout91_p13_0 {
		pinmux = <AURIX_PINMUX(13, 0, 1)>;
		output-enable;
	};

	/omit-if-no-ref/ gtm_tout92_p13_1: gtm_tout92_p13_1 {
		pinmux = <AURIX_PINMUX(13, 1, 1)>;
		output-enable;
	};

	/omit-if-no-ref/ gtm_tout93_p13_2: gtm_tout93_p13_2 {
		pinmux = <AURIX_PINMUX(13, 2, 1)>;
		output-enable;
	};

	/omit-if-no-ref/ gtm_tout94_p13_3: gtm_tout94_p13_3 {
		pinmux = <AURIX_PINMUX(13, 3, 1)>;
		output-enable;
	};

	/omit-if-no-ref/ gtm_tout95_p11_2: gtm_tout95_p11_2 {
		pinmux = <AURIX_PINMUX(11, 2, 1)>;
		output-enable;
	};

	/omit-if-no-ref/ gtm_tout96_p11_3: gtm_tout96_p11_3 {
		pinmux = <AURIX_PINMUX(11, 3, 1)>;
		output-enable;
	};

	/omit-if-no-ref/ gtm_tout97_p11_6: gtm_tout97_p11_6 {
		pinmux = <AURIX_PINMUX(11, 6, 1)>;
		output-enable;
	};

	/omit-if-no-ref/ gtm_tout98_p11_9: gtm_tout98_p11_9 {
		pinmux = <AURIX_PINMUX(11, 9, 1)>;
		output-enable;
	};

	/omit-if-no-ref/ gtm_tout99_p11_10: gtm_tout99_p11_10 {
		pinmux = <AURIX_PINMUX(11, 10, 1)>;
		output-enable;
	};

	/omit-if-no-ref/ gtm_tout9_p0_0: gtm_tout9_p0_0 {
		pinmux = <AURIX_PINMUX(0, 0, 1)>;
		output-enable;
	};

	/omit-if-no-ref/ hsct0_sysclk_out_p20_0: hsct0_sysclk_out_p20_0 {
		pinmux = <AURIX_PINMUX(20, 0, 5)>;
		output-enable;
	};

	/omit-if-no-ref/ i2c0_scl_p13_1: i2c0_scl_p13_1 {
		pinmux = <AURIX_PINMUX(13, 1, 6)>;
		output-enable;
	};

	/omit-if-no-ref/ i2c0_scl_p15_4: i2c0_scl_p15_4 {
		pinmux = <AURIX_PINMUX(15, 4, 6)>;
		output-enable;
	};

	/omit-if-no-ref/ i2c0_scl_p2_5: i2c0_scl_p2_5 {
		pinmux = <AURIX_PINMUX(2, 5, 5)>;
		output-enable;
	};

	/omit-if-no-ref/ i2c0_scla_p2_5: i2c0_scla_p2_5 {
		pinmux = <AURIX_PINMUX(2, 5, 0)>;
	};

	/omit-if-no-ref/ i2c0_sclb_p13_1: i2c0_sclb_p13_1 {
		pinmux = <AURIX_PINMUX(13, 1, 1)>;
	};

	/omit-if-no-ref/ i2c0_sclc_p15_4: i2c0_sclc_p15_4 {
		pinmux = <AURIX_PINMUX(15, 4, 2)>;
	};

	/omit-if-no-ref/ i2c0_sda_p13_2: i2c0_sda_p13_2 {
		pinmux = <AURIX_PINMUX(13, 2, 6)>;
		output-enable;
	};

	/omit-if-no-ref/ i2c0_sda_p15_5: i2c0_sda_p15_5 {
		pinmux = <AURIX_PINMUX(15, 5, 6)>;
		output-enable;
	};

	/omit-if-no-ref/ i2c0_sda_p2_4: i2c0_sda_p2_4 {
		pinmux = <AURIX_PINMUX(2, 4, 5)>;
		output-enable;
	};

	/omit-if-no-ref/ i2c0_sdaa_p2_4: i2c0_sdaa_p2_4 {
		pinmux = <AURIX_PINMUX(2, 4, 0)>;
	};

	/omit-if-no-ref/ i2c0_sdab_p13_2: i2c0_sdab_p13_2 {
		pinmux = <AURIX_PINMUX(13, 2, 1)>;
	};

	/omit-if-no-ref/ i2c0_sdac_p15_5: i2c0_sdac_p15_5 {
		pinmux = <AURIX_PINMUX(15, 5, 2)>;
	};

	/omit-if-no-ref/ msc0_en0_p10_2: msc0_en0_p10_2 {
		pinmux = <AURIX_PINMUX(10, 2, 4)>;
		output-enable;
	};

	/omit-if-no-ref/ msc0_en0_p10_3: msc0_en0_p10_3 {
		pinmux = <AURIX_PINMUX(10, 3, 4)>;
		output-enable;
	};

	/omit-if-no-ref/ msc0_en0_p10_4: msc0_en0_p10_4 {
		pinmux = <AURIX_PINMUX(10, 4, 5)>;
		output-enable;
	};

	/omit-if-no-ref/ msc0_en0_p11_11: msc0_en0_p11_11 {
		pinmux = <AURIX_PINMUX(11, 11, 5)>;
		output-enable;
	};

	/omit-if-no-ref/ msc0_en0_p14_10: msc0_en0_p14_10 {
		pinmux = <AURIX_PINMUX(14, 10, 3)>;
		output-enable;
	};

	/omit-if-no-ref/ msc0_en0_p15_5: msc0_en0_p15_5 {
		pinmux = <AURIX_PINMUX(15, 5, 5)>;
		output-enable;
	};

	/omit-if-no-ref/ msc0_en1_p10_1: msc0_en1_p10_1 {
		pinmux = <AURIX_PINMUX(10, 1, 4)>;
		output-enable;
	};

	/omit-if-no-ref/ msc0_en1_p11_2: msc0_en1_p11_2 {
		pinmux = <AURIX_PINMUX(11, 2, 5)>;
		output-enable;
	};

	/omit-if-no-ref/ msc0_en1_p13_0: msc0_en1_p13_0 {
		pinmux = <AURIX_PINMUX(13, 0, 4)>;
		output-enable;
	};

	/omit-if-no-ref/ msc0_en1_p14_9: msc0_en1_p14_9 {
		pinmux = <AURIX_PINMUX(14, 9, 3)>;
		output-enable;
	};

	/omit-if-no-ref/ msc0_en1_p15_3: msc0_en1_p15_3 {
		pinmux = <AURIX_PINMUX(15, 3, 5)>;
		output-enable;
	};

	/omit-if-no-ref/ msc0_fcln_p13_0: msc0_fcln_p13_0 {
		pinmux = <AURIX_PINMUX(13, 0, 5)>;
		output-enable;
	};

	/omit-if-no-ref/ msc0_fclp_p11_6: msc0_fclp_p11_6 {
		pinmux = <AURIX_PINMUX(11, 6, 5)>;
		output-enable;
	};

	/omit-if-no-ref/ msc0_fclp_p13_1: msc0_fclp_p13_1 {
		pinmux = <AURIX_PINMUX(13, 1, 5)>;
		output-enable;
	};

	/omit-if-no-ref/ msc0_fclp_p13_2: msc0_fclp_p13_2 {
		pinmux = <AURIX_PINMUX(13, 2, 4)>;
		output-enable;
	};

	/omit-if-no-ref/ msc0_son_p13_2: msc0_son_p13_2 {
		pinmux = <AURIX_PINMUX(13, 2, 5)>;
		output-enable;
	};

	/omit-if-no-ref/ msc0_sop_p11_9: msc0_sop_p11_9 {
		pinmux = <AURIX_PINMUX(11, 9, 5)>;
		output-enable;
	};

	/omit-if-no-ref/ msc0_sop_p13_3: msc0_sop_p13_3 {
		pinmux = <AURIX_PINMUX(13, 3, 5)>;
		output-enable;
	};

	/omit-if-no-ref/ msc1_en0_p23_4: msc1_en0_p23_4 {
		pinmux = <AURIX_PINMUX(23, 4, 5)>;
		output-enable;
	};

	/omit-if-no-ref/ msc1_en0_p32_4: msc1_en0_p32_4 {
		pinmux = <AURIX_PINMUX(32, 4, 5)>;
		output-enable;
	};

	/omit-if-no-ref/ msc1_en1_p23_5: msc1_en1_p23_5 {
		pinmux = <AURIX_PINMUX(23, 5, 5)>;
		output-enable;
	};

	/omit-if-no-ref/ msc1_fcln_p22_0: msc1_fcln_p22_0 {
		pinmux = <AURIX_PINMUX(22, 0, 5)>;
		output-enable;
	};

	/omit-if-no-ref/ msc1_fclp_p22_1: msc1_fclp_p22_1 {
		pinmux = <AURIX_PINMUX(22, 1, 5)>;
		output-enable;
	};

	/omit-if-no-ref/ msc1_son_p22_2: msc1_son_p22_2 {
		pinmux = <AURIX_PINMUX(22, 2, 5)>;
		output-enable;
	};

	/omit-if-no-ref/ msc1_sop_p22_3: msc1_sop_p22_3 {
		pinmux = <AURIX_PINMUX(22, 3, 5)>;
		output-enable;
	};

	/omit-if-no-ref/ pms_dcdcsynco_p32_2: pms_dcdcsynco_p32_2 {
		pinmux = <AURIX_PINMUX(32, 2, 6)>;
		output-enable;
	};

	/omit-if-no-ref/ psi5_rx0a_p0_1: psi5_rx0a_p0_1 {
		pinmux = <AURIX_PINMUX(0, 1, 0)>;
	};

	/omit-if-no-ref/ psi5_rx0b_p2_3: psi5_rx0b_p2_3 {
		pinmux = <AURIX_PINMUX(2, 3, 1)>;
	};

	/omit-if-no-ref/ psi5_rx0c_p33_1: psi5_rx0c_p33_1 {
		pinmux = <AURIX_PINMUX(33, 1, 2)>;
	};

	/omit-if-no-ref/ psi5_rx1a_p0_3: psi5_rx1a_p0_3 {
		pinmux = <AURIX_PINMUX(0, 3, 0)>;
	};

	/omit-if-no-ref/ psi5_rx1b_p2_5: psi5_rx1b_p2_5 {
		pinmux = <AURIX_PINMUX(2, 5, 1)>;
	};

	/omit-if-no-ref/ psi5_rx1c_p33_3: psi5_rx1c_p33_3 {
		pinmux = <AURIX_PINMUX(33, 3, 2)>;
	};

	/omit-if-no-ref/ psi5_tx0_p0_2: psi5_tx0_p0_2 {
		pinmux = <AURIX_PINMUX(0, 2, 4)>;
		output-enable;
	};

	/omit-if-no-ref/ psi5_tx0_p2_2: psi5_tx0_p2_2 {
		pinmux = <AURIX_PINMUX(2, 2, 4)>;
		output-enable;
	};

	/omit-if-no-ref/ psi5_tx0_p33_2: psi5_tx0_p33_2 {
		pinmux = <AURIX_PINMUX(33, 2, 4)>;
		output-enable;
	};

	/omit-if-no-ref/ psi5_tx1_p0_4: psi5_tx1_p0_4 {
		pinmux = <AURIX_PINMUX(0, 4, 4)>;
		output-enable;
	};

	/omit-if-no-ref/ psi5_tx1_p2_6: psi5_tx1_p2_6 {
		pinmux = <AURIX_PINMUX(2, 6, 4)>;
		output-enable;
	};

	/omit-if-no-ref/ psi5_tx1_p33_4: psi5_tx1_p33_4 {
		pinmux = <AURIX_PINMUX(33, 4, 4)>;
		output-enable;
	};

	/omit-if-no-ref/ psi5s_clk_p2_4: psi5s_clk_p2_4 {
		pinmux = <AURIX_PINMUX(2, 4, 4)>;
		output-enable;
	};

	/omit-if-no-ref/ psi5s_clk_p33_10: psi5s_clk_p33_10 {
		pinmux = <AURIX_PINMUX(33, 10, 5)>;
		output-enable;
	};

	/omit-if-no-ref/ psi5s_rxa_p0_3: psi5s_rxa_p0_3 {
		pinmux = <AURIX_PINMUX(0, 3, 0)>;
	};

	/omit-if-no-ref/ psi5s_rxb_p2_5: psi5s_rxb_p2_5 {
		pinmux = <AURIX_PINMUX(2, 5, 1)>;
	};

	/omit-if-no-ref/ psi5s_rxc_p33_5: psi5s_rxc_p33_5 {
		pinmux = <AURIX_PINMUX(33, 5, 2)>;
	};

	/omit-if-no-ref/ psi5s_tx_p0_4: psi5s_tx_p0_4 {
		pinmux = <AURIX_PINMUX(0, 4, 2)>;
		output-enable;
	};

	/omit-if-no-ref/ psi5s_tx_p2_6: psi5s_tx_p2_6 {
		pinmux = <AURIX_PINMUX(2, 6, 2)>;
		output-enable;
	};

	/omit-if-no-ref/ psi5s_tx_p33_6: psi5s_tx_p33_6 {
		pinmux = <AURIX_PINMUX(33, 6, 7)>;
		output-enable;
	};

	/omit-if-no-ref/ qspi0_mrst_p20_12: qspi0_mrst_p20_12 {
		pinmux = <AURIX_PINMUX(20, 12, 3)>;
		output-enable;
	};

	/omit-if-no-ref/ qspi0_mrsta_p20_12: qspi0_mrsta_p20_12 {
		pinmux = <AURIX_PINMUX(20, 12, 0)>;
	};

	/omit-if-no-ref/ qspi0_mtsr_p20_12: qspi0_mtsr_p20_12 {
		pinmux = <AURIX_PINMUX(20, 12, 4)>;
		output-enable;
	};

	/omit-if-no-ref/ qspi0_mtsr_p20_14: qspi0_mtsr_p20_14 {
		pinmux = <AURIX_PINMUX(20, 14, 3)>;
		output-enable;
	};

	/omit-if-no-ref/ qspi0_mtsra_p20_14: qspi0_mtsra_p20_14 {
		pinmux = <AURIX_PINMUX(20, 14, 0)>;
	};

	/omit-if-no-ref/ qspi0_sclk_p20_11: qspi0_sclk_p20_11 {
		pinmux = <AURIX_PINMUX(20, 11, 3)>;
		output-enable;
	};

	/omit-if-no-ref/ qspi0_sclk_p20_13: qspi0_sclk_p20_13 {
		pinmux = <AURIX_PINMUX(20, 13, 5)>;
		output-enable;
	};

	/omit-if-no-ref/ qspi0_sclka_p20_11: qspi0_sclka_p20_11 {
		pinmux = <AURIX_PINMUX(20, 11, 0)>;
	};

	/omit-if-no-ref/ qspi0_slsia_p20_13: qspi0_slsia_p20_13 {
		pinmux = <AURIX_PINMUX(20, 13, 0)>;
	};

	/omit-if-no-ref/ qspi0_slsib_p20_9: qspi0_slsib_p20_9 {
		pinmux = <AURIX_PINMUX(20, 9, 1)>;
	};

	/omit-if-no-ref/ qspi0_slso0_p20_8: qspi0_slso0_p20_8 {
		pinmux = <AURIX_PINMUX(20, 8, 3)>;
		output-enable;
	};

	/omit-if-no-ref/ qspi0_slso13_p15_0: qspi0_slso13_p15_0 {
		pinmux = <AURIX_PINMUX(15, 0, 3)>;
		output-enable;
	};

	/omit-if-no-ref/ qspi0_slso1_p20_9: qspi0_slso1_p20_9 {
		pinmux = <AURIX_PINMUX(20, 9, 3)>;
		output-enable;
	};

	/omit-if-no-ref/ qspi0_slso2_p20_13: qspi0_slso2_p20_13 {
		pinmux = <AURIX_PINMUX(20, 13, 3)>;
		output-enable;
	};

	/omit-if-no-ref/ qspi0_slso3_p11_10: qspi0_slso3_p11_10 {
		pinmux = <AURIX_PINMUX(11, 10, 3)>;
		output-enable;
	};

	/omit-if-no-ref/ qspi0_slso4_p11_11: qspi0_slso4_p11_11 {
		pinmux = <AURIX_PINMUX(11, 11, 3)>;
		output-enable;
	};

	/omit-if-no-ref/ qspi0_slso5_p11_2: qspi0_slso5_p11_2 {
		pinmux = <AURIX_PINMUX(11, 2, 3)>;
		output-enable;
	};

	/omit-if-no-ref/ qspi0_slso6_p20_10: qspi0_slso6_p20_10 {
		pinmux = <AURIX_PINMUX(20, 10, 3)>;
		output-enable;
	};

	/omit-if-no-ref/ qspi0_slso7_p33_5: qspi0_slso7_p33_5 {
		pinmux = <AURIX_PINMUX(33, 5, 2)>;
		output-enable;
	};

	/omit-if-no-ref/ qspi0_slso8_p20_6: qspi0_slso8_p20_6 {
		pinmux = <AURIX_PINMUX(20, 6, 3)>;
		output-enable;
	};

	/omit-if-no-ref/ qspi0_slso9_p20_3: qspi0_slso9_p20_3 {
		pinmux = <AURIX_PINMUX(20, 3, 3)>;
		output-enable;
	};

	/omit-if-no-ref/ qspi1_mrst_p10_1: qspi1_mrst_p10_1 {
		pinmux = <AURIX_PINMUX(10, 1, 3)>;
		output-enable;
	};

	/omit-if-no-ref/ qspi1_mrst_p10_6: qspi1_mrst_p10_6 {
		pinmux = <AURIX_PINMUX(10, 6, 6)>;
		output-enable;
	};

	/omit-if-no-ref/ qspi1_mrst_p11_3: qspi1_mrst_p11_3 {
		pinmux = <AURIX_PINMUX(11, 3, 3)>;
		output-enable;
	};

	/omit-if-no-ref/ qspi1_mrsta_p10_1: qspi1_mrsta_p10_1 {
		pinmux = <AURIX_PINMUX(10, 1, 0)>;
	};

	/omit-if-no-ref/ qspi1_mrstb_p11_3: qspi1_mrstb_p11_3 {
		pinmux = <AURIX_PINMUX(11, 3, 1)>;
	};

	/omit-if-no-ref/ qspi1_mtsr_p10_1: qspi1_mtsr_p10_1 {
		pinmux = <AURIX_PINMUX(10, 1, 2)>;
		output-enable;
	};

	/omit-if-no-ref/ qspi1_mtsr_p10_3: qspi1_mtsr_p10_3 {
		pinmux = <AURIX_PINMUX(10, 3, 3)>;
		output-enable;
	};

	/omit-if-no-ref/ qspi1_mtsr_p10_4: qspi1_mtsr_p10_4 {
		pinmux = <AURIX_PINMUX(10, 4, 4)>;
		output-enable;
	};

	/omit-if-no-ref/ qspi1_mtsr_p11_9: qspi1_mtsr_p11_9 {
		pinmux = <AURIX_PINMUX(11, 9, 3)>;
		output-enable;
	};

	/omit-if-no-ref/ qspi1_mtsra_p10_3: qspi1_mtsra_p10_3 {
		pinmux = <AURIX_PINMUX(10, 3, 0)>;
	};

	/omit-if-no-ref/ qspi1_mtsrb_p11_9: qspi1_mtsrb_p11_9 {
		pinmux = <AURIX_PINMUX(11, 9, 1)>;
	};

	/omit-if-no-ref/ qspi1_mtsrc_p10_4: qspi1_mtsrc_p10_4 {
		pinmux = <AURIX_PINMUX(10, 4, 2)>;
	};

	/omit-if-no-ref/ qspi1_sclk_p10_2: qspi1_sclk_p10_2 {
		pinmux = <AURIX_PINMUX(10, 2, 3)>;
		output-enable;
	};

	/omit-if-no-ref/ qspi1_sclk_p11_6: qspi1_sclk_p11_6 {
		pinmux = <AURIX_PINMUX(11, 6, 3)>;
		output-enable;
	};

	/omit-if-no-ref/ qspi1_sclka_p10_2: qspi1_sclka_p10_2 {
		pinmux = <AURIX_PINMUX(10, 2, 0)>;
	};

	/omit-if-no-ref/ qspi1_sclkb_p11_6: qspi1_sclkb_p11_6 {
		pinmux = <AURIX_PINMUX(11, 6, 1)>;
	};

	/omit-if-no-ref/ qspi1_slsia_p11_10: qspi1_slsia_p11_10 {
		pinmux = <AURIX_PINMUX(11, 10, 0)>;
	};

	/omit-if-no-ref/ qspi1_slso0_p20_8: qspi1_slso0_p20_8 {
		pinmux = <AURIX_PINMUX(20, 8, 4)>;
		output-enable;
	};

	/omit-if-no-ref/ qspi1_slso10_p10_0: qspi1_slso10_p10_0 {
		pinmux = <AURIX_PINMUX(10, 0, 3)>;
		output-enable;
	};

	/omit-if-no-ref/ qspi1_slso1_p20_9: qspi1_slso1_p20_9 {
		pinmux = <AURIX_PINMUX(20, 9, 4)>;
		output-enable;
	};

	/omit-if-no-ref/ qspi1_slso2_p20_13: qspi1_slso2_p20_13 {
		pinmux = <AURIX_PINMUX(20, 13, 4)>;
		output-enable;
	};

	/omit-if-no-ref/ qspi1_slso3_p11_10: qspi1_slso3_p11_10 {
		pinmux = <AURIX_PINMUX(11, 10, 4)>;
		output-enable;
	};

	/omit-if-no-ref/ qspi1_slso4_p11_11: qspi1_slso4_p11_11 {
		pinmux = <AURIX_PINMUX(11, 11, 4)>;
		output-enable;
	};

	/omit-if-no-ref/ qspi1_slso5_p11_2: qspi1_slso5_p11_2 {
		pinmux = <AURIX_PINMUX(11, 2, 4)>;
		output-enable;
	};

	/omit-if-no-ref/ qspi1_slso6_p33_10: qspi1_slso6_p33_10 {
		pinmux = <AURIX_PINMUX(33, 10, 2)>;
		output-enable;
	};

	/omit-if-no-ref/ qspi1_slso7_p33_5: qspi1_slso7_p33_5 {
		pinmux = <AURIX_PINMUX(33, 5, 3)>;
		output-enable;
	};

	/omit-if-no-ref/ qspi1_slso8_p10_4: qspi1_slso8_p10_4 {
		pinmux = <AURIX_PINMUX(10, 4, 3)>;
		output-enable;
	};

	/omit-if-no-ref/ qspi1_slso9_p10_5: qspi1_slso9_p10_5 {
		pinmux = <AURIX_PINMUX(10, 5, 4)>;
		output-enable;
	};

	/omit-if-no-ref/ qspi2_mrst_p15_4: qspi2_mrst_p15_4 {
		pinmux = <AURIX_PINMUX(15, 4, 3)>;
		output-enable;
	};

	/omit-if-no-ref/ qspi2_mrst_p15_7: qspi2_mrst_p15_7 {
		pinmux = <AURIX_PINMUX(15, 7, 3)>;
		output-enable;
	};

	/omit-if-no-ref/ qspi2_mrsta_p15_4: qspi2_mrsta_p15_4 {
		pinmux = <AURIX_PINMUX(15, 4, 0)>;
	};

	/omit-if-no-ref/ qspi2_mrstb_p15_7: qspi2_mrstb_p15_7 {
		pinmux = <AURIX_PINMUX(15, 7, 1)>;
	};

	/omit-if-no-ref/ qspi2_mrstcn_p21_2: qspi2_mrstcn_p21_2 {
		pinmux = <AURIX_PINMUX(21, 2, 2)>;
	};

	/omit-if-no-ref/ qspi2_mrstcp_p21_3: qspi2_mrstcp_p21_3 {
		pinmux = <AURIX_PINMUX(21, 3, 2)>;
	};

	/omit-if-no-ref/ qspi2_mrste_p15_2: qspi2_mrste_p15_2 {
		pinmux = <AURIX_PINMUX(15, 2, 4)>;
	};

	/omit-if-no-ref/ qspi2_mrstfn_p14_9: qspi2_mrstfn_p14_9 {
		pinmux = <AURIX_PINMUX(14, 9, 5)>;
	};

	/omit-if-no-ref/ qspi2_mrstfp_p14_10: qspi2_mrstfp_p14_10 {
		pinmux = <AURIX_PINMUX(14, 10, 5)>;
	};

	/omit-if-no-ref/ qspi2_mtsr_p15_5: qspi2_mtsr_p15_5 {
		pinmux = <AURIX_PINMUX(15, 5, 3)>;
		output-enable;
	};

	/omit-if-no-ref/ qspi2_mtsr_p15_6: qspi2_mtsr_p15_6 {
		pinmux = <AURIX_PINMUX(15, 6, 3)>;
		output-enable;
	};

	/omit-if-no-ref/ qspi2_mtsra_p15_5: qspi2_mtsra_p15_5 {
		pinmux = <AURIX_PINMUX(15, 5, 0)>;
	};

	/omit-if-no-ref/ qspi2_mtsrb_p15_6: qspi2_mtsrb_p15_6 {
		pinmux = <AURIX_PINMUX(15, 6, 1)>;
	};

	/omit-if-no-ref/ qspi2_mtsrn_p13_2: qspi2_mtsrn_p13_2 {
		pinmux = <AURIX_PINMUX(13, 2, 3)>;
		output-enable;
	};

	/omit-if-no-ref/ qspi2_mtsrp_p13_3: qspi2_mtsrp_p13_3 {
		pinmux = <AURIX_PINMUX(13, 3, 3)>;
		output-enable;
	};

	/omit-if-no-ref/ qspi2_sclk_p15_3: qspi2_sclk_p15_3 {
		pinmux = <AURIX_PINMUX(15, 3, 3)>;
		output-enable;
	};

	/omit-if-no-ref/ qspi2_sclk_p15_6: qspi2_sclk_p15_6 {
		pinmux = <AURIX_PINMUX(15, 6, 5)>;
		output-enable;
	};

	/omit-if-no-ref/ qspi2_sclk_p15_8: qspi2_sclk_p15_8 {
		pinmux = <AURIX_PINMUX(15, 8, 3)>;
		output-enable;
	};

	/omit-if-no-ref/ qspi2_sclk_p33_1: qspi2_sclk_p33_1 {
		pinmux = <AURIX_PINMUX(33, 1, 3)>;
		output-enable;
	};

	/omit-if-no-ref/ qspi2_sclka_p15_3: qspi2_sclka_p15_3 {
		pinmux = <AURIX_PINMUX(15, 3, 0)>;
	};

	/omit-if-no-ref/ qspi2_sclkb_p15_8: qspi2_sclkb_p15_8 {
		pinmux = <AURIX_PINMUX(15, 8, 1)>;
	};

	/omit-if-no-ref/ qspi2_sclkn_p13_0: qspi2_sclkn_p13_0 {
		pinmux = <AURIX_PINMUX(13, 0, 3)>;
		output-enable;
	};

	/omit-if-no-ref/ qspi2_sclkp_p13_1: qspi2_sclkp_p13_1 {
		pinmux = <AURIX_PINMUX(13, 1, 3)>;
		output-enable;
	};

	/omit-if-no-ref/ qspi2_slsia_p15_2: qspi2_slsia_p15_2 {
		pinmux = <AURIX_PINMUX(15, 2, 0)>;
	};

	/omit-if-no-ref/ qspi2_slsib_p15_1: qspi2_slsib_p15_1 {
		pinmux = <AURIX_PINMUX(15, 1, 1)>;
	};

	/omit-if-no-ref/ qspi2_slso0_p15_2: qspi2_slso0_p15_2 {
		pinmux = <AURIX_PINMUX(15, 2, 3)>;
		output-enable;
	};

	/omit-if-no-ref/ qspi2_slso10_p33_2: qspi2_slso10_p33_2 {
		pinmux = <AURIX_PINMUX(33, 2, 3)>;
		output-enable;
	};

	/omit-if-no-ref/ qspi2_slso11_p33_6: qspi2_slso11_p33_6 {
		pinmux = <AURIX_PINMUX(33, 6, 3)>;
		output-enable;
	};

	/omit-if-no-ref/ qspi2_slso12_p33_4: qspi2_slso12_p33_4 {
		pinmux = <AURIX_PINMUX(33, 4, 3)>;
		output-enable;
	};

	/omit-if-no-ref/ qspi2_slso1_p14_2: qspi2_slso1_p14_2 {
		pinmux = <AURIX_PINMUX(14, 2, 3)>;
		output-enable;
	};

	/omit-if-no-ref/ qspi2_slso2_p14_6: qspi2_slso2_p14_6 {
		pinmux = <AURIX_PINMUX(14, 6, 3)>;
		output-enable;
	};

	/omit-if-no-ref/ qspi2_slso3_p14_3: qspi2_slso3_p14_3 {
		pinmux = <AURIX_PINMUX(14, 3, 3)>;
		output-enable;
	};

	/omit-if-no-ref/ qspi2_slso4_p14_7: qspi2_slso4_p14_7 {
		pinmux = <AURIX_PINMUX(14, 7, 3)>;
		output-enable;
	};

	/omit-if-no-ref/ qspi2_slso5_p15_1: qspi2_slso5_p15_1 {
		pinmux = <AURIX_PINMUX(15, 1, 3)>;
		output-enable;
	};

	/omit-if-no-ref/ qspi2_slso6_p33_13: qspi2_slso6_p33_13 {
		pinmux = <AURIX_PINMUX(33, 13, 4)>;
		output-enable;
	};

	/omit-if-no-ref/ qspi2_slso7_p20_10: qspi2_slso7_p20_10 {
		pinmux = <AURIX_PINMUX(20, 10, 4)>;
		output-enable;
	};

	/omit-if-no-ref/ qspi2_slso8_p20_6: qspi2_slso8_p20_6 {
		pinmux = <AURIX_PINMUX(20, 6, 4)>;
		output-enable;
	};

	/omit-if-no-ref/ qspi2_slso9_p20_3: qspi2_slso9_p20_3 {
		pinmux = <AURIX_PINMUX(20, 3, 4)>;
		output-enable;
	};

	/omit-if-no-ref/ qspi3_mrst_p10_7: qspi3_mrst_p10_7 {
		pinmux = <AURIX_PINMUX(10, 7, 3)>;
		output-enable;
	};

	/omit-if-no-ref/ qspi3_mrst_p2_5: qspi3_mrst_p2_5 {
		pinmux = <AURIX_PINMUX(2, 5, 3)>;
		output-enable;
	};

	/omit-if-no-ref/ qspi3_mrsta_p2_5: qspi3_mrsta_p2_5 {
		pinmux = <AURIX_PINMUX(2, 5, 0)>;
	};

	/omit-if-no-ref/ qspi3_mrstb_p10_7: qspi3_mrstb_p10_7 {
		pinmux = <AURIX_PINMUX(10, 7, 1)>;
	};

	/omit-if-no-ref/ qspi3_mtsr_p10_6: qspi3_mtsr_p10_6 {
		pinmux = <AURIX_PINMUX(10, 6, 3)>;
		output-enable;
	};

	/omit-if-no-ref/ qspi3_mtsr_p2_6: qspi3_mtsr_p2_6 {
		pinmux = <AURIX_PINMUX(2, 6, 3)>;
		output-enable;
	};

	/omit-if-no-ref/ qspi3_mtsra_p2_6: qspi3_mtsra_p2_6 {
		pinmux = <AURIX_PINMUX(2, 6, 0)>;
	};

	/omit-if-no-ref/ qspi3_mtsrb_p10_6: qspi3_mtsrb_p10_6 {
		pinmux = <AURIX_PINMUX(10, 6, 1)>;
	};

	/omit-if-no-ref/ qspi3_sclk_p10_8: qspi3_sclk_p10_8 {
		pinmux = <AURIX_PINMUX(10, 8, 3)>;
		output-enable;
	};

	/omit-if-no-ref/ qspi3_sclk_p2_7: qspi3_sclk_p2_7 {
		pinmux = <AURIX_PINMUX(2, 7, 3)>;
		output-enable;
	};

	/omit-if-no-ref/ qspi3_sclka_p2_7: qspi3_sclka_p2_7 {
		pinmux = <AURIX_PINMUX(2, 7, 0)>;
	};

	/omit-if-no-ref/ qspi3_sclkb_p10_8: qspi3_sclkb_p10_8 {
		pinmux = <AURIX_PINMUX(10, 8, 1)>;
	};

	/omit-if-no-ref/ qspi3_slsia_p2_4: qspi3_slsia_p2_4 {
		pinmux = <AURIX_PINMUX(2, 4, 0)>;
	};

	/omit-if-no-ref/ qspi3_slso0_p2_4: qspi3_slso0_p2_4 {
		pinmux = <AURIX_PINMUX(2, 4, 3)>;
		output-enable;
	};

	/omit-if-no-ref/ qspi3_slso1_p2_0: qspi3_slso1_p2_0 {
		pinmux = <AURIX_PINMUX(2, 0, 3)>;
		output-enable;
	};

	/omit-if-no-ref/ qspi3_slso2_p2_1: qspi3_slso2_p2_1 {
		pinmux = <AURIX_PINMUX(2, 1, 3)>;
		output-enable;
	};

	/omit-if-no-ref/ qspi3_slso3_p0_5: qspi3_slso3_p0_5 {
		pinmux = <AURIX_PINMUX(0, 5, 3)>;
		output-enable;
	};

	/omit-if-no-ref/ qspi3_slso3_p2_2: qspi3_slso3_p2_2 {
		pinmux = <AURIX_PINMUX(2, 2, 3)>;
		output-enable;
	};

	/omit-if-no-ref/ qspi3_slso4_p0_2: qspi3_slso4_p0_2 {
		pinmux = <AURIX_PINMUX(0, 2, 6)>;
		output-enable;
	};

	/omit-if-no-ref/ qspi3_slso4_p2_3: qspi3_slso4_p2_3 {
		pinmux = <AURIX_PINMUX(2, 3, 3)>;
		output-enable;
	};

	/omit-if-no-ref/ qspi3_slso5_p2_8: qspi3_slso5_p2_8 {
		pinmux = <AURIX_PINMUX(2, 8, 2)>;
		output-enable;
	};

	/omit-if-no-ref/ qspi3_slso6_p0_8: qspi3_slso6_p0_8 {
		pinmux = <AURIX_PINMUX(0, 8, 2)>;
		output-enable;
	};

	/omit-if-no-ref/ qspi3_slso7_p0_9: qspi3_slso7_p0_9 {
		pinmux = <AURIX_PINMUX(0, 9, 2)>;
		output-enable;
	};

	/omit-if-no-ref/ qspi3_slso8_p10_5: qspi3_slso8_p10_5 {
		pinmux = <AURIX_PINMUX(10, 5, 3)>;
		output-enable;
	};

	/omit-if-no-ref/ qspi4_mrst_p22_1: qspi4_mrst_p22_1 {
		pinmux = <AURIX_PINMUX(22, 1, 3)>;
		output-enable;
	};

	/omit-if-no-ref/ qspi4_mrst_p33_13: qspi4_mrst_p33_13 {
		pinmux = <AURIX_PINMUX(33, 13, 3)>;
		output-enable;
	};

	/omit-if-no-ref/ qspi4_mrsta_p33_13: qspi4_mrsta_p33_13 {
		pinmux = <AURIX_PINMUX(33, 13, 0)>;
	};

	/omit-if-no-ref/ qspi4_mrstb_p22_1: qspi4_mrstb_p22_1 {
		pinmux = <AURIX_PINMUX(22, 1, 1)>;
	};

	/omit-if-no-ref/ qspi4_mrstcn_p21_2: qspi4_mrstcn_p21_2 {
		pinmux = <AURIX_PINMUX(21, 2, 2)>;
	};

	/omit-if-no-ref/ qspi4_mrstcp_p21_3: qspi4_mrstcp_p21_3 {
		pinmux = <AURIX_PINMUX(21, 3, 2)>;
	};

	/omit-if-no-ref/ qspi4_mrstdn_p21_0: qspi4_mrstdn_p21_0 {
		pinmux = <AURIX_PINMUX(21, 0, 3)>;
	};

	/omit-if-no-ref/ qspi4_mrstdp_p21_1: qspi4_mrstdp_p21_1 {
		pinmux = <AURIX_PINMUX(21, 1, 3)>;
	};

	/omit-if-no-ref/ qspi4_mtsr_p22_0: qspi4_mtsr_p22_0 {
		pinmux = <AURIX_PINMUX(22, 0, 3)>;
		output-enable;
	};

	/omit-if-no-ref/ qspi4_mtsr_p33_12: qspi4_mtsr_p33_12 {
		pinmux = <AURIX_PINMUX(33, 12, 3)>;
		output-enable;
	};

	/omit-if-no-ref/ qspi4_mtsra_p33_12: qspi4_mtsra_p33_12 {
		pinmux = <AURIX_PINMUX(33, 12, 0)>;
	};

	/omit-if-no-ref/ qspi4_mtsrb_p22_0: qspi4_mtsrb_p22_0 {
		pinmux = <AURIX_PINMUX(22, 0, 1)>;
	};

	/omit-if-no-ref/ qspi4_mtsrn_p22_2: qspi4_mtsrn_p22_2 {
		pinmux = <AURIX_PINMUX(22, 2, 4)>;
		output-enable;
	};

	/omit-if-no-ref/ qspi4_mtsrp_p22_3: qspi4_mtsrp_p22_3 {
		pinmux = <AURIX_PINMUX(22, 3, 4)>;
		output-enable;
	};

	/omit-if-no-ref/ qspi4_sclk_p22_3: qspi4_sclk_p22_3 {
		pinmux = <AURIX_PINMUX(22, 3, 3)>;
		output-enable;
	};

	/omit-if-no-ref/ qspi4_sclk_p33_11: qspi4_sclk_p33_11 {
		pinmux = <AURIX_PINMUX(33, 11, 3)>;
		output-enable;
	};

	/omit-if-no-ref/ qspi4_sclka_p33_11: qspi4_sclka_p33_11 {
		pinmux = <AURIX_PINMUX(33, 11, 0)>;
	};

	/omit-if-no-ref/ qspi4_sclkb_p22_3: qspi4_sclkb_p22_3 {
		pinmux = <AURIX_PINMUX(22, 3, 1)>;
	};

	/omit-if-no-ref/ qspi4_sclkn_p22_0: qspi4_sclkn_p22_0 {
		pinmux = <AURIX_PINMUX(22, 0, 4)>;
		output-enable;
	};

	/omit-if-no-ref/ qspi4_sclkp_p22_1: qspi4_sclkp_p22_1 {
		pinmux = <AURIX_PINMUX(22, 1, 4)>;
		output-enable;
	};

	/omit-if-no-ref/ qspi4_slsia_p33_10: qspi4_slsia_p33_10 {
		pinmux = <AURIX_PINMUX(33, 10, 0)>;
	};

	/omit-if-no-ref/ qspi4_slsib_p22_2: qspi4_slsib_p22_2 {
		pinmux = <AURIX_PINMUX(22, 2, 1)>;
	};

	/omit-if-no-ref/ qspi4_slso0_p33_10: qspi4_slso0_p33_10 {
		pinmux = <AURIX_PINMUX(33, 10, 3)>;
		output-enable;
	};

	/omit-if-no-ref/ qspi4_slso1_p33_9: qspi4_slso1_p33_9 {
		pinmux = <AURIX_PINMUX(33, 9, 3)>;
		output-enable;
	};

	/omit-if-no-ref/ qspi4_slso2_p33_3: qspi4_slso2_p33_3 {
		pinmux = <AURIX_PINMUX(33, 3, 3)>;
		output-enable;
	};

	/omit-if-no-ref/ qspi4_slso2_p33_8: qspi4_slso2_p33_8 {
		pinmux = <AURIX_PINMUX(33, 8, 3)>;
		output-enable;
	};

	/omit-if-no-ref/ qspi4_slso3_p22_2: qspi4_slso3_p22_2 {
		pinmux = <AURIX_PINMUX(22, 2, 3)>;
		output-enable;
	};

	/omit-if-no-ref/ qspi4_slso4_p23_5: qspi4_slso4_p23_5 {
		pinmux = <AURIX_PINMUX(23, 5, 3)>;
		output-enable;
	};

	/omit-if-no-ref/ qspi4_slso5_p23_4: qspi4_slso5_p23_4 {
		pinmux = <AURIX_PINMUX(23, 4, 3)>;
		output-enable;
	};

	/omit-if-no-ref/ qspi4_slso6_p23_1: qspi4_slso6_p23_1 {
		pinmux = <AURIX_PINMUX(23, 1, 3)>;
		output-enable;
	};

	/omit-if-no-ref/ qspi4_slso7_p2_1: qspi4_slso7_p2_1 {
		pinmux = <AURIX_PINMUX(2, 1, 2)>;
		output-enable;
	};

	/omit-if-no-ref/ qspi4_slso7_p33_7: qspi4_slso7_p33_7 {
		pinmux = <AURIX_PINMUX(33, 7, 3)>;
		output-enable;
	};

	/omit-if-no-ref/ scu_emgstop_port_a_p33_8: scu_emgstop_port_a_p33_8 {
		pinmux = <AURIX_PINMUX(33, 8, 0)>;
	};

	/omit-if-no-ref/ scu_emgstop_port_b_p21_2: scu_emgstop_port_b_p21_2 {
		pinmux = <AURIX_PINMUX(21, 2, 1)>;
	};

	/omit-if-no-ref/ sent_sent0a_p40_0: sent_sent0a_p40_0 {
		pinmux = <AURIX_PINMUX(40, 0, 0)>;
	};

	/omit-if-no-ref/ sent_sent0b_p0_1: sent_sent0b_p0_1 {
		pinmux = <AURIX_PINMUX(0, 1, 1)>;
	};

	/omit-if-no-ref/ sent_sent0c_p2_8: sent_sent0c_p2_8 {
		pinmux = <AURIX_PINMUX(2, 8, 2)>;
	};

	/omit-if-no-ref/ sent_sent10a_p40_10: sent_sent10a_p40_10 {
		pinmux = <AURIX_PINMUX(40, 10, 0)>;
	};

	/omit-if-no-ref/ sent_sent10b_p0_11: sent_sent10b_p0_11 {
		pinmux = <AURIX_PINMUX(0, 11, 1)>;
	};

	/omit-if-no-ref/ sent_sent10d_p15_2: sent_sent10d_p15_2 {
		pinmux = <AURIX_PINMUX(15, 2, 3)>;
	};

	/omit-if-no-ref/ sent_sent11a_p40_11: sent_sent11a_p40_11 {
		pinmux = <AURIX_PINMUX(40, 11, 0)>;
	};

	/omit-if-no-ref/ sent_sent11b_p0_12: sent_sent11b_p0_12 {
		pinmux = <AURIX_PINMUX(0, 12, 1)>;
	};

	/omit-if-no-ref/ sent_sent11d_p15_4: sent_sent11d_p15_4 {
		pinmux = <AURIX_PINMUX(15, 4, 3)>;
	};

	/omit-if-no-ref/ sent_sent12a_p40_12: sent_sent12a_p40_12 {
		pinmux = <AURIX_PINMUX(40, 12, 0)>;
	};

	/omit-if-no-ref/ sent_sent12b_p2_4: sent_sent12b_p2_4 {
		pinmux = <AURIX_PINMUX(2, 4, 1)>;
	};

	/omit-if-no-ref/ sent_sent13a_p40_13: sent_sent13a_p40_13 {
		pinmux = <AURIX_PINMUX(40, 13, 0)>;
	};

	/omit-if-no-ref/ sent_sent13b_p2_3: sent_sent13b_p2_3 {
		pinmux = <AURIX_PINMUX(2, 3, 1)>;
	};

	/omit-if-no-ref/ sent_sent13c_p33_0: sent_sent13c_p33_0 {
		pinmux = <AURIX_PINMUX(33, 0, 2)>;
	};

	/omit-if-no-ref/ sent_sent14a_p40_14: sent_sent14a_p40_14 {
		pinmux = <AURIX_PINMUX(40, 14, 0)>;
	};

	/omit-if-no-ref/ sent_sent14b_p2_2: sent_sent14b_p2_2 {
		pinmux = <AURIX_PINMUX(2, 2, 1)>;
	};

	/omit-if-no-ref/ sent_sent14c_p33_7: sent_sent14c_p33_7 {
		pinmux = <AURIX_PINMUX(33, 7, 2)>;
	};

	/omit-if-no-ref/ sent_sent1a_p40_1: sent_sent1a_p40_1 {
		pinmux = <AURIX_PINMUX(40, 1, 0)>;
	};

	/omit-if-no-ref/ sent_sent1b_p0_2: sent_sent1b_p0_2 {
		pinmux = <AURIX_PINMUX(0, 2, 1)>;
	};

	/omit-if-no-ref/ sent_sent1c_p2_7: sent_sent1c_p2_7 {
		pinmux = <AURIX_PINMUX(2, 7, 2)>;
	};

	/omit-if-no-ref/ sent_sent2a_p40_2: sent_sent2a_p40_2 {
		pinmux = <AURIX_PINMUX(40, 2, 0)>;
	};

	/omit-if-no-ref/ sent_sent2b_p0_3: sent_sent2b_p0_3 {
		pinmux = <AURIX_PINMUX(0, 3, 1)>;
	};

	/omit-if-no-ref/ sent_sent2c_p2_6: sent_sent2c_p2_6 {
		pinmux = <AURIX_PINMUX(2, 6, 2)>;
	};

	/omit-if-no-ref/ sent_sent3a_p40_3: sent_sent3a_p40_3 {
		pinmux = <AURIX_PINMUX(40, 3, 0)>;
	};

	/omit-if-no-ref/ sent_sent3b_p0_4: sent_sent3b_p0_4 {
		pinmux = <AURIX_PINMUX(0, 4, 1)>;
	};

	/omit-if-no-ref/ sent_sent3c_p2_5: sent_sent3c_p2_5 {
		pinmux = <AURIX_PINMUX(2, 5, 2)>;
	};

	/omit-if-no-ref/ sent_sent4a_p40_4: sent_sent4a_p40_4 {
		pinmux = <AURIX_PINMUX(40, 4, 0)>;
	};

	/omit-if-no-ref/ sent_sent4b_p0_5: sent_sent4b_p0_5 {
		pinmux = <AURIX_PINMUX(0, 5, 1)>;
	};

	/omit-if-no-ref/ sent_sent4c_p33_6: sent_sent4c_p33_6 {
		pinmux = <AURIX_PINMUX(33, 6, 2)>;
	};

	/omit-if-no-ref/ sent_sent5a_p40_5: sent_sent5a_p40_5 {
		pinmux = <AURIX_PINMUX(40, 5, 0)>;
	};

	/omit-if-no-ref/ sent_sent5b_p0_6: sent_sent5b_p0_6 {
		pinmux = <AURIX_PINMUX(0, 6, 1)>;
	};

	/omit-if-no-ref/ sent_sent5c_p33_5: sent_sent5c_p33_5 {
		pinmux = <AURIX_PINMUX(33, 5, 2)>;
	};

	/omit-if-no-ref/ sent_sent6a_p40_6: sent_sent6a_p40_6 {
		pinmux = <AURIX_PINMUX(40, 6, 0)>;
	};

	/omit-if-no-ref/ sent_sent6b_p0_7: sent_sent6b_p0_7 {
		pinmux = <AURIX_PINMUX(0, 7, 1)>;
	};

	/omit-if-no-ref/ sent_sent6c_p33_4: sent_sent6c_p33_4 {
		pinmux = <AURIX_PINMUX(33, 4, 2)>;
	};

	/omit-if-no-ref/ sent_sent7a_p40_7: sent_sent7a_p40_7 {
		pinmux = <AURIX_PINMUX(40, 7, 0)>;
	};

	/omit-if-no-ref/ sent_sent7b_p0_8: sent_sent7b_p0_8 {
		pinmux = <AURIX_PINMUX(0, 8, 1)>;
	};

	/omit-if-no-ref/ sent_sent7c_p33_3: sent_sent7c_p33_3 {
		pinmux = <AURIX_PINMUX(33, 3, 2)>;
	};

	/omit-if-no-ref/ sent_sent8a_p40_8: sent_sent8a_p40_8 {
		pinmux = <AURIX_PINMUX(40, 8, 0)>;
	};

	/omit-if-no-ref/ sent_sent8b_p0_9: sent_sent8b_p0_9 {
		pinmux = <AURIX_PINMUX(0, 9, 1)>;
	};

	/omit-if-no-ref/ sent_sent8c_p33_2: sent_sent8c_p33_2 {
		pinmux = <AURIX_PINMUX(33, 2, 2)>;
	};

	/omit-if-no-ref/ sent_sent9a_p40_9: sent_sent9a_p40_9 {
		pinmux = <AURIX_PINMUX(40, 9, 0)>;
	};

	/omit-if-no-ref/ sent_sent9b_p0_10: sent_sent9b_p0_10 {
		pinmux = <AURIX_PINMUX(0, 10, 1)>;
	};

	/omit-if-no-ref/ sent_sent9c_p33_1: sent_sent9c_p33_1 {
		pinmux = <AURIX_PINMUX(33, 1, 2)>;
	};

	/omit-if-no-ref/ sent_spc0_p0_1: sent_spc0_p0_1 {
		pinmux = <AURIX_PINMUX(0, 1, 6)>;
		output-enable;
	};

	/omit-if-no-ref/ sent_spc1_p2_7: sent_spc1_p2_7 {
		pinmux = <AURIX_PINMUX(2, 7, 6)>;
		output-enable;
	};

	/omit-if-no-ref/ sent_spc2_p0_3: sent_spc2_p0_3 {
		pinmux = <AURIX_PINMUX(0, 3, 6)>;
		output-enable;
	};

	/omit-if-no-ref/ sent_spc3_p0_4: sent_spc3_p0_4 {
		pinmux = <AURIX_PINMUX(0, 4, 6)>;
		output-enable;
	};

	/omit-if-no-ref/ sent_spc4_p0_5: sent_spc4_p0_5 {
		pinmux = <AURIX_PINMUX(0, 5, 6)>;
		output-enable;
	};

	/omit-if-no-ref/ sent_spc5_p0_6: sent_spc5_p0_6 {
		pinmux = <AURIX_PINMUX(0, 6, 6)>;
		output-enable;
	};

	/omit-if-no-ref/ sent_spc6_p0_7: sent_spc6_p0_7 {
		pinmux = <AURIX_PINMUX(0, 7, 6)>;
		output-enable;
	};

	/omit-if-no-ref/ sent_spc7_p0_8: sent_spc7_p0_8 {
		pinmux = <AURIX_PINMUX(0, 8, 6)>;
		output-enable;
	};

	/omit-if-no-ref/ sent_spc8_p0_9: sent_spc8_p0_9 {
		pinmux = <AURIX_PINMUX(0, 9, 6)>;
		output-enable;
	};

	/omit-if-no-ref/ sent_spc9_p0_10: sent_spc9_p0_10 {
		pinmux = <AURIX_PINMUX(0, 10, 6)>;
		output-enable;
	};
};
