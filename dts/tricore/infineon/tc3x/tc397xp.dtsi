/*
 * Copyright (c) 2024 Infineon Technologies AG
 *
 * SPDX-License-Identifier: Apache-2.0
 */

#include <mem.h>
#include <infineon/tc3x/tc39x.dtsi>
#include <infineon/tc3x/tc3x7-pinctrl.dtsi>

/ {

};

