/*
 * Copyright (c) 2024 Nordic Semiconductor ASA
 *
 * SPDX-License-Identifier: Apache-2.0
 */

#include "nrf54l_05_10_15.dtsi"

&cpuapp_sram {
	reg = <0x20000000 DT_SIZE_K(192)>;
	ranges = <0x0 0x20000000 DT_SIZE_K(192)>;

#ifndef USE_NON_SECURE_ADDRESS_MAP
	cpuapp_sram_app: sram@60 {
		compatible = "mmio-sram";
		reg = <0x60 (DT_SIZE_K(192) - 0x60)>;
	};
#endif
};

&cpuapp_rram {
	reg = <0x0 DT_SIZE_K(1012)>;
	ranges = <0x0 0x0 DT_SIZE_K(1012)>;
};
