/*
 * Copyright (c) Qualcomm Technologies, Inc. and/or its subsidiaries.
 *
 * SPDX-License-Identifier: Apache-2.0
 */

&flash0 {
	partitions {
		ranges;
		#address-cells = <0x1>;
		#size-cells = <0x1>;

		code_partition: partition@0 {
			compatible = "zephyr,mapped-partition";
			label = "code";
			reg = <0x0 DT_SIZE_M(16)>;
			read-only;
		};
	};
};
