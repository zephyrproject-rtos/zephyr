/*
 * SPDX-FileCopyrightText: Copyright (c) 2026 Process Mission
 * SPDX-License-Identifier: Apache-2.0
 */

/ {
	pinctrl: pinctrl@fd5f0000 {
		compatible = "rockchip,rk3588-pinctrl";
		reg = <0xfd5f0000 0x10000>;
		status = "disabled";
	};
};
