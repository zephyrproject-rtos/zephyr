/*
 * Copyright The Zephyr Project Contributors
 *
 * SPDX-License-Identifier: Apache-2.0
 */

#include <zephyr/dt-bindings/interrupt-controller/arm-gic.h>
#include <zephyr/dt-bindings/interrupt-controller/rp1_irq.h>

&rp1_intc {
	msi-parent = <&mip0>;
	interrupt-map = <RP1_IRQ_IO_BANK0 RP1_IRQ_TYPE_LEVEL
			 &mip0 RP1_IRQ_IO_BANK0 IRQ_TYPE_EDGE>,
			<RP1_IRQ_IO_BANK1 RP1_IRQ_TYPE_LEVEL
			 &mip0 RP1_IRQ_IO_BANK1 IRQ_TYPE_EDGE>,
			<RP1_IRQ_IO_BANK2 RP1_IRQ_TYPE_LEVEL
			 &mip0 RP1_IRQ_IO_BANK2 IRQ_TYPE_EDGE>,
			<RP1_IRQ_AUDIO_IN RP1_IRQ_TYPE_LEVEL
			 &mip0 RP1_IRQ_AUDIO_IN IRQ_TYPE_EDGE>,
			<RP1_IRQ_AUDIO_OUT RP1_IRQ_TYPE_LEVEL
			 &mip0 RP1_IRQ_AUDIO_OUT IRQ_TYPE_EDGE>,
			<RP1_IRQ_PWM0 RP1_IRQ_TYPE_LEVEL
			 &mip0 RP1_IRQ_PWM0 IRQ_TYPE_EDGE>,
			<RP1_IRQ_ETH RP1_IRQ_TYPE_LEVEL
			 &mip0 RP1_IRQ_ETH IRQ_TYPE_EDGE>,
			<RP1_IRQ_I2C0 RP1_IRQ_TYPE_LEVEL
			 &mip0 RP1_IRQ_I2C0 IRQ_TYPE_EDGE>,
			<RP1_IRQ_I2C1 RP1_IRQ_TYPE_LEVEL
			 &mip0 RP1_IRQ_I2C1 IRQ_TYPE_EDGE>,
			<RP1_IRQ_I2C2 RP1_IRQ_TYPE_LEVEL
			 &mip0 RP1_IRQ_I2C2 IRQ_TYPE_EDGE>,
			<RP1_IRQ_I2C3 RP1_IRQ_TYPE_LEVEL
			 &mip0 RP1_IRQ_I2C3 IRQ_TYPE_EDGE>,
			<RP1_IRQ_I2C4 RP1_IRQ_TYPE_LEVEL
			 &mip0 RP1_IRQ_I2C4 IRQ_TYPE_EDGE>,
			<RP1_IRQ_I2C5 RP1_IRQ_TYPE_LEVEL
			 &mip0 RP1_IRQ_I2C5 IRQ_TYPE_EDGE>,
			<RP1_IRQ_I2C6 RP1_IRQ_TYPE_LEVEL
			 &mip0 RP1_IRQ_I2C6 IRQ_TYPE_EDGE>,
			<RP1_IRQ_I2S0 RP1_IRQ_TYPE_LEVEL
			 &mip0 RP1_IRQ_I2S0 IRQ_TYPE_EDGE>,
			<RP1_IRQ_I2S1 RP1_IRQ_TYPE_LEVEL
			 &mip0 RP1_IRQ_I2S1 IRQ_TYPE_EDGE>,
			<RP1_IRQ_I2S2 RP1_IRQ_TYPE_LEVEL
			 &mip0 RP1_IRQ_I2S2 IRQ_TYPE_EDGE>,
			<RP1_IRQ_SDIO0 RP1_IRQ_TYPE_LEVEL
			 &mip0 RP1_IRQ_SDIO0 IRQ_TYPE_EDGE>,
			<RP1_IRQ_SDIO1 RP1_IRQ_TYPE_LEVEL
			 &mip0 RP1_IRQ_SDIO1 IRQ_TYPE_EDGE>,
			<RP1_IRQ_SPI0 RP1_IRQ_TYPE_LEVEL
			 &mip0 RP1_IRQ_SPI0 IRQ_TYPE_EDGE>,
			<RP1_IRQ_SPI1 RP1_IRQ_TYPE_LEVEL
			 &mip0 RP1_IRQ_SPI1 IRQ_TYPE_EDGE>,
			<RP1_IRQ_SPI2 RP1_IRQ_TYPE_LEVEL
			 &mip0 RP1_IRQ_SPI2 IRQ_TYPE_EDGE>,
			<RP1_IRQ_SPI3 RP1_IRQ_TYPE_LEVEL
			 &mip0 RP1_IRQ_SPI3 IRQ_TYPE_EDGE>,
			<RP1_IRQ_SPI4 RP1_IRQ_TYPE_LEVEL
			 &mip0 RP1_IRQ_SPI4 IRQ_TYPE_EDGE>,
			<RP1_IRQ_SPI5 RP1_IRQ_TYPE_LEVEL
			 &mip0 RP1_IRQ_SPI5 IRQ_TYPE_EDGE>,
			<RP1_IRQ_UART0 RP1_IRQ_TYPE_LEVEL
			 &mip0 RP1_IRQ_UART0 IRQ_TYPE_EDGE>,
			<RP1_IRQ_TIMER0 RP1_IRQ_TYPE_LEVEL
			 &mip0 RP1_IRQ_TIMER0 IRQ_TYPE_EDGE>,
			<RP1_IRQ_TIMER1 RP1_IRQ_TYPE_LEVEL
			 &mip0 RP1_IRQ_TIMER1 IRQ_TYPE_EDGE>,
			<RP1_IRQ_TIMER2 RP1_IRQ_TYPE_LEVEL
			 &mip0 RP1_IRQ_TIMER2 IRQ_TYPE_EDGE>,
			<RP1_IRQ_TIMER3 RP1_IRQ_TYPE_LEVEL
			 &mip0 RP1_IRQ_TIMER3 IRQ_TYPE_EDGE>,
			<RP1_IRQ_USBHOST0 RP1_IRQ_TYPE_EDGE
			 &mip0 RP1_IRQ_USBHOST0 IRQ_TYPE_EDGE>,
			<RP1_IRQ_USBHOST0_0 RP1_IRQ_TYPE_EDGE
			 &mip0 RP1_IRQ_USBHOST0_0 IRQ_TYPE_EDGE>,
			<RP1_IRQ_USBHOST0_1 RP1_IRQ_TYPE_EDGE
			 &mip0 RP1_IRQ_USBHOST0_1 IRQ_TYPE_EDGE>,
			<RP1_IRQ_USBHOST0_2 RP1_IRQ_TYPE_EDGE
			 &mip0 RP1_IRQ_USBHOST0_2 IRQ_TYPE_EDGE>,
			<RP1_IRQ_USBHOST0_3 RP1_IRQ_TYPE_EDGE
			 &mip0 RP1_IRQ_USBHOST0_3 IRQ_TYPE_EDGE>,
			<RP1_IRQ_USBHOST1 RP1_IRQ_TYPE_EDGE
			 &mip0 RP1_IRQ_USBHOST1 IRQ_TYPE_EDGE>,
			<RP1_IRQ_USBHOST1_0 RP1_IRQ_TYPE_EDGE
			 &mip0 RP1_IRQ_USBHOST1_0 IRQ_TYPE_EDGE>,
			<RP1_IRQ_USBHOST1_1 RP1_IRQ_TYPE_EDGE
			 &mip0 RP1_IRQ_USBHOST1_1 IRQ_TYPE_EDGE>,
			<RP1_IRQ_USBHOST1_2 RP1_IRQ_TYPE_EDGE
			 &mip0 RP1_IRQ_USBHOST1_2 IRQ_TYPE_EDGE>,
			<RP1_IRQ_USBHOST1_3 RP1_IRQ_TYPE_EDGE
			 &mip0 RP1_IRQ_USBHOST1_3 IRQ_TYPE_EDGE>,
			<RP1_IRQ_DMA RP1_IRQ_TYPE_LEVEL
			 &mip0 RP1_IRQ_DMA IRQ_TYPE_EDGE>,
			<RP1_IRQ_PWM1 RP1_IRQ_TYPE_LEVEL
			 &mip0 RP1_IRQ_PWM1 IRQ_TYPE_EDGE>,
			<RP1_IRQ_UART1 RP1_IRQ_TYPE_LEVEL
			 &mip0 RP1_IRQ_UART1 IRQ_TYPE_EDGE>,
			<RP1_IRQ_UART2 RP1_IRQ_TYPE_LEVEL
			 &mip0 RP1_IRQ_UART2 IRQ_TYPE_EDGE>,
			<RP1_IRQ_UART3 RP1_IRQ_TYPE_LEVEL
			 &mip0 RP1_IRQ_UART3 IRQ_TYPE_EDGE>,
			<RP1_IRQ_UART4 RP1_IRQ_TYPE_LEVEL
			 &mip0 RP1_IRQ_UART4 IRQ_TYPE_EDGE>,
			<RP1_IRQ_UART5 RP1_IRQ_TYPE_LEVEL
			 &mip0 RP1_IRQ_UART5 IRQ_TYPE_EDGE>,
			<RP1_IRQ_MIPI0 RP1_IRQ_TYPE_LEVEL
			 &mip0 RP1_IRQ_MIPI0 IRQ_TYPE_EDGE>,
			<RP1_IRQ_MIPI1 RP1_IRQ_TYPE_LEVEL
			 &mip0 RP1_IRQ_MIPI1 IRQ_TYPE_EDGE>,
			<RP1_IRQ_VIDEO_OUT RP1_IRQ_TYPE_LEVEL
			 &mip0 RP1_IRQ_VIDEO_OUT IRQ_TYPE_EDGE>,
			<RP1_IRQ_PIO0 RP1_IRQ_TYPE_LEVEL
			 &mip0 RP1_IRQ_PIO0 IRQ_TYPE_EDGE>,
			<RP1_IRQ_PIO1 RP1_IRQ_TYPE_LEVEL
			 &mip0 RP1_IRQ_PIO1 IRQ_TYPE_EDGE>,
			<RP1_IRQ_ADC_FIFO RP1_IRQ_TYPE_LEVEL
			 &mip0 RP1_IRQ_ADC_FIFO IRQ_TYPE_EDGE>,
			<RP1_IRQ_PCIE_OUT RP1_IRQ_TYPE_LEVEL
			 &mip0 RP1_IRQ_PCIE_OUT IRQ_TYPE_EDGE>,
			<RP1_IRQ_SPI6 RP1_IRQ_TYPE_LEVEL
			 &mip0 RP1_IRQ_SPI6 IRQ_TYPE_EDGE>,
			<RP1_IRQ_SPI7 RP1_IRQ_TYPE_LEVEL
			 &mip0 RP1_IRQ_SPI7 IRQ_TYPE_EDGE>,
			<RP1_IRQ_SPI8 RP1_IRQ_TYPE_LEVEL
			 &mip0 RP1_IRQ_SPI8 IRQ_TYPE_EDGE>,
			<RP1_IRQ_PROC_MISC RP1_IRQ_TYPE_LEVEL
			 &mip0 RP1_IRQ_PROC_MISC IRQ_TYPE_EDGE>,
			<RP1_IRQ_SYSCFG RP1_IRQ_TYPE_LEVEL
			 &mip0 RP1_IRQ_SYSCFG IRQ_TYPE_EDGE>,
			<RP1_IRQ_CLOCKS RP1_IRQ_TYPE_LEVEL
			 &mip0 RP1_IRQ_CLOCKS IRQ_TYPE_EDGE>,
			<RP1_IRQ_VBUSCTRL RP1_IRQ_TYPE_LEVEL
			 &mip0 RP1_IRQ_VBUSCTRL IRQ_TYPE_EDGE>;
};
