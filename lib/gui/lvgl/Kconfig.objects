## lib/hash/Kconfig
```kconfig
# Copyright (c) 2022 Meta
#
# SPDX-License-Identifier: Apache-2.0
rsource "Kconfig.hash_func"
rsource "Kconfig.hash_map"
```

## lib/hash/Kconfig.hash_func
```kconfig
# Copyright (c) 2022 Meta
#
# SPDX-License-Identifier: Apache-2.0

menu "Hash Function Support"

config SYS_HASH_FUNC32
	bool "Hash function support"
	help
	  Enable this option to support hash functions.

if SYS_HASH_FUNC32

config SYS_HASH_FUNC32_DJB2
	bool "Daniel J. Bernstein's hash function (djb2)"

config SYS_HASH_FUNC32_MURMUR3
	bool "Murmur3 hash function"

choice SYS_HASH_FUNC32_CHOICE
	prompt "Default system-wide 32-bit hash function"
	default SYS_HASH_FUNC32_CHOICE_MURMUR3
	help
	  The default system-wide 32-bit hash function is sys_hash32().

config SYS_HASH_FUNC32_CHOICE_DJB2
	bool "Default 32-bit hash is djb2"
	select SYS_HASH_FUNC32_DJB2

config SYS_HASH_FUNC32_CHOICE_MURMUR3
	bool "Default 32-bit hash is Murmur3"
	select SYS_HASH_FUNC32_MURMUR3

config SYS_HASH_FUNC32_CHOICE_IDENTITY
	bool "Default 32-bit hash is the identity"
	help
	  This is the naive identity hash function. It only works for strings
	  either 1, 2, 4, or 8 bytes in length and so is suitable for scalar
	  values such as keys in a Hashmap. It is implemented as a static
	  inline function.

endchoice # SYS_HASH_FUNC_CHOICE

endif # SYS_HASH_FUNC

endmenu
```

## lib/hash/Kconfig.hash_map
```kconfig
# Copyright (c) 2022 Meta
#
# SPDX-License-Identifier: Apache-2.0

menu "Hashmap (Hash Table) Support"

config SYS_HASH_MAP
	bool "Hashmap support"
	help
	  Support for Hashmaps (a.k.a. Hash Tables).

	  Hashmaps are data structures that are used when insertion, removal, and
	  lookup of key-value pairs must be done in O(1) time (on average).

if SYS_HASH_MAP

config SYS_HASH_MAP_SC
	bool "Separate-Chaining Hashmap"
	help
	  Separate-Chaining Hashmaps implement each bucket as a linked-list.

	  They are perhaps more useful on resource-constrained systems where
	  large contiguous memory regions are scarce.

	  The main disadvantage of Separate-Chaining Hashmaps are that their
	  use tends to incur more cache-misses as nodes are spread throughout
	  the heap.

config SYS_HASH_MAP_OA_LP
	bool "Open-Addressing / Linear Probe Hashmap"
	help
	  Open-Addressing Hashmaps do not chain entries together but instead
	  store all entries in the table itself which is a contiguously allocated
	  memory region.

	  The main advantage of Open-Addressing Hashmaps are due to their
	  contiguous allocation which improves performance on systems with
	  memory caching.

config SYS_HASH_MAP_CXX
	bool "C++ Hashmap"
	select CPP
	select CPP_EXCEPTIONS
	select REQUIRES_FULL_LIBCPP
	help
	  This enables a C wrapper around the C++ std::unordered_map.

	  It is mainly used for benchmarking purposes.

choice SYS_HASH_MAP_CHOICE
	prompt "Default hashmap implementation"
	default SYS_HASH_MAP_CHOICE_SC

config SYS_HASH_MAP_CHOICE_SC
	bool "Default hash is Separate-Chaining"
	select SYS_HASH_MAP_SC

config SYS_HASH_MAP_CHOICE_OA_LP
	bool "Default hash is Open-Addressing / Linear Probe"
	select SYS_HASH_MAP_OA_LP

config SYS_HASH_MAP_CHOICE_CXX
	bool "Default hash is C++"
	select SYS_HASH_MAP_CXX

endchoice # SYS_HASH_MAP_CHOICE

endif

endmenu
```

## lib/hashmap/Kconfig.hash_datatype
```kconfig
# Copyright (c) 2022 Meta
#
# SPDX-License-Identifier: Apache-2.0

menu "Hash Datatype support"

config SYS_UINT8
	bool "DBJ2 data type is uint8"

config SYS_UINT16
	bool "DBJ2 data type is uint16"

config SYS_UINT32
	bool "DBJ2 data type is uint32"

config SYS_UINT64
	bool "DBJ2 data type is uint64"

config SYS_BYTESTRING
	bool "DBJ2 data type is byte string"

choice SYS_DBJ2_DATA_TYPE_CHOICE
	prompt "Default data type to operate on for hash function keys in hashmaps"
	default SYS_UINT64_CHOICE
	help
	  The default data type for the DBJ2 hash function.

config SYS_UINT8_CHOICE
	bool "Default data type is uint8"
	select SYS_UINT8

config SYS_UINT16_CHOICE
	bool "Default data type is uint16"
	select SYS_UINT16

config SYS_UINT32_CHOICE
	bool "Default data type is uint32"
	select SYS_UINT32

config SYS_UINT64_CHOICE
	bool "Default data type is uint64"
	select SYS_UINT64

config SYS_BYTESTRING_CHOICE
	bool "Default data type is uint64"
	select SYS_BYTESTRING

endchoice

endmenu
```
