## lib/libc/newlib/Kconfig
```kconfig
# Copyright (c) 2016 Intel Corporation
# SPDX-License-Identifier: Apache-2.0

if NEWLIB_LIBC

config NEWLIB_LIBC_NANO
	bool "Build with newlib-nano C library"
	depends on HAS_NEWLIB_LIBC_NANO
	help
	  Build with newlib-nano library, for small embedded apps.
	  The newlib-nano library for ARM embedded processors is a part of the
	  GNU Tools for ARM Embedded Processors.

config NEWLIB_LIBC_MAX_MAPPED_REGION_SIZE
	int "Maximum memory mapped for newlib heap"
	depends on MMU
	default 1048576
	help
	  On MMU-based systems, indicates the maximum amount of memory which
	  will be used for the newlib malloc() heap. The actual amount of
	  memory used will be the minimum of this value and the amount of
	  free physical memory at kernel boot.

config NEWLIB_LIBC_MIN_REQUIRED_HEAP_SIZE
	int "Newlib minimum required heap size"
	default 2048 if NEWLIB_LIBC_NANO
	default 8192 if !NEWLIB_LIBC_NANO
	help
	  Specifies the amount of memory space that must be available for the
	  newlib heap. An assertion failure message will be displayed during
	  initialization if the memory space available for the newlib heap is
	  smaller than this value.

config NEWLIB_LIBC_ALIGNED_HEAP_SIZE
	int "Newlib aligned heap size"
	depends on MPU_REQUIRES_POWER_OF_TWO_ALIGNMENT
	depends on USERSPACE
	default 0
	help
	  If user mode is enabled, and MPU hardware has requirements that
	  regions be sized to a power of two and aligned to their size,
	  and user mode threads need to access this heap, then this is necessary
	  to properly define an MPU region for the heap.

	  If this is left at 0, then remaining system RAM will be used for this
	  area and it may not be possible to program it as an MPU region.

config NEWLIB_LIBC_FLOAT_PRINTF
	bool "Build with newlib float printf"
	help
	  Build with floating point printf enabled. This will increase the size of
	  the image.

config NEWLIB_LIBC_FLOAT_SCANF
	bool "Build with newlib float scanf"
	help
	  Build with floating point scanf enabled. This will increase the size of
	  the image.

config NEWLIB_LIBC_HEAP_LISTENER
	bool "Notify heap listeners of newlib libc heap events"
	select HEAP_LISTENER
	help
	  Notify registered heap listeners upon certain events related to the newlib
	  libc heap usage, such as the heap resize.

endif # NEWLIB_LIBC
```

## lib/libc/picolibc/Kconfig
```kconfig
# Copyright © 2021 Amazon.com, Inc. or its affiliates.
# SPDX-License-Identifier: Apache-2.0

if PICOLIBC

choice PICOLIBC_SOURCE
	prompt "Source of Picolibc"
	default PICOLIBC_USE_TOOLCHAIN if REQUIRES_FULL_LIBCPP || "$(TOOLCHAIN_HAS_PICOLIBC)" = "y"
	default PICOLIBC_USE_MODULE

config PICOLIBC_USE_MODULE
	bool "Picolibc from module"
	depends on ZEPHYR_PICOLIBC_MODULE
	depends on !GLIBCXX_LIBCPP
	help
	  Use picolibc module instead of picolibc included with toolchain.
	  This is enabled by default for toolchains other than the Zephyr
	  SDK.

# force TLS when using toolchain with TLS support
config PICOLIBC_USE_TOOLCHAIN
	bool "Picolibc from toolchain"
	depends on "$(TOOLCHAIN_HAS_PICOLIBC)" = "y"
	select THREAD_LOCAL_STORAGE if ARCH_HAS_THREAD_LOCAL_STORAGE && TOOLCHAIN_SUPPORTS_THREAD_LOCAL_STORAGE
	help
	  Use picolibc included with the toolchain.
	  This is required when using a full C++ standard library (`REQUIRES_FULL_LIBCPP=y`).

endchoice # PICOLIBC_SOURCE

choice PICOLIBC_IO_LEVEL
	prompt "Picolibc printf/scanf level"
	default PICOLIBC_IO_MINIMAL if CBPRINTF_NANO
	default PICOLIBC_IO_LONG_LONG if CBPRINTF_FULL_INTEGRAL
	default PICOLIBC_IO_INTEGER
	help
	  Selects the level of printf and scanf support

config PICOLIBC_IO_FLOAT
	bool "full support for integer/floating point values in printf/scanf"
	help
	  Include full floating point and integer support in printf/scanf
	  functions.

config PICOLIBC_IO_LONG_LONG
	bool "full support for integer values, including long long, in printf/scanf"
	depends on !REQUIRES_FLOAT_PRINTF && (!CBPRINTF_FP_SUPPORT || CBPRINTF_NANO)
	help
	  Includes full integer with long long, but no floating
	  point in printf/scanf.

config PICOLIBC_IO_INTEGER
	bool "full support for integer values, other than long long, in printf/scanf"
	depends on !REQUIRES_FLOAT_PRINTF && ((!CBPRINTF_FP_SUPPORT && !CBPRINTF_FULL_INTEGRAL) || CBPRINTF_NANO)
	help
	  Include full integer other than long long, but no floating point
	  in printf/scanf.

config PICOLIBC_IO_MINIMAL
	bool "limited support for integer values in printf/scanf"
	depends on !REQUIRES_FLOAT_PRINTF && CBPRINTF_NANO
	help
	  Include limited integer and no floating point support in
	  printf/scanf.

endchoice

if PICOLIBC_USE_MODULE

choice PICOLIBC_OPTIMIZATIONS
	prompt "Optimization level"
	default PICOLIBC_SIZE_OPTIMIZATIONS if SIZE_OPTIMIZATIONS
	default PICOLIBC_SPEED_OPTIMIZATIONS if SPEED_OPTIMIZATIONS
	default PICOLIBC_DEBUG_OPTIMIZATIONS if DEBUG_OPTIMIZATIONS
	default PICOLIBC_NO_OPTIMIZATIONS if NO_OPTIMIZATIONS
	help
	  Note that these flags shall only control the compiler
	  optimization level for picolibc, not the level for the
	  rest of Zephyr

config PICOLIBC_SIZE_OPTIMIZATIONS
	bool "Optimize for size"
	help
	  Compiler optimizations will be set to -Os independently of other
	  options.

config PICOLIBC_SPEED_OPTIMIZATIONS
	bool "Optimize for speed"
	help
	  Compiler optimizations will be set to -O2 independently of other
	  options.

config PICOLIBC_DEBUG_OPTIMIZATIONS
	bool "Optimize debugging experience"
	help
	  Compiler optimizations will be set to -Og independently of other
	  options.

config PICOLIBC_NO_OPTIMIZATIONS
	bool "Optimize nothing"
	help
	  Compiler optimizations will be set to -O0 independently of other
	  options.

endchoice

config PICOLIBC_FAST_STRCMP
	bool "always use fast strcmp paths"
	default y
	help
	  This provides a faster strcmp version even when libc is
	  built in space-optimized mode

config PICOLIBC_ASSERT_VERBOSE
	bool "assert provides verbose information"
	help
	  The usual picolibc assert helper, __assert_func, takes file, line,
	  function and expression information to make the presented message
	  more helpful. These all require storage in the image. Unselecting
	  this option eliminates all of that information, making the results
	  less helpful but also making them consume less memory.

config PICOLIBC_IO_C99_FORMATS
	bool "support C99 format additions in printf/scanf"
	default y
	help
	  Includes C99 printf and scanf support for j, z, t size
	  modifiers. C99 support is always included in the floating-point
	  variant

config PICOLIBC_IO_POS_ARGS
	bool "Support POSIX positional args (e.g. %$1d) in printf/scanf"
	default y
	depends on !PICOLIBC_IO_MINIMAL
	help
	  Includes support for positional args (e.g. $1) in integer-only
	  printf and scanf. Positional args are always supported in the
	  floating-point variant.

config PICOLIBC_IO_FLOAT_EXACT
	bool "support for exact float/string conversion"
	default y
	help
	  Uses Ryu algorithm for exact binary/decimal float conversions.
	  This ensures that printf values with enough digits can be
	  fed to scanf and generate exactly the same binary value.

config PICOLIBC_IO_SMALL_ULTOA
	bool "avoid soft division in printf"
	default y
	help
	  Replaces division and modulus by 10 with shifts and adds when
	  doing binary to decimal conversion in printf for 64-bit
	  values on 32-bit targets.

config PICOLIBC_IO_MINIMAL_LONG_LONG
	bool "Include long long support in minimal printf"
	depends on PICOLIBC_IO_MINIMAL
	default y if CBPRINTF_FULL_INTEGRAL
	help
	  Include long long support in the minimal picolibc printf code

config PICOLIBC_LOCALE_INFO
	bool "support locales in libc functions"
	help
	  Includes code for basic locale support

config PICOLIBC_LOCALE_EXTENDED_INFO
	bool "support extended locales in libc functions"
	help
	  Includes code for extended locale support

config PICOLIBC_MULTIBYTE
	bool "support multibyte functions in libc"
	help
	  Includes code for multi-byte characters

config PICOLIBC_PICOEXIT
	bool "use smaller atexit/onexit implementation"
	default y
	help
	  Provides a simpler atexit/onexit implementation that doesn't use
	  malloc, but only supports a small number (32) of exit handlers.

config PICOLIBC_MULTITHREAD
	bool "support multiple threads using retargetable locking API"
	default y
	help
	  Protects shared data structures in libc with mutexes that use
	  an API which can be retargeted to OS provided routines.

config PICOLIBC_GLOBAL_ERRNO
	bool "use a single global variable for errno"
	help
	  Picolibc usually uses a TLS variable for errno, ensuring that
	  multiple threads have a reliable mechanism for detecting libc
	  exceptions. This option switches to a single global errno variable,
	  which can be used to avoid TLS variable usage by the library if
	  necessary.

endif # PICOLIBC_USE_MODULE

endif # PICOLIBC
```

## lib/libmp/Kconfig
```kconfig
#
# Copyright 2025 NXP
#
# SPDX-License-Identifier: Apache-2.0
#

menuconfig MP
    bool "Media Pipe library"
    help
        Enable Media Pipe library.

if MP

module = LIBMP
module-str = libmp
source "subsys/logging/Kconfig.template.log_config"

config MP_RPC
    bool "RPC support"

# Load core configurations
source "lib/libmp/src/core/Kconfig"

# Load all plugin configurations
source "lib/libmp/src/plugins/Kconfig"

endif # MP
```

## lib/libmp/src/core/Kconfig
```kconfig
#
# Copyright 2025 NXP
#
# SPDX-License-Identifier: Apache-2.0
#

config MP_THREADS_NUM
    int "Maximum number of threads"
    range 0 255
    default 3

config MP_THREAD_STACK_SIZE
    int "Stack size of a thread"
    default 1024

config MP_THREAD_DEFAULT_PRIORITY
    int "Priority of a thread"
    default 5

config MP_CAPSFILTER
    bool "Capsfilter support"
```

## lib/libmp/src/plugins/Kconfig
```kconfig
#
# Copyright 2025 NXP
#
# SPDX-License-Identifier: Apache-2.0
#

menu "Media Pipe plugins"

osource "lib/libmp/src/plugins/*/Kconfig"

endmenu
```

## lib/libmp/src/plugins/zaud/Kconfig
```kconfig
#
# Copyright 2025 NXP
#
# SPDX-License-Identifier: Apache-2.0
#

config MP_PLUGIN_ZAUD
	bool "Zaud plugin support"

if MP_PLUGIN_ZAUD

config ZAUD_BUFFER_POOL_SZ_MAX
	int "Size of the largest buffer in the buffer pool"
	default 98304

config ZAUD_BUFFER_POOL_NUM_MAX
	int "Number of maximum sized buffers in the buffer pool"
	default 10

config ZAUD_I2S_CODEC_SINK_CODEC_MASTER
	bool "Configure the selected codec device as a master device."
	default y

config ZAUD_I2S_CODEC_SINK_I2S_MASTER
	bool "Configure the selected I2S peripheral as a master device."

endif # MP_PLUGIN_ZAUD
```

## lib/libmp/src/plugins/zdisp/Kconfig
```kconfig
#
# Copyright 2025 NXP
#
# SPDX-License-Identifier: Apache-2.0
#

config MP_PLUGIN_ZDISP
    bool "Zvid plugin support"
```

## lib/libmp/src/plugins/zvid/Kconfig
```kconfig
#
# Copyright 2025 NXP
#
# SPDX-License-Identifier: Apache-2.0
#

config MP_PLUGIN_ZVID
    bool "Zvid plugin support"
```

## lib/mem_blocks/Kconfig
```kconfig
# Copyright (c) 2021,2023 Intel Corporation
#
# SPDX-License-Identifier: Apache-2.0

menu "Memory Blocks"

config SYS_MEM_BLOCKS
	bool "(Yet Another) Memory Blocks Allocator"
	help
	  This enables support for memory block allocator where:
	  () All memory blocks have a single fixed size.
	  () Multiple blocks can be allocated or freed at the same time.
	  () A group of blocks allocated together may not be contiguous.
	     This is useful for operations such as scatter-gather DMA
	     transfers.
	  () Bookkeeping of allocated blocks is done outside of
	     the associated buffer (unlike memory slab). This allows
	     the buffer to reside in memory regions where these can be
	     powered down to conserve energy.

config SYS_MEM_BLOCKS_LISTENER
	bool "Memory Blocks Allocator event notifications"
	depends on SYS_MEM_BLOCKS
	select HEAP_LISTENER
	help
	  This allows application to listen for memory blocks allocator
	  events, such as memory allocation and de-allocation.

config SYS_MEM_BLOCKS_RUNTIME_STATS
	bool "Memory blocks runtime statistics"
	depends on SYS_MEM_BLOCKS
	help
	  This option enables the tracking and reporting of the memory
	  blocks statistics related to the current and maximum number
	  of allocations in a given memory block.

config OBJ_CORE_SYS_MEM_BLOCKS
	bool "Kernel object for memory blocks"
	depends on SYS_MEM_BLOCKS && OBJ_CORE
	default y if SYS_MEM_BLOCKS && OBJ_CORE
	help
	  This option allows object cores to be integrated into memory block
	  objects.

config OBJ_CORE_STATS_SYS_MEM_BLOCKS
	bool "Object core statistics for memory blocks"
	depends on SYS_MEM_BLOCKS && OBJ_CORE_STATS
	default y if SYS_MEM_BLOCKS && OBJ_CORE_STATS
	select SYS_MEM_BLOCKS_RUNTIME_STATS
	help
	  This option integrates the object core statistics framework into
	  the memory blocks.

endmenu
```
