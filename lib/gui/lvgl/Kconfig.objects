## lib/iot/mqtt/Kconfig
```kconfig
# Kconfig - MQTT Library for Zephyr

#
# Copyright (c) 2016 Intel Corporation
#
# Licensed under the Apache License, Version 2.0 (the "License");
# you may not use this file except in compliance with the License.
# You may obtain a copy of the License at
#
#     http://www.apache.org/licenses/LICENSE-2.0
#
# Unless required by applicable law or agreed to in writing, software
# distributed under the License is distributed on an "AS IS" BASIS,
# WITHOUT WARRANTIES OR CONDITIONS OF ANY KIND, either express or implied.
# See the License for the specific language governing permissions and
# limitations under the License.
#

config  MQTT_LIB
	bool "MQTT Library Support"
	default n
	help
	Enable the Zephyr MQTT Library

config MQTT_MSG_MAX_SIZE
	int
	prompt "Max size of a MQTT message"
	depends on MQTT_LIB
	default 128
	range 128 1024
	help
	Set the maximum size of the MQTT message. So, no messages
	longer than CONFIG_MQTT_MSG_SIZE will be processed.

config MQTT_ADDITIONAL_BUFFER_CTR
	int
	prompt "Additional buffers available for the MQTT application"
	depends on MQTT_LIB
	default 0
	help
	Set some additional buffers. When two or more concurrent contexts are
	used in the same application, additional buffers may help to have a 1:1
	relation between application contexts and internal buffers.

config MQTT_SUBSCRIBE_MAX_TOPICS
	int
	prompt "Max number of topics to subscribe to"
	depends on MQTT_LIB
	default 1
	range 1 8
	help
	Set the maximum number of topics handled by the SUBSCRIBE/SUBACK
	messages during reception.
```

## lib/json/Kconfig
```kconfig
# Kconfig - JSON library

#
# Copyright (c) 2016 Intel Corporation
#
# SPDX-License-Identifier: Apache-2.0
#

menu "Additional libraries"

config JSON_LIBRARY
	bool
	default N
	prompt "Build JSON library"
	help
	  Build a minimal JSON parsing/encoding library. Used by sample
	  applications such as the NATS client.

endmenu
```

## lib/libc/Kconfig
```kconfig
# C library

# Copyright (c) 2016 Intel Corporation
# SPDX-License-Identifier: Apache-2.0

config REQUIRES_FULL_LIBC
	prompt "Require complete C library"
	bool
	help
	  Select a C library implementation that provides a complete C library
	  implementation, rather than the subset provided by MINIMAL_LIBC.

config REQUIRES_FLOAT_PRINTF
	bool "Requires floating point support in printf"
	select CBPRINTF_FP_SUPPORT if MINIMAL_LIBC
	select NEWLIB_LIBC_FLOAT_PRINTF if NEWLIB_LIBC
	help
	  Select a printf implementation that provides a complete
	  implementation including floating point support.

config FULL_LIBC_SUPPORTED
	bool
	help
	  Selected when the target has at least one C library that offers a
	  complete implementation and which would be selected when
	  REQUIRES_FULL_LIBC is set.

config MINIMAL_LIBC_SUPPORTED
	bool
	depends on !NATIVE_APPLICATION
	default y
	help
	  Selected when the target has support for the minimal C library

config NEWLIB_LIBC_SUPPORTED
	bool
	default y
	depends on "$(TOOLCHAIN_HAS_NEWLIB)" = "y"
	depends on !NATIVE_APPLICATION
	select FULL_LIBC_SUPPORTED
	help
	  Selected when the target has support for the newlib C library

# Picolibc with C++ support in Zephyr SDK is handled by Zephyr SDK's own Kconfig.
config PICOLIBC_SUPPORTED
	bool
	depends on !NATIVE_APPLICATION
	depends on ("$(TOOLCHAIN_HAS_PICOLIBC)" = "y") || (ZEPHYR_PICOLIBC_MODULE && !REQUIRES_FULL_LIBCPP)
	default y
	select FULL_LIBC_SUPPORTED
	help
	  Selected when the target has support for picolibc.

config NATIVE_LIBC_INCOMPATIBLE
	bool
	help
	  Other Kconfig options can select this, if they are not compatible with the
	  native/host libC, and should only be compiled with an embedded libC

menu "C Library"

choice LIBC_IMPLEMENTATION
	prompt "C Library Implementation"
	default EXTERNAL_LIBC if NATIVE_BUILD && !(NATIVE_LIBRARY && NATIVE_LIBC_INCOMPATIBLE)
	default PICOLIBC
	default NEWLIB_LIBC if REQUIRES_FULL_LIBC
	default MINIMAL_LIBC

config MINIMAL_LIBC
	bool "Minimal C library"
	depends on !REQUIRES_FULL_LIBC
	depends on MINIMAL_LIBC_SUPPORTED
	imply COMPILER_FREESTANDING
	select COMMON_LIBC_ABORT
	select COMMON_LIBC_STRNLEN
	imply COMMON_LIBC_MALLOC
	imply COMMON_LIBC_CALLOC
	imply COMMON_LIBC_REALLOCARRAY
	help
	  Build with minimal C library.

config PICOLIBC
	bool "Picolibc library"
	select COMMON_LIBC_ABORT
	imply THREAD_LOCAL_STORAGE if ARCH_HAS_THREAD_LOCAL_STORAGE && TOOLCHAIN_SUPPORTS_THREAD_LOCAL_STORAGE
	select LIBC_ERRNO if THREAD_LOCAL_STORAGE
	select NEED_LIBC_MEM_PARTITION
	select TC_PROVIDES_POSIX_C_LANG_SUPPORT_R
	imply COMMON_LIBC_MALLOC
	depends on PICOLIBC_SUPPORTED
	help
	  Build with picolibc library. The picolibc library is built as
	  a module if PICOLIBC_MODULE is set, otherwise picolibc is
	  expected to be provided by the toolchain.

config NEWLIB_LIBC
	bool "Newlib C library"
	select COMMON_LIBC_ABORT
	depends on NEWLIB_LIBC_SUPPORTED
	select NEED_LIBC_MEM_PARTITION
	imply POSIX_DEVICE_IO_ALIAS_CLOSE
	imply POSIX_DEVICE_IO_ALIAS_OPEN
	imply POSIX_DEVICE_IO_ALIAS_READ
	imply POSIX_DEVICE_IO_ALIAS_WRITE
	imply POSIX_FD_MGMT_ALIAS_LSEEK
	imply POSIX_FILE_SYSTEM_ALIAS_FSTAT
	imply POSIX_MULTI_PROCESS_ALIAS_GETPID
	imply POSIX_SIGNALS_ALIAS_KILL
	help
	  Build with newlib library. The newlib library is expected to be
	  part of the SDK in this case.

config ARCMWDT_LIBC
	bool "ARC MWDT C library"
	depends on !NATIVE_APPLICATION
	depends on "$(ZEPHYR_TOOLCHAIN_VARIANT)" = "arcmwdt"
	help
	  C library provided by ARC MWDT toolchain.

config EXTERNAL_LIBC
	bool "External C library"
	help
	  Build with external/user provided C library.

endchoice # LIBC_IMPLEMENTATION

config HAS_NEWLIB_LIBC_NANO
	bool

rsource "common/Kconfig"
rsource "minimal/Kconfig"
rsource "newlib/Kconfig"
rsource "picolibc/Kconfig"

config STDOUT_CONSOLE
	bool "Send stdout to console"
	depends on CONSOLE_HAS_DRIVER
	depends on !(NATIVE_APPLICATION || (NATIVE_LIBRARY && EXTERNAL_LIBC))
	default y
	help
	  This option directs standard output (e.g. printf) to the console
	  device, rather than suppressing it entirely. See also EARLY_CONSOLE
	  option.

config NEED_LIBC_MEM_PARTITION
	bool
	help
	  Hidden option to signal that a memory partition is needed for
	  the C library even though it would not have been enabled
	  otherwise.

endmenu
```

## lib/libc/common/Kconfig
```kconfig
# Copyright (c) 2023 Intel Corporation
# SPDX-License-Identifier: Apache-2.0

config COMMON_LIBC_ABORT
	bool
	help
	  common implementation of abort().

config COMMON_LIBC_ASCTIME
	bool
	help
	  common implementation of asctime().

config COMMON_LIBC_ASCTIME_R
	bool "Thread-safe version of asctime()"
	select COMMON_LIBC_ASCTIME
	help
	  common implementation of asctime_r().

config COMMON_LIBC_CTIME
	bool
	select COMMON_LIBC_LOCALTIME_R_UTC
	help
	  common implementation of ctime().

config COMMON_LIBC_CTIME_R
	bool "Thread-safe version of ctime()"
	select COMMON_LIBC_CTIME
	help
	  common implementation of ctime_r().

config COMMON_LIBC_GMTIME_R
	bool
	help
	  common implementation of gmtime_r().

config COMMON_LIBC_LOCALTIME_R_UTC
	bool
	select COMMON_LIBC_GMTIME_R
	help
	  Simple implementation of localtime() & localtime_r().
	  This option just wraps around the gmtime(), the result is always expressed as
	  Coordinated Universal Time (UTC).

config COMMON_LIBC_TIME
	bool
	help
	  common implementation of time().

config COMMON_LIBC_MALLOC_SUPPORTED
	bool
	help
	  Hidden option to signal that malloc is supported.

choice COMMON_LIBC_MALLOC
	prompt "Common C library malloc support"
	default COMMON_LIBC_MALLOC_SHARED if PICOLIBC || MINIMAL_LIBC
	default COMMON_LIBC_MALLOC_NONE
	help
	  Defines whether the malloc family of functions will be available.

config COMMON_LIBC_MALLOC_NONE
	bool "None"
	help
	  No malloc support.

config COMMON_LIBC_MALLOC_SHARED
	bool "Shared"
	select COMMON_LIBC_MALLOC_SUPPORTED
	select NEED_LIBC_MEM_PARTITION if COMMON_LIBC_MALLOC_ARENA_SIZE != 0
	help
	  Common implementation of malloc family that uses a shared heap in a
	  dedicated memory partition.

config COMMON_LIBC_MALLOC_TLS
	bool "Per-thread"
	select COMMON_LIBC_MALLOC_SUPPORTED
	depends on THREAD_LOCAL_STORAGE
	depends on SYS_SYNC_HEAP
	help
	  Common implementation of malloc family that uses TLS-based per-thread
	  assigned heaps for user and kernel threads.

endchoice

config COMMON_LIBC_MALLOC_REQUIRED
	bool
	depends on COMMON_LIBC_MALLOC_SUPPORTED
	help
	  Hidden option to signal that malloc is required.

config COMMON_LIBC_MALLOC_ARENA_SIZE
	int "Size of the common C library malloc arena"
	depends on COMMON_LIBC_MALLOC_SHARED
	default 0 if MINIMAL_LIBC
	default 16384 if MMU
	default 2048 if USERSPACE && MPU_REQUIRES_POWER_OF_TWO_ALIGNMENT
	default 16384 if ARCH_POSIX
	default -1
	help
	  Indicate the size in bytes of the memory arena used for
	  common C library malloc() implementation.

	  If set to zero, then no malloc() heap will be available.

	  If set to -1, then all remaining system RAM will be used for this
	  area.

	  If user mode is enabled, and MPU hardware has requirements that
	  regions be sized to a power of two and aligned to their size,
	  then this must be defined as a power of two or a compile error
	  will result.

	  When using the minimal C library, the default is to have no
	  malloc heap. Otherwise, on systems with an MMU the default is
	  16kB and all other systems will default to using all remaining
	  ram for the malloc heap.

config COMMON_LIBC_MALLOC_TLS_FALLBACK
	bool "Kernel threads fall back to system heap"
	depends on COMMON_LIBC_MALLOC_TLS
	depends on HEAP_MEM_POOL_SIZE > 0
	default y
	help
	  If no heap has been assigned, kernel threads fall back to allocate
	  from the system heap.

config COMMON_LIBC_CALLOC
	bool "Common C library calloc"
	depends on COMMON_LIBC_MALLOC_SUPPORTED
	default n if MINIMAL_LIBC
	default y
	help
	  Enable the common C library trivial implementation of calloc,
	  which forwards to malloc and memset.

config COMMON_LIBC_REALLOCARRAY
	bool "Common C library reallocarray"
	depends on COMMON_LIBC_MALLOC_SUPPORTED
	default n if MINIMAL_LIBC
	default y
	help
	  Enable the common C library trivial implementation of
	  reallocarray, which forwards to realloc.

config COMMON_LIBC_STRNLEN
	bool
	help
	  common implementation of strnlen().

config COMMON_LIBC_THRD
	bool "C11 <threads.h> API support"
	depends on DYNAMIC_THREAD
	# Note: the POSIX_API dependency is only necessary until common elements
	# of C11 threads and POSIX API can be abstracted out to a common library.
	depends on POSIX_API
	default y
	help
	  Common implementation of C11 <threads.h> API.

config COMMON_LIBC_REMOVE
	bool "Common C library remove"
	depends on !SEMIHOST
	default y if FILE_SYSTEM
	help
	  Common implementation of remove().
```

## lib/libc/common/source/Kconfig
```kconfig
# Copyright (c) 2024 Meta Platforms
# SPDX-License-Identifier: Apache-2.0

rsource "stdio/Kconfig"
```

## lib/libc/common/source/stdio/Kconfig
```kconfig
# Copyright (c) 2024 Meta Platforms
# SPDX-License-Identifier: Apache-2.0

config COMMON_LIBC_STDIO
	bool
	help
	  common function implementation in stdio.h

config COMMON_LIBC_GETC_UNLOCKED
	bool
	select COMMON_LIBC_STDIO
	help
	  common implementation of getc_unlocked() & getchar_unlocked().

config COMMON_LIBC_PUTC_UNLOCKED
	bool
	select COMMON_LIBC_STDIO
	help
	  common implementation of putc_unlocked() & putchar_unlocked().
```

## lib/libc/minimal/Kconfig
```kconfig
# Copyright (c) 2016 Intel Corporation
# SPDX-License-Identifier: Apache-2.0

if MINIMAL_LIBC

config MINIMAL_LIBC_NON_REENTRANT_FUNCTIONS
	bool "Non-reentrant functions"
	default y if !USERSPACE
	select NEED_LIBC_MEM_PARTITION
	help
	  Enable non-reentrant functions that make use of the globals; e.g.
	  rand() and gmtime(). The globals must be put into a dedicated C
	  library memory partition when CONFIG_USERSPACE=y, and enabling this
	  option may require an additional memory protection region.

config MINIMAL_LIBC_LL_PRINTF
	bool "Build with minimal libc long long printf" if !64BIT
	default y if 64BIT
	help
	  Build with long long printf enabled. This will increase the size of
	  the image.

config MINIMAL_LIBC_OPTIMIZE_STRING_FOR_SIZE
	bool "Use size optimized string functions"
	default y if SIZE_OPTIMIZATIONS || SIZE_OPTIMIZATIONS_AGGRESSIVE
	help
	  Enable smaller but potentially slower implementations of memcpy and
	  memset. On the Cortex-M0+ this reduces the total code size by 120 bytes.

config MINIMAL_LIBC_RAND
	bool "Rand and srand functions"
	help
	  Enable rand_r() for the minimal libc.

	  In order to make use of the non-reentrant rand() and srand(), it is
	  necessary to set CONFIG_MINIMAL_LIBC_NON_REENTRANT_FUNCTIONS=y.

config MINIMAL_LIBC_TIME
	bool "Time functions"
	select COMMON_LIBC_TIME if POSIX_TIMERS
	select POSIX_C_LANG_SUPPORT_R
	select COMMON_LIBC_GMTIME_R
	select COMMON_LIBC_ASCTIME
	select COMMON_LIBC_LOCALTIME_R_UTC
	select COMMON_LIBC_CTIME
	default y
	help
	  Enable time() and gmtime_r() for the minimal libc.

	  time() requires CONFIG_POSIX_TIMERS=y because it relies on the POSIX
	  clock_gettime() function.

	  In order to make use of the non-reentrant gmtime(), it is necessary
	  to set CONFIG_MINIMAL_LIBC_NON_REENTRANT_FUNCTIONS=y.

config MINIMAL_LIBC_STRING_ERROR_TABLE
	bool "String error table for strerror() and strerror_r()"
	help
	  Select this option to ensure that streror(), strerror_r()
	  produce strings corresponding to the descriptions in errno.h.

	  The string error table can add ~2kiB to ROM. As such, it is
	  disabled by default. In this case, strerror() and strerror_r()
	  symbols are still present, but the functions produce an empty
	  string.

endif # MINIMAL_LIBC
```
