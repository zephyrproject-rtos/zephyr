## lib/gui/lvgl/Kconfig.themes
```kconfig
# Copyright (c) 2018 Jan Van Winkel <jan.van_winkel@dxplore.eu>
# Copyright (c) 2020 Teslabs Engineering S.L.
# SPDX-License-Identifier: Apache-2.0

menu "Themes"

choice
	prompt "Theme"
	default LVGL_USE_THEME_EMPTY

	config LVGL_USE_THEME_EMPTY
		bool "Empty theme"
		help
		  No theme, you can apply your styles as you need

	config LVGL_USE_THEME_MATERIAL
		bool "Material theme"
		help
		  Material theme, flat theme with bold colors and light shadow, support

	config LVGL_USE_THEME_MONO
		bool "Mono theme"
		help
		  Mono theme, monochrome, support

	config LVGL_USE_THEME_CUSTOM
		bool "Custom theme"
		help
		  Custom theme.
endchoice

if LVGL_USE_THEME_MATERIAL

choice
	prompt "Default material theme flags"
	default LVGL_THEME_MATERIAL_LIGHT

	config LVGL_THEME_MATERIAL_LIGHT
		bool "Light"

	config LVGL_THEME_MATERIAL_DARK
		bool "Dark"
endchoice

config LVGL_THEME_MATERIAL_FLAG_NO_TRANSITION
	bool "Disable transitions"
	help
	  Disable transitions in material theme

config LVGL_THEME_MATERIAL_FLAG_NO_FOCUS
	bool "Disable focus"
	help
	  Disable indication of focused state in material theme

endif # LVGL_USE_THEME_MATERIAL

if LVGL_USE_THEME_CUSTOM

config LVGL_THEME_CUSTOM_INIT_FUNCTION
	string "Custom theme initialization function"

endif # LVGL_USE_THEME_CUSTOM

choice
	prompt "Default theme primary color"
	default LVGL_THEME_DEFAULT_COLOR_PRIMARY_RED
	default LVGL_THEME_DEFAULT_COLOR_PRIMARY_BLACK if LVGL_USE_THEME_MONO

	config LVGL_THEME_DEFAULT_COLOR_PRIMARY_WHITE
		bool "White"

	config LVGL_THEME_DEFAULT_COLOR_PRIMARY_SILVER
		bool "Silver"

	config LVGL_THEME_DEFAULT_COLOR_PRIMARY_GRAY
		bool "Gray"

	config LVGL_THEME_DEFAULT_COLOR_PRIMARY_BLACK
		bool "Black"

	config LVGL_THEME_DEFAULT_COLOR_PRIMARY_RED
		bool "Red"

	config LVGL_THEME_DEFAULT_COLOR_PRIMARY_MAROON
		bool "Maroon"

	config LVGL_THEME_DEFAULT_COLOR_PRIMARY_YELLOW
		bool "Yellow"

	config LVGL_THEME_DEFAULT_COLOR_PRIMARY_OLIVE
		bool "Olive"

	config LVGL_THEME_DEFAULT_COLOR_PRIMARY_LIME
		bool "Lime"

	config LVGL_THEME_DEFAULT_COLOR_PRIMARY_GREEN
		bool "Green"

	config LVGL_THEME_DEFAULT_COLOR_PRIMARY_CYAN
		bool "Cyan"

	config LVGL_THEME_DEFAULT_COLOR_PRIMARY_AQUA
		bool "Aqua"

	config LVGL_THEME_DEFAULT_COLOR_PRIMARY_TEAL
		bool "Teal"

	config LVGL_THEME_DEFAULT_COLOR_PRIMARY_BLUE
		bool "Blue"

	config LVGL_THEME_DEFAULT_COLOR_PRIMARY_NAVY
		bool "Navy"

	config LVGL_THEME_DEFAULT_COLOR_PRIMARY_MAGENTA
		bool "Magenta"

	config LVGL_THEME_DEFAULT_COLOR_PRIMARY_PURPLE
		bool "Purple"

	config LVGL_THEME_DEFAULT_COLOR_PRIMARY_ORANGE
		bool "Orange"

	config LVGL_THEME_DEFAULT_COLOR_PRIMARY_CUSTOM
		bool "Custom"
endchoice

if LVGL_THEME_DEFAULT_COLOR_PRIMARY_CUSTOM

config LVGL_THEME_DEFAULT_COLOR_PRIMARY_CUSTOM_RED
	hex "Custom primary color (red)"
	range 0x00 0xFF
	default 0x00
	help
	  Custom primary color RGB red channel

config LVGL_THEME_DEFAULT_COLOR_PRIMARY_CUSTOM_GREEN
	hex "Custom primary color (green)"
	range 0x00 0xFF
	default 0x00
	help
	  Custom primary color RGB green channel

config LVGL_THEME_DEFAULT_COLOR_PRIMARY_CUSTOM_BLUE
	hex "Custom primary color (blue)"
	range 0x00 0xFF
	default 0x00
	help
	  Custom primary color RGB blue channel

endif # LVGL_THEME_DEFAULT_COLOR_PRIMARY_CUSTOM

choice
	prompt "Default theme secondary color"
	default LVGL_THEME_DEFAULT_COLOR_SECONDARY_RED
	default LVGL_THEME_DEFAULT_COLOR_SECONDARY_BLACK if LVGL_USE_THEME_MONO

	config LVGL_THEME_DEFAULT_COLOR_SECONDARY_WHITE
		bool "White"

	config LVGL_THEME_DEFAULT_COLOR_SECONDARY_SILVER
		bool "Silver"

	config LVGL_THEME_DEFAULT_COLOR_SECONDARY_GRAY
		bool "Gray"

	config LVGL_THEME_DEFAULT_COLOR_SECONDARY_BLACK
		bool "Black"

	config LVGL_THEME_DEFAULT_COLOR_SECONDARY_RED
		bool "Red"

	config LVGL_THEME_DEFAULT_COLOR_SECONDARY_MAROON
		bool "Maroon"

	config LVGL_THEME_DEFAULT_COLOR_SECONDARY_YELLOW
		bool "Yellow"

	config LVGL_THEME_DEFAULT_COLOR_SECONDARY_OLIVE
		bool "Olive"

	config LVGL_THEME_DEFAULT_COLOR_SECONDARY_LIME
		bool "Lime"

	config LVGL_THEME_DEFAULT_COLOR_SECONDARY_GREEN
		bool "Green"

	config LVGL_THEME_DEFAULT_COLOR_SECONDARY_CYAN
		bool "Cyan"

	config LVGL_THEME_DEFAULT_COLOR_SECONDARY_AQUA
		bool "Aqua"

	config LVGL_THEME_DEFAULT_COLOR_SECONDARY_TEAL
		bool "Teal"

	config LVGL_THEME_DEFAULT_COLOR_SECONDARY_BLUE
		bool "Blue"

	config LVGL_THEME_DEFAULT_COLOR_SECONDARY_NAVY
		bool "Navy"

	config LVGL_THEME_DEFAULT_COLOR_SECONDARY_MAGENTA
		bool "Magenta"

	config LVGL_THEME_DEFAULT_COLOR_SECONDARY_PURPLE
		bool "Purple"

	config LVGL_THEME_DEFAULT_COLOR_SECONDARY_ORANGE
		bool "Orange"

	config LVGL_THEME_DEFAULT_COLOR_SECONDARY_CUSTOM
		bool "Custom"
endchoice

if LVGL_THEME_DEFAULT_COLOR_SECONDARY_CUSTOM

config LVGL_THEME_DEFAULT_COLOR_SECONDARY_CUSTOM_RED
	hex "Custom secondary color (red)"
	range 0x00 0xFF
	default 0x00
	help
	  Custom secondary color RGB red channel

config LVGL_THEME_DEFAULT_COLOR_SECONDARY_CUSTOM_GREEN
	hex "Custom secondary color (green)"
	range 0x00 0xFF
	default 0x00
	help
	  Custom secondary color RGB green channel

config LVGL_THEME_DEFAULT_COLOR_SECONDARY_CUSTOM_BLUE
	hex "Custom secondary color (blue)"
	range 0x00 0xFF
	default 0x00
	help
	  Custom secondary color RGB blue channel

endif # LVGL_THEME_DEFAULT_COLOR_SECONDARY_CUSTOM

choice
	prompt "Default theme small font"
	default LVGL_THEME_DEFAULT_FONT_SMALL_UNSCII_8

	config LVGL_THEME_DEFAULT_FONT_SMALL_MONTSERRAT_8
		bool "Build-in font size 8"
		depends on LVGL_FONT_MONTSERRAT_8

	config LVGL_THEME_DEFAULT_FONT_SMALL_MONTSERRAT_10
		bool "Build-in font size 10"
		depends on LVGL_FONT_MONTSERRAT_10

	config LVGL_THEME_DEFAULT_FONT_SMALL_MONTSERRAT_12
		bool "Build-in font size 12"
		depends on LVGL_FONT_MONTSERRAT_12

	config LVGL_THEME_DEFAULT_FONT_SMALL_MONTSERRAT_14
		bool "Build-in font size 14"
		depends on LVGL_FONT_MONTSERRAT_14

	config LVGL_THEME_DEFAULT_FONT_SMALL_MONTSERRAT_16
		bool "Build-in font size 16"
		depends on LVGL_FONT_MONTSERRAT_16

	config LVGL_THEME_DEFAULT_FONT_SMALL_MONTSERRAT_18
		bool "Build-in font size 18"
		depends on LVGL_FONT_MONTSERRAT_18

	config LVGL_THEME_DEFAULT_FONT_SMALL_MONTSERRAT_20
		bool "Build-in font size 20"
		depends on LVGL_FONT_MONTSERRAT_20

	config LVGL_THEME_DEFAULT_FONT_SMALL_MONTSERRAT_22
		bool "Build-in font size 22"
		depends on LVGL_FONT_MONTSERRAT_22

	config LVGL_THEME_DEFAULT_FONT_SMALL_MONTSERRAT_24
		bool "Build-in font size 24"
		depends on LVGL_FONT_MONTSERRAT_24

	config LVGL_THEME_DEFAULT_FONT_SMALL_MONTSERRAT_26
		bool "Build-in font size 26"
		depends on LVGL_FONT_MONTSERRAT_26

	config LVGL_THEME_DEFAULT_FONT_SMALL_MONTSERRAT_28
		bool "Build-in font size 28"
		depends on LVGL_FONT_MONTSERRAT_28

	config LVGL_THEME_DEFAULT_FONT_SMALL_MONTSERRAT_30
		bool "Build-in font size 30"
		depends on LVGL_FONT_MONTSERRAT_30

		config LVGL_THEME_DEFAULT_FONT_SMALL_MONTSERRAT_32
		bool "Build-in font size 32"
		depends on LVGL_FONT_MONTSERRAT_32

	config LVGL_THEME_DEFAULT_FONT_SMALL_MONTSERRAT_34
		bool "Build-in font size 34"
		depends on LVGL_FONT_MONTSERRAT_34

	config LVGL_THEME_DEFAULT_FONT_SMALL_MONTSERRAT_36
		bool "Build-in font size 36"
		depends on LVGL_FONT_MONTSERRAT_36

	config LVGL_THEME_DEFAULT_FONT_SMALL_MONTSERRAT_38
		bool "Build-in font size 38"
		depends on LVGL_FONT_MONTSERRAT_38

	config LVGL_THEME_DEFAULT_FONT_SMALL_MONTSERRAT_40
		bool "Build-in font size 40"
		depends on LVGL_FONT_MONTSERRAT_40

	config LVGL_THEME_DEFAULT_FONT_SMALL_MONTSERRAT_42
		bool "Build-in font size 42"
		depends on LVGL_FONT_MONTSERRAT_42

	config LVGL_THEME_DEFAULT_FONT_SMALL_MONTSERRAT_44
		bool "Build-in font size 44"
		depends on LVGL_FONT_MONTSERRAT_44

	config LVGL_THEME_DEFAULT_FONT_SMALL_MONTSERRAT_46
		bool "Build-in font size 46"
		depends on LVGL_FONT_MONTSERRAT_46

	config LVGL_THEME_DEFAULT_FONT_SMALL_MONTSERRAT_48
		bool "Build-in font size 48"
		depends on LVGL_FONT_MONTSERRAT_48

	config LVGL_THEME_DEFAULT_FONT_SMALL_MONTSERRAT_12_SUBPX
		bool "Build-in font size 12 with sub-pixel rendering"
		depends on LVGL_FONT_MONTSERRAT_12_SUBPX

	config LVGL_THEME_DEFAULT_FONT_SMALL_MONTSERRAT_28_COMPRESSED
		bool "Build-in compressed font size 28"
		depends on LVGL_FONT_MONTSERRAT_28_COMPRESSED

	config LVGL_THEME_DEFAULT_FONT_SMALL_DEJAVU_16_PERSIAN_HEBREW
		bool "Build-in font size 16 with Hebrew, Arabic and Persian"
		depends on LVGL_FONT_DEJAVU_16_PERSIAN_HEBREW

	config LVGL_THEME_DEFAULT_FONT_SMALL_SIMSUN_16_CJK
		bool "Build-in font size 16 with CJK radicals"
		depends on LVGL_FONT_SIMSUN_16_CJK

	config LVGL_THEME_DEFAULT_FONT_SMALL_UNSCII_8
		bool "Build-in monospace font"
		depends on LVGL_FONT_UNSCII_8

	config LVGL_THEME_DEFAULT_FONT_SMALL_CUSTOM
		bool "Custom font"
		help
		  Use a none build-in font as default small font. A pointer named
		  lv_theme_default_small_font_custom_ptr should exists as a global
		  variable and point to a valid font structure

endchoice

choice
	prompt "Default theme normal font"
	default LVGL_THEME_DEFAULT_FONT_NORMAL_UNSCII_8

	config LVGL_THEME_DEFAULT_FONT_NORMAL_MONTSERRAT_8
		bool "Build-in font size 8"
		depends on LVGL_FONT_MONTSERRAT_8

	config LVGL_THEME_DEFAULT_FONT_NORMAL_MONTSERRAT_10
		bool "Build-in font size 10"
		depends on LVGL_FONT_MONTSERRAT_10

	config LVGL_THEME_DEFAULT_FONT_NORMAL_MONTSERRAT_12
		bool "Build-in font size 12"
		depends on LVGL_FONT_MONTSERRAT_12

	config LVGL_THEME_DEFAULT_FONT_NORMAL_MONTSERRAT_14
		bool "Build-in font size 14"
		depends on LVGL_FONT_MONTSERRAT_14

	config LVGL_THEME_DEFAULT_FONT_NORMAL_MONTSERRAT_16
		bool "Build-in font size 16"
		depends on LVGL_FONT_MONTSERRAT_16

	config LVGL_THEME_DEFAULT_FONT_NORMAL_MONTSERRAT_18
		bool "Build-in font size 18"
		depends on LVGL_FONT_MONTSERRAT_18

	config LVGL_THEME_DEFAULT_FONT_NORMAL_MONTSERRAT_20
		bool "Build-in font size 20"
		depends on LVGL_FONT_MONTSERRAT_20

	config LVGL_THEME_DEFAULT_FONT_NORMAL_MONTSERRAT_22
		bool "Build-in font size 22"
		depends on LVGL_FONT_MONTSERRAT_22

	config LVGL_THEME_DEFAULT_FONT_NORMAL_MONTSERRAT_24
		bool "Build-in font size 24"
		depends on LVGL_FONT_MONTSERRAT_24

	config LVGL_THEME_DEFAULT_FONT_NORMAL_MONTSERRAT_26
		bool "Build-in font size 26"
		depends on LVGL_FONT_MONTSERRAT_26

	config LVGL_THEME_DEFAULT_FONT_NORMAL_MONTSERRAT_28
		bool "Build-in font size 28"
		depends on LVGL_FONT_MONTSERRAT_28

	config LVGL_THEME_DEFAULT_FONT_NORMAL_MONTSERRAT_30
		bool "Build-in font size 30"
		depends on LVGL_FONT_MONTSERRAT_30

		config LVGL_THEME_DEFAULT_FONT_NORMAL_MONTSERRAT_32
		bool "Build-in font size 32"
		depends on LVGL_FONT_MONTSERRAT_32

	config LVGL_THEME_DEFAULT_FONT_NORMAL_MONTSERRAT_34
		bool "Build-in font size 34"
		depends on LVGL_FONT_MONTSERRAT_34

	config LVGL_THEME_DEFAULT_FONT_NORMAL_MONTSERRAT_36
		bool "Build-in font size 36"
		depends on LVGL_FONT_MONTSERRAT_36

	config LVGL_THEME_DEFAULT_FONT_NORMAL_MONTSERRAT_38
		bool "Build-in font size 38"
		depends on LVGL_FONT_MONTSERRAT_38

	config LVGL_THEME_DEFAULT_FONT_NORMAL_MONTSERRAT_40
		bool "Build-in font size 40"
		depends on LVGL_FONT_MONTSERRAT_40

	config LVGL_THEME_DEFAULT_FONT_NORMAL_MONTSERRAT_42
		bool "Build-in font size 42"
		depends on LVGL_FONT_MONTSERRAT_42

	config LVGL_THEME_DEFAULT_FONT_NORMAL_MONTSERRAT_44
		bool "Build-in font size 44"
		depends on LVGL_FONT_MONTSERRAT_44

	config LVGL_THEME_DEFAULT_FONT_NORMAL_MONTSERRAT_46
		bool "Build-in font size 46"
		depends on LVGL_FONT_MONTSERRAT_46

	config LVGL_THEME_DEFAULT_FONT_NORMAL_MONTSERRAT_48
		bool "Build-in font size 48"
		depends on LVGL_FONT_MONTSERRAT_48

	config LVGL_THEME_DEFAULT_FONT_NORMAL_MONTSERRAT_12_SUBPX
		bool "Build-in font size 12 with sub-pixel rendering"
		depends on LVGL_FONT_MONTSERRAT_12_SUBPX

	config LVGL_THEME_DEFAULT_FONT_NORMAL_MONTSERRAT_28_COMPRESSED
		bool "Build-in compressed font size 28"
		depends on LVGL_FONT_MONTSERRAT_28_COMPRESSED

	config LVGL_THEME_DEFAULT_FONT_NORMAL_DEJAVU_16_PERSIAN_HEBREW
		bool "Build-in font size 16 with Hebrew, Arabic and Persian"
		depends on LVGL_FONT_DEJAVU_16_PERSIAN_HEBREW

	config LVGL_THEME_DEFAULT_FONT_NORMAL_SIMSUN_16_CJK
		bool "Build-in font size 16 with CJK radicals"
		depends on LVGL_FONT_SIMSUN_16_CJK

	config LVGL_THEME_DEFAULT_FONT_NORMAL_UNSCII_8
		bool "Build-in monospace font"
		depends on LVGL_FONT_UNSCII_8

	config LVGL_THEME_DEFAULT_FONT_NORMAL_CUSTOM
		bool "Custom font"
		help
		  Use a none build-in font as default normal font. A pointer named
		  lv_theme_default_normal_font_custom_ptr should exists as a global
		  variable and point to a valid font structure

endchoice

choice
	prompt "Default theme subtitle font"
	default LVGL_THEME_DEFAULT_FONT_SUBTITLE_UNSCII_8

	config LVGL_THEME_DEFAULT_FONT_SUBTITLE_MONTSERRAT_8
		bool "Build-in font size 8"
		depends on LVGL_FONT_MONTSERRAT_8

	config LVGL_THEME_DEFAULT_FONT_SUBTITLE_MONTSERRAT_10
		bool "Build-in font size 10"
		depends on LVGL_FONT_MONTSERRAT_10

	config LVGL_THEME_DEFAULT_FONT_SUBTITLE_MONTSERRAT_12
		bool "Build-in font size 12"
		depends on LVGL_FONT_MONTSERRAT_12

	config LVGL_THEME_DEFAULT_FONT_SUBTITLE_MONTSERRAT_14
		bool "Build-in font size 14"
		depends on LVGL_FONT_MONTSERRAT_14

	config LVGL_THEME_DEFAULT_FONT_SUBTITLE_MONTSERRAT_16
		bool "Build-in font size 16"
		depends on LVGL_FONT_MONTSERRAT_16

	config LVGL_THEME_DEFAULT_FONT_SUBTITLE_MONTSERRAT_18
		bool "Build-in font size 18"
		depends on LVGL_FONT_MONTSERRAT_18

	config LVGL_THEME_DEFAULT_FONT_SUBTITLE_MONTSERRAT_20
		bool "Build-in font size 20"
		depends on LVGL_FONT_MONTSERRAT_20

	config LVGL_THEME_DEFAULT_FONT_SUBTITLE_MONTSERRAT_22
		bool "Build-in font size 22"
		depends on LVGL_FONT_MONTSERRAT_22

	config LVGL_THEME_DEFAULT_FONT_SUBTITLE_MONTSERRAT_24
		bool "Build-in font size 24"
		depends on LVGL_FONT_MONTSERRAT_24

	config LVGL_THEME_DEFAULT_FONT_SUBTITLE_MONTSERRAT_26
		bool "Build-in font size 26"
		depends on LVGL_FONT_MONTSERRAT_26

	config LVGL_THEME_DEFAULT_FONT_SUBTITLE_MONTSERRAT_28
		bool "Build-in font size 28"
		depends on LVGL_FONT_MONTSERRAT_28

	config LVGL_THEME_DEFAULT_FONT_SUBTITLE_MONTSERRAT_30
		bool "Build-in font size 30"
		depends on LVGL_FONT_MONTSERRAT_30

		config LVGL_THEME_DEFAULT_FONT_SUBTITLE_MONTSERRAT_32
		bool "Build-in font size 32"
		depends on LVGL_FONT_MONTSERRAT_32

	config LVGL_THEME_DEFAULT_FONT_SUBTITLE_MONTSERRAT_34
		bool "Build-in font size 34"
		depends on LVGL_FONT_MONTSERRAT_34

	config LVGL_THEME_DEFAULT_FONT_SUBTITLE_MONTSERRAT_36
		bool "Build-in font size 36"
		depends on LVGL_FONT_MONTSERRAT_36

	config LVGL_THEME_DEFAULT_FONT_SUBTITLE_MONTSERRAT_38
		bool "Build-in font size 38"
		depends on LVGL_FONT_MONTSERRAT_38

	config LVGL_THEME_DEFAULT_FONT_SUBTITLE_MONTSERRAT_40
		bool "Build-in font size 40"
		depends on LVGL_FONT_MONTSERRAT_40

	config LVGL_THEME_DEFAULT_FONT_SUBTITLE_MONTSERRAT_42
		bool "Build-in font size 42"
		depends on LVGL_FONT_MONTSERRAT_42

	config LVGL_THEME_DEFAULT_FONT_SUBTITLE_MONTSERRAT_44
		bool "Build-in font size 44"
		depends on LVGL_FONT_MONTSERRAT_44

	config LVGL_THEME_DEFAULT_FONT_SUBTITLE_MONTSERRAT_46
		bool "Build-in font size 46"
		depends on LVGL_FONT_MONTSERRAT_46

	config LVGL_THEME_DEFAULT_FONT_SUBTITLE_MONTSERRAT_48
		bool "Build-in font size 48"
		depends on LVGL_FONT_MONTSERRAT_48

	config LVGL_THEME_DEFAULT_FONT_SUBTITLE_MONTSERRAT_12_SUBPX
		bool "Build-in font size 12 with sub-pixel rendering"
		depends on LVGL_FONT_MONTSERRAT_12_SUBPX

	config LVGL_THEME_DEFAULT_FONT_SUBTITLE_MONTSERRAT_28_COMPRESSED
		bool "Build-in compressed font size 28"
		depends on LVGL_FONT_MONTSERRAT_28_COMPRESSED

	config LVGL_THEME_DEFAULT_FONT_SUBTITLE_DEJAVU_16_PERSIAN_HEBREW
		bool "Build-in font size 16 with Hebrew, Arabic and Persian"
		depends on LVGL_FONT_DEJAVU_16_PERSIAN_HEBREW

	config LVGL_THEME_DEFAULT_FONT_SUBTITLE_SIMSUN_16_CJK
		bool "Build-in font size 16 with CJK radicals"
		depends on LVGL_FONT_SIMSUN_16_CJK

	config LVGL_THEME_DEFAULT_FONT_SUBTITLE_UNSCII_8
		bool "Build-in monospace font"
		depends on LVGL_FONT_UNSCII_8

	config LVGL_THEME_DEFAULT_FONT_SUBTITLE_CUSTOM
		bool "Custom font"
		help
		  Use a none build-in font as default subtitle font. A pointer named
		  lv_theme_default_small_font_subtitle_ptr should exists as a global
		  variable and point to a valid font structure

endchoice

choice
	prompt "Default theme title font"
	default LVGL_THEME_DEFAULT_FONT_TITLE_UNSCII_8

	config LVGL_THEME_DEFAULT_FONT_TITLE_MONTSERRAT_8
		bool "Build-in font size 8"
		depends on LVGL_FONT_MONTSERRAT_8

	config LVGL_THEME_DEFAULT_FONT_TITLE_MONTSERRAT_10
		bool "Build-in font size 10"
		depends on LVGL_FONT_MONTSERRAT_10

	config LVGL_THEME_DEFAULT_FONT_TITLE_MONTSERRAT_12
		bool "Build-in font size 12"
		depends on LVGL_FONT_MONTSERRAT_12

	config LVGL_THEME_DEFAULT_FONT_TITLE_MONTSERRAT_14
		bool "Build-in font size 14"
		depends on LVGL_FONT_MONTSERRAT_14

	config LVGL_THEME_DEFAULT_FONT_TITLE_MONTSERRAT_16
		bool "Build-in font size 16"
		depends on LVGL_FONT_MONTSERRAT_16

	config LVGL_THEME_DEFAULT_FONT_TITLE_MONTSERRAT_18
		bool "Build-in font size 18"
		depends on LVGL_FONT_MONTSERRAT_18

	config LVGL_THEME_DEFAULT_FONT_TITLE_MONTSERRAT_20
		bool "Build-in font size 20"
		depends on LVGL_FONT_MONTSERRAT_20

	config LVGL_THEME_DEFAULT_FONT_TITLE_MONTSERRAT_22
		bool "Build-in font size 22"
		depends on LVGL_FONT_MONTSERRAT_22

	config LVGL_THEME_DEFAULT_FONT_TITLE_MONTSERRAT_24
		bool "Build-in font size 24"
		depends on LVGL_FONT_MONTSERRAT_24

	config LVGL_THEME_DEFAULT_FONT_TITLE_MONTSERRAT_26
		bool "Build-in font size 26"
		depends on LVGL_FONT_MONTSERRAT_26

	config LVGL_THEME_DEFAULT_FONT_TITLE_MONTSERRAT_28
		bool "Build-in font size 28"
		depends on LVGL_FONT_MONTSERRAT_28

	config LVGL_THEME_DEFAULT_FONT_TITLE_MONTSERRAT_30
		bool "Build-in font size 30"
		depends on LVGL_FONT_MONTSERRAT_30

		config LVGL_THEME_DEFAULT_FONT_TITLE_MONTSERRAT_32
		bool "Build-in font size 32"
		depends on LVGL_FONT_MONTSERRAT_32

	config LVGL_THEME_DEFAULT_FONT_TITLE_MONTSERRAT_34
		bool "Build-in font size 34"
		depends on LVGL_FONT_MONTSERRAT_34

	config LVGL_THEME_DEFAULT_FONT_TITLE_MONTSERRAT_36
		bool "Build-in font size 36"
		depends on LVGL_FONT_MONTSERRAT_36

	config LVGL_THEME_DEFAULT_FONT_TITLE_MONTSERRAT_38
		bool "Build-in font size 38"
		depends on LVGL_FONT_MONTSERRAT_38

	config LVGL_THEME_DEFAULT_FONT_TITLE_MONTSERRAT_40
		bool "Build-in font size 40"
		depends on LVGL_FONT_MONTSERRAT_40

	config LVGL_THEME_DEFAULT_FONT_TITLE_MONTSERRAT_42
		bool "Build-in font size 42"
		depends on LVGL_FONT_MONTSERRAT_42

	config LVGL_THEME_DEFAULT_FONT_TITLE_MONTSERRAT_44
		bool "Build-in font size 44"
		depends on LVGL_FONT_MONTSERRAT_44

	config LVGL_THEME_DEFAULT_FONT_TITLE_MONTSERRAT_46
		bool "Build-in font size 46"
		depends on LVGL_FONT_MONTSERRAT_46

	config LVGL_THEME_DEFAULT_FONT_TITLE_MONTSERRAT_48
		bool "Build-in font size 48"
		depends on LVGL_FONT_MONTSERRAT_48

	config LVGL_THEME_DEFAULT_FONT_TITLE_MONTSERRAT_12_SUBPX
		bool "Build-in font size 12 with sub-pixel rendering"
		depends on LVGL_FONT_MONTSERRAT_12_SUBPX

	config LVGL_THEME_DEFAULT_FONT_TITLE_MONTSERRAT_28_COMPRESSED
		bool "Build-in compressed font size 28"
		depends on LVGL_FONT_MONTSERRAT_28_COMPRESSED

	config LVGL_THEME_DEFAULT_FONT_TITLE_DEJAVU_16_PERSIAN_HEBREW
		bool "Build-in font size 16 with Hebrew, Arabic and Persian"
		depends on LVGL_FONT_DEJAVU_16_PERSIAN_HEBREW

	config LVGL_THEME_DEFAULT_FONT_TITLE_SIMSUN_16_CJK
		bool "Build-in font size 16 with CJK radicals"
		depends on LVGL_FONT_SIMSUN_16_CJK

	config LVGL_THEME_DEFAULT_FONT_TITLE_UNSCII_8
		bool "Build-in monospace font"
		depends on LVGL_FONT_UNSCII_8

	config LVGL_THEME_DEFAULT_FONT_TITLE_CUSTOM
		bool "Custom font"
		help
		  Use a none build-in font as default title font. A pointer named
		  lv_theme_default_small_font_title_ptr should exists as a global
		  variable and point to a valid font structure

endchoice

endmenu
```
