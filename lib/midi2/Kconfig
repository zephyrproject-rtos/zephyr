## lib/midi2/Kconfig
```kconfig
# Copyright (c) 2025 Titouan Christophe
# SPDX-License-Identifier: Apache-2.0

menu "MIDI2"

config MIDI2_UMP_STREAM_RESPONDER
	bool "MIDI2 UMP Stream responder"
	help
	  Library to respond to UMP Stream discovery messages, as specified
	  in "Universal MIDI Packet (UMP) Format and MIDI 2.0 Protocol"
	  version 1.1.2 section 7.1: "UMP Stream Messages"

endmenu
```

## lib/min_heap/Kconfig
```kconfig
# Copyright (c) 2025 Aerlync Labs Inc.
# SPDX-License-Identifier: Apache-2.0

config MIN_HEAP
	bool "Min-Heap Data Structure"
	help
		Enable support for a generic Min-Heap data structure library.

		A Min-Heap is a binary tree-based data structure in which the
		smallest element is always at the root. It supports efficient
		insertion and removal of the minimum element in O(log n) time,
		making it useful for priority queues, schedulers, and timeout
		queues.

		This implementation is designed for general-purpose use in both
		kernel and application code. It supports static and dynamic
		initialization and allows for custom comparator functions.

		Note: This is unrelated to the kernel's heap memory allocator
		(used for dynamic memory allocation with `k_malloc()` or
		`k_heap_alloc()`). The "heap" in Min-Heap refers to the ordering
		structure, not memory management.
```

## lib/ocpp/Kconfig
```kconfig
# Copyright (c) 2023 Linumiz
# SPDX-License-Identifier: Apache-2.0

config OCPP
	bool "Open Charge Point Protocol"
	depends on JSONC
	help
	  This option enables the open charge poin protocol library

if OCPP

config OCPP_INT_THREAD_STACKSIZE
	int "OCPP internal thread stacksize"
	default 4096
	help
	   OCPP internal thread stacksize

config OCPP_WSREADER_THREAD_STACKSIZE
	int "OCPP websocket reader thread stacksize"
	default 4096
	help
	   OCPP websocket reader thread stacksize

config OCPP_RECV_BUFFER_SIZE
	int "OCPP websocket recive buffer size"
	default 2048
	help
	   OCPP websocket recive buffer size

config OCPP_INTERNAL_MSGQ_CNT
	int "OCPP internal message queue count"
	default 10
	help
	   Messages communication between websocket reader and internal
	   process thread

config OCPP_MSG_JSON
	bool "PDU message format as JSON"
	default y
	help
	   If y, then the Charge Point and Central System PDU message format
	   as JSON

config OCPP_PROFILE_SMART_CHARGE
	bool "OCPP profile smart charging"
	default n
	help
	  choose to y to enable smart charging profile

config OCPP_PROFILE_REMOTE_TRIG
	bool "OCPP profile remote trigger"
	default n
	help
	  choose to y to enable remote trigger profile

config OCPP_PROFILE_RESERVATION
	bool "OCPP profile reservation"
	default n
	help
	  choose to y to enable reservation profile

config OCPP_PROFILE_LOCAL_AUTH_LIST
	bool "OCPP profile local authorization list"
	default n
	help
	  choose to y to enable local authorization list profile

config OCPP_PROFILE_FIRMWARE_MGNT
	bool "OCPP profile firmware management"
	default n
	help
	  choose to y to enable firmware management profile

endif # OCPP
```

## lib/open-amp/Kconfig
```kconfig
#
# Copyright (c) 2020, STMicroelectronics
#
# SPDX-License-Identifier: Apache-2.0
#

config OPENAMP_RSC_TABLE
	bool "coprocessor resource table"
	imply OPENAMP
	help
	  add the resource table in the generated binary. This table is
	  compatible with linux remote proc framework and OpenAMP library.

config OPENAMP_RSC_TABLE_NUM_RPMSG_BUFF
	int "Resource table number of rpmsg buffers"
	default 0
	depends on OPENAMP_RSC_TABLE
	help
	  This option specifies the number of buffer used in a Vring for
	  interprocessor communication

config OPENAMP_RSC_TABLE_IPM_RX_ID
	int "IPM RX channel ID"
	default 0
	depends on OPENAMP_RSC_TABLE
	help
	   This option specifies the IPM RX channel ID used in a VRING
	   for interprocessor communication

config OPENAMP_RSC_TABLE_IPM_TX_ID
	int "IPM TX channel ID"
	default 1
	depends on OPENAMP_RSC_TABLE
	help
	   This option specifies the IPM TX channel ID used in a VRING
	   for interprocessor communication

config OPENAMP_COPY_RSC_TABLE
	bool "Copy resource table section"
	depends on OPENAMP_RSC_TABLE
	help
	  The .resource_table section must be placed in a specific location
	  known by both this core and the remote core. If this is not taken
	  care of by the remote then this firmware has the ability to copy
	  the table to a specific location. This memory region can be declared
	  in the device tree by the "zephyr,ipc_rsc_table" node.

	  This is not needed if the remote loads this firmware and has control
	  over the placement of the .resource_table section such as remoteproc.

config OPENAMP_ADDR_TRANSLATION
	bool "Address translation support for OpenAMP"
	depends on OPENAMP
	help
	  Enable support for address translation from remote driver to device

config OPENAMP_VENDOR_ADDR_TRANSLATION_FILE
	string "Header file containing vendor-specific address translation table"
	default "addr_translation.h"
	depends on OPENAMP_ADDR_TRANSLATION
	help
	  Name of a header file containing vendor-specific
	  address translation table.
```

## lib/os/Kconfig
```kconfig
# Copyright (c) 2016 Intel Corporation
# SPDX-License-Identifier: Apache-2.0

menu "OS Support Library"

config FDTABLE
	bool "File descriptor table"
	help
	  This file provides generic file descriptor table implementation, suitable
	  for any I/O object implementing POSIX I/O semantics (i.e. read/write +
	  aux operations).

config ZVFS_OPEN_MAX
	int "Maximum number of open file descriptors"
	default 16 if WIFI_NM_WPA_SUPPLICANT
	default 16 if POSIX_API
	default 4
	help
	  Maximum number of open file descriptors, this includes
	  files, sockets, special devices, etc.

config PRINTK_SYNC
	bool "Serialize printk() calls"
	default y if SMP && MP_MAX_NUM_CPUS > 1 && !(EFI_CONSOLE && LOG)
	help
	  When true, a spinlock will be taken around the output from a
	  single printk() call, preventing the output data from
	  interleaving with concurrent usage from another CPU or an
	  preempting interrupt.

config MPSC_PBUF
	bool "Multi producer, single consumer packet buffer"
	select TIMEOUT_64BIT
	help
	  Enable usage of mpsc packet buffer. Packet buffer is capable of
	  storing variable length packets in a circular way and operate directly
	  on the buffer memory.

config SPSC_PBUF
	bool "Single producer, single consumer packet buffer"
	help
	  Enable usage of spsc packet buffer. Packet buffer is capable of
	  storing variable length packets in a circular way and operate directly
	  on the buffer memory.

if SPSC_PBUF

choice SPSC_PBUF_CACHE_HANDLING
	prompt "Cache handling"
	default SPSC_PBUF_CACHE_ALWAYS if SPSC_PBUF_USE_CACHE && !SPSC_PBUF_NO_CACHE
	default SPSC_PBUF_CACHE_NEVER if !SPSC_PBUF_USE_CACHE && SPSC_PBUF_NO_CACHE
	default SPSC_PBUF_CACHE_FLAG

config SPSC_PBUF_CACHE_FLAG
	bool "Use cache flag"
	help
	  Use instance specific configuration flag for cache handling.

config SPSC_PBUF_CACHE_ALWAYS
	bool "Always handle cache"
	help
	  Handle cache writeback and invalidation for all instances. Option used
	  to avoid runtime check and thus reduce memory footprint. Beware! It shall
	  be used only if all packet buffer instances are used for data sharing
	  between cores.

config SPSC_PBUF_CACHE_NEVER
	bool "Never handle cache"
	help
	  Discar cache handling for all instances. Option used to avoid runtime
	  check and thus reduce memory footprint.

endchoice

config SPSC_PBUF_USE_CACHE
	bool

config SPSC_PBUF_NO_CACHE
	bool

if SPSC_PBUF_CACHE_FLAG || SPSC_PBUF_CACHE_ALWAYS

config SPSC_PBUF_REMOTE_DCACHE_LINE
	int "Remote cache line size"
	default 32
	help
	  If a packet buffer is used for data sharing between two cores then
	  this value should be set to the data cache line size of the remote core.
	  If local data cache line is detected at runtime then it should be
	  maximum of local and remote line size.

endif # SPSC_PBUF_CACHE_FLAG || SPSC_PBUF_CACHE_ALWAYS

config SPSC_PBUF_UTILIZATION
	bool "Track maximum utilization"
	help
	  When enabled, maximum utilization is tracked which can be used to
	  determine the size of the packet buffer.

endif # SPSC_PBUF

if MPSC_PBUF
config MPSC_CLEAR_ALLOCATED
	bool "Clear allocated packet"
	help
	  When enabled packet space is zeroed before returning from allocation.
endif

if SCHED_DEADLINE

config P4WQ_INIT_STAGE_EARLY
	bool "Early initialization of P4WQ threads"
	help
	  Initialize P4WQ threads early so that the P4WQ can be used on devices
	  initialization sequence.

endif

config REBOOT
	bool "Reboot functionality"
	help
	  Enable the sys_reboot() API. Enabling this can drag in other subsystems
	  needed to perform a "safe" reboot (e.g. to stop the system clock before
	  issuing a reset).

config HAS_POWEROFF
	bool
	help
	  Option to signal that power off functionality is implemented.

config POWEROFF
	bool "Power off functionality"
	depends on HAS_POWEROFF
	help
	  Enable support for system power off.

rsource "Kconfig.cbprintf"
rsource "zvfs/Kconfig"

endmenu
```

## lib/os/Kconfig.atomics
```kconfig
# Copyright (c) 2014-2015 Wind River Systems, Inc.
#
# SPDX-License-Identifier: Apache-2.0

menu "Atomic Operations"

config ATOMIC_OPERATIONS_BUILTIN
	bool
	help
	  Use the compiler builtin functions for atomic operations. This is
	  the preferred method. However, support for all arches in GCC is
	  incomplete.

config ATOMIC_OPERATIONS_ARCH
	bool
	help
	  Use when there isn't support for compiler built-ins, but you have
	  written optimized assembly code under arch/ which implements these.

config ATOMIC_OPERATIONS_C
	bool
	help
	  Use atomic operations routines that are implemented entirely
	  in C by locking interrupts. Selected by architectures which either
	  do not have support for atomic operations in their instruction
	  set, or haven't been implemented yet during bring-up, and also
	  the compiler does not have support for the atomic __sync_* builtins.
endmenu
```
