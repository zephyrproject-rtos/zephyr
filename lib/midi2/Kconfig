## lib/os/Kconfig.cbprintf
```kconfig
# Copyright (c) 2020 Nordic Semiconductor ASA
# SPDX-License-Identifier: Apache-2.0

choice CBPRINTF_IMPLEMENTATION
	prompt "Capabilities of cbprintf implementation"
	default CBPRINTF_COMPLETE

config CBPRINTF_COMPLETE
	bool "All selected features"
	help
	  Select this for an implementation that supports all potential
	  conversions, with Kconfig options to control availability at build
	  time.

# 80: -53% / 982 B (80 / 00)
config CBPRINTF_NANO
	bool "Space-optimized but feature-limited"
	# nano needs to count characters if it's the formatter for libc
	imply CBPRINTF_LIBC_SUBSTS if MINIMAL_LIBC
	help
	  If selected a completely different implementation of the core
	  formatting capability is substituted.  This has a much smaller code
	  footprint, but provides fewer capabilities.

endchoice # CBPRINTF_IMPLEMENTATION

choice CBPRINTF_INTEGRAL_CONV
	prompt "Control range of convertible integer values"
	default CBPRINTF_FULL_INTEGRAL

# 01: 0% / 0 B (01 / 00)
config CBPRINTF_FULL_INTEGRAL
	bool "Convert the full range of integer values"
	select PICOLIBC_IO_MINIMAL_LONG_LONG if PICOLIBC_IO_MINIMAL && PICOLIBC_USE_MODULE
	help
	  Build cbprintf with buffers sized to support converting the full
	  range of all integral and pointer values.

	  Selecting this may increase code size on 32-bit systems as
	  GCC's __udivdi3 helper could end up being pulled into the
	  final binary. In any case, this will increase call stack size
	  by a few words.

# 00:
config CBPRINTF_REDUCED_INTEGRAL
	bool "Convert only integer values that fit in 32 bits"
	help
	  Build cbprintf with buffers sized to support converting integer
	  values with no more than 32 bits.

	  This will decrease stack space, but affects conversion of any type
	  with more than 32 bits.  This includes not only intmax_t but any
	  type that can be converted to an integral representation including
	  size_t and pointers.

	  With CBPRINTF_COMPLETE conversions that may result in value-specific
	  truncation are not supported, and the generated text will be the
	  specification (e.g. %jd).

	  With CBPRINTF_NANO all conversions will be attempted but values that
	  cannot fit will be silently truncated.

endchoice

# 02: 82% / 1530 B (02 / 00)
config CBPRINTF_FP_SUPPORT
	bool "Floating point formatting in cbprintf"
	default y if FPU
	depends on CBPRINTF_COMPLETE
	help
	  Build the cbprintf utility function with support for floating
	  point format specifiers.  Selecting this increases stack size
	  requirements slightly, but increases code size significantly.

# 04: 13% / 456 B (07 / 03)
config CBPRINTF_FP_A_SUPPORT
	bool "Floating point %a conversions"
	depends on CBPRINTF_FULL_INTEGRAL
	select CBPRINTF_FP_SUPPORT
	help
	  The %a hexadecimal format for floating point value conversion was
	  added in C99, but the output is not easily understood so it rarely
	  appears in application code.

	  Selecting this adds support for the conversion, but increases the
	  overall code size related to FP support.

# 40: -15% / -508 B (46 / 06)
config CBPRINTF_FP_ALWAYS_A
	bool "Select %a format for all floating point specifications"
	select CBPRINTF_FP_A_SUPPORT
	depends on !PICOLIBC
	help
	  The %a format for floats requires significantly less code than the
	  standard decimal representations (%f, %e, %g).  Selecting this
	  option implicitly uses %a (or %A) for all decimal floating
	  conversions.  The precision of the original specification is
	  ignored.

	  Selecting this decreases code size when FP_SUPPORT is enabled.

# 08: 3% / 60 B (08 / 00)
config CBPRINTF_N_SPECIFIER
	bool "Support %n specifications"
	depends on CBPRINTF_COMPLETE
	depends on !PICOLIBC
	default y
	help
	  If selected %n can be used to determine the number of characters
	  emitted.  If enabled there is a small increase in code size.
	  Picolibc does not support this feature for security reasons.

# 180: 18% / 138 B (180 / 80) [NANO]
config CBPRINTF_LIBC_SUBSTS
	bool "Generate C-library compatible functions using cbprintf"
	help
	  If selected wrappers are generated for various C library functions
	  using the cbprintf formatter underneath.  The wrappers use the C
	  library function name with a cb suffix; e.g. printfcb() or
	  vsnprintfcb().

	  When used with CBPRINTF_NANO this increases the implementation code
	  size by a small amount.

	  When used with picolibc, this option generates cbprintf-compatible
	  functions using stdio, effectively inverting the sense above.

module = CBPRINTF_PACKAGE
module-str = cbprintf_package
source "subsys/logging/Kconfig.template.log_config"

config CBPRINTF_PACKAGE_LONGDOUBLE
	bool "Support packaging of long doubles"
	help
	  Option impact required alignment for buffers used for packaging
	  (CBPRINTF_PACKAGE_ALIGNMENT). On most platforms long doubles
	  requires buffer to be 16 bytes aligned. Long doubles are rarely used
	  so such alignment is an unnecessary waste. If option is disabled,
	  then compilation fails if long double is used.

config CBPRINTF_STATIC_PACKAGE_CHECK_ALIGNMENT
	bool "Validate alignment of a static package buffer"
	# To avoid self referential macro when printk is redirected to logging
	depends on !LOG_PRINTK
	help
	  When enabled, CBPRINTF_STATIC_PACKAGE asserts when buffer is not
	  properly aligned. If macro is widely used then assert may impact
	  memory footprint.

config CBPRINTF_PACKAGE_HEADER_STORE_CREATION_FLAGS
	bool
	help
	  Enable this option to store the flags used to create the package
	  into the package itself.

config CBPRINTF_PACKAGE_SUPPORT_TAGGED_ARGUMENTS
	bool
	depends on !PICOLIBC
	select CBPRINTF_PACKAGE_HEADER_STORE_CREATION_FLAGS
	help
	  Hidden option to support tagged arguments in cbvprint_package().
	  If enabled and cbvprint_package() is called with the corresponding
	  flag, the packaging function no longer looks at the format strings
	  to determine the types of arguments, but instead, each argument is
	  tagged with a type by preceding it with another argument as type
	  (integer).

config CBPRINTF_CONVERT_CHECK_PTR
	bool
	default y if !LOG_FMT_SECTION_STRIP
	help
	  If enabled, cbprintf_package_convert() supports checking if string
	  candidate is used for %p format specifier. Check cannot be performed
	  if string is not present in the memory.
```

## lib/os/cpu_load/Kconfig
```kconfig
# Copyright (c) 2024, Nordic Semiconductor ASA
#
# SPDX-License-Identifier: Apache-2.0

config CPU_LOAD
	bool "CPU load measurement"
	depends on CPU_CORTEX_M || RISCV || CPU_CORTEX_A || XTENSA
	depends on !SMP
	select SYS_IDLE_HOOKS
	help
	  Track CPU load by measuring the time spent in the idle loop using the
	  architecture idle hooks. Does not depend on the tracing subsystem.

if CPU_LOAD

# Workaround for not being able to have commas in macro arguments
DT_CHOSEN_Z_CPU_LOAD_COUNTER := zephyr,cpu-load-counter

config CPU_LOAD_USE_COUNTER
	bool "Use counter"
	depends on $(dt_chosen_enabled,$(DT_CHOSEN_Z_CPU_LOAD_COUNTER))
	default y
	select COUNTER
	help
	  Use counter for tracking CPU idle time.

config CPU_LOAD_LOG_PERIODICALLY
	int "Report period (in milliseconds)"
	depends on LOG
	default 0
	help
	  Specifies how often CPU load shall be logged. 0 means that there is no logging.

module = CPU_LOAD
module-str = cpu_load
source "subsys/logging/Kconfig.template.log_config"

endif # CPU_LOAD
```

## lib/os/zassert/Kconfig.template.zassert
```kconfig
# Copyright (c) 2026 Måns Ansgariusson <mansgariusson@gmail.com>
# Assertion group level configuration template.
#
# Sourced by a Kconfig file to generate the CONFIG_<group>_ZASSERT_LEVEL symbol
# consumed by ZASSERT_GROUP(<group>) (see <zephyr/sys/zassert.h>).
# The group name must be an UPPERCASE identifier: the C preprocessor pastes it
# verbatim into CONFIG_<group>_ZASSERT_LEVEL, so it has to match this symbol
# exactly.
# Use it as:
#	zassert-group = MYGROUP
#	zassert-group-str = my group
#	source "lib/os/zassert/Kconfig.template.zassert"
#
# This produces a user-facing choice (Off / On / Verbose) and the derived,
# non-assignable CONFIG_$(zassert-group)_ZASSERT_LEVEL integer symbol. The choice
# defaults to Off, unless the group opts into an On-by-default by giving
# CONFIG_$(zassert-group)_ZASSERT_DEFAULTS_ON a "default y [if ...]" (e.g. from a
# debug master switch). The level stays overridable from prj.conf.
#
# SPDX-License-Identifier: Apache-2.0

choice "$(zassert-group)_ZASSERT_LEVEL_CHOICE"
	prompt "Assertion level for $(zassert-group-str)"
	default $(zassert-group)_ZASSERT_LEVEL_ON if $(zassert-group)_ZASSERT_DEFAULTS_ON
	default $(zassert-group)_ZASSERT_LEVEL_OFF
	depends on ZASSERT

config $(zassert-group)_ZASSERT_LEVEL_OFF
	bool "Off"
	help
	  ZASSERT_OFF: assertions for this group are compiled out.

config $(zassert-group)_ZASSERT_LEVEL_ON
	bool "On (no message)"
	help
	  ZASSERT_ON: assertions are checked, but the message and its arguments
	  are not compiled in.

config $(zassert-group)_ZASSERT_LEVEL_VERBOSE
	bool "Verbose (with message)"
	help
	  ZASSERT_VERBOSE: assertions are checked and the message and its
	  arguments are compiled in.

endchoice

config $(zassert-group)_ZASSERT_DEFAULTS_ON
	bool

config $(zassert-group)_ZASSERT_LEVEL
	int
	default 0 if !ZASSERT
	default 0 if $(zassert-group)_ZASSERT_LEVEL_OFF
	default 1 if $(zassert-group)_ZASSERT_LEVEL_ON
	default 2 if $(zassert-group)_ZASSERT_LEVEL_VERBOSE
```

## lib/pid/Kconfig
```kconfig
# Copyright (c) 2026 Contributors to the Zephyr Project
# SPDX-License-Identifier: Apache-2.0

config PID_CONTROLLER
	bool "PID controller library"
	help
	  Generic discrete PID controller with anti-windup, using
	  Q16.16 fixed-point arithmetic. Suitable for motor control,
	  thermal regulation, and other feedback control applications.
	  No FPU or kernel dependencies required.
```

## lib/pixel/Kconfig
```kconfig
# Copyright (c) 2025 tinyVision.ai Inc.
# SPDX-License-Identifier: Apache-2.0

menuconfig PIXEL
	bool "Pixel and Image Manipulation Library"
	imply RING_BUFFER_LARGE

if PIXEL

config PIXEL_HEAP_SIZE
	int "Size in bytes for use in pixel operations intermediate buffers"
	default 4096
	help
	  Every time an operation is performed on an image, intermediate buffers matching the
	  line width are allocated. This configures how much memory to use for it.
	  The default is enough for a few conversion for small frames.

choice PIXEL_PRINT
	bool "Select the print function to use for sending characters out."
	default PIXEL_PRINT_PRINTF
	help
	  The default is to use printf() as it most often leads to the output being printed out.

config PIXEL_PRINT_PRINTF
	bool "Image output to print is sent to printf()"
	help
	  The data is directly handled by the libc bypassing most configuration.

config PIXEL_PRINT_PRINTK
	bool "Image output to print is sent to printk()"
	help
	  The printk() function will sometimes drop characters to avoid slowing-down the rest of
	  the firmware, and can be configured to use the logging subsystem.

config PIXEL_PRINT_SHELL
	bool "Image output to print is sent to shell_print()"
	help
	  The shell instance used is set by pixel_print_set_shell().

config PIXEL_PRINT_NONE
	bool "Image output is dropped and not sent anywhere"
	help
	  This is useful for environments where UTF-8 or escape characters can be a problem,
	  or where a human is not watching, like CI, or quickly toggle on/off this feature.

endchoice

module = PIXEL
module-str = pixel
source "subsys/logging/Kconfig.template.log_config"

endif
```

## lib/posix/Kconfig
```kconfig
# Copyright (c) 2024 Meta
#
# SPDX-License-Identifier: Apache-2.0

menu "POSIX API Support"

rsource "options/Kconfig"
rsource "shell/Kconfig"

endmenu # "POSIX API Support"
```

## lib/posix/Kconfig.clock
```kconfig
# Copyright (c) 2018 Intel Corporation
#
# SPDX-License-Identifier: Apache-2.0

config POSIX_CLOCK
	bool "POSIX clock, timer, and sleep APIs"
	default y if POSIX_API
	help
	  This enables POSIX clock\_\*(), timer\_\*(), and \*sleep()
	  functions.
```

## lib/posix/Kconfig.cond
```kconfig
# Copyright (c) 2017 Intel Corporation
# Copyright (c) 2023 Meta
#
# SPDX-License-Identifier: Apache-2.0

TYPE = PTHREAD_COND
type = pthread_cond_t
type-function = pthread_cond_wait
source "lib/posix/Kconfig.template.pooled_ipc_type"
```

## lib/posix/Kconfig.cx.string
```kconfig
# Copyright (c) 2023 Meta
#
# SPDX-License-Identifier: Apache-2.0

# CX: Extension to the ISO C standard
# See IEEE 1003.1-2017

config POSIX_CX_STRERROR_R
	bool "Get error message string"
	default y if POSIX_API
	select COMMON_LIBC_STRERROR
	help
	  Enable the strerror_r() POSIX C extension.

	  This function is a thread-safe version of ISO C strerror().
```

## lib/posix/Kconfig.fnmatch
```kconfig
# Copyright (c) 2018 Nordic Semiconductor ASA
#
# SPDX-License-Identifier: Apache-2.0

config FNMATCH
	bool "Support for fnmatch"
	default y if POSIX_API
	help
	  Match filenames using the the fnmatch function. For example, the pattern
	  "*.c" matches the filename "hello.c".
```

## lib/posix/Kconfig.getopt
```kconfig
# Copyright (c) 2021 Nordic Semiconductor ASA
#
# SPDX-License-Identifier: Apache-2.0

source "lib/posix/getopt/Kconfig"
```

## lib/posix/Kconfig.limits
```kconfig
# Copyright (c) 2023 Meta
#
# SPDX-License-Identifier: Apache-2.0

if POSIX_SIGNAL
config POSIX_LIMITS_RTSIG_MAX
	int "_POSIX_RTSIG_MAX value in limits.h"
	default 8
	help
	  Define the _POSIX_RTSIG_MAX value in limits.h.
	  IEEE 1003.1 defines this to be 8.

endif
```

## lib/posix/Kconfig.pthread
```kconfig
# Copyright (c) 2017 Intel Corporation
# Copyright (c) 2023 Meta
#
# SPDX-License-Identifier: Apache-2.0

TYPE = PTHREAD
type = pthread_t
type-function = pthread_create
source "lib/posix/Kconfig.template.pooled_ipc_type"

if PTHREAD

config PTHREAD_RECYCLER_DELAY_MS
	int "Delay for reclaiming dynamic pthread stacks (ms)"
	default 100
	help
	  Prior to a POSIX thread terminating via k_thread_abort(), scheduled
	  work is added to the system workqueue (SWQ) so that any resources
	  allocated by the thread (e.g. thread stack from a pool or the heap)
	  can be released back to the system. Because resources are also freed
	  on calls to pthread_create() there is no need to worry about resource
	  starvation.

	  This option sets the number of milliseconds by which to defer
	  scheduled work.

	  Note: this option should be considered temporary and will likely be
	  removed once a more synchronous solution is available.

endif
```

## lib/posix/Kconfig.sched
```kconfig
# Copyright (c) 2023 Intel Corporation
#
# SPDX-License-Identifier: Apache-2.0

config POSIX_SCHED
	bool "_POSIX_PRIORITY_SCHEDULING API support"
	default y if PTHREAD
	depends on PTHREAD
	help
	  This enables POSIX scheduling APIs (_POSIX_PRIORITY_SCHEDULING).
```

## lib/posix/Kconfig.semaphore
```kconfig
# Copyright (c) 2018 Intel Corporation
#
# SPDX-License-Identifier: Apache-2.0

config SEM_VALUE_MAX
	int "Maximum semaphore limit"
	default 32767
	range 1 32767
	help
	  Maximum semaphore count in POSIX compliant Application.
```

## lib/posix/Kconfig.signal
```kconfig
# Copyright (c) 2023 Meta
#
# SPDX-License-Identifier: Apache-2.0

config POSIX_SIGNAL
	bool "Support for POSIX signal APIs"
	default y if POSIX_API
	help
	  Enable support for POSIX signal APIs.

if POSIX_SIGNAL

config POSIX_SIGNAL_STRING_DESC
	bool "Use full description for the strsignal API"
	default y
	help
	  Use full description for the strsignal API.
	  Will use 256 bytes of ROM.

endif

# needed outside of if clause above to define constants & types in signal.h
config POSIX_RTSIG_MAX
	int "Maximum number of realtime signals"
	default 31 if POSIX_SIGNAL
	default 0 if !POSIX_SIGNAL
	help
	  Define the maximum number of realtime signals (RTSIG_MAX).
	  The range of realtime signals is [SIGRTMIN .. (SIGRTMIN+RTSIG_MAX)]
```
