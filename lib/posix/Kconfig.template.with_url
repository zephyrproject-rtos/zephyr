## lib/posix/Kconfig.timer
```kconfig
# Copyright (c) 2018 Intel Corporation
#
# SPDX-License-Identifier: Apache-2.0

TYPE = TIMER
type = timer_t
type-function = timer_create
source "lib/posix/Kconfig.template.pooled_type"

config TIMER_CREATE_WAIT
	int "Time to wait for timer availability (in msec) in POSIX application"
	default 100
	range 0 1000
	help
	  This controls how long to wait for resources to come available to create
	  a new timer in POSIX compliant application

config TIMER_DELAYTIMER_MAX
	int "Maximum count returned my timer_getoverrun() in POSIX application"
	default 20
	help
	  This controls the maximum number of times a timer can overrun before
	  timer_getoverrun() in POSIX compliant application.
```

## lib/posix/c_lib_ext/Kconfig
```kconfig
# Copyright (c) 2024 Tenstorrent AI ULC
#
# SPDX-License-Identifier: Apache-2.0

config POSIX_C_LIB_EXT
	bool "POSIX general C library extension"
	select GETOPT
	help
	  Select 'y' here and Zephyr will provide an implementation of the POSIX_C_LIB_EXT Option
	  Group, consisting of fnmatch(), getopt(), getsubopt(), optarg, opterr, optind, optopt,
	  stpcpy(), stpncpy(), strcasecmp(), strdup(), strfmon(), and strncasecmp(), strndup(), and
	  strnlen().

	  For more information, please see
	  https://pubs.opengroup.org/onlinepubs/9699919799/xrat/V4_subprofiles.html
```

## lib/posix/conformance/Kconfig
```kconfig
# Copyright (c) 2024, Fried Professional Engineering Services, Inc
#
# SPDX-License-Identifier: Apache-2.0

rsource "application/Kconfig"
```

## lib/posix/conformance/application/Kconfig
```kconfig
# Copyright (c) 2024, Friedt Professional Engineering Services, Inc
#
# SPDX-License-Identifier: Apache-2.0

menu "Application Conformance"

# The latest versions from IEEE 1003.1-2017
config POSIX_C_SOURCE_LATEST_VERSION
	int
	# The required 'L' is appended by CMake if > 2
	default 200809

config XOPEN_SOURCE_LATEST_VERSION
	int
	default 700

choice POSIX_C_SOURCE_CHOICE
	prompt "Selection for _POSIX_C_SOURCE"
	default POSIX_C_SOURCE_CHOICE_DEFAULT if POSIX_API
	default POSIX_C_SOURCE_CHOICE_NONE
	help
	  POSIX API application conformance level.

	  This Kconfig option is used by the CMake function
	  zephyr_posix_library_compile_definitions([min]).

config POSIX_C_SOURCE_CHOICE_NONE
	bool "None"
	help
	  The application does not require _POSIX_C_SOURCE defined.

	  This is the default.

config POSIX_C_SOURCE_CHOICE_DEFAULT
	bool "Default"
	help
	  This is normally the latest version specified by IEEE 1003.1.

config POSIX_C_SOURCE_CHOICE_200809L
	bool "200809L"
	help
	  Prefer _POSIX_C_SOURCE=200809L. This is the value specified in both
	  IEEE Std. 1003.1-2008 and IEEE Std. 1003.1-2017.

config POSIX_C_SOURCE_CHOICE_200112L
	bool "200112L"
	help
	  Prefer _POSIX_C_SOURCE=200112L. This is the value specified in IEEE Std. 1003.1-2001.

config POSIX_C_SOURCE_CHOICE_199506L
	bool "199506L"
	help
	  Prefer _POSIX_C_SOURCE=199506L. This is the value specified in IEEE Std. 1003.1c-1995.

config POSIX_C_SOURCE_CHOICE_199309L
	bool "199309L"
	help
	  Prefer _POSIX_C_SOURCE=199309L. This is the value specified in IEEE Std. 1003.1b-1993.

config POSIX_C_SOURCE_CHOICE_2
	bool "2"
	help
	  Prefer _POSIX_C_SOURCE=2. This is the value specified in IEEE Std. 1003.2-1992.

config POSIX_C_SOURCE_CHOICE_1
	bool "1"
	help
	  Prefer _POSIX_C_SOURCE=1. This is the value specified in IEEE Std. 1003.1-1990.

endchoice

choice XOPEN_SOURCE_CHOICE
	prompt "Selection for _XOPEN_SOURCE"
	default XOPEN_SOURCE_CHOICE_DEFAULT if POSIX_API
	default XOPEN_SOURCE_CHOICE_NONE
	help
	  X/Open application conformance level.

	  This Kconfig option is used by the CMake function
	  zephyr_xopen_library_compile_definitions([min]).

config XOPEN_SOURCE_CHOICE_NONE
	bool "None"
	help
	  The application does not require _XOPEN_SOURCE defined.

	  This is the default.

config XOPEN_SOURCE_CHOICE_DEFAULT
	bool "Default"
	help
	  This is normally the latest version specified by IEEE 1003.1.

config XOPEN_SOURCE_CHOICE_700
	bool "700"
	help
	  Prefer _XOPEN_SOURCE=700. This is the value specified in IEEE Std. 1003.1-2008
	  and IEEE Std. 1003.1-2017.

config XOPEN_SOURCE_CHOICE_600
	bool "600"
	help
	  Prefer _XOPEN_SOURCE=600. This is the value specified in IEEE Std. 1003.1-2001.

config XOPEN_SOURCE_CHOICE_500
	bool "500"
	help
	  Prefer _XOPEN_SOURCE=500. This includes everything up to Single Unix Specification,
	  version 2 (SUSv2).

endchoice

endmenu # "Application Conformance"
```

## lib/posix/getopt/Kconfig
```kconfig
# Copyright (c) 2021 Nordic Semiconductor
# SPDX-License-Identifier: Apache-2.0


menuconfig GETOPT
	bool "Getopt library support"
	default y if POSIX_API
	help
	  This option adds support of getopt.
	  Different shell backends are use their own instance of getopt to
	  not interfere with each other.
	  All not shell threads share one global instance of getopt state, hence
	  apart from shell this library is not thread safe. User can add support
	  for other threads by extending function getopt_state_get in
	  getopt_common.c file.
	  This option enables the following function: getopt.

config GETOPT_LONG
	bool "Getopt long library support"
	depends on GETOPT
	help
	  This option adds support of the getopt long.
	  Different shell backends are using their own instance of getopt to
	  not interfere with each other.
	  All not shell threads share one global instance of getopt state, hence
	  apart from shell this library is not thread safe. User can add support
	  for other threads by extending function getopt_state_get in
	  getopt_common.c file.
```

## lib/posix/options/Kconfig
```kconfig
# Copyright (c) 2018 Intel Corporation
# Copyright (c) 2023 Meta
# Copyright (c) 2024 Tenstorrent AI ULC
#
# SPDX-License-Identifier: Apache-2.0

# zephyr-keep-sorted-start
rsource "Kconfig.aio"
rsource "Kconfig.barrier"
rsource "Kconfig.device_io"
rsource "Kconfig.fd_mgmt"
rsource "Kconfig.file_system_r"
rsource "Kconfig.fs"
rsource "Kconfig.mem"
rsource "Kconfig.mqueue"
rsource "Kconfig.net"
rsource "Kconfig.proc1"
rsource "Kconfig.procN"
rsource "Kconfig.pthread"
rsource "Kconfig.rwlock"
rsource "Kconfig.sched"
rsource "Kconfig.semaphore"
rsource "Kconfig.signal"
rsource "Kconfig.spinlock"
rsource "Kconfig.sync_io"
rsource "Kconfig.timer"
# zephyr-keep-sorted-stop

menu "X/Open system interfaces"

# zephyr-keep-sorted-start
rsource "Kconfig.xsi_realtime"
rsource "Kconfig.xsi_single_process"
rsource "Kconfig.xsi_streams"
rsource "Kconfig.xsi_system_logging"
rsource "Kconfig.xsi_threads_ext"
# zephyr-keep-sorted-stop

endmenu # "X/Open system interfaces"
```

## lib/posix/options/Kconfig.aio
```kconfig
# Copyright (c) 2024 Tenstorrent AI ULC
#
# SPDX-License-Identifier: Apache-2.0

config POSIX_ASYNCHRONOUS_IO
	bool "POSIX asynchronous I/O [EXPERIMENTAL]"
	select EXPERIMENTAL
	help
	  Enable this option for asynchronous I/O. This option is present for conformance purposes
	  only. All functions listed in <aio.h> return -1 and set errno to ENOSYS.
```

## lib/posix/options/Kconfig.barrier
```kconfig
# Copyright (c) 2017 Intel Corporation
# Copyright (c) 2023 Meta
# Copyright (c) 2024 Tenstorrent
#
# SPDX-License-Identifier: Apache-2.0

menuconfig POSIX_BARRIERS
	bool "POSIX barriers"
	help
	  Select 'y' here to enable POSIX barriers.

	  For more information please see
	  https://pubs.opengroup.org/onlinepubs/9699919799/xrat/V4_subprofiles.html

if POSIX_BARRIERS

config MAX_PTHREAD_BARRIER_COUNT
	int "Maximum number of POSIX barriers"
	default 5
	help
	  Maximum simultaneously active pthread_barrier_t in a POSIX application.

	  Note: this is a non-standard option.

config PTHREAD_CREATE_BARRIER
	bool "Use a POSIX barrier to serialize pthread_create()"
	help
	  When running several SMP applications in parallel instances of Qemu,
	  e.g. via twister, explicit serialization may be required between
	  pthread_create() and zephyr_thread_wrapper() when spawning and joining
	  many pthreads concurrently.

	  On such systems, say Y here to introduce explicit serialization
	  via pthread_barrier_wait().

module = PTHREAD_BARRIER
module-str = POSIX thread barriers
source "subsys/logging/Kconfig.template.log_config"

endif # POSIX_BARRIERS
```

## lib/posix/options/Kconfig.build
```kconfig
# Copyright (c) 2025 Tenstorrent AI ULC
#
# SPDX-License-Identifier: Apache-2.0

menu "POSIX build options"

config POSIX_HEADERS_IN_DEFAULT_SEARCH_PATH
	bool "POSIX headers in default search path"
	help
	  Select 'y' here and Zephyr's POSIX headers will be included in the default search path.

endmenu
```

## lib/posix/options/Kconfig.c_lang_r
```kconfig
# Copyright (c) 2024 Tenstorrent AI ULC
# Copyright (c) 2024 Meta Platforms
#
# SPDX-License-Identifier: Apache-2.0

config POSIX_C_LANG_SUPPORT_R
	bool "Thread-Safe General ISO C Library"
	select COMMON_LIBC_ASCTIME_R if ! TC_PROVIDES_POSIX_C_LANG_SUPPORT_R
	select COMMON_LIBC_CTIME_R if ! TC_PROVIDES_POSIX_C_LANG_SUPPORT_R
	select COMMON_LIBC_GMTIME_R if ! TC_PROVIDES_POSIX_C_LANG_SUPPORT_R
	select COMMON_LIBC_LOCALTIME_R_UTC if ! TC_PROVIDES_POSIX_C_LANG_SUPPORT_R
	help
	  Select 'y' here and Zephyr will provide an implementation of the POSIX_C_LANG_SUPPORT_R
	  Option Group, consisting of asctime_r(), ctime_r(), gmtime_r(), localtime_r(), rand_r(),
	  strerror_r(), and strtok_r()

	  For more informnation, please see
	  https://pubs.opengroup.org/onlinepubs/9699919799/xrat/V4_subprofiles.html
```

## lib/posix/options/Kconfig.c_lib_ext
```kconfig
# Copyright (c) 2024 Tenstorrent AI ULC
#
# SPDX-License-Identifier: Apache-2.0

menuconfig POSIX_C_LIB_EXT
	bool "POSIX general C library extension"
	help
	  Select 'y' here and Zephyr will provide an implementation of the POSIX_C_LIB_EXT Option
	  Group, consisting of fnmatch(), getopt(), getsubopt(), optarg, opterr, optind, optopt,
	  stpcpy(), stpncpy(), strcasecmp(), strdup(), strfmon(), and strncasecmp(), strndup(), and
	  strnlen().

	  For more informnation, please see
	  https://pubs.opengroup.org/onlinepubs/9699919799/xrat/V4_subprofiles.html

if POSIX_C_LIB_EXT

config GETOPT_LONG
	bool "Getopt long library support"
	help
	  This option adds support of the getopt long.
	  Different shell backends are using their own instance of getopt to
	  not interfere with each other.
	  All not shell threads share one global instance of getopt state, hence
	  apart from shell this library is not thread safe. User can add support
	  for other threads by extending function getopt_state_get in
	  getopt_common.c file.

endif # POSIX_C_LIB_EXT
```

## lib/posix/options/Kconfig.clock
```kconfig
# Copyright (c) 2018 Intel Corporation
#
# SPDX-License-Identifier: Apache-2.0

config POSIX_CLOCK
	bool "clock and sleep APIs"
	default y if POSIX_API
	imply TIMER
	depends on !NATIVE_LIBC
	help
	  This enables POSIX clock\_\*() and \*sleep() functions.
```

## lib/posix/options/Kconfig.compat
```kconfig
# Copyright (c) 2020 Tobias Svehagen
# Copyright (c) 2023 Meta
#
# SPDX-License-Identifier: Apache-2.0

menu "Miscellaneous POSIX-related options"

config EVENTFD
	bool "Support for eventfd"
	depends on !NATIVE_APPLICATION
	select ZVFS
	select ZVFS_EVENTFD
	help
	  Enable support for event file descriptors, eventfd. An eventfd can
	  be used as an event wait/notify mechanism together with POSIX calls
	  like read, write and poll.

endmenu
```

## lib/posix/options/Kconfig.cond
```kconfig
# Copyright (c) 2017 Intel Corporation
# Copyright (c) 2023 Meta
#
# SPDX-License-Identifier: Apache-2.0

TYPE = PTHREAD_COND
type = pthread_cond_t
type-function = pthread_cond_wait
rsource "Kconfig.template.pooled_ipc_type"
```

## lib/posix/options/Kconfig.confstr
```kconfig
# Copyright (c) 2024, Meta
#
# SPDX-License-Identifier: Apache-2.0

config POSIX_CONFSTR
	bool "Retrieve string system configuration"
	default y if POSIX_API
	help
	  This enables the POSIX confstr() function.
```
