## lib/posix/options/Kconfig.deprecated
```kconfig
# Copyright (c) 2024 Tenstorrent AI ULC
#
# SPDX-License-Identifier: Apache-2.0

# This file should be removed after Zephyr 4.0 is released

menu "Deprecated POSIX options"

config EVENTFD_MAX
	int "Maximum number of eventfd's [DEPRECATED]"
	default ZVFS_EVENTFD_MAX if ZVFS_EVENTFD
	default 0
	help
	  This option is deprecated.

	  Please use CONFIG_ZVFS_EVENTFD_MAX instead.

config FNMATCH
	bool "Support for fnmatch [DEPRECATED]"
	select DEPRECATED
	select POSIX_C_LIB_EXT
	help
	  This option is deprecated.

	  Please use CONFIG_POSIX_C_LIB_EXT instead.

config GETENTROPY
	bool "Support for getentropy [DEPRECATED]"
	select DEPRECATED
	select POSIX_C_LIB_EXT
	help
	  This option is deprecated.

	  Please use CONFIG_POSIX_C_LIB_EXT instead.

config GETOPT
	bool "Getopt library support [DEPRECATED]"
	select DEPRECATED
	select POSIX_C_LIB_EXT
	help
	  This option is deprecated.

	  Please use CONFIG_POSIX_C_LIB_EXT instead.

config MAX_PTHREAD_COUNT
	int "Maximum number of pthread_t [DEPRECATED]"
	default POSIX_THREAD_THREADS_MAX if POSIX_THREADS
	default 0
	help
	  This option is deprecated.

	  Please use CONFIG_POSIX_THREAD_THREADS_MAX instead.

config MAX_PTHREAD_KEY_COUNT
	int "Maximum number of pthread_key_t [DEPRECATED]"
	default POSIX_THREAD_KEYS_MAX if POSIX_THREADS
	default 0
	help
	  This option is deprecated.

	  Please use CONFIG_POSIX_THREAD_KEYS_MAX instead.

config MAX_TIMER_COUNT
	int "Maximum number of timer_t [DEPRECATED]"
	default POSIX_TIMER_MAX if POSIX_TIMERS
	default 0
	help
	  This option is deprecated.

	  Please use CONFIG_POSIX_TIMER_MAX instead.

config MSG_COUNT_MAX
	int "Maximum number of messages in a POSIX message queue [DEPRECATED]"
	default POSIX_MQ_OPEN_MAX if POSIX_MESSAGE_PASSING
	default 0
	help
	  This option is deprecated.

	  Please use CONFIG_POSIX_MQ_OPEN_MAX instead.

config POSIX_CLOCK
	bool "clock and sleep APIs [DEPRECATED]"
	select DEPRECATED
	select POSIX_CLOCK_SELECTION
	select POSIX_CPUTIME
	select POSIX_MONOTONIC_CLOCK
	select POSIX_TIMERS
	select POSIX_TIMEOUTS
	help
	  This option is deprecated.

	  Please use CONFIG_POSIX_TIMERS instead.

config POSIX_CONFSTR
	bool "Retrieve string system configuration [DEPRECATED]"
	select DEPRECATED
	select POSIX_SINGLE_PROCESS
	help
	  This option is deprecated.

	  Please use CONFIG_POSIX_SINGLE_PROCESS instead.

config POSIX_ENV
	bool "Support for environ, getenv(), getenv_r(), setenv(), and unsetenv() [DEPRECATED]"
	select DEPRECATED
	select POSIX_SINGLE_PROCESS
	help
	  This option is deprecated.

	  Please use CONFIG_POSIX_SINGLE_PROCESS instead.

config POSIX_FS
	bool "POSIX file system API support [DEPRECATED]"
	select DEPRECATED
	select POSIX_FILE_SYSTEM
	help
	  This option is deprecated.

	  Please use CONFIG_POSIX_FILE_SYSTEM instead.

config POSIX_LIMITS_RTSIG_MAX
	int "_POSIX_RTSIG_MAX value in limits.h [DEPRECATED]"
	default POSIX_RTSIG_MAX if POSIX_REALTIME_SIGNALS
	default 0
	help
	  This option is deprecated.

	  Please use CONFIG_POSIX_RTSIG_MAX instead.

config POSIX_MAX_FDS
	int "Maximum number of open file descriptors [DEPRECATED]"
	default POSIX_OPEN_MAX
	help
	  This option is deprecated.

	  Please use CONFIG_POSIX_OPEN_MAX instead.

	  See also CONFIG_ZVFS_OPEN_MAX.

config POSIX_MAX_OPEN_FILES
	int "Maximum number of open file descriptors [DEPRECATED]"
	default POSIX_OPEN_MAX
	help
	  This option is deprecated.

	  Please use CONFIG_POSIX_OPEN_MAX instead.

	  See also CONFIG_ZVFS_OPEN_MAX.

config POSIX_MQUEUE
	bool "Message queue support [DEPRECATED]"
	select DEPRECATED
	select POSIX_MESSAGE_PASSING
	help
	  This option is deprecated.

	  Please use CONFIG_POSIX_MESSAGE_PASSING instead.

config POSIX_PUTMSG
	bool "Support for putmsg function [DEPRECATED]"
	select DEPRECATED
	select XOPEN_STREAMS
	help
	  This option is deprecated.

	  Please use CONFIG_XOPEN_STREAMS instead.

config POSIX_SIGNAL
	bool "Support for POSIX signal APIs [DEPRECATED]"
	select DEPRECATED
	select POSIX_SIGNALS
	help
	  This option is deprecated.

	  Please use CONFIG_POSIX_SIGNALS instead.

config POSIX_SYSCONF
	bool "Support for sysconf() [DEPRECATED]"
	select DEPRECATED
	select POSIX_SINGLE_PROCESS
	help
	  This option is deprecated.

	  Please use CONFIG_POSIX_SINGLE_PROCESS instead.

config POSIX_SYSLOG
	bool "Support for syslog() [DEPRECATED]"
	select DEPRECATED
	select XSI_SYSTEM_LOGGING
	help
	  This option is deprecated.

	  Please use CONFIG_XSI_SYSTEM_LOGGING instead.

config POSIX_UNAME
	bool "Support for uname [DEPRECATED]"
	select DEPRECATED
	select POSIX_SINGLE_PROCESS
	help
	  This option is deprecated.

	  Please use CONFIG_POSIX_SINGLE_PROCESS instead.

config PTHREAD
	bool "pthread_t support [DEPRECATED]"
	select DEPRECATED
	select POSIX_THREADS
	help
	  This option is deprecated.

	  Please use CONFIG_POSIX_THREADS instead.

config PTHREAD_BARRIER
	bool "pthread_barrier_t support [DEPRECATED]"
	select DEPRECATED
	select POSIX_BARRIERS
	help
	  This option is deprecated.

	  Please use CONFIG_POSIX_BARRIERS instead.

config PTHREAD_COND
	bool "pthread_cond_t support [DEPRECATED]"
	select DEPRECATED
	select POSIX_THREADS
	help
	  This option is deprecated.

	  Please use CONFIG_POSIX_THREADS instead.


config PTHREAD_IPC
	bool "POSIX pthread IPC API [DEPRECATED]"
	select DEPRECATED
	select POSIX_THREADS
	help
	  This option is deprecated.

	  Please use CONFIG_POSIX_THREADS instead.

config PTHREAD_KEY
	bool "pthread_key_t support [DEPRECATED]"
	select DEPRECATED
	select POSIX_THREADS
	help
	  This option is deprecated.

	  Please use CONFIG_POSIX_THREADS instead.

config PTHREAD_MUTEX
	bool "pthread_mutex_t support [DEPRECATED]"
	select DEPRECATED
	select POSIX_THREADS
	help
	  This option is deprecated.

	  Please use CONFIG_POSIX_THREADS instead.

config PTHREAD_RWLOCK
	bool "pthread_spinlock_t support [DEPRECATED]"
	select DEPRECATED
	select POSIX_READER_WRITER_LOCKS
	help
	  This option is deprecated.

	  Please use CONFIG_POSIX_READER_WRITER_LOCKS instead.

config PTHREAD_SPINLOCK
	bool "pthread_spinlock_t support [DEPRECATED]"
	select DEPRECATED
	select POSIX_SPIN_LOCKS
	help
	  This option is deprecated.

	  Please use CONFIG_POSIX_SPIN_LOCKS instead.

config TIMER
	bool "Timer support [DEPRECATED]"
	select DEPRECATED
	select POSIX_TIMERS
	help
	  This option is deprecated.

	  Please use CONFIG_POSIX_TIMERS instead.

config TIMER_DELAYTIMER_MAX
	int "Maximum count returned my timer_getoverrun() in POSIX application [DEPRECATED]"
	default POSIX_DELAYTIMER_MAX if POSIX_TIMERS
	default 0
	help
	  This option is deprecated.

	  Please use CONFIG_POSIX_DELAYTIMER_MAX instead.

config SEM_NAMELEN_MAX
	int "Maximum name length [DEPRECATED]"
	default POSIX_SEM_NAMELEN_MAX if POSIX_SEMAPHORES
	default 0
	help
	  This option is deprecated.

	  Please use CONFIG_POSIX_SEM_NAMELEN_MAX instead.

config SEM_VALUE_MAX
	int "Maximum semaphore limit [DEPRECATED]"
	default POSIX_SEM_VALUE_MAX if POSIX_SEMAPHORES
	default 0
	help
	  This option is deprecated.

	  Please use CONFIG_POSIX_SEM_VALUE_MAX instead.

endmenu
```

## lib/posix/options/Kconfig.device_io
```kconfig
# Copyright (c) 2024 Tenstorrent AI ULC
#
# SPDX-License-Identifier: Apache-2.0

menu "POSIX device I/O"

config POSIX_DEVICE_IO
	bool "POSIX device I/O"
	select REQUIRES_FULL_LIBC
	select ZVFS
	select ZVFS_POLL
	select ZVFS_SELECT
	help
	  Select 'y' here and Zephyr will provide an implementation of the POSIX_DEVICE_IO Option
	  Group such as FD_CLR(), FD_ISSET(), FD_SET(), FD_ZERO(), close(), fdopen(), fileno(), open(),
	  poll(), pread(), pselect(), pwrite(), read(), select(), and write().

	  For more information, please see
	  https://pubs.opengroup.org/onlinepubs/9699919799/xrat/V4_subprofiles.html

if POSIX_DEVICE_IO

config POSIX_DEVICE_IO_STDIO_CONSOLE
	bool "read() and write() to/from stdio use console subsystem"
	default y
	depends on CONSOLE_SUBSYS
	depends on !(CONSOLE_GETCHAR || CONSOLE_GETLINE)
	help
	  Enable to use UART console whenever read() or write() is called
	  on stdin, stdout or stderr.

if POSIX_DEVICE_IO_STDIO_CONSOLE

config POSIX_DEVICE_IO_STDIN_BUFSIZE
	int "read() buffer size for stdin"
	default 16
	help
	  Size of internal buffer for read()-ing from stdin. Setting both this and
	  POSIX_DEVICE_IO_STDOUT_BUFSIZE to 0 will replace interrupt-driven operation
	  with busy-polling and stop poll(), select() and others from working with stdio.

config POSIX_DEVICE_IO_STDOUT_BUFSIZE
	int "write() buffer size for stdout"
	default 16
	help
	  Size of internal buffer for write()-ing to stdout. Setting both this and
	  POSIX_DEVICE_IO_STDIN_BUFSIZE to 0 will replace interrupt-driven operation
	  with busy-polling and stop poll(), select() and others from working with stdio.

endif # POSIX_DEVICE_IO_STDIO_CONSOLE

# These options are intended to be used for compatibility with external POSIX
# implementations such as those in Newlib or Picolibc.

config POSIX_DEVICE_IO_ALIAS_CLOSE
	bool
	help
	  When selected via Kconfig, Zephyr will provide an alias for close() as _close().

config POSIX_DEVICE_IO_ALIAS_OPEN
	bool
	help
	  When selected via Kconfig, Zephyr will provide an alias for open() as _open().

config POSIX_DEVICE_IO_ALIAS_READ
	bool
	help
	  When selected via Kconfig, Zephyr will provide an alias for read() as _read().

config POSIX_DEVICE_IO_ALIAS_WRITE
	bool
	help
	  When selected via Kconfig, Zephyr will provide an alias for write() as _write().

endif # POSIX_DEVICE_IO

config POSIX_OPEN_MAX
	int
	default ZVFS_OPEN_MAX
	help
	  The maximum number of files that a process can have open at one time. This option is not
	  directly user-configurable but can be adjusted via CONFIG_ZVFS_OPEN_MAX.

	  For more information, please see
	  https://pubs.opengroup.org/onlinepubs/9699919799/basedefs/limits.h.html

endmenu
```

## lib/posix/options/Kconfig.env
```kconfig
# Copyright (c) 2023, Meta
#
# SPDX-License-Identifier: Apache-2.0

config POSIX_ENV
	bool "Support for environ, getenv(), getenv_r(), setenv(), and unsetenv()"
	depends on COMMON_LIBC_MALLOC
	default y if POSIX_API
	help
	  Select this option to add support for environment variables.

module = POSIX_ENV
module-str = POSIX env logging
source "subsys/logging/Kconfig.template.log_config"
```

## lib/posix/options/Kconfig.eventfd
```kconfig
# Copyright (c) 2020 Tobias Svehagen
# Copyright (c) 2023 Meta
#
# SPDX-License-Identifier: Apache-2.0

menuconfig EVENTFD
	bool "Support for eventfd"
	depends on !NATIVE_APPLICATION
	select POLL
	select FDTABLE
	default y if POSIX_API
	help
	  Enable support for event file descriptors, eventfd. An eventfd can
	  be used as an event wait/notify mechanism together with POSIX calls
	  like read, write and poll.

config EVENTFD_MAX
	int "Maximum number of eventfd's"
	depends on EVENTFD
	default 1
	range 1 4096
	help
	  The maximum number of supported event file descriptors.
```

## lib/posix/options/Kconfig.fd_mgmt
```kconfig
# Copyright (c) 2024 Tenstorrent AI ULC
#
# SPDX-License-Identifier: Apache-2.0

menuconfig POSIX_FD_MGMT
	bool "POSIX file descriptor management [EXPERIMENTAL]"
	select EXPERIMENTAL
	help
	  Select 'y' here and Zephyr will provide implementations for the POSIX_FD_MGMT Option Group.
	  This includes support for dup(), dup2(), fcntl(), fseeko(), ftello(), ftruncate(),
	  and lseek().

	  For more information, please see
	  https://pubs.opengroup.org/onlinepubs/9699919799/xrat/V4_subprofiles.html

if POSIX_FD_MGMT

# These options are intended to be used for compatibility with external POSIX
# implementations such as those in Newlib or Picolibc.

config POSIX_FD_MGMT_ALIAS_FCNTL
	bool
	help
	  When selected via Kconfig, Zephyr will provide an alias for fcntl() as _fcntl().

config POSIX_FD_MGMT_ALIAS_FTRUNCATE
	bool
	help
	  When selected via Kconfig, Zephyr will provide an alias for ftruncate() as _ftruncate().

config POSIX_FD_MGMT_ALIAS_LSEEK
	bool
	help
	  When selected via Kconfig, Zephyr will provide an alias for lseek() as _lseek().

endif # POSIX_FD_MGMT
```

## lib/posix/options/Kconfig.fdtable
```kconfig
# Copyright (c) 2018 Linaro
#
# SPDX-License-Identifier: Apache-2.0

menu "File descriptor table options"

config POSIX_MAX_FDS
	int "Maximum number of open file descriptors"
	default 16 if WIFI_NM_WPA_SUPPLICANT
	default 16 if POSIX_API
	default 4
	help
	  Maximum number of open file descriptors, this includes
	  files, sockets, special devices, etc.

endmenu # "File descriptor table options"
```

## lib/posix/options/Kconfig.file_locking
```kconfig
# Copyright (c) 2024 Tenstorrent AI ULC
#
# SPDX-License-Identifier: Apache-2.0

config POSIX_FILE_LOCKING
	bool "POSIX file locking"
	help
	  Select 'y' here and the following functions will be available:

	  flockfile(), ftrylockfile(), funlockfile(), getc_unlocked(), getchar_unlocked(),
	  putc_unlocked(), putchar_unlocked().

	  For more information, please see
	  https://pubs.opengroup.org/onlinepubs/9699919799/xrat/V4_subprofiles.html
```

## lib/posix/options/Kconfig.file_system_r
```kconfig
# Copyright (c) 2018 Intel Corporation
#
# SPDX-License-Identifier: Apache-2.0

config POSIX_FILE_SYSTEM_R
	bool "Thread-Safe File System"
	select FILE_SYSTEM
	select FDTABLE
	help
	  Select 'y' here and Zephyr will provide an implementation of the POSIX_FILE_SYSTEM_R
	  Option Group, consisting of readdir_r().

	  For more information, please see
	  https://pubs.opengroup.org/onlinepubs/9699919799/xrat/V4_subprofiles.html
```

## lib/posix/options/Kconfig.getentropy
```kconfig
# Copyright (c) 2024 Google LLC
#
# SPDX-License-Identifier: Apache-2.0

DT_CHOSEN_ZEPHYR_ENTROPY := zephyr,entropy

config GETENTROPY
	bool "Support for getentropy"
	depends on !NATIVE_APPLICATION
	select NATIVE_LIBC_INCOMPATIBLE
	depends on ENTROPY_HAS_DRIVER
	depends on $(dt_chosen_enabled,$(DT_CHOSEN_ZEPHYR_ENTROPY))
	help
	  Enable support for getentropy() function.
```
