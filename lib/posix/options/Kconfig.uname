## lib/posix/options/Kconfig.uname
```kconfig
# Copyright (c) 2023 Meta
#
# SPDX-License-Identifier: Apache-2.0

menuconfig POSIX_UNAME
	bool "Support for uname"
	default y if POSIX_API
	help
	  The uname() function shall store information identifying the current
	  system in the structure pointed to by name.

if POSIX_UNAME
config POSIX_UNAME_VERSION_LEN
	int "uname version string length"
	default 70
	help
	  Defines the maximum string length of uname version.

config POSIX_UNAME_NODENAME_LEN
	int "uname nodename string length"
	default 6 if !NET_HOSTNAME_UNIQUE
	default 22 if NET_HOSTNAME_UNIQUE
	help
	  Defines the maximum string length of nodename version.

endif # POSIX_UNAME
```

## lib/posix/options/Kconfig.xsi
```kconfig
# Copyright (c) 2025, Friedt Professional Engineering Services, Inc
#
# SPDX-License-Identifier: Apache-2.0

menuconfig XSI
	bool "X/Open System Interfaces (XSI)"
	select POSIX_FSYNC
	select POSIX_THREAD_ATTR_STACKADDR
	select POSIX_THREAD_ATTR_STACKSIZE
	help
	  For more information, please see
	  https://pubs.opengroup.org/onlinepubs/9699919799/basedefs/V1_chap02.html#tag_02_01_04_01

if XSI

# zephyr-keep-sorted-start
rsource "Kconfig.xsi_realtime"
rsource "Kconfig.xsi_single_process"
rsource "Kconfig.xsi_streams"
rsource "Kconfig.xsi_system_logging"
rsource "Kconfig.xsi_threads_ext"
# zephyr-keep-sorted-stop

endif # XSI
```

## lib/posix/options/Kconfig.xsi_realtime_threads
```kconfig
# Copyright (c) 2024 Tenstorrent AI ULC
#
# SPDX-License-Identifier: Apache-2.0

config XSI_REALTIME_THREADS
	bool "X/Open realtime threads"
	select POSIX_THREAD_PRIO_INHERIT
	select POSIX_THREAD_PRIO_PROTECT
	select POSIX_THREAD_PRIORITY_SCHEDULING
	select POSIX_THREAD_ROBUST_PRIO_INHERIT
	select POSIX_THREAD_ROBUST_PRIO_PROTECT
	help
	  Select 'y' here to enable the _POSIX_THREAD_PRIO_INHERIT, _POSIX_THREAD_PRIO_PROTECT,
	  _POSIX_THREAD_PRIORITY_SCHEDULING, _POSIX_THREAD_ROBUST_PRIO_INHERIT, and
	  _POSIX_THREAD_ROBUST_PRIO_PROTECT options.

	  The feature test macro _XOPEN_REALTIME_THREADS will be defined to a value other than -1.

	  For more information, please see
	  https://pubs.opengroup.org/onlinepubs/9699919799/basedefs/V1_chap02.html

if XSI_REALTIME_THREADS

module = XSI_REALTIME_THREADS
module-str = XSI Realtime Threads
source "subsys/logging/Kconfig.template.log_config"

endif
```

## lib/posix/options/Kconfig.xsi_single_process
```kconfig
# Copyright (c) 2024 Tenstorrent AI ULC
#
# SPDX-License-Identifier: Apache-2.0

config XSI_SINGLE_PROCESS
	bool "X/Open single process"
	depends on POSIX_SINGLE_PROCESS
	depends on POSIX_TIMERS
	help
	  Select 'y' here and Zephyr will provide implementations of
	  gethostid(), gettimeofday(), and putenv().

	  For more information, please see
	  https://pubs.opengroup.org/onlinepubs/9699919799/xrat/V4_subprofiles.html
```

## lib/posix/options/Kconfig.xsi_streams
```kconfig
# Copyright (c) 2024 Tenstorrent AI ULC
#
# SPDX-License-Identifier: Apache-2.0

config XOPEN_STREAMS
	bool "X/Open streams"
	help
	  This option provides support for the X/Open Streams interface, including functions such as
	  fattach(), fdetach(), getmsg(), getpmsg(), putmsg(), and putpmsg().

	  For more information, please see
	  https://pubs.opengroup.org/onlinepubs/9699919799/basedefs/V1_chap02.html#tag_02_01_05_09
```

## lib/posix/shell/Kconfig
```kconfig
# Copyright (c) 2024 Meta
# SPDX-License-Identifier: Apache-2.0

menu "POSIX Shell Utilities"

config POSIX_SHELL
	bool
	depends on SHELL
	default y if SHELL_ALL
	help
	  Compile the parent `posix` shell command.

rsource "Kconfig.env"
rsource "Kconfig.uname"

endmenu # "POSIX Shell Utilities"
```

## lib/posix/shell/Kconfig.env
```kconfig
# Copyright (c) 2024 Meta
# SPDX-License-Identifier: Apache-2.0

config POSIX_ENV_SHELL
	bool "Support for shell"
	select POSIX_SINGLE_PROCESS
	select POSIX_SHELL
	help
	  This shell provides access to system environment variables.
```

## lib/posix/shell/Kconfig.uname
```kconfig
# Copyright (c) 2024 Meta
# SPDX-License-Identifier: Apache-2.0

if POSIX_SINGLE_PROCESS

config POSIX_UNAME_SHELL
	bool "Support for `uname` command"
	select SHELL_GETOPT
	select POSIX_SHELL
	help
	  Support for `uname` command in the terminal.

endif # POSIX_SINGLE_PROCESS
```

## lib/posix/signal/Kconfig
```kconfig
# Copyright (c) 2023 Meta
# SPDX-License-Identifier: Apache-2.0


menuconfig POSIX_SIGNAL
	bool "POSIX signal support"
	default y if POSIX_API
	help
	  This option adds support of POSIX signal.

config POSIX_SIGNAL_MAX
	int "Highest valid signal number"
	depends on POSIX_SIGNAL
	default 63
	help
	  Defines the highest valid signal number.

config POSIX_SIGNAL_STD_MAX
	int "Highest number for standard signal"
	depends on POSIX_SIGNAL
	default 31
	help
	  Defines the highest number for standard signal.
```

## lib/posix/timerfd/Kconfig
```kconfig
# Copyright (c) 2025 Atym, Inc.
#
# SPDX-License-Identifier: Apache-2.0

config TIMERFD
	bool "Support for timerfd"
	select ZVFS
	select ZVFS_TIMERFD
	help
	  Enable support for timer file descriptors, timerfd. A timerfd can
	  be used as an timer waiting mechanism together with POSIX calls
	  like read, write and poll.
```

## lib/realtime/Kconfig
```kconfig
# Copyright (c) 2024 Bjarki Arge Andreasen
# SPDX-License-Identifier: Apache-2.0

menuconfig SYS_REALTIME
	bool "System real-time library"

if SYS_REALTIME

choice SYS_REALTIME_CONVERT
	prompt "System real-time conversion library"
	default SYS_REALTIME_CONVERT_NATIVE

config SYS_REALTIME_CONVERT_NATIVE
	bool "Use native real-time conversion library"

endchoice # SYS_REALTIME_CONVERT

if SYS_REALTIME_CONVERT_NATIVE

config SYS_REALTIME_CONVERT_NATIVE_MIN_YEAR
	int "Minimum year to support for realtime conversions"
	default 1600

config SYS_REALTIME_CONVERT_NATIVE_MAX_YEAR
	int "Maximum year to support for realtime  conversions"
	default 2400

endif # SYS_REALTIME_CONVERT_NATIVE

choice SYS_REALTIME_BASE_CLOCK
	prompt "System real-time base clock"
	default SYS_REALTIME_BASE_CLOCK_SYS_CLOCK

config SYS_REALTIME_BASE_CLOCK_SYS_CLOCK
	bool "Use system clock as base clock for system realtime"

endchoice # SYS_REALTIME_BASE_CLOCK

endif # SYS_REALTIME
```

## lib/runtime/Kconfig
```kconfig
# Copyright (c) 2023 The ChromiumOS Authors
# SPDX-License-Identifier: Apache-2.0

config COMPILER_RT_SUPPORTED
	bool
	default y
	depends on "$(ZEPHYR_TOOLCHAIN_VARIANT)" = "llvm"
	help
	  Selected when the compiler supports compiler-rt runtime library.

choice RTLIB_IMPLEMENTATION
	prompt "Runtime library implementation"
	default LIBGCC_RTLIB

config LIBGCC_RTLIB
	bool "GNU Libgcc"
	help
	  Use libgcc as a runtime library.

config COMPILER_RT_RTLIB
	bool "LLVM compiler-rt"
	depends on COMPILER_RT_SUPPORTED
	help
	  Use LLVM compiler-rt as a runtime library.

endchoice
```

## lib/rust/Kconfig
```kconfig
# Rust configuration options
#
# Copyright (c) 2024 Linaro LTD
# SPDX-License-Identifier: Apache-2.0

menu "Rust Language Support"

config RUST_SUPPORTED
	bool
	default y if (CPU_CORTEX_M || \
		(RISCV && !RISCV_ISA_RV32E && !RISCV_ISA_RV128I))
	help
	  Selected for platforms that have support for Rust.

config RUST
	bool "Rust support for the application"
	depends on RUST_SUPPORTED
	select EXPERIMENTAL
	help
	  This option enables the use of applications written in Rust.

endmenu
```

## lib/smf/Kconfig
```kconfig
# Copyright 2021 The Chromium OS Authors
# SPDX-License-Identifier: Apache-2.0

menuconfig SMF
	bool "State Machine Framework"
	help
	  Enable the State Machine Framework (SMF) library, which provides
	  support for flat and hierarchical state machines.

if SMF

config SMF_ANCESTOR_SUPPORT
	bool "Ancestor state support"
	help
	  Enable ancestor state support in the state machine framework,
	  allowing hierarchical state machines.

config SMF_INITIAL_TRANSITION
	depends on SMF_ANCESTOR_SUPPORT
	bool "Support initial transitions for ancestor states"
	help
	  Enable initial transition support, allowing each state to define
	  an initial transition to a sub-state upon entry.

config SMF_INSTRUMENTATION
	bool "State machine instrumentation hooks"
	help
	   If y, then the state machine framework includes instrumentation
	   hooks for observing state transitions

endif # SMF
```

## lib/updatehub/Kconfig
```kconfig
#
# Copyright (c) 2018, 2019 O.S.Systems
#
# SPDX -License-Identifier: Apache-2.0
#

menuconfig UPDATEHUB
	bool"UpdateHub Firmware Over-the-Air support"
	select FLASH
	select REBOOT
	select IMG_MANAGER
	select BOOTLOADER_MCUBOOT
	select MPU_ALLOW_FLASH_WRITE
	select NETWORKING
	select NEWLIB_LIBC
	select NET_UDP
	select NET_SOCKETS
	select NET_SOCKETS_POSIX_NAMES
	select COAP
	select NET_CONFIG_SETTINGS
	select DNS_RESOLVER
	select JSON_LIBRARY
	select TINYCRYPT
	select TINYCRYPT_SHA256
	select HWINFO
	help
	  UpdateHub is an enterprise-grade solution which makes simple to
	  remotely update all your embedded devices in the field. It
	  handles all aspects related to sending Firmware Over-the-Air
	  (FOTA) updates with maximum security and efficiency, while you
	  focus in adding value to your product.

config UPDATEHUB_POLL_INTERVAL
	int "Time to poll interval (in minutes)"
	default 1440
	range 0 43200
	depends on UPDATEHUB
	help
	  Set the interval that the UpdateHub update server will be polled.
	  This time interval is zero and 43200 minutes(30 days).

config UPDATEHUB_PRODUCT_UID
	string "Product Unique Identifier (UID)"
	depends on UPDATEHUB
	help
	  The product unique identifier is used when communicating
	  with the UpdateHub server.

config UPDATEHUB_SUPPORTED_HARDWARE_MAX
	int "Max number of supported hardware"
	default 1
	range 1 100
	depends on UPDATEHUB
	help
	  Configure the max number of supported hardware
	  by the same image.

config UPDATEHUB_CE
	bool "Use UpdateHub Community Edition Sever"
	depends on UPDATEHUB
	help
	  Allow the use of UpdateHub Community
	  Server (updatehub-ce) as alternative to the
	  updatehub.io enterprise server.

config UPDATEHUB_SERVER
	string "User address for the updatehub-ce-server"
	depends on UPDATEHUB_CE
	help
	  This configuration is default, if need to use
	  other address, must be set on the UpdateHub shell

config UPDATEHUB_SHELL
	bool "Enable UpdateHub shell utilities"
	depends on UPDATEHUB
	depends on SHELL
	select KERNEL_SHELL
	help
	  Activate shell module that provides UpdateHub commands like

config UPDATEHUB_DTLS
	bool"Activate communication CoAPS/DTLS"
	depends on UPDATEHUB
	select MBEDTLS
	select MBEDTLS_ENABLE_HEAP
	select NET_SOCKETS_SOCKOPT_TLS
	select NET_SOCKETS_ENABLE_DTLS
	help
	  Enables DTLS communication between the UpdateHub
	  client and the server

module = UPDATEHUB
module-str = Log level for UpdateHub
module-help = Enables logging for UpdateHub code.
source "subsys/logging/Kconfig.template.log_config"
```

## lib/util/Kconfig
```kconfig
# Copyright (c) 2021 Nordic Semiconductor ASA
# SPDX-License-Identifier: Apache-2.0


menu "Util libraries"

source "lib/util/fnmatch/Kconfig"

source "lib/util/getopt/Kconfig"

endmenu
```

## lib/util/getopt/Kconfig
```kconfig
# Copyright (c) 2021 Nordic Semiconductor
# SPDX-License-Identifier: Apache-2.0

config GETOPT
	bool "GetOpt Support"
	help
	  This option enables the getopt library
```

## lib/uuid/Kconfig
```kconfig
# Copyright (c) 2025, SECO Mind Srl
#
# SPDX-License-Identifier: Apache-2.0

menu "Universally Unique Identifier (UUID)"

config UUID
	bool "UUID support [EXPERIMENTAL]"
	select EXPERIMENTAL
	help
	  Enable use of the UUID library.

config UUID_V4
	bool "UUID version 4 generation support [EXPERIMENTAL]"
	select EXPERIMENTAL
	depends on UUID
	depends on ENTROPY_GENERATOR
	help
	  Enable generation of UUID v4.

config UUID_V5
	bool "UUID version 5 generation support [EXPERIMENTAL]"
	select EXPERIMENTAL
	depends on UUID
	depends on MBEDTLS
	depends on MBEDTLS_PSA_CRYPTO_C
	depends on PSA_WANT_ALG_SHA_1
	# When TF-M is enabled, Mbed TLS's MD module (which is used to generate
	# v5 UUIDs) will dispacth hash operations to TF-M. Unfortunately TF-M
	# does not support SHA-1 (because it's a weak algorithm) so the
	# computation will fail.
	depends on !BUILD_WITH_TFM
	help
	  Enable generation of UUID v5.

config UUID_BASE64
	bool "UUID Base64 support [EXPERIMENTAL]"
	select EXPERIMENTAL
	depends on UUID
	depends on BASE64
	help
	  Enable conversion functions to write UUIDs in base 64
	  formats.

endmenu
```

## lib/word_granular_access/Kconfig
```kconfig
# Copyright (c) 2026 Intel Corporation
# SPDX-License-Identifier: Apache-2.0

config WORD_GRANULAR_ACCESS
	bool "Word Granular Access Memory Support"
	help
	  Enable support for word granular access to byte addressable memory.

	  When enabled, this option adds library support for safely accessing
	  word granular access memory regions, which require that all reads and writes
	  be aligned to the word size and be in multiples of the word size.

	  This is particularly useful for certain types of hardware peripherals,
	  memory-mapped I/O regions, or specialized memory types that have strict
	  access requirements.
```
