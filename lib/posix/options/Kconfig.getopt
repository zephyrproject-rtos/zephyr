## lib/posix/options/Kconfig.rwlock
```kconfig
# Copyright (c) 2024 Meta
#
# SPDX-License-Identifier: Apache-2.0

menuconfig POSIX_READER_WRITER_LOCKS
	bool "POSIX reader-writer locks"
	help
	  Select 'y' here to enable POSIX reader-writer locks.

	  For more information please see
	  https://pubs.opengroup.org/onlinepubs/9699919799/xrat/V4_subprofiles.html

if POSIX_READER_WRITER_LOCKS

config MAX_PTHREAD_RWLOCK_COUNT
	int "Maximum number of POSIX reader-writer locks"
	default 5
	help
	  Maximum simultaneously active reader-writer locks in a POSIX application.

	  Note: this is a non-standard option.

module = PTHREAD_RWLOCK
module-str = POSIX Reader-Writer Locks
source "subsys/logging/Kconfig.template.log_config"

endif # POSIX_READER_WRITER_LOCKS
```

## lib/posix/options/Kconfig.sched
```kconfig
# Copyright (c) 2023 Intel Corporation
#
# SPDX-License-Identifier: Apache-2.0

config POSIX_PRIORITY_SCHEDULING
	bool "Priority scheduling"
	default y if POSIX_THREADS
	default y if POSIX_API
	depends on POSIX_THREADS
	help
	  This enables POSIX scheduling APIs (_POSIX_PRIORITY_SCHEDULING).
```

## lib/posix/options/Kconfig.semaphore
```kconfig
# Copyright (c) 2018 Intel Corporation
#
# SPDX-License-Identifier: Apache-2.0

menuconfig POSIX_SEMAPHORES
	bool "POSIX semaphore support"
	help
	  Enable this option for POSIX semaphore support.

if POSIX_SEMAPHORES

config POSIX_SEM_VALUE_MAX
	int "Maximum semaphore value"
	default $(INT16_MAX)
	range 1 $(INT16_MAX)
	help
	  Maximum semaphore count in POSIX compliant Application.

config POSIX_SEM_NSEMS_MAX
	int "Maximum number of semaphores"
	default 256
	help
	  Maximum number of semaphores in a POSIX application.

	  Note: currently, in Zephyr, this only limits the number of named semaphores (i.e. those
	  created via sem_open()).

config POSIX_SEM_NAMELEN_MAX
	int "Maximum semaphore name length"
	default 16
	range 2 $(UINT8_MAX)
	help
	  Maximum length of name for a named semaphore.
	  The max value of 255 corresponds to {NAME_MAX}.

endif # POSIX_SEMAPHORES
```

## lib/posix/options/Kconfig.signal
```kconfig
# Copyright (c) 2023 Meta
#
# SPDX-License-Identifier: Apache-2.0

menu "POSIX signals"

config POSIX_REALTIME_SIGNALS
	bool "POSIX realtime signals [EXPERIMENTAL]"
	select EXPERIMENTAL
	help
	  Enable support for POSIX realtime signals.

if POSIX_REALTIME_SIGNALS

config POSIX_RTSIG_MAX
	int "Maximum number of realtime signals"
	default 8
	help
	  Define the maximum number of realtime signals (RTSIG_MAX).
	  The range of realtime signals is [SIGRTMIN .. (SIGRTMIN+RTSIG_MAX)]

endif # POSIX_REALTIME_SIGNALS

config POSIX_SIGNALS
	bool "POSIX signals [EXPERIMENTAL]"
	select EXPERIMENTAL
	select POSIX_MULTI_PROCESS
	help
	  Enable support for POSIX signals.

if POSIX_SIGNALS

config POSIX_SIGNAL_STRING_DESC
	bool "Use full description for the strsignal API"
	default y
	help
	  Use full description for the strsignal API.
	  Will use 256 bytes of ROM.

# These options are intended to be used for compatibility with external POSIX
# implementations such as those in Newlib or Picolibc.

config POSIX_SIGNALS_ALIAS_KILL
	bool

endif

endmenu # "Signal support"
```

## lib/posix/options/Kconfig.spinlock
```kconfig
# Copyright (c) 2023 Meta
#
# SPDX-License-Identifier: Apache-2.0

menuconfig POSIX_SPIN_LOCKS
	bool "POSIX spin locks"
	help
	  Select 'y' here to enable POSIX spin locks.

	  For more information please see
	  https://pubs.opengroup.org/onlinepubs/9699919799/xrat/V4_subprofiles.html

if POSIX_SPIN_LOCKS

config MAX_PTHREAD_SPINLOCK_COUNT
	int "Maximum number of POSIX spin locks"
	default 5
	help
	  Maximum simultaneously active spin locks in a POSIX application.

	  Note: this is a non-standard option.

module = PTHREAD_SPINLOCK
module-str = POSIX Spin Locks
source "subsys/logging/Kconfig.template.log_config"

endif # POSIX_SPIN_LOCKS
```

## lib/posix/options/Kconfig.stropts
```kconfig
# copyright (c) 2024 Abhinav Srivastava
#
# SPDX-License-Identifier: Apache-2.0

config XOPEN_STREAMS
	bool "Support for XOPEN_STREAMS"
	default y if POSIX_API
	help
	  This option provides support for the XOPEN_STREAMS API.
```

## lib/posix/options/Kconfig.sysconf
```kconfig
# Copyright (c) 2024 BayLibre SAS
#
# SPDX-License-Identifier: Apache-2.0

menu "Sysconf support"

config POSIX_SYSCONF
	bool "Support for sysconf"
	default y if POSIX_API
	help
	  The sysconf() function provides a method for the application to determine
	  the current value of a configurable system limit or option (variable).

config POSIX_PAGE_SIZE_BITS
	int "Number of bits to use for PAGE_SIZE"
	range 6 16
	default 12 if POSIX_API
	default 6
	help
	  Define PAGE_SIZE as BIT(n), where n is the value configured here.
	  PAGE_SIZE is supported in the range [64, 65536]
	  If CONFIG_POSIX_API=y, PAGE_SIZE defaults to 4096, otherwise, it is 64 bytes.

if POSIX_SYSCONF

choice POSIX_SYSCONF_IMPL_CHOICE
	default POSIX_SYSCONF_IMPL_FULL if CPP
	default POSIX_SYSCONF_IMPL_MACRO
	prompt "Sysconf implementation method"

config POSIX_SYSCONF_IMPL_MACRO
	bool "Macro"
	help
	  The sysconf() function is implemented compile-time constant via macros. This is the option
	  with the least overhead. The downside is that sysconf() is not an addressable function.

config POSIX_SYSCONF_IMPL_FULL
	bool "Full"
	help
	  The sysconf() function is implemented as a large integer-integer array. The advantage if this
	  option is that all sysconf() options can be queried and that the sysconf() symbol is
	  addressable.

endchoice

endif # POSIX_SYSCONF

endmenu # "Sysconf support"
```

## lib/posix/options/Kconfig.syslog
```kconfig
# Copyright (c) 2024, Meta
#
# SPDX-License-Identifier: Apache-2.0

config POSIX_SYSLOG
	bool "Support for syslog()"
	default y if POSIX_API
	help
	  This option provides support for closelog(), openlog(), syslog(),
	  setlogmask(), and vsyslog().
```

## lib/posix/options/Kconfig.system_database
```kconfig
# Copyright (c) 2024 Tenstorrent AI ULC
#
# SPDX-License-Identifier: Apache-2.0

config POSIX_SYSTEM_DATABASE
	bool "POSIX System Database"
	select POSIX_SYSTEM_DATABASE_R
	help
	  Select 'y' here, and the system will support getgrgid(), getgrnam(), getpwnam(), and
	  getpwuid().

	  For more information, please see
	  https://pubs.opengroup.org/onlinepubs/9699919799/xrat/V4_subprofiles.html
```

## lib/posix/options/Kconfig.system_database_r
```kconfig
# Copyright (c) 2024 Tenstorrent AI ULC
#
# SPDX-License-Identifier: Apache-2.0

config POSIX_SYSTEM_DATABASE_R
	bool "POSIX System Database"
	help
	  Select 'y' here, and the system will support getgrgid_r(), getgrnam_r(), getpwnam_r(), and
	  getpwuid_r().

	  For more information, please see
	  https://pubs.opengroup.org/onlinepubs/9699919799/xrat/V4_subprofiles.html

config POSIX_GETGR_R_SIZE_MAX
	int "Initial size of getgrgid_r() and getgrnam_r() data buffers"
	default 96
	help
	  This option sets the maximum size of the buffer for getgrgid_r() and getgrnam_r().

	  The default size is derived from the formula below. Note, that the home directory and
	  shell fields are not based on PATH_MAX, which can be excessively large.

	  _POSIX_LOGIN_NAME_MAX + 1 +
	  sizeof(void *) +
	  sizeof("4294967295") + 1 +
	  2 * (_POSIX_NAME_MAX + 1 + sizeof(void *))
	  + sizeof(void *)

config POSIX_GETPW_R_SIZE_MAX
	int "Initial size of getpwnam_r() and getpwuid_r() data buffers"
	default 64
	help
	  This option sets the maximum size of the buffer for getpwnam_r() and getpwuid_r().

	  The default size is derived from the formula below. Note, that the home directory and
	  shell fields are not based on PATH_MAX, which can be excessively large.

	  _POSIX_LOGIN_NAME_MAX + 1 +
	  sizeof("4294967295") + 1 +
	  sizeof("4294967295") + 1 +
	  _POSIX_NAME_MAX + 1 +
	  _POSIX_NAME_MAX + 1
```

## lib/posix/options/Kconfig.template.pooled_ipc_type
```kconfig
# Copyright (c) 2023 Meta
#
# SPDX-License-Identifier: Apache-2.0

rsource "Kconfig.template.with_url"

# Not user configurable (i.e. private for now)
menuconfig $(TYPE)
	bool "$(type) support"
	depends on PTHREAD_IPC
	default y
	help
	  Support for $(TYPE)
	  For more info, see
	  $(posix-url-base)/$(type-function).html

if $(TYPE)

# eventually, this size should be defaulted to 0
config MAX_$(TYPE)_COUNT
	int "Maximum number of $(type)"
	default 5
	depends on $(TYPE)
	help
	  Maximum simultaneously active $(type) in a POSIX application.

rsource "Kconfig.template.with_logging"

endif # $(TYPE)
```

## lib/posix/options/Kconfig.template.pooled_type
```kconfig
# Copyright (c) 2023 Meta
#
# SPDX-License-Identifier: Apache-2.0

rsource "Kconfig.template.with_url"

menuconfig $(TYPE)
	bool "$(type) support"
	default y if POSIX_API
	help
	  For more info, see
	  $(posix-url-base)/$(type-function).html

if $(TYPE)

# eventually, this size should be defaulted to 0 as a safe value
config MAX_$(TYPE)_COUNT
	int "Maximum number of $(type)"
	default 5
	help
	  Maximum simultaneously active $(type) in a POSIX application.

rsource "Kconfig.template.with_logging"

endif # $(TYPE)
```

## lib/posix/options/Kconfig.template.with_logging
```kconfig
# Copyright (c) 2023 Meta
#
# SPDX-License-Identifier: Apache-2.0

module = $(TYPE)
module-str = $(TYPE) logging
source "subsys/logging/Kconfig.template.log_config"
```

## lib/posix/options/Kconfig.timer
```kconfig
# Copyright (c) 2018 Intel Corporation
#
# SPDX-License-Identifier: Apache-2.0

menuconfig POSIX_TIMERS
	bool "POSIX timers, clocks, and sleep functions"
	default y if POSIX_API
	help
	  This enables POSIX clock, timer, and sleep functions.

if POSIX_TIMERS

config POSIX_TIMER_MAX
	int "Maximum number of timer_t"
	default 5
	help
	  Maximum simultaneously active timer_t in a POSIX application.

config POSIX_MONOTONIC_CLOCK
	bool "POSIX Monotonic clock support"
	default y
	help
	  This enables CLOCK_MONOTONIC.

config POSIX_CLOCK_SELECTION
	bool "POSIX Clock selection"
	default y
	help
	  This enables POSIX clock selection.

config TIMER_CREATE_WAIT
	int "Time to wait for timer availability (in msec) in POSIX application"
	default 100
	range 0 1000
	help
	  This controls how long to wait for resources to come available to create
	  a new timer in POSIX compliant application

config TIMER_DELAYTIMER_MAX
	int "Maximum count returned my timer_getoverrun() in POSIX application"
	default 20
	help
	  This controls the maximum number of times a timer can overrun before
	  timer_getoverrun() in POSIX compliant application.

module = TIMER
module-str = POSIX Timers
source "subsys/logging/Kconfig.template.log_config"

endif # POSIX_TIMERS
```

## lib/posix/options/Kconfig.toolchain
```kconfig
# Copyright (c) 2024 Tenstorrent AI ULC
#
# SPDX-License-Identifier: Apache-2.0

# The following list of Kconfig options are based on standard POSIX Subprofiling Option Groups
# and may be used to override Zephyr's internal POSIX implementations. This facility is mainly
# for toolchain integrators, C library maintainers, etc, and is not intended for general users.
#
# Use these features with caution as doing so might introduce unwanted, unexpected, or undefined
# behavior.
#
# POSIX Subprofiling Option Groups are defined at the link below:
#
# https://pubs.opengroup.org/onlinepubs/9699919799/xrat/V4_subprofiles.html

config TC_PROVIDES_POSIX_ASYNCHRONOUS_IO
	bool

config TC_PROVIDES_POSIX_BARRIERS
	bool

config TC_PROVIDES_POSIX_C_LANG_JUMP
	bool

config TC_PROVIDES_POSIX_C_LANG_MATH
	bool

config TC_PROVIDES_POSIX_C_LANG_SUPPORT
	bool

config TC_PROVIDES_POSIX_C_LANG_SUPPORT_R
	bool

config TC_PROVIDES_POSIX_C_LANG_WIDE_CHAR
	bool

config TC_PROVIDES_POSIX_C_LANG_WIDE_CHAR_EXT
	bool

config TC_PROVIDES_POSIX_C_LIB_EXT
	bool

config TC_PROVIDES_POSIX_CLOCK_SELECTION
	bool

config TC_PROVIDES_POSIX_DEVICE_IO
	bool

config TC_PROVIDES_POSIX_DEVICE_IO_EXT
	bool

config TC_PROVIDES_POSIX_DEVICE_SPECIFIC
	bool

config TC_PROVIDES_POSIX_DEVICE_SPECIFIC_R
	bool

config TC_PROVIDES_POSIX_DYNAMIC_LINKING
	bool

config TC_PROVIDES_POSIX_FD_MGMT
	bool

config TC_PROVIDES_POSIX_FIFO
	bool

config TC_PROVIDES_POSIX_FIFO_FD
	bool

config TC_PROVIDES_POSIX_FILE_ATTRIBUTES
	bool

config TC_PROVIDES_POSIX_FILE_ATTRIBUTES_FD
	bool

config TC_PROVIDES_POSIX_FILE_LOCKING
	bool

config TC_PROVIDES_POSIX_FILE_SYSTEM
	bool

config TC_PROVIDES_POSIX_FILE_SYSTEM_EXT
	bool

config TC_PROVIDES_POSIX_FILE_SYSTEM_FD
	bool

config TC_PROVIDES_POSIX_FILE_SYSTEM_GLOB
	bool

config TC_PROVIDES_POSIX_FILE_SYSTEM_R
	bool

config TC_PROVIDES_POSIX_I18N
	bool

config TC_PROVIDES_POSIX_JOB_CONTROL
	bool

config TC_PROVIDES_POSIX_MAPPED_FILES
	bool

config TC_PROVIDES_POSIX_MEMORY_PROTECTION
	bool

config TC_PROVIDES_POSIX_MULTI_CONCURRENT_LOCALES
	bool

config TC_PROVIDES_POSIX_MULTI_PROCESS
	bool

config TC_PROVIDES_POSIX_MULTI_PROCESS_FD
	bool

config TC_PROVIDES_POSIX_NETWORKING
	bool

config TC_PROVIDES_POSIX_PIPE
	bool

config TC_PROVIDES_POSIX_ROBUST_MUTEXES
	bool

config TC_PROVIDES_POSIX_REALTIME_SIGNALS
	bool

config TC_PROVIDES_POSIX_REGEXP
	bool

# Note: the Option is _POSIX_READER_WRITER_LOCKS, while the Option Group is POSIX_RW_LOCKS
# We have opted to use POSIX_READER_WRITER_LOCKS here to match the Option name.
config TC_PROVIDES_POSIX_READER_WRITER_LOCKS
	bool

config TC_PROVIDES_POSIX_SEMAPHORES
	bool

config TC_PROVIDES_POSIX_SHARED_MEMORY_OBJECTS
	bool

config TC_PROVIDES_POSIX_SHELL_FUNC
	bool

config TC_PROVIDES_POSIX_SIGNAL_JUMP
	bool

config TC_PROVIDES_POSIX_SIGNALS
	bool

config TC_PROVIDES_POSIX_SIGNALS_EXT
	bool

config TC_PROVIDES_POSIX_SINGLE_PROCESS
	bool

config TC_PROVIDES_POSIX_SPIN_LOCKS
	bool

config TC_PROVIDES_POSIX_SYMBOLIC_LINKS
	bool

config TC_PROVIDES_POSIX_SYMBOLIC_LINKS_FD
	bool

config TC_PROVIDES_POSIX_SYSTEM_DATABASE
	bool

config TC_PROVIDES_POSIX_SYSTEM_DATABASE_R
	bool

# Note: the Option is _POSIX_THREADS, while the Option Group is POSIX_THREADS_BASE.
# We have opted to use POSIX_THREADS here to match the Option name.
config TC_PROVIDES_POSIX_THREADS
	bool

config TC_PROVIDES_POSIX_THREADS_EXT
	bool

config TC_PROVIDES_POSIX_TIMERS
	bool

config TC_PROVIDES_POSIX_USER_GROUPS
	bool

config TC_PROVIDES_POSIX_USER_GROUPS_R
	bool

config TC_PROVIDES_POSIX_WIDE_CHAR_DEVICE_IO
	bool

config TC_PROVIDES_XSI_C_LANG_SUPPORT
	bool

config TC_PROVIDES_XSI_DBM
	bool

config TC_PROVIDES_XSI_DEVICE_IO
	bool

config TC_PROVIDES_XSI_DEVICE_SPECIFIC
	bool

config TC_PROVIDES_XSI_FILE_SYSTEM
	bool

config TC_PROVIDES_XSI_IPC
	bool

config TC_PROVIDES_XSI_JUMP
	bool

config TC_PROVIDES_XSI_MATH
	bool

config TC_PROVIDES_XSI_MULTI_PROCESS
	bool

config TC_PROVIDES_XSI_SIGNALS
	bool

config TC_PROVIDES_XSI_SINGLE_PROCESS
	bool

config TC_PROVIDES_XSI_SYSTEM_DATABASE
	bool

config TC_PROVIDES_XSI_SYSTEM_LOGGING
	bool

config TC_PROVIDES_XSI_THREADS_EXT
	bool

config TC_PROVIDES_XSI_TIMERS
	bool

config TC_PROVIDES_XSI_USER_GROUPS
	bool

config TC_PROVIDES_XSI_WIDE_CHAR
	bool
```
