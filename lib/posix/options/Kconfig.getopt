## lib/posix/options/Kconfig.getopt
```kconfig
# Copyright (c) 2021 Nordic Semiconductor ASA
#
# SPDX-License-Identifier: Apache-2.0

rsource "getopt/Kconfig"
```

## lib/posix/options/Kconfig.key
```kconfig
# Copyright (c) 2018 Intel Corporation
# Copyright (c) 2023 Meta
#
# SPDX-License-Identifier: Apache-2.0

TYPE = PTHREAD_KEY
type = pthread_key_t
type-function = pthread_setspecific
rsource "Kconfig.template.pooled_ipc_type"
```

## lib/posix/options/Kconfig.mem
```kconfig
# Copyright (c) 2024 BayLibre SAS
#
# SPDX-License-Identifier: Apache-2.0

menu "POSIX memory"

config POSIX_PAGE_SIZE
	hex
	# TODO: something similar and arch-independent for MPUs
	default MMU_PAGE_SIZE if MMU
	default 0x40
	help
	  This option is not user-configurable.

config POSIX_SHARED_MEMORY_OBJECTS
	bool "POSIX shared memory objects"
	select SYS_HASH_FUNC32
	select SYS_HASH_FUNC32_DJB2
	select FDTABLE
	select POSIX_MAPPED_FILES
	help
	  Select 'y' here and Zephyr will provide implementations of shm_open() and shm_unlink().

	  For more information, please see
	  https://pubs.opengroup.org/onlinepubs/9699919799.orig/functions/V2_chap02.html
	  https://pubs.opengroup.org/onlinepubs/9699919799/xrat/V4_port.html#tag_24_03_04

config POSIX_MAPPED_FILES
	bool "POSIX memory-mapped files"
	help
	  Select 'y' here and Zephyr will provide support for mmap(), msync(), and munmap().

	  Note: This feature depends on hardware MMU support. If the underlying platform does not
	  support an MMU, then affected POSIX API functions may return -1 and set errno to ENOTSUP.

	  For more information, please see
	  https://pubs.opengroup.org/onlinepubs/9699919799.orig/functions/V2_chap02.html
	  https://pubs.opengroup.org/onlinepubs/9699919799/xrat/V4_port.html#tag_24_03_04

if POSIX_MAPPED_FILES

config POSIX_MEMLOCK
	bool "POSIX memory locking"
	help
	  Select 'y' here and Zephyr will provide support for mlockall() and munlockall().

	  Note: This feature depends on hardware MMU support as well as DEMAND_PAGING. If the
	  underlying platform does not support an MMU or DEMAND_PAGING, then affected POSIX API
	  functions will return -1 and set errno to ENOTSUP.

	  For more information, please see
	  https://pubs.opengroup.org/onlinepubs/9699919799.orig/functions/V2_chap02.html
	  https://pubs.opengroup.org/onlinepubs/9699919799/xrat/V4_port.html#tag_24_03_04

config POSIX_MEMLOCK_RANGE
	bool "POSIX range memory locking"
	imply DEMAND_PAGING
	help
	  Select 'y' here and Zephyr will provide support for mlock() and munlock().

	  Note: This feature depends on hardware MMU support. If the underlying platform does not
	  support an MMU, then affected POSIX API functions will return -1 and set errno to ENOTSUP.

	  For more information, please see
	  https://pubs.opengroup.org/onlinepubs/9699919799.orig/functions/V2_chap02.html
	  https://pubs.opengroup.org/onlinepubs/9699919799/xrat/V4_port.html#tag_24_03_04

endif

config POSIX_MEMORY_PROTECTION
	bool "POSIX memory protection"
	help
	  Select 'y' here and Zephyr will provide support for mprotect().

	  For more information, please see
	  https://pubs.opengroup.org/onlinepubs/9699919799.orig/functions/V2_chap02.html
	  https://pubs.opengroup.org/onlinepubs/9699919799/xrat/V4_port.html#tag_24_03_04

endmenu
```

## lib/posix/options/Kconfig.mqueue
```kconfig
# Copyright (c) 2017 Intel Corporation
#
# SPDX-License-Identifier: Apache-2.0

menuconfig POSIX_MESSAGE_PASSING
	bool "POSIX message queue support"
	help
	  This enabled POSIX message queue related APIs.

if POSIX_MESSAGE_PASSING

config POSIX_MQ_OPEN_MAX
	int "Maximum number of messages in a POSIX message queue"
	default 16
	help
	  Mention maximum number of messages in message queue in POSIX compliant
	  application.

config POSIX_MQ_PRIO_MAX
	int "Maximum number of POSIX message priorities"
	default 32
	help
	  Maximum number of message priorities supported by the implementation.

config MSG_SIZE_MAX
	int "Maximum size of a POSIX message"
	default 16
	help
	  Mention maximum size of message in bytes.

config MQUEUE_NAMELEN_MAX
	int "Maximum POSIX message queue name size"
	default 16
	range 2 255
	help
	  Mention size of message queue name in number of characters.

config HEAP_MEM_POOL_ADD_SIZE_MQUEUE
	def_int 1024

endif
```

## lib/posix/options/Kconfig.mutex
```kconfig
# Copyright (c) 2017 Intel Corporation
# Copyright (c) 2023 Meta
#
# SPDX-License-Identifier: Apache-2.0

TYPE = PTHREAD_MUTEX
type = pthread_mutex_t
type-function = pthread_mutex_lock
rsource "Kconfig.template.pooled_ipc_type"
```

## lib/posix/options/Kconfig.net
```kconfig
# Copyright (c) 2024, Friedt Professional Engineering Services, Inc
#
# SPDX-License-Identifier: Apache-2.0

menuconfig POSIX_NETWORKING
	bool "POSIX Networking API"
	depends on NETWORKING
	select NET_HOSTNAME_ENABLE
	select NET_HOSTNAME_DYNAMIC
	select NET_INTERFACE_NAME
	select NET_SOCKETPAIR
	select NET_SOCKETS
	help
	  Enable this option to support the POSIX networking API. This includes
	  support for BSD Sockets.

	  For additional details, please see
	  https://pubs.opengroup.org/onlinepubs/9699919799/xrat/V4_subprofiles.html

if POSIX_NETWORKING

config POSIX_HOST_NAME_MAX
	int
	default NET_HOSTNAME_MAX_LEN
	help
	  The maximum length of a host name as defined by POSIX.

	  For additional details, please see
	  https://pubs.opengroup.org/onlinepubs/009695399/basedefs/limits.h.html

config POSIX_IPV6
	bool "POSIX IPv6 support"
	select NET_IPV6
	help
	  Enable this option to support the POSIX IPv6 API.

	  For more information, please see
	  https://pubs.opengroup.org/onlinepubs/9699919799/xrat/V4_port.html#tag_24_03_04

config POSIX_RAW_SOCKETS
	bool "POSIX RAW socket support"
	select NET_SOCKETS_PACKET
	help
	  Enable this option to support the raw sockets.

	  For more information, please see
	  https://pubs.opengroup.org/onlinepubs/9699919799.2008edition/xrat/V4_xsh_chap02.html#tag_22_02_10_18

endif # POSIX_NETWORKING
```

## lib/posix/options/Kconfig.pipe
```kconfig
# Copyright (c) 2024, Bruce Rosier
#
# SPDX-License-Identifier: Apache-2.0

menu "POSIX Pipe Options"

config POSIX_PIPE
	bool"POSIX pipe support"
	default y
	select PIPES
	help
	  For more information, please see
	  https://pubs.opengroup.org/onlinepubs/9699919799/xrat/V4_subprofiles.html

if POSIX_PIPE

config POSIX_PIPES_MAX
	int "Number of available pipes"
	default 2
	help
	  Specify the number of POSIX pipes available in the system.
	  This value controls how many pipes can be created concurrently.

config POSIX_PIPE_BUF
	int "Size of pipe buffer"
	default 512
	help
	  Specify the size of the buffe (in bytes) used by the pipe function.

endif

endmenu
```

## lib/posix/options/Kconfig.proc1
```kconfig
# Copyright (c) 2023 Meta
# Copyright (c) 2024 BayLibre SAS
# Copyright (c) 2024 Tenstorrent AI ULC
#
# SPDX-License-Identifier: Apache-2.0

menuconfig POSIX_SINGLE_PROCESS
	bool "POSIX single process support"
	# imply COMMON_LIBC_MALLOC # for env.c
	help
	  Select 'y' here to use confstr(), environ, errno, getenv(), setenv(), sysconf(), uname(),
	  or unsetenv().

	  For more information, please see
	  https://pubs.opengroup.org/onlinepubs/9699919799/xrat/V4_subprofiles.html

if POSIX_SINGLE_PROCESS

choice POSIX_SYSCONF_IMPL_CHOICE
	default POSIX_SYSCONF_IMPL_FULL if CPP
	default POSIX_SYSCONF_IMPL_MACRO
	prompt "Sysconf implementation method"

config POSIX_SYSCONF_IMPL_MACRO
	bool "Macro"
	help
	  The sysconf() function is implemented compile-time constant via macros. This is the option
	  with the least overhead. The downside is that sysconf() is not an addressable function.

config POSIX_SYSCONF_IMPL_FULL
	bool "Full"
	help
	  The sysconf() function is implemented as a large integer-integer array. The advantage if this
	  option is that all sysconf() options can be queried and that the sysconf() symbol is
	  addressable.

endchoice

config POSIX_UNAME_VERSION_LEN
	int "uname version string length"
	default 70
	help
	  Defines the maximum string length of uname version.

config POSIX_UNAME_NODENAME_LEN
	int "uname nodename string length"
	default 6 if !NET_HOSTNAME_UNIQUE
	default 22 if NET_HOSTNAME_UNIQUE
	help
	  Defines the maximum string length of nodename version.

module = POSIX_ENV
module-str = POSIX env logging
source "subsys/logging/Kconfig.template.log_config"

endif # POSIX_SINGLE_PROCESS
```

## lib/posix/options/Kconfig.procN
```kconfig
# Copyright (c) 2024 Tenstorrent AI ULC
#
# SPDX-License-Identifier: Apache-2.0

menuconfig POSIX_MULTI_PROCESS
	bool "POSIX multi-process support"
	help
	  Support for multi-processing.

	  Note: Currently Zephyr does not support multiple processes and therefore much of this option
	  group is not implemented and is considered undefined behaviour.

	  For more information, please see
	  https://pubs.opengroup.org/onlinepubs/9699919799/xrat/V4_subprofiles.html

if POSIX_MULTI_PROCESS

# These options are intended to be used for compatibility with external POSIX
# implementations such as those in Newlib or Picolibc.

config POSIX_MULTI_PROCESS_ALIAS_GETPID
	bool
	default y
	help
	  Select 'y' here and Zephyr will provide an alias for getpid() as _getpid().

endif # POSIX_MULTI_PROCESS
```

## lib/posix/options/Kconfig.pthread
```kconfig
# Copyright (c) 2017 Intel Corporation
# Copyright (c) 2023 Meta
# Copyright (c) 2024 Tenstorrent AI ULC
#
# SPDX-License-Identifier: Apache-2.0

menuconfig POSIX_THREADS
	bool "POSIX thread support"
	help
	  Select 'y' here to enable POSIX threads, mutexes, condition variables, and thread-specific
	  storage.

	  For more information please see
	  https://pubs.opengroup.org/onlinepubs/9699919799/xrat/V4_subprofiles.html

if POSIX_THREADS

config POSIX_THREAD_THREADS_MAX
	int "Maximum number of POSIX threads"
	default 5
	help
	  Maximum simultaneously active threads in a POSIX application.

	  For more information, see
	  https://pubs.opengroup.org/onlinepubs/9699919799/basedefs/limits.h.html

config MAX_PTHREAD_MUTEX_COUNT
	int "Maximum number of POSIX mutexes"
	default 5
	help
	  Maximum simultaneously active mutexes in a POSIX application.

config MAX_PTHREAD_COND_COUNT
	int "Maximum number of POSIX condition variables"
	default 5
	help
	  Maximum simultaneously active condition variables in a POSIX application.

config POSIX_THREAD_KEYS_MAX
	int "Maximum number of POSIX thread-specific-storage keys"
	default 5
	help
	  Maximum simultaneously active thread-specific-storage keys in a POSIX application.

	  For more information, see
	  https://pubs.opengroup.org/onlinepubs/9699919799/basedefs/limits.h.html

config PTHREAD_RECYCLER_DELAY_MS
	int "Delay for reclaiming dynamic pthread stacks (ms)"
	default 100
	help
	  Prior to a POSIX thread terminating via k_thread_abort(), scheduled
	  work is added to the system workqueue (SWQ) so that any resources
	  allocated by the thread (e.g. thread stack from a pool or the heap)
	  can be released back to the system. Because resources are also freed
	  on calls to pthread_create() there is no need to worry about resource
	  starvation.

	  This option sets the number of milliseconds by which to defer
	  scheduled work.

	  Note: this option should be considered temporary and will likely be
	  removed once a more synchronous solution is available.

config POSIX_THREAD_ATTR_STACKADDR
	bool "Support getting and setting POSIX thread stack addresses"
	help
	  Enable this option to use pthread_attr_getstackaddr() and
	  pthread_attr_setstackaddr().

	  This option was removed in IEEE 1003.1-2017 in favour of
	  pthread_attr_getstack() and pthread_attr_setstack().

	  For more information, please see
	  https://pubs.opengroup.org/onlinepubs/009696799/functions/pthread_attr_getstackaddr.html
	  https://pubs.opengroup.org/onlinepubs/9699919799/xrat/V4_xsh_chap03.html
	  https://pubs.opengroup.org/onlinepubs/9699919799/functions/V2_chap02.html#tag_15_09_08

config POSIX_THREAD_ATTR_STACKSIZE
	bool "Support getting and setting POSIX thread stack sizes"
	help
	  Enable this option to use pthread_attr_getstacksize() or
	  pthread_attr_setstacksize().

	  For more information, please see
	  https://pubs.opengroup.org/onlinepubs/009696699/functions/pthread_attr_getstacksize.html

config POSIX_THREADS_EXT
	bool "Extended POSIX thread support"
	help
	  Enable this option to use pthread_attr_getguardsize(), pthread_attr_setguardsize(),
	  pthread_mutexattr_gettype(), or pthread_mutexattr_settype().

	  For more information, please see
	  https://pubs.opengroup.org/onlinepubs/9699919799/xrat/V4_subprofiles.html

config POSIX_THREAD_PRIORITY_SCHEDULING
	bool "Run POSIX threads with different priorities and schedulers"
	help
	  Enabling this option allows the application to configure different priorities and
	  scheduling algorithms for different threads via functions such as pthread_setschedparam()
	  and pthread_setschedprio(). This is required for Realtime Threads and Advanced Realtime
	  Threads.

	  For more information, please see
	  https://pubs.opengroup.org/onlinepubs/9699919799/basedefs/V1_chap02.html#tag_02_01_06
	  https://man7.org/linux/man-pages/man7/posixoptions.7.html

config POSIX_PTHREAD_ATTR_STACKSIZE_BITS
	int "Significant bits for pthread_attr_t stacksize"
	range 8 31
	default 23
	help
	  This value plays a part in determining the maximum supported
	  pthread_attr_t stacksize. Valid stacksizes are in the range
	  [1, N], where N = 1 << M, and M is this configuration value.

config POSIX_PTHREAD_ATTR_GUARDSIZE_BITS
	int "Significant bits for pthread_attr_t guardsize"
	range 1 31
	default 9
	help
	  This value plays a part in determining the maximum supported
	  pthread_attr_t guardsize. Valid guardsizes are in the range
	  [0, N-1], where N = 1 << M, and M is this configuration value.

	  Actual guardsize values may be rounded-up.

config POSIX_PTHREAD_ATTR_GUARDSIZE_DEFAULT
	int "Default size of stack guard area"
	default 0
	help
	  This is the default amount of space to reserve at the overflow end of a
	  pthread stack. Since Zephyr already supports both software-based stack
	  protection (canaries) and hardware-based stack protection (MMU or MPU),
	  this is set to 0 by default. However, a conforming application would be
	  required to set this to PAGESIZE. Eventually, this option might
	  facilitate a more dynamic approach to guard areas (via software or
	  hardware) but for now it simply increases the size of thread stacks.

config POSIX_THREAD_PRIO_INHERIT
	bool "POSIX mutex priority inheritance"
	help
	  Select 'y' here to enable POSIX mutex priority inheritance.

	  For more information, please see
	  https://pubs.opengroup.org/onlinepubs/9699919799/functions/pthread_mutexattr_getprotocol.html

config POSIX_THREAD_PRIO_PROTECT
	bool "POSIX mutex priority protection"
	help
	  Select 'y' here to enable POSIX mutex priority protection.

	  For more information, please see
	  https://pubs.opengroup.org/onlinepubs/9699919799/functions/pthread_mutexattr_getprotocol.html

config POSIX_THREAD_SAFE_FUNCTIONS
	bool "POSIX thread-safe functions"
	help
	  Select 'y' here to enable POSIX thread-safe functions including asctime_r(), ctime_r(),
	  flockfile(), ftrylockfile(), funlockfile(), getc_unlocked(), getchar_unlocked(),
	  getgrgid_r(), getgrnam_r(), getpwnam_r(), getpwuid_r(), gmtime_r(), localtime_r(),
	  putc_unlocked(), putchar_unlocked(), rand_r(), readdir_r(), strerror_r(), and strtok_r().

	  For more information, please see
	  https://pubs.opengroup.org/onlinepubs/9699919799/xrat/V4_xsh_chap02.html#tag_22_02_09_07

module = PTHREAD
module-str = POSIX thread
source "subsys/logging/Kconfig.template.log_config"

module = PTHREAD_MUTEX
module-str = POSIX mutex
source "subsys/logging/Kconfig.template.log_config"

module = PTHREAD_COND
module-str = POSIX condition variable
source "subsys/logging/Kconfig.template.log_config"

module = PTHREAD_KEY
module-str = POSIX thread-specific data
source "subsys/logging/Kconfig.template.log_config"

endif # POSIX_THREADS
```
