## modules/Kconfig.civetweb
```kconfig
# Copyright (c) 2019 Antmicro Ltd
# SPDX-License-Identifier: Apache-2.0

config CIVETWEB
	bool "Civetweb Support (DEPRECATED)"
	# The CONFIG_NET_TCP_ISN_RFC6528 option would pull in mbedtls,
	# and there are include file issues if CONFIG_POSIX_API is set.
	# Because Civetweb sets the POSIX API option in the samples,
	# make sure that we do not try to use Civetweb if the TCP ISN
	# option is set.
	depends on !NET_TCP_ISN_RFC6528
	help
	  This option enables the civetweb HTTP API.
	  Support for this module is now deprecated due to a lack
	  of maintainers. Please volunteer to maintain this module
	  if you would like to see support for it remain in upstream
	  Zephyr.
```

## modules/Kconfig.cmsis
```kconfig
# Copyright (c) 2016 Intel Corporation
# SPDX-License-Identifier: Apache-2.0

config HAS_CMSIS_CORE
	bool
	select HAS_CMSIS_CORE_A if CPU_AARCH32_CORTEX_A
	select HAS_CMSIS_CORE_R if CPU_AARCH32_CORTEX_R
	select HAS_CMSIS_CORE_M if CPU_CORTEX_M

if HAS_CMSIS_CORE

config HAS_CMSIS_CORE_A
	bool

config HAS_CMSIS_CORE_R
	bool

config HAS_CMSIS_CORE_M
	bool

endif

menuconfig CMSIS_DSP
	bool "CMSIS-DSP Library Support"
	depends on (CPU_CORTEX && NEWLIB_LIBC) || ARCH_POSIX

if CMSIS_DSP
source "modules/Kconfig.cmsis_dsp"
endif

menuconfig CMSIS_NN
	bool "CMSIS-NN Library Support"
	depends on CPU_CORTEX_M
	select CMSIS_DSP

if CMSIS_NN
source "modules/Kconfig.cmsis_nn"
endif
```
