## modules/Kconfig.silabs
```kconfig
# Gecko SDK

# Copyright (c) 2017, Christian Taedcke
# SPDX-License-Identifier: Apache-2.0

config HAS_SILABS_GECKO
	bool
	select HAS_CMSIS_CORE
	depends on SOC_FAMILY_SILABS_S0 || SOC_FAMILY_SILABS_S1 || SOC_FAMILY_SILABS_S2
```
