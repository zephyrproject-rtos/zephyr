## modules/Kconfig.cmsis_nn
```kconfig
# Copyright (c) 2020 Silvano Cortesi <cortesis@student.ethz.ch>
# SPDX-License-Identifier: Apache-2.0

comment "Components"

config CMSIS_NN_ACTIVATION
	bool "Activation"
	default y
	help
	  This option enables the NN libraries for the activation layers
	  It can perform activation layers, including ReLU (Rectified
	  Linear Unit), sigmoid and tanh.

config CMSIS_NN_BASICMATH
	bool "Basic Math for NN"
	default y
	help
	  This option enables the NN libraries for the basic maths operations.
	  It adds functionality for element-wise add and multiplication functions.

config CMSIS_NN_CONCATENATION
	bool "Concatenation"
	default y
	help
	  This option enables the NN libraries for the concatenation layers.

config CMSIS_NN_CONVOLUTION
	bool "Convolution"
	default y
	help
	  Collection of convolution, depthwise convolution functions and
	  their variants. The convolution is implemented in 2 steps: im2col
	  and GEMM. GEMM is performed with CMSIS-DSP arm_mat_mult similar options.

config CMSIS_NN_FULLYCONNECTED
	bool "Fully Connected"
	default y
	help
	  Collection of fully-connected and matrix multiplication functions.

config CMSIS_NN_NNSUPPORT
	bool "NN Support"
	default y
	help
	  When off, its default behavior is all tables are included.

config CMSIS_NN_POOLING
	bool "Pooling"
	default y
	help
	  This option enables pooling layers, including max pooling
	  and average pooling.

config CMSIS_NN_RESHAPE
	bool "Reshape"
	default y
	help
	  This option enables the NN libraries for the reshape layers.

config CMSIS_NN_SOFTMAX
	bool "Softmax"
	default y
	help
	  This option enables the NN libraries for the softmax layers (exp2 based).
```

## modules/Kconfig.cypress
```kconfig
# Copyright (c) 2018 Cypress Semiconductor
# SPDX-License-Identifier: Apache-2.0

config HAS_CYPRESS_DRIVERS
	bool
	select HAS_CMSIS_CORE
```

## modules/Kconfig.eos_s3
```kconfig
# QuickLogic HAL

# Copyright (c) 2020 Antmicro Ltd <www.antmicro.com>
# SPDX-License-Identifier: Apache-2.0

config EOS_S3_HAL
	bool
	depends on SOC_EOS_S3
```

## modules/Kconfig.esp-idf
```kconfig
# Espressif ESP-IDF module

# Copyright (c) 2020 Intel Corporation
# SPDX-License-Identifier: Apache-2.0

config HAS_ESP_IDF
	bool "Espressif ESP-IDF support"
	depends on SOC_ESP32 || SOC_ESP32S2

# ESP-IDF Configurations that appear is some header files used
config IDF_TARGET
	string
	depends on HAS_ESP_IDF
	default SOC

config IDF_TARGET_ESP32
	bool
	depends on HAS_ESP_IDF
	default y if IDF_TARGET="esp32"

config IDF_TARGET_ESP32S2
	bool
	depends on HAS_ESP_IDF
	default y if IDF_TARGET="esp32s2"
```

## modules/Kconfig.gigadevice
```kconfig
# Copyright (c) 2020 Intel Corporation
# SPDX-License-Identifier: Apache-2.0

config HAS_GDLIB
	bool

config HAS_GD32CUBE
	bool
	select HAS_CMSIS_CORE
	select USE_GD32_HAL_GPIO
	depends on SOC_FAMILY_GD32

config USE_GD32_HAL_GPIO
	bool
	help
	  Enable GD32 General-purpose I/Os (GPIO) HAL module driver
```

## modules/Kconfig.imx
```kconfig
# IMX M4 Core SDK

# Copyright (c) 2018, NXP
# SPDX-License-Identifier: Apache-2.0

config HAS_IMX_HAL
	bool
	select HAS_CMSIS_CORE
	depends on SOC_FAMILY_IMX

config NXP_HAL_DISABLE_IMPLICIT_CLOCKING
	bool "Disable implicit clocking on NXP HAL drivers"
	help
		Set this to disable implicit clocking in
		NXP HAL drivers. What this means is that
		the NXP HAL drivers will not attempt to perform
		clock-related operations in their functions.

if HAS_IMX_HAL

config HAS_IMX_GPIO
	bool
	help
	  Set if the GPIO module is present in the SoC.

config HAS_IMX_I2C
	bool
	help
	  Set if the I2C module is present in the SoC.

config HAS_IMX_EPIT
	bool
	help
	  Set if the EPIT module is present in the SoC.

config HAS_IMX_IOMUXC
	bool
	help
	  Set if the IOMUXC module is present in the SoC.

endif # HAS_IMX_HAL
```

## modules/Kconfig.infineon
```kconfig
# SPDX-License-Identifier: Apache-2.0
#
# Copyright (c) 2020 Linumiz
# Author: Parthiban Nallathambi <parthiban@linumiz.com>

config HAS_XMCLIB
	bool
	select HAS_CMSIS_CORE
	depends on SOC_FAMILY_INFINEON_XMC

if HAS_XMCLIB

config HAS_XMCLIB_UART
	bool
	help
	  Enable XMCLIB Universal asynchronous receiver transmitter (UART)

config HAS_XMCLIB_FLASH
	bool
	help
	  Enable XMCLIB Flash

config HAS_XMCLIB_ERU
	bool
	help
	  Enable XMCLIB Event Request Unit (ERU) for GPIO interrupt support

config HAS_XMCLIB_VADC
	bool
	help
	  Enable XMCLIB VADC

config HAS_XMCLIB_DMA
	bool
	help
	  Enable XMCLIB DMA

config HAS_XMCLIB_SPI
	bool
	help
	  Enable XMCLIB SPI

config HAS_XMCLIB_I2C
	bool
	help
	  Enable XMCLIB I2C

config HAS_XMCLIB_CCU
	bool
	help
	  Enable XMCLIB CCU4/CCU8

config HAS_XMCLIB_WDT
	bool
	help
	  Enable XMCLIB WDT

config HAS_XMCLIB_ETH
	bool
	help
	  Enable XMCLIB Ethernet MAC

config HAS_XMCLIB_CAN
	bool
	help
	  Enable XMCLIB CAN

endif # HAS_XMCLIB
```

## modules/Kconfig.liblc3codec
```kconfig
# Copyright (c) 2022 Bose Corporation
# SPDX-License-Identifier: Apache-2.0

config LIBLC3CODEC
	bool "liblc3codec Support"
	depends on CPLUSPLUS
	depends on LIB_CPLUSPLUS
	help
	  This option enables the EHIMA liblc3codec library for Bluetooth LE Audio
```

## modules/Kconfig.loramac-node
```kconfig
#
# Copyright (c) 2019 Manivannan Sadhasivam
#
# SPDX-License-Identifier: Apache-2.0
#

config HAS_SEMTECH_LORAMAC
	bool "Semtech LoRaMac Stack"
	help
	  This option enables the use of Semtech's LoRaMac stack

config HAS_SEMTECH_RADIO_DRIVERS
	bool "Semtech LoRa Radio Drivers"
	help
	  This option enables the use of Semtech's Radio drivers

config HAS_SEMTECH_SX1276
	bool
	depends on HAS_SEMTECH_RADIO_DRIVERS

config HAS_SEMTECH_SX126X
	bool
	depends on HAS_SEMTECH_RADIO_DRIVERS
```

## modules/Kconfig.lvgl
```kconfig
# Copyright (c) 2022 Huawei Inc.
# SPDX-License-Identifier: Apache-2.0

config LVGL
	bool "LittlevGL GUI library"
	depends on !CPU_CORTEX_M0 && !CPU_CORTEX_M0PLUS
	help
	  This option enables the LittlevGL GUI library.

if LVGL

config LV_Z_POINTER_KSCAN
	bool

config LV_Z_POINTER_KSCAN_MSGQ_COUNT
	int
	default 10

config LV_Z_POINTER_KSCAN_SWAP_XY
	bool

config LV_Z_POINTER_KSCAN_INVERT_X
	bool

config LV_Z_POINTER_KSCAN_INVERT_Y
	bool

choice LV_COLOR_DEPTH
	default LV_COLOR_DEPTH_16
	prompt "Color depth."
	depends on LVGL

	config LV_COLOR_DEPTH_32
		bool "32: ARGB8888"
	config LV_COLOR_DEPTH_16
		bool "16: RGB565"
	config LV_COLOR_DEPTH_8
		bool "8: RGB232"
	config LV_COLOR_DEPTH_1
		bool "1: 1 byte per pixel"
endchoice

config LV_COLOR_16_SWAP
	bool

endif
```

## modules/Kconfig.mbedtls
```kconfig
# Cryptography primitive options for mbed TLS

# Copyright (c) 2016 Intel Corporation
# SPDX-License-Identifier: Apache-2.0

menuconfig MBEDTLS
	bool "mbedTLS Support"
	help
	  This option enables the mbedTLS cryptography library.

if MBEDTLS

choice
	prompt "Select implementation"
	default MBEDTLS_BUILTIN

config MBEDTLS_BUILTIN
	bool "Use Zephyr in-tree mbedTLS version"
	help
	  Link with mbedTLS sources included with Zephyr distribution.
	  Included mbedTLS version is well integrated with and supported
	  by Zephyr, and the recommended choice for most users.

config MBEDTLS_LIBRARY
	bool "Use external mbedTLS library"
	help
	  Use external, out-of-tree prebuilt mbedTLS library. For advanced
	  users only.

endchoice

config MBEDTLS_CFG_FILE
	string "mbed TLS configuration file"
	depends on MBEDTLS_BUILTIN
	default "config-tls-generic.h"
	help
	  Use a specific mbedTLS configuration file. The default config file
	  file can be tweaked with Kconfig. The default configuration is
	  suitable to communicate with majority of HTTPS servers on the Internet,
	  but has relatively many features enabled. To optimize resources for
	  special TLS usage, use available Kconfig options, or select an
	  alternative config.

rsource "Kconfig.tls-generic"

config MBEDTLS_SSL_MAX_CONTENT_LEN
	int "Max payload size for TLS protocol message"
	default 1500
	depends on MBEDTLS_BUILTIN
	help
	  The TLS standards mandate max payload size of 16384 bytes. So, for
	  maximum operability and for general-purpose usage, that value must
	  be used. For specific usages, that value can be largely decreased.
	  E.g. for DTLS, payload size is limited by UDP datagram size, and
	  even for HTTPS REST API, the payload can be limited to max size of
	  (REST request, REST response, server certificate(s)).
	  mbedTLS uses this value separate for input and output buffers, so
	  twice this value will be allocated (on mbedTLS own heap, so the
	  value of MBEDTLS_HEAP_SIZE should accommodate that).

config MBEDTLS_DEBUG
	bool "mbed TLS debug activation"
	depends on MBEDTLS_BUILTIN
	help
	  Enable debugging activation for mbed TLS configuration. If you use
	  mbedTLS/Zephyr integration (e.g. net_app), this will activate debug
	  logging (of the level configured by MBEDTLS_DEBUG_LEVEL).
	  If you use mbedTLS directly instead, you will need to perform
	  additional configuration yourself: call
	  mbedtls_ssl_conf_dbg(&mbedtls.conf, my_debug, NULL);
	  mbedtls_debug_set_threshold(level);
	  functions in your application, and create the my_debug() function to
	  actually print something useful.

config MBEDTLS_DEBUG_LEVEL
	int "mbed TLS default debug level"
	depends on MBEDTLS_DEBUG
	default 0
	range 0 4
	help
	  Default mbed TLS debug logging level for Zephyr integration code
	  (from ext/lib/crypto/mbedtls/include/mbedtls/debug.h):
	  0 No debug
	  1 Error
	  2 State change
	  3 Information
	  4 Verbose

config MBEDTLS_MEMORY_DEBUG
	bool "mbed TLS memory debug activation"
	depends on MBEDTLS_BUILTIN
	help
	  Enable debugging of buffer allocator memory issues. Automatically
	  prints (to stderr) all (fatal) messages on memory allocation
	  issues. Enables function for 'debug output' of allocated memory.

config MBEDTLS_TEST
	bool "Compile internal self test functions"
	depends on MBEDTLS_BUILTIN
	help
	  Enable self test function for the crypto algorithms

config MBEDTLS_INSTALL_PATH
	string "mbedTLS install path"
	depends on MBEDTLS_LIBRARY
	help
	  This option holds the path where the mbedTLS libraries and headers are
	  installed. Make sure this option is properly set when MBEDTLS_LIBRARY
	  is enabled otherwise the build will fail.

config MBEDTLS_ENABLE_HEAP
	bool "Enable global heap for mbed TLS"
	help
	  This option enables the mbedtls to use the heap. This setting must
	  be global so that various applications and libraries in Zephyr do not
	  try to do this themselves as there can be only one heap defined
	  in mbedtls. If this is enabled, then the Zephyr will, during the device
	  startup, initialize the heap automatically.

config MBEDTLS_HEAP_SIZE
	int "Heap size for mbed TLS"
	default 10240 if OPENTHREAD_COMMISSIONER || OPENTHREAD_JOINER
	default 512
	depends on MBEDTLS_ENABLE_HEAP
	help
	  The mbedtls routines will use this heap if enabled.
	  See ext/lib/crypto/mbedtls/include/mbedtls/config.h and
	  MBEDTLS_MEMORY_BUFFER_ALLOC_C option for details. That option is not
	  enabled by default.
	  Default value for the heap size is not set as it depends on the
	  application. For streaming communication with arbitrary (HTTPS)
	  servers on the Internet, 32KB + overheads (up to another 20KB) may
	  be needed. For some dedicated and specific usage of mbedtls API, the
	  1000 bytes might be ok.

config APP_LINK_WITH_MBEDTLS
	bool "Link 'app' with MBEDTLS"
	default y
	help
	  Add MBEDTLS header files to the 'app' include path. It may be
	  disabled if the include paths for MBEDTLS are causing aliasing
	  issues for 'app'.

endif # MBEDTLS
```
