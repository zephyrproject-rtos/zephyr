## modules/hal_nxp/mcux/mcux-sdk-ng/middleware/Kconfig.multicore
```kconfig
# Copyright 2026 NXP
#
# SPDX-License-Identifier: Apache-2.0

config NXP_MULTICORE
	bool "NXP Multicore Manager support"
	help
	  Includes NXP Multicore Manager support.
```

## modules/hal_nxp/nxp_crypto_hal/Kconfig
```kconfig
# Copyright 2026 NXP
# SPDX-License-Identifier: Apache-2.0

rsource "Kconfig.els_pkc"
rsource "Kconfig.psa_crypto_driver"
rsource "Kconfig.sgi_pkc"

config TF_PSA_CRYPTO_DISPATCH_DIR
	default "$(ZEPHYR_HAL_NXP_MODULE_DIR)/nxp_crypto_hal/mbedtls/dispatch" \
		if MCUX_PSA_CRYPTO_DRIVER_ELS_PKC || PSA_CRYPTO_DRIVER_SGI_PKC
```

## modules/hal_nxp/nxp_crypto_hal/Kconfig.els_pkc
```kconfig
# Copyright 2024-2026 NXP
# SPDX-License-Identifier: Apache-2.0

config MCUX_ELS_PKC
	bool "Build els_pkc"
	depends on HAS_MCUX_ELS_PKC
	default y if BUILD_WITH_TFM
	default y if MBEDTLS_PSA_CRYPTO_C
	help
	  Include the els_pkc component from the NXP MCU SDK in the build.
	  Enabled on SoCs that integrate the ELS PKC accelerator.

config MCUX_ELS_PKC_TRNG_USE_ELS
	bool
	default y if SOC_FAMILY_MCXN || SOC_SERIES_IMXRT7XX
	help
	  Select the TRNG source used by els_pkc. Some platforms (e.g. MCXN
	  and RT700 / MIMXRT7xx) have no standalone SA_TRNG peripheral and use
	  the ELS internal TRNG (MCUXCL_FEATURE_TRNG_ELS). Others (e.g. RW61x)
	  use the standalone SA_TRNG. When enabled, mcuxClTrng_ELS.c is built;
	  otherwise mcuxClTrng_SA_TRNG.c is built.

config MCUX_ELS_PKC_ENABLE_KEY_DERIVATION
	bool
	default y if SOC_SERIES_IMXRT7XX
	help
	  Build the key-derivation (HKDF/PBKDF2/NIST SP800-108/SP800-56C) and
	  RSA key-type source files. These provide descriptor symbols
	  (mcuxClKey_DerivationAlgorithmDescriptor_*,
	  mcuxClKey_TypeDescriptor_derivationKey_variableLength,
	  mcuxClKey_TypeDescriptor_Rsa_*) required by platforms such as
	  RT700 / MIMXRT7xx. Platforms that do not use this feature set
	  (e.g. MCXN, RW61x) leave this disabled.
```

## modules/hal_nxp/nxp_crypto_hal/Kconfig.psa_crypto_driver
```kconfig
# Copyright 2024-2026 NXP
# SPDX-License-Identifier: Apache-2.0

# HW acceleration configs for psa-crypto-driver.

config MCUX_PSA_CRYPTO_DRIVER_ELS_PKC
	bool "Build psa_crypto_driver for els_pkc"
	depends on MBEDTLS_PSA_CRYPTO_C && MCUX_ELS_PKC
	default y
	help
	  Include the psa_crypto_driver component from the NXP MCU SDK in the
	  build. This provides an abstraction on top of the els_pkc component
	  in order to be able to access the hardware acceleration offered by
	  els_pkc from mbedtls via the mbedtls psa_crypto_driver_wrapper.
	  Enabled by default on SoCs that integrate the ELS PKC accelerator.

config MCUX_PSA_CRYPTO_DRIVER_ELS_PKC_THREAD
	bool "Threading support in psa-crypto-driver"
	depends on MCUX_ELS_PKC && MCUX_PSA_CRYPTO_DRIVER_ELS_PKC
	default n if BUILD_WITH_TFM
	help
	  Enables threading support in psa-crypto-driver component.

config MCUX_PSA_CRYPTO_DRIVER_USE_ELS_PKC_SHA1
	bool "Use of SHA1 from els-pkc via psa-crypto-driver"
	depends on MCUX_ELS_PKC && MCUX_PSA_CRYPTO_DRIVER_ELS_PKC
	help
	  Enables use of SHA1 from els-pkc via psa-crypto-driver component.

config PSA_CRYPTO_DRIVER_SGI_PKC
	bool "SGI PKC support in psa-crypto-driver"
	depends on MBEDTLS_PSA_CRYPTO_C && HAS_MCUX_SGI_PKC
	select SGI_PKC
	default y
	help
	  Enables SGI PKC support in psa-crypto-driver component.
	  Enabled by default on SoCs that integrate the SGI PKC accelerator.

config PSA_CRYPTO_DRIVER_THREAD_EN
	bool "PSA Crypto Thread"
	depends on MBEDTLS_PSA_CRYPTO_C
	help
	  Enables PSA_CRYPTO_THREAD.
```

## modules/hal_nxp/nxp_crypto_hal/Kconfig.sgi_pkc
```kconfig
# Copyright 2026 NXP
# SPDX-License-Identifier: Apache-2.0

menuconfig SGI_PKC
	bool "NXP SGI PKC Cryptographic Library"
	depends on HAS_MCUX_SGI_PKC
	help
	  Enable NXP SGI PKC (Secure Gateway Interface - Public Key Cryptography)
	  cryptographic library support.

if SGI_PKC

config SGI_PKC_PLATFORM_MCXA
	def_bool y if SOC_MCXA266 || SOC_MCXA366
	help
	  Automatically enabled for MCXA2xx/MCXA3xx SoCs.
	  Selects mcxa2xx platform include directories.

config SGI_PKC_PLATFORM_MCXA5
	def_bool y if SOC_MCXA577
	help
	  Automatically enabled for MCXA5xx SoCs.
	  Selects mcxa5xx platform include directories.

config SGI_PKC_PLATFORM_MCXL
	def_bool y if SOC_MCXL255
	help
	  Automatically enabled for MCXL2xx SoCs.
	  Selects mcxl2xx platform include directories.

config SGI_PKC_PLATFORM_MCXW
	def_bool y if SOC_MCXW70AC
	help
	  Automatically enabled for MCXW7xx (W70/KW43) SoCs.
	  Selects mcxw7x platform include directories.

config SGI_PKC_CORE
	bool
	default y
	help
	  Core component providing basic functionality.

config SGI_PKC_TOOLCHAIN
	bool
	default y
	help
	  Toolchain specific definitions and macros.

config SGI_PKC_PRE_PROCESSOR
	bool
	default y
	help
	  CSSL C Pre-Processor component.

config SGI_PKC_DATA_INTEGRITY
	bool
	default y
	help
	  CSSL Data Integrity component.

config SGI_PKC_FLOW_PROTECTION
	bool
	default y
	help
	  CSSL Flow Protection component.

config SGI_PKC_PARAM_INTEGRITY
	bool
	default y
	help
	  CSSL Parameter Integrity component.

config SGI_PKC_SECURE_COUNTER
	bool
	default y
	help
	  CSSL Secure Counter component.

config SGI_PKC_MEMORY
	bool
	default y
	help
	  Memory operations component (including CSSL Memory).

config SGI_PKC_BUFFER
	bool
	default y
	help
	  Buffer management component.

config SGI_PKC_SESSION
	bool
	default y
	help
	  Session management component.

config SGI_PKC_RESOURCE
	bool
	default y
	help
	  Resource management component.

config SGI_PKC_PKC
	bool
	default y
	help
	  PKC (Public Key Cryptography) engine component.

config SGI_PKC_SGI
	bool
	default y
	help
	  SGI (Secure Gateway Interface) driver component.

config SGI_PKC_DMA
	bool
	default y
	help
	  DMA operations component.

# Cryptographic Components
config SGI_PKC_AES
	bool
	default y
	help
	  AES cryptographic component.

config SGI_PKC_CIPHER
	bool
	default y
	help
	  Cipher operations component.

config SGI_PKC_CIPHER_MODES
	bool
	default y
	help
	  Cipher modes (ECB, CBC, CTR) component.

config SGI_PKC_AEAD
	bool
	default y
	help
	  AEAD (Authenticated Encryption with Associated Data) component.

config SGI_PKC_AEAD_MODES
	bool
	default y
	help
	  AEAD modes (CCM, GCM) component.

config SGI_PKC_HASH
	bool
	default y
	help
	  Hash operations component.

config SGI_PKC_HASHMODES
	bool
	default y
	help
	  Hash modes (SHA-224, SHA-256, SHA-384, SHA-512) component.

config SGI_PKC_MAC
	bool
	default y
	help
	  MAC (Message Authentication Code) component.

config SGI_PKC_MAC_MODES
	bool
	default y
	help
	  MAC modes (CMAC, GMAC, CBC-MAC) component.

config SGI_PKC_HMAC
	bool
	default y
	help
	  HMAC (Hash-based Message Authentication Code) component.

config SGI_PKC_PADDING
	bool
	default y
	help
	  Padding schemes component.

# Public Key Cryptography Components
config SGI_PKC_ECC
	bool
	default y
	help
	  ECC (Elliptic Curve Cryptography) component.

config SGI_PKC_RSA
	bool
	default y
	help
	  RSA cryptographic component.

config SGI_PKC_FFDH
	bool
	default y
	depends on SGI_PKC_PLATFORM_MCXA
	help
	  FFDH (Finite Field Diffie-Hellman) component.
	  Only available on MCXA2xx platforms (no mcxa5xx platform headers).

config SGI_PKC_SIGNATURE
	bool
	default y
	help
	  Digital signature component.

config SGI_PKC_KEY
	bool
	default y
	help
	  Key management component.

config SGI_PKC_MATH
	bool
	default y
	help
	  Mathematical operations component for PKC.

# Random Number Generation Components
config SGI_PKC_RANDOM
	bool
	default y
	help
	  Random number generation component.

config SGI_PKC_RANDOM_MODES
	bool
	default y
	help
	  Random modes (CTR-DRBG) component.

config SGI_PKC_PRNG
	bool
	default y
	help
	  PRNG (Pseudo Random Number Generator) component.

config SGI_PKC_CSSL_PRNG
	bool
	default y
	help
	  CSSL PRNG component.

config SGI_PKC_TRNG
	bool
	default y
	help
	  TRNG (True Random Number Generator) component.

config SGI_PKC_KDF_MODES
	bool
	default y
	depends on SGI_PKC_PLATFORM_MCXA5
	help
	  KDF modes (HKDF, SP800-108, SP800-56C, PBKDF2) component.
	  Only available on MCXA5xx platforms.

config SGI_PKC_XOF
	bool
	default y
	depends on SGI_PKC_PLATFORM_MCXA5
	help
	  XOF (Extendable Output Function) component.

config SGI_PKC_XOF_MODES
	bool
	default y
	depends on SGI_PKC_PLATFORM_MCXA5
	help
	  XOF modes (SHAKE-128, SHAKE-256) component.
	  Only available on MCXA5xx platforms.

# Utility Components
config SGI_PKC_CRC
	bool
	default y
	help
	  CRC (Cyclic Redundancy Check) component.

config SGI_PKC_GLIKEY
	bool
	default y
	help
	  Glikey component for key management.

endif # SGI_PKC
```

## modules/hal_py32/Kconfig
```kconfig
# SPDX-FileCopyrightText: Copyright The Zephyr Project Contributors
# SPDX-License-Identifier: Apache-2.0

if SOC_FAMILY_PY32

config USE_PY32_ASSERT
	bool
	help
	  Enable the Puya PY32 ASSERT implementation.

config USE_PY32_HAL_ADC
	bool
	help
	  Enable the Puya PY32 HAL ADC implementation.

config USE_PY32_HAL_ADC_EX
	bool
	help
	  Enable the Puya PY32 HAL ADC EX implementation.

config USE_PY32_HAL_COMP
	bool
	help
	  Enable the Puya PY32 HAL COMP implementation.

config USE_PY32_HAL_CORTEX
	bool
	help
	  Enable the Puya PY32 HAL CORTEX implementation.

config USE_PY32_HAL_CRC
	bool
	help
	  Enable the Puya PY32 HAL CRC implementation.

config USE_PY32_HAL_DMA
	bool
	help
	  Enable the Puya PY32 HAL DMA implementation.

config USE_PY32_HAL_EXTI
	bool
	help
	  Enable the Puya PY32 HAL EXTI implementation.

config USE_PY32_HAL_FLASH
	bool
	help
	  Enable the Puya PY32 HAL FLASH implementation.

config USE_PY32_HAL_GPIO
	bool
	help
	  Enable the Puya PY32 HAL GPIO implementation.

config USE_PY32_HAL_I2C
	bool
	help
	  Enable the Puya PY32 HAL I2C implementation.

config USE_PY32_HAL_IRDA
	bool
	help
	  Enable the Puya PY32 HAL IRDA implementation.

config USE_PY32_HAL_IWDG
	bool
	help
	  Enable the Puya PY32 HAL IWDG implementation.

config USE_PY32_HAL_LPTIM
	bool
	help
	  Enable the Puya PY32 HAL LPTIM implementation.

config USE_PY32_HAL_PWR
	bool
	help
	  Enable the Puya PY32 HAL PWR implementation.

config USE_PY32_HAL_RTC
	bool
	help
	  Enable the Puya PY32 HAL RTC implementation.

config USE_PY32_HAL_RTC_EX
	bool
	help
	  Enable the Puya PY32 HAL RTC EX implementation.

config USE_PY32_HAL_SPI
	bool
	help
	  Enable the Puya PY32 HAL SPI implementation.

config USE_PY32_HAL_TIM
	bool
	help
	  Enable the Puya PY32 HAL TIM implementation.

config USE_PY32_HAL_TIM_EX
	bool
	help
	  Enable the Puya PY32 HAL TIM EX implementation.

config USE_PY32_HAL_UART
	bool
	help
	  Enable the Puya PY32 HAL UART implementation.

config USE_PY32_HAL_USART
	bool
	help
	  Enable the Puya PY32 HAL USART implementation.

config USE_PY32_HAL_WWDG
	bool
	help
	  Enable the Puya PY32 HAL WWDG implementation.

config USE_PY32_LL_ADC
	bool
	help
	  Enable the Puya PY32 LL ADC implementation.

config USE_PY32_LL_COMP
	bool
	help
	  Enable the Puya PY32 LL COMP implementation.

config USE_PY32_LL_CRC
	bool
	help
	  Enable the Puya PY32 LL CRC implementation.

config USE_PY32_LL_DMA
	bool
	help
	  Enable the Puya PY32 LL DMA implementation.

config USE_PY32_LL_EXTI
	bool
	help
	  Enable the Puya PY32 LL EXTI implementation.

config USE_PY32_LL_GPIO
	bool
	help
	  Enable the Puya PY32 LL GPIO implementation.

config USE_PY32_LL_I2C
	bool
	help
	  Enable the Puya PY32 LL I2C implementation.

config USE_PY32_LL_LPTIM
	bool
	help
	  Enable the Puya PY32 LL LPTIM implementation.

config USE_PY32_LL_PWR
	bool
	help
	  Enable the Puya PY32 LL PWR implementation.

config USE_PY32_LL_RCC
	bool
	help
	  Enable the Puya PY32 LL RCC implementation.

config USE_PY32_LL_RTC
	bool
	help
	  Enable the Puya PY32 LL RTC implementation.

config USE_PY32_LL_SPI
	bool
	help
	  Enable the Puya PY32 LL SPI implementation.

config USE_PY32_LL_TIM
	bool
	help
	  Enable the Puya PY32 LL TIM implementation.

config USE_PY32_LL_USART
	bool
	help
	  Enable the Puya PY32 LL USART implementation.

config USE_PY32_LL_UTILS
	bool
	help
	  Enable the Puya PY32 LL UTILS implementation.

endif # SOC_FAMILY_PY32
```

## modules/hal_realtek/ameba/Kconfig.ameba
```kconfig
# Copyright (c) 2026 Realtek Semiconductor Corp.
# SPDX-License-Identifier: Apache-2.0

config REALTEK_AMEBA_OS_WRAPPER
	bool "Realtek Ameba OS Wrapper Layer"
	default y
	depends on SOC_FAMILY_REALTEK_AMEBA
	help
	  Enable the Realtek Ameba OS wrapper abstraction layer.
	  This provides RTOS abstraction for Ameba HAL drivers.

if REALTEK_AMEBA_OS_WRAPPER

config REALTEK_AMEBA_OS_WRAPPER_DEFERRED_POOL_SIZE
	int "Deferred-work slots for OS wrapper clean-up"
	default 4
	range 1 64
	help
	  Slots for clean-up deferred to the system workqueue (thread
	  self-delete, timer delete, pended call). Raise if os_if_deferred
	  logs "pool exhausted".

endif # REALTEK_AMEBA_OS_WRAPPER
```

## modules/hal_realtek/ameba/Kconfig.timer
```kconfig
# SPDX-FileCopyrightText: Copyright The Zephyr Project Contributors
# SPDX-License-Identifier: Apache-2.0

config REALTEK_AMEBA_TIMER_STACK_SIZE
	int "Ameba software timer thread stack size"
	default 6144
	range 1024 65536
	help
	  Stack for the dedicated thread that executes vendor software timer
	  callbacks. Wi-Fi authentication callbacks can take mutexes and must
	  not execute in interrupt context or on the system workqueue.

config REALTEK_AMEBA_TIMER_PRIORITY
	int "Ameba software timer thread priority"
	default 4 if NUM_PREEMPT_PRIORITIES > 4
	default 0
	range 0 127
	help
	  Preemptible priority of the dedicated Ameba software timer thread.
```

## modules/hal_rpi_pico/Kconfig
```kconfig
# Copyright (c) 2021 Yonatan Schachter
# SPDX-License-Identifier: Apache-2.0

config ZEPHYR_HAL_RPI_PICO_MODULE
	bool

config ZEPHYR_HAL_RPI_PICO_MODULE_ACTIVE
	bool
	depends on ZEPHYR_HAL_RPI_PICO_MODULE

config HAS_RPI_PICO
	bool
	select ZEPHYR_HAL_RPI_PICO_MODULE_ACTIVE

config PICOSDK_USE_UART
	bool
	select ZEPHYR_HAL_RPI_PICO_MODULE_ACTIVE
	help
	  Use the UART driver from pico-sdk

config PICOSDK_USE_GPIO
	bool
	select ZEPHYR_HAL_RPI_PICO_MODULE_ACTIVE
	help
	  Use the GPIO driver from pico-sdk

config PICOSDK_USE_FLASH
	bool
	select ZEPHYR_HAL_RPI_PICO_MODULE_ACTIVE
	help
	  Use the flash driver from pico-sdk

config PICOSDK_USE_PWM
	bool
	select ZEPHYR_HAL_RPI_PICO_MODULE_ACTIVE
	help
	  Use the PWM driver from pico-sdk

config PICOSDK_USE_ADC
	bool
	select ZEPHYR_HAL_RPI_PICO_MODULE_ACTIVE
	help
	  Use the ADC driver from pico-sdk

config PICOSDK_USE_DMA
	bool
	select ZEPHYR_HAL_RPI_PICO_MODULE_ACTIVE
	help
	  Use the DMA driver from pico-sdk

config PICOSDK_USE_PIO
	bool
	select PICOSDK_USE_CLAIM
	select ZEPHYR_HAL_RPI_PICO_MODULE_ACTIVE
	help
	  Use the PIO driver from pico-sdk

config PICOSDK_USE_CLAIM
	bool
	select ZEPHYR_HAL_RPI_PICO_MODULE_ACTIVE
	help
	  Use the "claim" driver from pico-sdk

config PICOSDK_USE_TIMER
	bool
	select ZEPHYR_HAL_RPI_PICO_MODULE_ACTIVE
	help
	  Use the TIMER driver from pico-sdk

config PICOSDK_USE_RTC
	bool
	select ZEPHYR_HAL_RPI_PICO_MODULE_ACTIVE
	help
	  Use the RTC driver from pico-sdk

config PICOSDK_USE_SHA256
	bool
	select ZEPHYR_HAL_RPI_PICO_MODULE_ACTIVE
	help
	  Use the SHA-256 driver and utilities from pico-sdk

config PICOSDK_USE_RAND
	bool
	select ZEPHYR_HAL_RPI_PICO_MODULE_ACTIVE
	help
	  Use the "rand" driver from pico-sdk
```
