## modules/hal_silabs/Kconfig
```kconfig
# Gecko and Si32 SDK

# Copyright (c) 2017, Christian Taedcke
# SPDX-License-Identifier: Apache-2.0

config ZEPHYR_HAL_SILABS_MODULE
	bool

config ZEPHYR_HAL_SILABS_MODULE_ACTIVE
	bool
	depends on ZEPHYR_HAL_SILABS_MODULE

config ZEPHYR_HAL_SILABS_MODULE_BLOBS
	bool

config HAS_SILABS_GECKO
	bool
	select HAS_CMSIS_CORE
	depends on SOC_FAMILY_SILABS_S0 || SOC_FAMILY_SILABS_S1
	select ZEPHYR_HAL_SILABS_MODULE_ACTIVE

config HAS_SILABS_SISDK
	bool
	select HAS_CMSIS_CORE
	depends on SOC_FAMILY_SILABS_S2
	select ZEPHYR_HAL_SILABS_MODULE_ACTIVE

config HAS_SILABS_WISECONNECT
	bool
	select HAS_CMSIS_CORE
	depends on SOC_FAMILY_SILABS_SIWX91X
	select ZEPHYR_HAL_SILABS_MODULE_ACTIVE

config HAS_SILABS_SI32
	bool
	select HAS_CMSIS_CORE
	select ZEPHYR_HAL_SILABS_MODULE_ACTIVE

rsource "*/Kconfig"
```

## modules/hal_silabs/cpc/Kconfig
```kconfig
# Copyright (c) 2026 Silicon Laboratories Inc.
# SPDX-License-Identifier: Apache-2.0

config SILABS_CPC
	bool
	select CMSIS_RTOS_V2
	select THREAD_NAME
	select THREAD_STACK_INFO
	select THREAD_MONITOR
	select INIT_STACKS
	select SILABS_SISDK_SLIST if HAS_SILABS_SISDK
	help
	  Build the Silicon Labs CPC (Co-Processor Communication) core in the
	  primary role. Selected by drivers that talk to a Silicon Labs
	  co-processor over CPC.

	  The core runs on top of the CMSIS RTOS v2 API. The application must
	  set NUM_PREEMPT_PRIORITIES to at least 56 and size the CMSIS_V2_*
	  pools (one thread per bus, mutexes and semaphores for each bus and
	  endpoint).

if SILABS_CPC

module = SILABS_CPC
module-str = silabs_cpc
source "subsys/logging/Kconfig.template.log_config"

endif # SILABS_CPC
```

## modules/hal_wch/Kconfig
```kconfig
#
# Copyright (c) 2024 Dhiru Kholia
#
# SPDX-License-Identifier: Apache-2.0
#

config ZEPHYR_HAL_WCH_MODULE
	bool

config ZEPHYR_HAL_WCH_MODULE_ACTIVE
	bool
	depends on ZEPHYR_HAL_WCH_MODULE

config HAS_WCH_CH32FUN
	bool
	select ZEPHYR_HAL_WCH_MODULE_ACTIVE
	help
	  The ch32fun headers for WCH SoCs. Selected by the SoC family, whose
	  sources and pinctrl drivers are built against them.
```

## modules/hal_wurthelektronik/Kconfig
```kconfig
# Copyright (c) 2026 Embeint Inc
# SPDX-License-Identifier: Apache-2.0

config ZEPHYR_HAL_WURTHELEKTRONIK_MODULE
	bool
```

## modules/jpegdec/Kconfig
```kconfig
# Copyright The Zephyr Project Contributors
# SPDX-License-Identifier: Apache-2.0

config ZEPHYR_JPEGDEC_MODULE
	bool

config JPEGDEC
	bool "JPEGDEC software JPEG decoder"
	depends on ZEPHYR_JPEGDEC_MODULE
	help
	  Baseline and progressive JPEG decoder from the jpegdec module. The
	  decoder keeps its state in a caller-owned JPEGIMAGE and allocates
	  nothing.
```

## modules/libsbc/Kconfig
```kconfig
# Copyright (c) 2024 NXP
# SPDX-License-Identifier: Apache-2.0

config ZEPHYR_LIBSBC_MODULE
	bool

config ZEPHYR_LIBSBC_MODULE_ACTIVE
	bool
	depends on ZEPHYR_LIBSBC_MODULE

config LIBSBC
	bool "libsbc Support"
	select ZEPHYR_LIBSBC_MODULE_ACTIVE
	help
	  This option enables Low Complexity Subband Codec (SBC)
```

## modules/lora-basics-modem/Kconfig
```kconfig
# Copyright (c) 2024 Semtech Corporation
# SPDX-License-Identifier: Apache-2.0

# Top-level configuration file for LoRa Basics Modem containing LoRa
# transceiver drivers and LBM LoRaWAN stack

config ZEPHYR_LORA_BASICS_MODEM_MODULE
	bool

config USE_LORA_BASICS_MODEM_DRIVERS
	bool

config LORA_BASICS_MODEM_HAL
	bool "LoRa Basics Modem HAL implementation"
	depends on USE_LORA_BASICS_MODEM_DRIVERS && LORA_SX126X
	default y if LORAWAN
	help
	  Compile the smtc_modem_hal implementation for LoRa Basics Modem.
	  This is required for porting tests and full modem functionality.
	  Currently only supported with SX126x radios.

config LORA_BASICS_MODEM_NVM
	bool "Keep the modem context in non-volatile storage"
	depends on LORA_BASICS_MODEM_HAL
	depends on SETTINGS
	default y
	help
	  Store the modem context, which holds the join nonce among other
	  things, so that it survives a reboot. A network rejects a join
	  request whose nonce does not increase, so a device that forgets the
	  context can only join once. This needs a settings backend, which the
	  application chooses.

config LORA_BASICS_MODEM_CORE
	bool "LoRa Basics Modem LoRaWAN stack"
	depends on LORA_BASICS_MODEM_HAL
	depends on LORAWAN
	default y
	select ENTROPY_GENERATOR
	help
	  Compile the modem core, which provides the LoRaWAN stack on top of
	  the radio drivers. The LoRaWAN subsystem needs it to reach the
	  modem, so it comes on by default once both sides are present.
```

## modules/lvgl/Kconfig
```kconfig
# Copyright (c) 2023 Fabian Blatz <fabianblatz@gmail.com>
# Copyright 2023 NXP
# SPDX-License-Identifier: Apache-2.0

config ZEPHYR_LVGL_MODULE
	bool

config LVGL
	bool "LVGL support"
	help
	  This option enables the LVGL graphics library.

if LVGL

config LV_Z_DRAW_BUF_ALIGN
	int "Draw buffer address alignment (bytes)"
	default 4
	help
	  Align LVGL draw buffer addresses to this many bytes.

config LV_Z_DPI_DEF
	int "Default DPI (px/inch)"
	default 130
	help
	  Used to initialize default widget sizes and style paddings.

config LV_Z_ATTRIBUTE_MEM_ALIGN_SIZE
	int "Memory alignment size (bytes)"
	default 4
	range 1 256
	help
	  Alignment in bytes for LVGL buffers and constant data.

module = LV_Z
module-str = LVGL
source "subsys/logging/Kconfig.template.log_config"

config LV_Z_USE_ROUNDER_CB
	bool
	default y if LV_Z_AREA_X_ALIGNMENT_WIDTH != 1 || LV_Z_AREA_Y_ALIGNMENT_WIDTH != 1

config APP_LINK_WITH_LVGL
	bool "Link 'app' with LVGL"
	default y
	help
	  Add LVGL header files to the 'app' include path. It may be
	  disabled if the include paths for LVGL are causing aliasing
	  issues for 'app'.

config LV_Z_USE_FILESYSTEM
	bool "LVGL file system support"
	depends on FILE_SYSTEM
	default y if FILE_SYSTEM
	help
	  Enable LittlevGL file system

choice LV_Z_COLOR_FORMAT
	prompt "Color format"
	default LV_Z_COLOR_FORMAT_RGB565
	help
	  Default color format LVGL renders in, which also selects the LVGL
	  color depth. Takes precedence over the default color format option
	  of the LVGL module.

config LV_Z_COLOR_FORMAT_I1
	bool "I1 (1 bit per pixel, monochrome)"

config LV_Z_COLOR_FORMAT_L8
	bool "L8 (8 bit grayscale)"

config LV_Z_COLOR_FORMAT_RGB565
	bool "RGB565"

config LV_Z_COLOR_FORMAT_RGB565_SWAPPED
	bool "RGB565 (big-endian)"

config LV_Z_COLOR_FORMAT_RGB888
	bool "RGB888"

config LV_Z_COLOR_FORMAT_XRGB8888
	bool "XRGB8888"

config LV_Z_COLOR_FORMAT_ARGB8888
	bool "ARGB8888"

endchoice

config LV_COLOR_16_SWAP
	bool "Swap the 2 bytes of RGB565 color."
	depends on LV_Z_COLOR_FORMAT_RGB565

config LV_Z_COLOR_MONO_HW_INVERSION
	bool "Hardware pixel inversion (disables software pixel inversion)."
	depends on LV_Z_COLOR_FORMAT_I1

config LV_Z_FLUSH_THREAD
	bool "Flush LVGL frames in a separate thread"
	help
	  Flush LVGL frames in a separate thread, while the primary thread
	  renders the next LVGL frame. Can be disabled if the performance
	  gain this approach offers is not required

if LV_Z_FLUSH_THREAD

config LV_Z_FLUSH_THREAD_STACK_SIZE
	int "Stack size for flushing thread"
	default 1024
	help
	  Stack size for LVGL flush thread, which will call display_write

config LV_Z_FLUSH_THREAD_PRIORITY
	int "LVGL flush thread priority"
	default -1
	help
	  Priority of LVGL flush thread.

endif # LV_Z_FLUSH_THREAD

config LV_Z_AREA_X_ALIGNMENT_WIDTH
	int "Frame X alignment size"
	default 1
	help
	  Number of pixels, X axis should be rounded to. Should be used to override
	  the current frame dimensions to meet display and/or LCD host
	  controller requirements. The value must be power of 2.

config LV_Z_AREA_Y_ALIGNMENT_WIDTH
	int "Frame Y alignment size"
	default 1
	help
	  Number of pixels, Y axis should be rounded to. Should be used to override
	  the current frame dimensions to meet display and/or LCD host
	  controller requirements. The value must be power of 2.

config LV_Z_AUTO_INIT
	bool "Initialize LVGL before application startup"
	default y
	help
	  Configure LVGL callbacks and display initialization before the application starts.
	  This can be useful to disable if you need to change a display's pixel format
	  prior to initialization. If using static allocation, ensure that LV_Z_BITS_PER_PIXEL
	  is set correctly.

config LV_Z_INIT_PRIORITY
	int "Default init priority for LVGL"
	default 90
	depends on LV_Z_AUTO_INIT
	help
	  Priority used for the automatic initialization of LVGL.

config LV_Z_LVGL_MUTEX
	bool "Provide LVGL API mutex (un)locking functions"
	help
	  LVGL API functions are not thread-safe, provide functions for locking and unlocking.

config LV_Z_RUN_LVGL_ON_WORKQUEUE
	bool "Use a dedicated workqueue to run LVGL core"
	imply LV_Z_AUTO_INIT
	imply LV_Z_LVGL_MUTEX
	help
	  Runs the LVGL in a separate workqueue automatically
	  without requiring user to add a timed loop for that. User can
	  disable this option if periodic calls of LV timer
	  is application responsibillity

if LV_Z_RUN_LVGL_ON_WORKQUEUE

config LV_Z_LVGL_WORKQUEUE_STACK_SIZE
	int "Stack size of LVGL workqueue"
	default 4096
	help
	  Stack size of the LVGL dedicated workqueue

config LV_Z_LVGL_WORKQUEUE_PRIORITY
	int "Priority of the LVGL workqueue"
	default 0
	help
	  Priority of the LVGL dedicated workequeue.

endif # LV_Z_RUN_LVGL_ON_WORKQUEUE

config LV_Z_DRAW_DMA2D
	bool "DMA2D renderer"

config LV_Z_DRAW_DMA2D_INTERRUPT
	bool "DMA2D interrupt"
	depends on LV_Z_DRAW_DMA2D

config LV_Z_DRAW_DMA2D_HAL_INCLUDE
	string "DMA2D HAL header"
	default "stm32h7xx_hal.h"
	depends on LV_Z_DRAW_DMA2D
	help
	  Must be defined to include path of CMSIS header of target processor
	  e.g. "stm32f769xx.h" or "stm32f429xx.h"

config LV_Z_DRAW_DAVE2D
	bool "Dave2D renderer"
	imply RENESAS_DRW

config LV_Z_USE_OSAL
	bool "Use OSAL enabling parallel rendering"
	depends on DYNAMIC_THREAD
	help
	  Use the Zephyr LVGL OSAL to enable parallel rendering
	  pipelines.

config LV_Z_DRAW_PXP
	bool "PXP renderer"

config LV_USE_GPU_NXP_PXP
	bool
	default y if LV_Z_DRAW_PXP

config LV_Z_PXP_INTERRUPT_PRIORITY
	int "PXP interrupt priority"
	depends on LV_Z_DRAW_PXP
	default 3
	help
	  Sets the interrupt priority for PXP

rsource "Kconfig.memory"
rsource "Kconfig.input"
rsource "Kconfig.shell"

rsource "nemagfx/Kconfig"

endif
```

## modules/lvgl/esp32_ppa/Kconfig
```kconfig
# Copyright (c) 2026 Espressif Systems (Shanghai) Co., Ltd.
#
# SPDX-License-Identifier: Apache-2.0

menuconfig LV_Z_USE_ESP32_PPA
	bool "Pixel processing accelerator draw unit"
	depends on ESP32_PPA
	help
	  Draw fills and image blits with the pixel processing
	  accelerator instead of the software renderer.

if LV_Z_USE_ESP32_PPA

config LV_Z_USE_ESP32_PPA_IMG
	bool "Accelerate image draws"
	default y
	help
	  Draw unscaled, unrotated image blits with the accelerator.

config LV_DRAW_BUF_ALIGN
	default ESP32_CACHE_L2_LINE_SIZE
	help
	  The accelerator reads and writes the draw buffers over 2D-DMA,
	  so they are aligned to the L2 cache line.

endif # LV_Z_USE_ESP32_PPA
```

## modules/lvgl/gpu-vglite/Kconfig
```kconfig
# Copyright 2026 NXP
# SPDX-License-Identifier: Apache-2.0

config LV_USE_DRAW_VG_LITE
	bool

config LV_USE_GPU_VG_LITE
	bool
	default y if LV_USE_DRAW_VG_LITE

config LV_USE_VG_LITE_DRIVER
	bool "VG-Lite GPU acceleration"
	help
	  Select vglite driver.

	  Use LVGL-internal VG-Lite driver (else external module).
```

## modules/lvgl/nemagfx/Kconfig
```kconfig
# Copyright (c) 2026 Silicon Signals Pvt. Ltd.
#
# SPDX-License-Identifier: Apache-2.0

menu "LVGL Zephyr NemaGFX support"

config LV_Z_USE_NEMA_GFX
	bool
	depends on DT_HAS_ST_NEOCHROM_GPU2D_ENABLED
	select STM32_NEOCHROM_GPU2D
	help
	  Set when the LVGL NemaGFX renderer (CONFIG_LV_USE_NEMA_GFX) is
	  enabled. Enables the NeoChrom GPU driver it uses.

config LV_Z_NEMA_HAL_CUSTOM
	bool
	depends on LV_Z_USE_NEMA_GFX
	help
	  Set when the LVGL NemaGFX HAL choice is custom
	  (CONFIG_LV_NEMA_HAL_CUSTOM). The Zephyr NemaGFX HAL is used then.

config LV_Z_NEMA_USE_CACHE
	bool
	depends on LV_Z_USE_NEMA_GFX
	help
	  Board default for CONFIG_LV_NEMA_USE_CACHE. Applications set
	  CONFIG_LV_NEMA_USE_CACHE instead.

config LV_Z_NEMA_CACHE_HAL_INCLUDE
	string
	depends on LV_Z_USE_NEMA_GFX
	help
	  Board default for CONFIG_LV_NEMA_CACHE_HAL_INCLUDE: the header
	  providing the CMSIS data cache maintenance functions used by the
	  NemaGFX renderer. Empty leaves the LVGL default.

config LV_Z_NEMA_LIB_M33_REVC
	bool
	help
	  Board default for the LVGL NemaGFX library choice:
	  CONFIG_LV_NEMA_LIB_M33_REVC.

config LV_Z_NEMA_LIB_M33_NEMAPVG
	bool
	help
	  Board default for the LVGL NemaGFX library choice:
	  CONFIG_LV_NEMA_LIB_M33_NEMAPVG.

config LV_Z_NEMA_LIB_M55
	bool
	help
	  Board default for the LVGL NemaGFX library choice:
	  CONFIG_LV_NEMA_LIB_M55.

config LV_Z_NEMA_LIB_M7
	bool
	help
	  Board default for the LVGL NemaGFX library choice:
	  CONFIG_LV_NEMA_LIB_M7.

if LV_Z_USE_NEMA_GFX && LV_Z_NEMA_HAL_CUSTOM

config FPU
	default y

config LV_Z_NEMA_GFX_MULTI_THREAD
	bool "Multi-thread support for NemaGFX"
	default n

config LV_Z_NEMA_HAL_RING_SIZE
	int "NemaGFX ring size"
	default 1024
	help
	  Size of the NemaGFX command ring.

endif # LV_Z_USE_NEMA_GFX

endmenu
```

## modules/mbedtls/Kconfig.tf-psa-crypto.interface
```kconfig
# Copyright (c) 2026 Nordic Semiconductor ASA
# SPDX-License-Identifier: Apache-2.0

config MBEDTLS_PSA_CRYPTO_CLIENT
	def_bool y

config TF_PSA_CRYPTO_CONFIG_FILE
	string "TF-PSA-Crypto configuration file"
	default "config-tf-psa-crypto.h"
	help
	  Specify the configuration header file to be used when building
	  TF-PSA-Crypto. The default one can be tweaked with Kconfig.

if TF_PSA_CRYPTO_CONFIG_FILE = "config-tf-psa-crypto.h"

config TF_PSA_CRYPTO_DRIVER_CONFIG_FILE
	string
	help
	  Optional driver configuration header to be included at the end of
	  TF_PSA_CRYPTO_CONFIG_FILE. This file is intended to be used to supply
	  configuration options needed by the driver dispatch interface.

config TF_PSA_CRYPTO_DRIVER_CONFIG
	def_bool TF_PSA_CRYPTO_DRIVER_CONFIG_FILE != ""

endif # TF_PSA_CRYPTO_CONFIG_FILE = "config-tf-psa-crypto.h"

config TF_PSA_CRYPTO_USER_CONFIG_FILE
	string "User configuration file for TF-PSA-Crypto"
	help
	  If defined, this is a header which will be included after TF_PSA_CRYPTO_CONFIG_FILE.
	  This allows you to modify the default configuration,
	  including the ability to undefine options that are enabled.

config TF_PSA_CRYPTO_USER_CONFIG
	def_bool TF_PSA_CRYPTO_USER_CONFIG_FILE != ""

config TF_PSA_CRYPTO_DISPATCH_DIR
	string
	default "${ZEPHYR_TF_PSA_CRYPTO_MODULE_DIR}/dispatch"
```
