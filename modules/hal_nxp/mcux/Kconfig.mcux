## modules/liblc3/Kconfig
```kconfig
# Copyright (c) 2022 Bose Corporation
# Copyright (c) 2024 Codecoup
# SPDX-License-Identifier: Apache-2.0

config ZEPHYR_LIBLC3_MODULE
	bool

config LIBLC3
	bool "liblc3 Support"
	depends on FPU
	select REQUIRES_FULL_LIBC
	help
	  Enable the Low Complexity Communication Codec (LC3)

if LIBLC3

config LIBLC3_PLUS
	bool "LC3plus Support [EXPERIMENTAL]"
	select EXPERIMENTAL
	help
	  Enable support of 2.5ms and 5ms frame durations.

config LIBLC3_PLUS_HR
	bool "LC3plus High Resolution Support [EXPERIMENTAL]"
	select EXPERIMENTAL
	help
	  Enable support of the High-Resolution mode.

endif
```

## modules/liblc3codec/Kconfig
```kconfig
# Copyright (c) 2022 Bose Corporation
# SPDX-License-Identifier: Apache-2.0

config LIBLC3CODEC
	bool "liblc3codec Support"
	depends on FPU
	help
	  This option enables the Android liblc3codec library for Bluetooth LE Audio
```

## modules/libsrtp/Kconfig
```kconfig
# SPDX-FileCopyrightText: Copyright 2026 Sayed Naser Moravej
# SPDX-License-Identifier: Apache-2.0

config LIBSRTP
	bool "libsrtp support"
	select MBEDTLS
	select PSA_CRYPTO
	select MBEDTLS_PSA_CRYPTO_C
	select MBEDTLS_ENABLE_HEAP
	select PSA_WANT_KEY_TYPE_AES
	select PSA_WANT_ALG_CTR
	select PSA_WANT_ALG_HMAC
	select PSA_WANT_ALG_SHA_1

	help
	  Enable libsrtp library integration as a Zephyr module.

if LIBSRTP

config MBEDTLS_PSA_ASSUME_EXCLUSIVE_BUFFERS
	bool "Assume exclusive buffers for PSA Crypto operations"
	default n

config MBEDTLS_HEAP_SIZE
	default 16384 if LIBSRTP

endif #LIBSRTP
```

## modules/loramac-node/Kconfig
```kconfig
#
# Copyright (c) 2019 Manivannan Sadhasivam
#
# SPDX-License-Identifier: Apache-2.0
#

config ZEPHYR_LORAMAC_NODE_MODULE
	bool

config HAS_SEMTECH_RADIO_DRIVERS
	bool "Semtech LoRa Radio Drivers"
	help
	  This option enables the use of Semtech's Radio drivers

config HAS_SEMTECH_SX1272
	bool
	depends on HAS_SEMTECH_RADIO_DRIVERS

config HAS_SEMTECH_SX1276
	bool
	depends on HAS_SEMTECH_RADIO_DRIVERS

config HAS_SEMTECH_SX126X
	bool
	depends on HAS_SEMTECH_RADIO_DRIVERS

config HAS_SEMTECH_LORAMAC
	bool "Semtech LoRaMac Stack"
	depends on HAS_SEMTECH_RADIO_DRIVERS
	help
	  This option enables the use of Semtech's LoRaMac stack

config HAS_SEMTECH_SOFT_SE
	bool "Semtech Secure Element software implementation"
	depends on HAS_SEMTECH_LORAMAC
	help
	  This option enables the use of Semtech's Secure Element
	  software implementation
```

## modules/lvgl/Kconfig.input
```kconfig
# Copyright (c) 2018-2019 Jan Van Winkel <jan.van_winkel@dxplore.eu>
# Copyright (c) 2020 Teslabs Engineering S.L.
# SPDX-License-Identifier: Apache-2.0

menu "Input device settings"

DT_CHOSEN_Z_TOUCH := zephyr,touch
DT_CHOSEN_Z_DISPLAY := zephyr,display

config LV_Z_POINTER_FROM_CHOSEN_TOUCH
	bool "Create LVGL pointer from DT 'zephyr,touch' chosen device"
	depends on INPUT
	depends on $(dt_chosen_enabled,$(DT_CHOSEN_Z_TOUCH))
	default y if !DT_HAS_ZEPHYR_LVGL_POINTER_INPUT_ENABLED
	help
	  Enable creation of LVGL pointer input device
	  based on 'zephyr,touch' chosen property in devicetree.

config LV_Z_POINTER_FROM_CHOSEN_TOUCH_INFER_DISPLAY
	bool "Link input pointer to chosen display"
	depends on LV_Z_POINTER_FROM_CHOSEN_TOUCH
	depends on $(dt_chosen_enabled,$(DT_CHOSEN_Z_DISPLAY))
	default y
	help
	  Process input events of the pointer device created
	  from the 'zephyr,touch' chosen property and link it to the
	  'zephyr,display' chosen device.

config LV_Z_POINTER_INPUT
	bool "Input lvgl pointer"
	default y
	depends on INPUT
	depends on DT_HAS_ZEPHYR_LVGL_POINTER_INPUT_ENABLED || LV_Z_POINTER_FROM_CHOSEN_TOUCH

config LV_Z_POINTER_INPUT_MSGQ_COUNT
	int "Input pointer queue message count"
	default 10
	depends on LV_Z_POINTER_INPUT
	help
	  Size of the pointer message queue buffering input events.

config LV_Z_BUTTON_INPUT
	bool "Input lvgl button"
	default y
	depends on INPUT
	depends on DT_HAS_ZEPHYR_LVGL_BUTTON_INPUT_ENABLED

config LV_Z_BUTTON_INPUT_MSGQ_COUNT
	int "Input button queue message count"
	default 4
	depends on LV_Z_BUTTON_INPUT
	help
	  Size of the button message queue buffering input events.

config LV_Z_ENCODER_INPUT
	bool "Input lvgl encoder"
	default y
	depends on INPUT
	depends on DT_HAS_ZEPHYR_LVGL_ENCODER_INPUT_ENABLED

config LV_Z_ENCODER_INPUT_MSGQ_COUNT
	int "Input encoder queue message count"
	default 4
	depends on LV_Z_ENCODER_INPUT
	help
	  Size of the encoder message queue buffering input events.

config LV_Z_KEYPAD_INPUT
	bool "Input lvgl keypad"
	default y
	depends on INPUT
	depends on DT_HAS_ZEPHYR_LVGL_KEYPAD_INPUT_ENABLED

config LV_Z_KEYPAD_INPUT_MSGQ_COUNT
	int "Input keypad queue message count"
	default 4
	depends on LV_Z_KEYPAD_INPUT
	help
	  Size of the keypad message queue buffering input events.

endmenu
```

## modules/lvgl/Kconfig.memory
```kconfig
# Copyright (c) 2018-2019 Jan Van Winkel <jan.van_winkel@dxplore.eu>
# Copyright (c) 2020 Teslabs Engineering S.L.
# SPDX-License-Identifier: Apache-2.0

menu "Memory manager settings"

config LV_Z_BITS_PER_PIXEL
	int "Bits per pixel"
	default 32 if LV_COLOR_DEPTH_32
	default 24 if LV_COLOR_DEPTH_24
	default 16 if LV_COLOR_DEPTH_16
	default 8 if LV_COLOR_DEPTH_8
	default 1 if LV_COLOR_DEPTH_1
	default 32
	range 1 32
	help
	  Number of bits per pixel.

choice LV_Z_MEMORY_POOL
	prompt "Memory pool"
	default LV_Z_MEM_POOL_SYS_HEAP
	help
	  Memory pool to use for lvgl allocated objects

	config LV_Z_MEM_POOL_HEAP_LIB_C
	  bool "C library Heap"
	  depends on !MINIMAL_LIBC || (COMMON_LIBC_MALLOC_ARENA_SIZE != 0)
	  help
		Use C library malloc and free to allocate objects on the C library heap

	config LV_Z_MEM_POOL_SYS_HEAP
		bool "User space lvgl pool"
		select SYS_HEAP_INFO
		help
		  Use a dedicated memory pool from a private sys heap.

endchoice

config LV_Z_MEM_POOL_SIZE
	int "Memory pool size"
	default 2048
	depends on LV_Z_MEM_POOL_SYS_HEAP
	help
	  Size of the memory pool in bytes

config LV_Z_MEMORY_POOL_CUSTOM_SECTION
	bool "Link memory pool to custom section"
	depends on LV_Z_MEM_POOL_SYS_HEAP
	help
	  Place LVGL memory pool in custom section, with tag ".lvgl_heap".
	  This can be used by custom linker scripts to relocate the LVGL
	  memory pool to a custom location, such as tightly coupled or
	  external memory.

config LV_Z_MEMORY_POOL_ZEPHYR_REGION
	bool "Place LVGL memory pool in a Zephyr memory-region"
	depends on LV_Z_MEM_POOL_SYS_HEAP
	depends on !LV_Z_MEMORY_POOL_CUSTOM_SECTION
	help
	  Place LVGL memory pool in a section, automatically
	  created from a 'zephyr,memory-region' compatible node,
	  whose name is specified in LV_Z_MEMORY_POOL_ZEPHYR_REGION_NAME.

config LV_Z_MEMORY_POOL_ZEPHYR_REGION_NAME
	string "Name of the zephyr memory-region for memory pool"
	depends on LV_Z_MEMORY_POOL_ZEPHYR_REGION
	help
	  Name of the Zephyr memory-region where LVGL memory pool is placed.

config LV_Z_VDB_SIZE
	int "Rendering buffer size"
	default 100 if LV_Z_FULL_REFRESH
	default 100 if LV_Z_DIRECT_RENDERING
	default 10
	range 1 100
	help
	  Size of the buffer used for rendering screen content as a percentage
	  of total display size.

config LV_Z_DOUBLE_VDB
	bool "Use two rendering buffers"
	help
	  Use two buffers to render and flush data in parallel

choice LV_Z_RENDERING_MODE
	prompt "Rendering Mode"
	default LV_Z_PARTIAL_REFRESH
	help
	  Select the rendering mode for LVGL.

config LV_Z_PARTIAL_REFRESH
	bool "Partial Refresh Mode"
	help
	  Use the buffer(s) to render to the display using buffers smaller
	  than the size of the display. Use of buffers at least 1/10 display
	  size is recommended. In the Flush Callback, the rendered images
	  need to be copied to the given area of the display. In this mode
	  if a button is pressed, only the button's area will be redrawn.

config LV_Z_DIRECT_RENDERING
	bool "Direct Rendering Mode"
	help
	  The buffer size(s) must match the size of the display. LVGL will
	  render into the correct location of the buffer. Using this method,
	  the buffer(s) always contain the whole display image. If two buffers
	  are used, the rendered areas are automatically copied to the other
	  buffer after flushing. This mode can benefit from the performance
	  gained by use zero copying (available also for LV_Z_FULL_REFRESH)
	  and partial redraws (same as for LV_Z_PARTIAL_REFRESH).

config LV_Z_FULL_REFRESH
	bool "Force Full Refresh Mode"
	help
	  Force full refresh of the display on update. LVGL will always redraw
	  the whole screen even if only 1 pixel has been changed
	  When combined with LV_Z_VDB_SIZE, this setting can improve
	  performance for display controllers that require a framebuffer
	  to be present in system memory, since the controller can render
	  the LVGL framebuffer directly.

endchoice

config LV_Z_VDB_ALIGN
	int "Rending buffer alignment"
	default 4
	default 8 if DISPLAY_MCUX_ELCDIF
	depends on LV_Z_BUFFER_ALLOC_STATIC
	help
	  Rendering buffer alignment. Depending on chosen color depth,
	  buffer may be accessed as a uint8_t *, uint16_t *, or uint32_t *,
	  so buffer must be aligned to prevent unaligned memory access

config LV_Z_VDB_CUSTOM_SECTION
	bool "Link rendering buffers to custom section"
	depends on LV_Z_BUFFER_ALLOC_STATIC
	help
	  Place LVGL rendering buffers in custom section, with tag ".lvgl_buf".
	  This can be used by custom linker scripts to relocate the LVGL
	  rendering buffers to a custom location, such as tightly coupled or
	  external memory.

config LV_Z_VDB_ZEPHYR_REGION
	bool "Place LVGL rendering buffers in a Zephyr memory-region"
	depends on LV_Z_BUFFER_ALLOC_STATIC
	depends on !LV_Z_VDB_CUSTOM_SECTION
	help
	  Place LVGL rendering buffers in a section, automatically
	  created from a 'zephyr,memory-region' compatible node,
	  whose name is specified in LV_Z_VDB_ZEPHYR_REGION_NAME.

config LV_Z_VDB_ZEPHYR_REGION_NAME
	string "Name of the Zephyr memory-region for rendering buffers"
	depends on LV_Z_VDB_ZEPHYR_REGION
	help
	  Name of the Zephyr memory-region where LVGL rendering buffers are placed.

config LV_Z_MONOCHROME_CONVERSION_BUFFER
	bool "Use intermediate conversion buffer for monochrome displays"
	default y
	help
	  When using a monochrome display an intermediate buffer with LV_Z_VDB_SIZE
	  is needed to perform the conversion.

choice LV_Z_RENDERING_BUFFER_ALLOCATION
	prompt "Rendering Buffer Allocation"
	default LV_Z_BUFFER_ALLOC_STATIC
	help
	  Type of allocation that should be used for allocating rendering buffers

config LV_Z_BUFFER_ALLOC_STATIC
	bool "Static"
	help
	  Rendering buffers are statically allocated based on the following
	  configuration parameters:
	  * Horizontal screen resolution
	  * Vertical screen resolution
	  * Rendering buffer size
	  * Bytes per pixel

config LV_Z_BUFFER_ALLOC_DYNAMIC
	bool "Dynamic"
	help
	  Rendering buffers are dynamically allocated based on the actual
	  display parameters

endchoice

endmenu
```

## modules/lz4/Kconfig
```kconfig
# Copyright (c) 2020 Linumiz
# SPDX-License-Identifier: Apache-2.0

config ZEPHYR_LZ4_MODULE
	bool

menuconfig LZ4
	bool "Lz4 data compression and decompression"
	help
	  This option enables lz4 compression & decompression library
	  support.
if LZ4

config LZ4_MEMORY_USAGE
	int "Lz4 memory usage"
	range 10 20
	default 14
	help
	  Increasing memory usage improves compression ratio, but usually at the
	  cost of speed, due to cache locality. Memory usage 2^value (10 -> 1KB,
	  12 -> 4KB, 20 -> 1MB).

config LZ4_DISABLE_DYNAMIC_MEMORY_ALLOCATION
	bool "Disable dynamic memory allocation"
	help
	  Disable lz4 functions that use dynamic memory allocation functions.

choice LZ4_HEAPMODE
	prompt "How stateless compression functions allocate memory for their hash table"
	default LZ4_HEAPMODE_HEAP

config LZ4_HEAPMODE_STACK
	bool "in memory stack"
	help
	  Allocate memory from stack (fastest).

config LZ4_HEAPMODE_HEAP
	bool "in memory heap"
	depends on !LZ4_DISABLE_DYNAMIC_MEMORY_ALLOCATION
	help
	  Allocate memory from heap (requires malloc()).
endchoice

config LZ4_HIGH_COMPRESSION_VARIANT
	bool "Lz4 high compression variant"
	help
	  For more compression ratio at the cost of compression speed,
	  the High Compression variant called lz4hc is available. This variant
	  also compresses data using the lz4 block format.

if LZ4_HIGH_COMPRESSION_VARIANT
choice LZ4HC_HEAPMODE
	prompt "How stateless HC compression functions allocate memory for their workspace"
	default LZ4HC_HEAPMODE_HEAP

config LZ4HC_HEAPMODE_STACK
	bool "in memory stack"
	help
	  Allocate memory from stack (fastest).

config LZ4HC_HEAPMODE_HEAP
	bool "in memory heap"
	depends on !LZ4_DISABLE_DYNAMIC_MEMORY_ALLOCATION
	help
	  Allocate memory from heap (requires malloc()).
endchoice
endif

config LZ4_XX_HASH
	bool "xxHash hashing algorithm"
	help
	  Build xxHash library included in lz4 sources.

config LZ4_FRAME_SUPPORT
	bool "LZ4 frame support"
	select LZ4_XX_HASH
	select LZ4_HIGH_COMPRESSION_VARIANT
	help
	  In order to produce compressed data compatible with lz4 command line
	  utility, it's necessary to use the official interoperable frame format.
	  This format is generated and decoded automatically by the lz4frame library.
	  Its public API is described in lib/lz4frame.h.

if LZ4_FRAME_SUPPORT
choice LZ4F_HEAPMODE
	prompt "Control how LZ4F_compressFrame() allocates the Compression State"
	default LZ4F_HEAPMODE_STACK

config LZ4F_HEAPMODE_STACK
	bool "in memory stack"
	help
	  Allocate memory from stack (fastest).

config LZ4F_HEAPMODE_HEAP
	bool "in memory heap"
	depends on !LZ4_DISABLE_DYNAMIC_MEMORY_ALLOCATION
	help
	  Allocate memory from heap (requires malloc()).
endchoice
endif

endif
```

## modules/lzma/Kconfig
```kconfig
# Copyright (c) 2024 Telink Semiconductor
# SPDX-License-Identifier: Apache-2.0

config ZEPHYR_LZMA_MODULE
	bool

config LZMA
	bool "LZMA data compression and decompression"
	help
	  This option enables lzma compression & decompression library
	  support.
```
