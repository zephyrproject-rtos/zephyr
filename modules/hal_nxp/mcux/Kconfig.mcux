## modules/hal_realtek/bee/Kconfig.bee
```kconfig
# Copyright(c) 2026, Realtek Semiconductor Corporation.
# SPDX-License-Identifier: Apache-2.0

config ZEPHYR_HAL_REALTEK_BEE_MODULE
	bool

config HAL_REALTEK_BEE_ADC
	bool

config HAL_REALTEK_BEE_BT
	bool

config HAL_REALTEK_BEE_CAN
	bool

config HAL_REALTEK_BEE_CODEC
	bool

config HAL_REALTEK_BEE_DMA
	bool

config HAL_REALTEK_BEE_GPIO
	bool

config HAL_REALTEK_BEE_I2C
	bool

config HAL_REALTEK_BEE_I2S
	bool

config HAL_REALTEK_BEE_IR
	bool

config HAL_REALTEK_BEE_KEYSCAN
	bool

config HAL_REALTEK_BEE_NVIC
	bool

config HAL_REALTEK_BEE_PINMUX
	bool

config HAL_REALTEK_BEE_AON_QDEC
	bool

config HAL_REALTEK_BEE_QDEC
	bool

config HAL_REALTEK_BEE_RCC
	bool

config HAL_REALTEK_BEE_RTC
	bool

config HAL_REALTEK_BEE_SDHC
	bool

config HAL_REALTEK_BEE_SPI
	bool

config HAL_REALTEK_BEE_TIM
	bool

config HAL_REALTEK_BEE_ENHTIM
	bool

config HAL_REALTEK_BEE_UART
	bool

config HAL_REALTEK_BEE_USB
	bool

config HAL_REALTEK_BEE_AON_WDT
	bool

config HAL_REALTEK_BEE_CORE_WDT
	bool

menuconfig USE_REALTEK_BEE_OS_INTERFACE
	bool "Realtek Bee OS Interface (OSIF) Layer"
	select POLL
	help
	  Enable the Realtek Bee OS Interface (OSIF) abstraction layer.
	  This layer provides a unified API wrapper to ensure portability
	  across different underlying operating systems for Realtek Bee
	  family SoCs.

if USE_REALTEK_BEE_OS_INTERFACE

config REALTEK_BEE_OSIF_TIMER_MAX_COUNT
	int "Maximum number of timers"
	default 64
	range 0 255
	help
	  Set the maximum number of timer objects that can be allocated
	  simultaneously in the OSIF layer.

config REALTEK_BEE_OSIF_TASK_MAX_COUNT
	int "Maximum number of tasks"
	default 3
	range 0 255
	help
	  Set the maximum number of task (thread) objects supported by OSIF.

config REALTEK_BEE_OSIF_MSGQ_MAX_COUNT
	int "Maximum number of message queues"
	default 3
	range 0 255
	help
	  Set the maximum number of message queue objects supported by OSIF.

config REALTEK_BEE_OSIF_SEM_MAX_COUNT
	int "Maximum number of semaphores"
	default 3
	range 0 255
	help
	  Set the maximum number of semaphore objects supported by OSIF.

config REALTEK_BEE_OSIF_MUTEX_MAX_COUNT
	int "Maximum number of mutexes"
	default 3
	range 0 255
	help
	  Set the maximum number of mutex objects supported by OSIF.

endif # USE_REALTEK_BEE_OS_INTERFACE
```

## modules/hal_sifli/Kconfig
```kconfig
# Copyright (c) 2025 Core Devices LLC
# SPDX-License-Identifier: Apache-2.0

config ZEPHYR_HAL_SIFLI_MODULE
	bool

config HAS_SIFLI_HAL
	bool
	select HAS_CMSIS_CORE

if HAS_SIFLI_HAL

config USE_SIFLI_HAL
	bool "SiFli HAL"
	help
	  Enable SiFli HAL module

if USE_SIFLI_HAL

config USE_SIFLI_HAL_ADC
	bool "ADC SiFli HAL module"
	help
	  Enable ADC SiFli HAL module driver

config USE_SIFLI_HAL_AES
	bool "AES SiFli HAL module"
	help
	  Enable AES SiFli HAL module driver

config USE_SIFLI_HAL_AON
	bool "AON SiFli HAL module"
	help
	  Enable AON SiFli HAL module driver

config USE_SIFLI_HAL_ATIM
	bool "ATIM SiFli HAL module"
	depends on SOC_SERIES_SF32LB52X
	help
	  Enable ATIM SiFli HAL module driver

config USE_SIFLI_HAL_AUDCODEC
	bool "AUDCODEC SiFli HAL module"
	depends on SOC_SERIES_SF32LB52X
	help
	  Enable AUDCODEC SiFli HAL module driver

config USE_SIFLI_HAL_AUDPRC
	bool "AUDPRC SiFli HAL module"
	depends on SOC_SERIES_SF32LB52X
	help
	  Enable AUDPRC SiFli HAL module driver

config USE_SIFLI_HAL_BUSMON
	bool "BUSMON SiFli HAL module"
	help
	  Enable BUSMON SiFli HAL module driver

config USE_SIFLI_HAL_CACHE
	bool "CACHE SiFli HAL module"
	help
	  Enable CACHE SiFli HAL module driver

config USE_SIFLI_HAL_CRC
	bool "CRC SiFli HAL module"
	help
	  Enable CRC SiFli HAL module driver

config USE_SIFLI_HAL_DMA
	bool "DMA SiFli HAL module"
	help
	  Enable DMA SiFli HAL module driver

config USE_SIFLI_HAL_EPIC
	bool "EPIC SiFli HAL module"
	help
	  Enable EPIC SiFli HAL module driver

config USE_SIFLI_HAL_EZIP
	bool "EZIP SiFli HAL module"
	help
	  Enable EZIP SiFli HAL module driver

config USE_SIFLI_HAL_EXTDMA
	bool "EXTDMA SiFli HAL module"
	help
	  Enable EXTDMA SiFli HAL module driver

config USE_SIFLI_HAL_GPIO
	bool "GPIO SiFli HAL module"
	help
	  Enable GPIO SiFli HAL module driver

config USE_SIFLI_HAL_GPT
	bool "GPT SiFli HAL module"
	help
	  Enable GPT SiFli HAL module driver

config USE_SIFLI_HAL_HASH
	bool "HASH SiFli HAL module"
	depends on SOC_SERIES_SF32LB52X
	help
	  Enable HASH SiFli HAL module driver

config USE_SIFLI_HAL_HCD
	bool "HCD SiFli HAL module"
	help
	  Enable HCD SiFli HAL module driver

config USE_SIFLI_HAL_I2C
	bool "I2C SiFli HAL module"
	help
	  Enable I2C SiFli HAL module driver

config USE_SIFLI_HAL_I2S
	bool "I2S SiFli HAL module"
	help
	  Enable I2S SiFli HAL module driver

config USE_SIFLI_HAL_LCD
	bool "LCD SiFli HAL module"
	help
	  Enable LCD SiFli HAL module driver

config USE_SIFLI_HAL_LCPU_CONFIGURE
	bool "LCPU_CONFIGURE SiFli HAL module"
	help
	  Enable LCPU_CONFIGURE SiFli HAL module

config USE_SIFLI_HAL_LCPU_PATCH
	bool "LCPU_PATCH SiFli HAL module"
	help
	  Enable LCPU_PATCH SiFli HAL module

config USE_SIFLI_HAL_LRC_CAL
	bool "LRC_CAL SiFli HAL module"
	help
	  Enable LRC_CAL SiFli HAL module

config USE_SIFLI_HAL_LPTIM
	bool "LPTIM SiFli HAL module"
	help
	  Enable LPTIM SiFli HAL module driver

config USE_SIFLI_HAL_MAILBOX
	bool "MAILBOX SiFli HAL module"
	help
	  Enable MAILBOX SiFli HAL module driver

config USE_SIFLI_HAL_MATH
	bool "MATH SiFli HAL module"
	help
	  Enable MATH SiFli HAL module driver

config USE_SIFLI_HAL_MMC
	bool "MMC SiFli HAL module"
	help
	  Enable MMC SiFli HAL module driver

config USE_SIFLI_HAL_MPI
	bool "MPI SiFli HAL module"
	depends on SOC_SERIES_SF32LB52X
	help
	  Enable MPI SiFli HAL module driver

config USE_SIFLI_HAL_PCD
	bool "PCD SiFli HAL module"
	help
	  Enable PCD SiFli HAL module driver

config USE_SIFLI_HAL_PDM
	bool "PDM SiFli HAL module"
	help
	  Enable PDM SiFli HAL module driver

config USE_SIFLI_HAL_PINMUX
	bool "PINMUX SiFli HAL module"
	help
	  Enable PINMUX SiFli HAL module driver

config USE_SIFLI_HAL_PTC
	bool "PTC SiFli HAL module"
	help
	  Enable PTC SiFli HAL module driver

config USE_SIFLI_HAL_RNG
	bool "RNG SiFli HAL module"
	help
	  Enable RNG SiFli HAL module driver

config USE_SIFLI_HAL_RTC
	bool "RTC SiFli HAL module"
	help
	  Enable RTC SiFli HAL module driver

config USE_SIFLI_HAL_SD
	bool "SD SiFli HAL module"
	depends on SOC_SERIES_SF32LB52X
	help
	  Enable SD SiFli HAL module driver

config USE_SIFLI_HAL_SDHCI
	bool "SDHCI SiFli HAL module"
	help
	  Enable SDHCI SiFli HAL module driver

config USE_SIFLI_HAL_SECU
	bool "SECU SiFli HAL module"
	depends on SOC_SERIES_SF32LB52X
	help
	  Enable SECU SiFli HAL module driver

config USE_SIFLI_HAL_SPI
	bool "SPI SiFli HAL module"
	help
	  Enable SPI SiFli HAL module driver

config USE_SIFLI_HAL_SYSTEM_CONFIG
	bool "SYSTEM_CONFIG SiFli HAL module"
	help
	  Enable SYSTEM_CONFIG SiFli HAL module

config USE_SIFLI_HAL_TSEN
	bool "TSEN SiFli HAL module"
	help
	  Enable TSEN SiFli HAL module driver

config USE_SIFLI_HAL_UART
	bool "UART SiFli HAL module"
	help
	  Enable UART SiFli HAL module driver

config USE_SIFLI_HAL_WDT
	bool "WDT SiFli HAL module"
	help
	  Enable WDT SiFli HAL module driver

endif # USE_SIFLI_HAL

endif # HAS_SIFLI_HAL
```

## modules/hal_silabs/gecko/Kconfig
```kconfig
# Copyright The Zephyr Project Contributors
# SPDX-License-Identifier: Apache-2.0

menu "Gecko SDK configuration"
	depends on HAS_SILABS_GECKO

config SILABS_GECKO_RAIL_MULTIPROTOCOL
	bool "Use RAIL Multiprotocol library"
	depends on SOC_GECKO_USE_RAIL
	help
	  Enable the Silicon Labs RAIL multiprotocol library, which provides
	  coexistence and arbitration between multiple wireless protocols (for
	  example, Bluetooth LE and a proprietary 2.4 GHz stack) on Gecko SoCs.

config SOC_GECKO_CMU
	bool
	help
	  Set if the clock management unit (CMU) HAL module is used.

config SOC_GECKO_BURTC
	bool
	help
	  Set if the Back-Up Real Time Counter (BURTC) HAL module is used.

config SOC_GECKO_CORE
	bool
	default y
	help
	  Set if the Core interrupt handling (CORE) HAL module is used.

config SOC_GECKO_ADC
	bool
	help
	  Set if the Analog to Digital Converter (ADC) HAL module is used.

config SOC_GECKO_CRYOTIMER
	bool
	help
	  Set if the Ultra Low Energy Timer/Counter (CRYOTIMER) HAL module is used.

config SOC_GECKO_EMU
	bool
	help
	  Set if the Energy Management Unit (EMU) HAL module is used.

config SOC_GECKO_GPIO
	bool
	help
	  Set if the General Purpose Input/Output (GPIO) HAL module is used.

config SOC_GECKO_I2C
	bool
	help
	  Set if the Inter-Integrated Circuit Interface (I2C) HAL module is used.

config SOC_GECKO_LETIMER
	bool
	help
	  Set if the Low Energy Timer (LETIMER) HAL module is used.

config SOC_GECKO_LEUART
	bool
	help
	  Set if the Low Energy Universal Asynchronous Receiver/Transmitter (LEUART)
	  HAL module is used.

config SOC_GECKO_MSC
	bool
	help
	  Set if the Memory System Controller (MSC) HAL module is used.

config SOC_GECKO_PRS
	bool
	help
	  Set if the Peripheral Reflex System (PRS) HAL module is used.

config SOC_GECKO_RMU
	bool
	help
	  Set if the Reset Management Unit (RMU) HAL module is used.

config SOC_GECKO_RTC
	bool
	help
	  Set if the Real Time Counter (RTC) HAL module is used.

config SOC_GECKO_RTCC
	bool
	help
	  Set if the Real Time Counter and Calendar (RTCC) HAL module is used.

config SOC_GECKO_TIMER
	bool
	help
	  Set if the Timer/Counter (TIMER) HAL module is used.

config SOC_GECKO_USART
	bool
	help
	  Set if the Universal Synchronous Asynchronous Receiver/Transmitter (USART)
	  HAL module is used.

config SOC_GECKO_EUSART
	bool
	help
	  Set if the Extended Universal Synchronous Asynchronous Receiver/Transmitter (EUSART)
	  HAL module is used.

config SOC_GECKO_WDOG
	bool
	help
	  Set if the Watchdog Timer (WDOG) HAL module is used.

config SOC_GECKO_TRNG
	bool
	help
	  Set if the SoC has a True Random Number Generator (TRNG) module.

endmenu
```

## modules/hal_silabs/simplicity_sdk/Kconfig
```kconfig
# Copyright (c) 2025 Silicon Laboratories Inc.
# SPDX-License-Identifier: Apache-2.0

menu "SiSDK configuration"
	depends on HAS_SILABS_SISDK

# Peripherals

config SILABS_SISDK_ACMP
	bool "Peripheral HAL for ACMP"

config SILABS_SISDK_BURTC
	bool "Peripheral HAL for BURTC"

config SILABS_SISDK_CORE
	bool "Peripheral HAL for CORE"

config SILABS_SISDK_EMU
	bool "Peripheral HAL for EMU"

config SILABS_SISDK_EUSART
	bool "Peripheral HAL for EUSART"

config SILABS_SISDK_GPIO
	bool "Peripheral HAL for GPIO"

config SILABS_SISDK_I2C
	bool "Peripheral HAL for I2C"

config SILABS_SISDK_IADC
	bool "Peripheral HAL for IADC"
	select SILABS_SISDK_SYSTEM

config SILABS_SISDK_LDMA
	bool "Peripheral HAL for LDMA"

config SILABS_SISDK_LETIMER
	bool "Peripheral HAL for LETIMER"

config SILABS_SISDK_MSC
	bool "Peripheral HAL for MSC"

config SILABS_SISDK_PRS
	bool "Peripheral HAL for PRS"

config SILABS_SISDK_RMU
	bool "Peripheral HAL for RMU"

config SILABS_SISDK_RTCC
	bool "Peripheral HAL for RTCC"

config SILABS_SISDK_SE
	bool "Peripheral HAL for SE (Secure Engine)"

config SILABS_SISDK_SYSTEM
	bool "Peripheral HAL for SYSTEM (device info)"

config SILABS_SISDK_TIMER
	bool "Peripheral HAL for TIMER"

config SILABS_SISDK_USART
	bool "Peripheral HAL for USART"

config SILABS_SISDK_VDAC
	bool "Peripheral HAL for VDAC"

config SILABS_SISDK_WDOG
	bool "Peripheral HAL for WDOG"

# Utilities

config SILABS_SISDK_SLIST
	bool

# Services

config SILABS_SISDK_CLOCK_MANAGER
	bool "Clock Manager service"
	help
	  Set if the Clock Manager HAL module is used.

config SILABS_SISDK_DEVICE_INIT
	bool "Device Init service"
	select SILABS_SISDK_EMU
	help
	  Use the device initialization routines from the device_init service
	  in Silicon Labs HAL.

config SILABS_SISDK_HFXO_MANAGER
	bool "HFXO Manager service"
	help
	  Set if the HFXO Manager HAL module is used.

config SILABS_SISDK_POWER_MANAGER
	bool "Power Manager service"
	select SILABS_SISDK_EMU
	select SILABS_SISDK_SLIST
	help
	  Set if the Power Manager HAL module is used.

config SILABS_SISDK_SLEEPTIMER
	bool "Sleeptimer service"
	select SILABS_SISDK_PRS
	select SILABS_SISDK_RTCC if $(dt_nodelabel_enabled,rtcc0)
	help
	  Set if the Sleeptimer HAL module is used.

# Radio

config SILABS_SISDK_RAIL_PA_CURVE_HEADER
	string "RAIL PA custom curve header file"
	default "pa_curves_efr32.h"
	help
	  Name of custom PA curve header file for use by PA initialization.
	  See AN1127 for information on how to create a custom PA curve.
	  The header file must be available on the include path.

config SILABS_SISDK_RAIL_PA_CURVE_TYPES_HEADER
	string "RAIL PA curve types header file"
	default "pa_curve_types_efr32.h"
	help
	  Name of custom PA curve type header file for use by PA initialization.
	  See AN1127 for information on how to create a custom PA curve.
	  The header file must be available on the include path.

config SILABS_SISDK_RAIL_PA_ENABLE_CALIBRATION
	bool "RAIL PA: apply factory calibration offset"
	default y
	help
	  Ensure that the PA power remains constant chip-to-chip by applying factory
	  calibration. This option is enabled by default, and is recommended for all
	  Series 2 devices.

config SILABS_SISDK_RAIL_MULTIPROTOCOL
	bool "Use RAIL Multiprotocol library"
	depends on SOC_GECKO_USE_RAIL
	help
	  Enable the Silicon Labs RAIL multiprotocol library, which provides
	  coexistence and arbitration between multiple wireless protocols (for
	  example, Bluetooth LE and a proprietary 2.4 GHz stack) on Gecko SoCs.

config SILABS_SISDK_PROTOCOL_CRYPTO
	bool
	depends on SOC_GECKO_HAS_RADIO

endmenu
```

## modules/hal_silabs/wiseconnect/Kconfig
```kconfig
# Copyright (c) 2025 Silicon Laboratories Inc.
# SPDX-License-Identifier: Apache-2.0

menu "WiSeConnect configuration"
	depends on HAS_SILABS_WISECONNECT

config SILABS_SISDK_SLEEPTIMER
	bool "Sleeptimer service"
	select SRAM_VECTOR_TABLE
	select CODE_DATA_RELOCATION_SRAM
	help
	  Set if the Sleeptimer HAL module is used.

endmenu
```
