## modules/openthread/Kconfig.thread
```kconfig
# Thread network configuration options

# Copyright (c) 2020 Nordic Semiconductor ASA
# SPDX-License-Identifier: Apache-2.0

config OPENTHREAD_PANID
	int "Default PAN ID"
	default 43981

config OPENTHREAD_CHANNEL
	int "Default Channel"
	default 11

config OPENTHREAD_NETWORK_NAME
	string "Default network name"
	default "ot_zephyr"
	help
	  Network name for OpenThread

config OPENTHREAD_XPANID
	string "Default Extended PAN ID"
	default "de:ad:00:be:ef:00:ca:fe"
	help
	  Extended PAN ID for OpenThread with
	  format "de:ad:00:be:ef:00:ca:fe"

config OPENTHREAD_NETWORKKEY
	string "Default Thread Network Key"
	help
	  Network Key for OpenThread with format
	  "00:11:22:33:44:55:66:77:88:99:aa:bb:cc:dd:ee:ff"

config OPENTHREAD_JOINER_AUTOSTART
	bool "Automatic joiner start"
	depends on OPENTHREAD_JOINER

config OPENTHREAD_JOINER_PSKD
	string "Default pre shared key for the Joiner"
	depends on OPENTHREAD_JOINER_AUTOSTART
	default "J01NME"

choice OPENTHREAD_DEVICE_TYPE
	prompt "OpenThread device type"
	help
	  This option selects Thread network device type

config OPENTHREAD_FTD
	bool "FTD - Full Thread Device"
config OPENTHREAD_MTD
	bool "MTD - Minimal Thread Device"
endchoice

config OPENTHREAD_MTD_SED
	bool "SED - Sleepy End Device"
	depends on OPENTHREAD_MTD

config OPENTHREAD_POLL_PERIOD
	int "Poll period for sleepy end devices [ms]"
	default 236000
	depends on OPENTHREAD_MTD_SED

config OPENTHREAD_MAX_CHILDREN
	int "The maximum number of children"
	range 1 511
	default 32

config OPENTHREAD_MAX_IP_ADDR_PER_CHILD
	int "The maximum number of IPv6 address registrations per child"
	range 4 $(UINT8_MAX)
	default 6

config OPENTHREAD_CONFIG_PLATFORM_INFO
	string "The platform-specific string to insert into the OpenThread version string"
	default "Zephyr"

config OPENTHREAD_RADIO_LINK_IEEE_802_15_4_ENABLE
	bool "Support for IEEE802.15.4 radio link"
	default y

config OPENTHREAD_CSL_AUTO_SYNC
	bool "CSL autosync"
	default y if OPENTHREAD_CSL_RECEIVER

config OPENTHREAD_CSL_REQUEST_TIME_AHEAD
	int "CSL transmitter request time ahead"
	default 2000
	help
	  Defines how many microseconds ahead should MAC deliver a CSL frame to the sub-MAC layer.

config OPENTHREAD_CSL_RECEIVE_TIME_AHEAD
	int "CSL receiver wake up margin in microseconds"
	default 5000

config OPENTHREAD_MIN_RECEIVE_ON_AHEAD
	int "Minimum receiving time before start of MHR"
	default 192
	help
	  The minimum time (microseconds) that radio has to be in receive mode before the start of the MHR.

config OPENTHREAD_MIN_RECEIVE_ON_AFTER
	int "Minimum receiving time after start of MHR"
	default 5504
	help
	  The minimum time (microseconds) that radio should be in receive mode after the start of the MHR.

config OPENTHREAD_PLATFORM_CSL_UNCERT
	int "CSL uncertainty"
	default $(UINT8_MAX)
	range 0 $(UINT8_MAX)
	help
	  The fixed uncertainty of the Device for scheduling CSL Transmissions in units of 10 microseconds.

config OPENTHREAD_CSL_TIMEOUT
	int "CSL timeout in seconds"
	default 100
	help
	  The default CSL timeout in seconds.

config OPENTHREAD_MAC_SOFTWARE_TX_SECURITY_ENABLE
	bool "Software transmission security logic"
	default y if !OPENTHREAD_THREAD_VERSION_1_1

config OPENTHREAD_MLE_INFORM_PREVIOUS_PARENT_ON_REATTACH
	bool "Inform previous parent on reattach"
	default y if OPENTHREAD_PARENT_SEARCH
	help
	  To allow end devices (EDs) in a Thread network to inform their
	  previous parent router that they have attached to a new parent
	  router, enable the Inform Previous Parent on Reattach feature.

config OPENTHREAD_PARENT_SEARCH
	bool "Periodic parent search support"
	help
	  To allow end devices (EDs) in a Thread network to switch to a
	  better parent router than their current one—while still attached
	  to the network—enable the Periodic Parent Search feature.

config OPENTHREAD_PARENT_SEARCH_CHECK_INTERVAL
	int "Interval to trigger parent search in seconds"
	default 540
	depends on OPENTHREAD_PARENT_SEARCH

config OPENTHREAD_PARENT_SEARCH_BACKOFF_INTERVAL
	int "Backoff interval to prevent parent search retry in seconds"
	default 36000
	depends on OPENTHREAD_PARENT_SEARCH

config OPENTHREAD_PARENT_SEARCH_RSS_THRESHOLD
	int "RSSI threshold to trigger parent search"
	default -65
	depends on OPENTHREAD_PARENT_SEARCH

config OPENTHREAD_CLI_MAX_LINE_LENGTH
	int "The maximum size of the CLI line in bytes"
	range 16 $(UINT16_MAX)
	default 384

config OPENTHREAD_IP6_MAX_EXT_UCAST_ADDRS
	int "The maximum number of supported IPv6 addresses allows to be externally added"
	range 0 32
	default 4

config OPENTHREAD_IP6_MAX_EXT_MCAST_ADDRS
	int "The maximum number of supported IPv6 multicast addresses allows to be externally added"
	range 0 32
	default 2

config OPENTHREAD_TCP_ENABLE
	bool "TCP support"

config OPENTHREAD_CLI_TCP_ENABLE
	bool "TCP in the CLI tool"
	default y if SHELL
	depends on OPENTHREAD_TCP_ENABLE

config OPENTHREAD_HISTORY_TRACKER
	bool "History tracker support"

config OPENTHREAD_MAC_STAY_AWAKE_BETWEEN_FRAGMENTS
	bool "Stay awake between packet fragments"
	help
	  This optimization is done at the expense of power consumption on SED/SSED devices.

config OPENTHREAD_DEFAULT_RX_SENSITIVITY
	int "OpenThread default RX sensitivity in dBm"
	range $(INT8_MIN) $(INT8_MAX)
	default -100
	help
	  Set the default receive sensitivity [dBm] in radio driver.

config OPENTHREAD_DEFAULT_TX_POWER
	int "OpenThread default tx power in dBm"
	range -40 20 if NRF_802154_RADIO_DRIVER
	default 0
	help
	  Set the default TX output power [dBm] in radio driver for OpenThread purpose.

config OPENTHREAD_TCAT_MULTIRADIO_CAPABILITIES
	bool "Openthread multiradio capability"
	default y if OPENTHREAD_BLE_TCAT
	help
	  Openthread multiradio capability.

config OPENTHREAD_BLE_TCAT_THREAD_STACK_SIZE
	int "Openthread default TCAT stack size"
	default 5120 if OPENTHREAD_CRYPTO_PSA
	default 4200
	help
	  Openthread default TCAT stack size.

config OPENTHREAD_BLE_TCAT_RING_BUF_SIZE
	int "Openthread BLE ringbuffer size"
	default 512
	help
	  Openthread BLE TCAT ringbuffer size.

config OPENTHREAD_NAT64_CIDR
	string "Set IPv4 CIDR used by NAT64"
	default "192.168.255.0/24"
	depends on OPENTHREAD_BORDER_ROUTING && OPENTHREAD_NAT64_TRANSLATOR
	help
	  Set the IPv4 CIDR (Classless Inter-Domain Routing) used by NAT64
	  to set source address of the outgoing translated IPv4 packets.
	  The CIDR must have four bytes in the address with the
	  non-zero length of prefix (e.g., "127.0.0.1/24").

config OPENTHREAD_STORE_FRAME_COUNTER_AHEAD
	int "Openthread frame counter ahead value"
	default 100000
	help
	  Openthread value ahead of the current frame counter for persistent storage.

config OPENTHREAD_CHILD_SUPERVISION_CHECK_TIMEOUT
	int "Openthread child supervision check timeout in seconds"
	default 190
	help
	  The supervision check timeout interval in seconds used by a device in child state.
	  Set to zero to disable the supervision check process on the child.

config OPENTHREAD_CHILD_SUPERVISION_INTERVAL
	int "Openthread child supervision interval in seconds"
	default 129
	help
	  The supervision interval used by a parent device to send a supervision message
	  to the child, if there is no transmission to the child within this interval.
	  Set to zero to disable the supervision check process on the child.

config OPENTHREAD_MLE_CHILD_TIMEOUT
	int "Openthread MLE child timeout in seconds"
	default 240
	help
	  The value of MLE child timeout in seconds.

config OPENTHREAD_RCP_RESTORATION_MAX_COUNT
	int "Openthread RCP restoration maximum count"
	default 2
	help
	  The maximum number of attempts to restore the RCP connection.

config OPENTHREAD_ROUTER_SELECTION_JITTER_OVERRIDE
	bool "Override default router selection jitter"
	depends on OPENTHREAD_FTD

config OPENTHREAD_ROUTER_SELECTION_JITTER
	int "OpenThread router selection jitter in seconds"
	depends on OPENTHREAD_ROUTER_SELECTION_JITTER_OVERRIDE
	default 120
```

## modules/paddlelite/Kconfig
```kconfig
# SPDX-License-Identifier: Apache-2.0
# Copyright (c) 2016 PaddlePaddle Authors. All Rights Reserved.

config PADDLE_LITE
	bool "Paddle Lite Support"
	select REQUIRES_FULL_LIBCPP
	help
	  This option enables the Paddle Lite library.
```

## modules/percepio/Kconfig
```kconfig
# Zephyr module config for percepio.
# The real Kconfig for the module is located in the module repository,
# this file is to ensure ZEPHYR_PERCEPIO_MODULE is defined also when the
# module is unavailable.

# Copyright (c) 2021 Nordic Semiconductor ASA
# SPDX-License-Identifier: Apache-2.0

config ZEPHYR_PERCEPIO_MODULE
	bool
```

## modules/qcbor/Kconfig
```kconfig
# Copyright (c) 2021 Golioth, Inc.
# SPDX-License-Identifier: Apache-2.0

config ZEPHYR_QCBOR_MODULE
	bool

config QCBOR
	bool "QCBOR library"
	help
	  Enable QCBOR library, which is a powerful, commercial-quality CBOR
	  encoder/decoder.
```

## modules/segger/Kconfig
```kconfig
# Copyright (c) 2016 Nordic Semiconductor ASA
# SPDX-License-Identifier: Apache-2.0

config ZEPHYR_SEGGER_MODULE
	bool

config HAS_SEGGER_RTT
	bool
	help
	  Indicates that the platform supports SEGGER J-Link RTT.

config USE_SEGGER_RTT
	bool "SEGGER RTT libraries."
	depends on HAS_SEGGER_RTT
	select STM32_ENABLE_DEBUG_SLEEP_STOP if SOC_FAMILY_STM32
	help
	  Enable Segger J-Link RTT libraries for platforms that support it.
	  Selection of this option enables use of RTT for various subsystems.
	  Note that by enabling this option, RTT buffers consume more RAM.

if USE_SEGGER_RTT

config SEGGER_RTT_CUSTOM_LOCKING
	bool "Custom locking"
	help
	  Enable custom locking using Zephyr APIs.

config SEGGER_RTT_CB_ALIGNMENT
	int "Alignment of the RTT control block"
	default 16
	help
	  Specify the alignment of the RTT control block in memory. The default
	  alignment of 16 bytes is chosen because PyOCD fails to discover blocks
	  where the 16 byte `acID` field falls across a 32 byte boundary.

config SEGGER_RTT_MAX_NUM_UP_BUFFERS
	int "Maximum number of up-buffers"
	default 3

config SEGGER_RTT_MAX_NUM_DOWN_BUFFERS
	int "Maximum number of down-buffers"
	default 3

config SEGGER_RTT_BUFFER_SIZE_UP
	int "Size of the buffer for terminal output of target, up to host"
	default 1024

config SEGGER_RTT_BUFFER_SIZE_DOWN
	int "Size of the buffer for terminal input of target, from host"
	default 16

config SEGGER_RTT_PRINTF_BUFFER_SIZE
	int "Size of buffer for RTT printf to bulk-send chars via RTT"
	default 64

choice SEGGER_RTT_MODE
	prompt "Mode for pre-initialized terminal channel (buffer 0)"
	default SEGGER_RTT_MODE_NO_BLOCK_SKIP

config SEGGER_RTT_MODE_NO_BLOCK_SKIP
	bool "Skip. Do not block, output nothing."

config SEGGER_RTT_MODE_NO_BLOCK_TRIM
	bool "Trim: Do not block, output as much as fits."

config SEGGER_RTT_MODE_BLOCK_IF_FIFO_FULL
	bool "Block: Wait until there is space in the buffer."

endchoice

config SEGGER_RTT_MODE
	int
	default 2 if SEGGER_RTT_MODE_BLOCK_IF_FIFO_FULL
	default 1 if SEGGER_RTT_MODE_NO_BLOCK_TRIM
	default 0

config SEGGER_RTT_MEMCPY_USE_BYTELOOP
	bool "Use a simple byte-loop instead of standard memcpy"

choice SEGGER_RTT_SECTION
	prompt "Choose RTT data linker section"
	default SEGGER_RTT_SECTION_CUSTOM

config SEGGER_RTT_SECTION_NONE
	bool "Place RTT data in the default linker section"

config SEGGER_RTT_SECTION_DTCM
	bool "Place RTT data in the DTCM linker section"

config SEGGER_RTT_SECTION_CCM
	bool "Place RTT data in the CCM linker section"

if CPU_CORTEX_M

config SEGGER_RTT_SECTION_CUSTOM
	bool "Place RTT data in custom linker section at RAM start"

config SEGGER_RTT_SECTION_CUSTOM_DTS_REGION
	bool "Place RTT data in custom linker section defined by a memory region in DTS"

endif

endchoice

if SEGGER_RTT_SECTION_CUSTOM || SEGGER_RTT_SECTION_CUSTOM_DTS_REGION

config SEGGER_RTT_SECTION_CUSTOM_NAME
	string "Name of RTT data custom linker section"
	default ".rtt_buff_data"

endif

choice SEGGER_RTT_INIT_MODE
	prompt "RTT Initialization mode"
	help
		RTT initialization function can avoid re-init of Control Block
		if another program (e.g. bootloader) has already initialized it.
	default SEGGER_RTT_INIT_MODE_STRONG_CHECK if SEGGER_RTT_SECTION_CUSTOM
	default SEGGER_RTT_INIT_MODE_STRONG_CHECK

config SEGGER_RTT_INIT_MODE_ALWAYS
	bool "RTT Initialization done without conditions"

config SEGGER_RTT_INIT_MODE_STRONG_CHECK
	bool "RTT Initialization done if full check on Control Block ID fails"

config SEGGER_RTT_INIT_MODE_WEAK_CHECK
	bool "RTT Initialization done if partial check on Control Block ID fails"

endchoice

endif
```

## modules/tensorflow/Kconfig
```kconfig
# Copyright (c) 2021 Intel Corporation
# SPDX-License-Identifier: Apache-2.0

config ZEPHYR_TENSORFLOW_LITE_MICRO_MODULE
	bool

config TENSORFLOW_LITE_MICRO
	bool "TensorFlow Lite Micro Support"
	help
	  This option enables the TensorFlow Lite Micro library.
```

## modules/tflite-micro/Kconfig
```kconfig
# Copyright (c) 2021 Intel Corporation
# Copyright 2022 Arm Limited and/or its affiliates <open-source-office@arm.com>
# SPDX-License-Identifier: Apache-2.0

config ZEPHYR_TFLITE-MICRO_MODULE
	bool

config TENSORFLOW_LITE_MICRO
	bool "TensorFlow Lite Micro Support"
	select REQUIRES_FULL_LIBCPP
	help
	  This option enables the TensorFlow Lite Micro library.

if CPU_CORTEX_M

config TENSORFLOW_LITE_MICRO_CMSIS_NN_KERNELS
	bool "TensorFlow Lite Micro with optimized CMSIS-NN kernels"
	depends on TENSORFLOW_LITE_MICRO
	select CMSIS_NN
	select CMSIS_NN_ACTIVATION
	select CMSIS_NN_BASICMATH
	select CMSIS_NN_CONCATENATION
	select CMSIS_NN_CONVOLUTION
	select CMSIS_NN_FULLYCONNECTED
	select CMSIS_NN_NNSUPPORT
	select CMSIS_NN_POOLING
	select CMSIS_NN_RESHAPE
	select CMSIS_NN_SOFTMAX
	select CMSIS_NN_SVD
	help
	  This option adds support for CMSIS-NN optimized kernels when using TensorFlow Lite Micro.

endif # CPU_CORTEX_M
```

## modules/thrift/Kconfig
```kconfig
# Copyright 2022 Meta
# SPDX-License-Identifier: Apache-2.0

config ZEPHYR_THRIFT_MODULE
	bool

menuconfig THRIFT
	bool "Support for Thrift [EXPERIMENTAL]"
	select EXPERIMENTAL
	depends on CPP
	depends on STD_CPP17
	depends on CPP_EXCEPTIONS
	depends on POSIX_API
	select REQUIRES_FULL_LIBCPP
	help
	  Enable this option to support Apache Thrift

if THRIFT

config THRIFT_SSL_SOCKET
	bool "TSSLSocket support for Thrift"
	depends on MBEDTLS
	depends on MBEDTLS_PEM_CERTIFICATE_FORMAT
	depends on NET_SOCKETS_SOCKOPT_TLS
	help
	  Enable this option to support TSSLSocket for Thrift

module = THRIFT
module-str = THRIFT
source "subsys/logging/Kconfig.template.log_config"

endif # THRIFT
```

## modules/trusted-firmware-a/Kconfig
```kconfig
# Copyright (c) 2022 Arm Limited (or its affiliates). All rights reserved.
# SPDX-License-Identifier: Apache-2.0

config ZEPHYR_TRUSTED_FIRMWARE_A_MODULE
	bool

menuconfig BUILD_WITH_TFA
	bool "Build with TF-A as the Secure Execution Environment"
	help
	  When enabled, this option instructs the Zephyr build process to
	  additionally generate a TF-A image for the Secure Execution
	  environment, along with the Zephyr image. The Zephyr image
	  itself is to be executed in the Non-Secure Processing Environment.

if BUILD_WITH_TFA

config TFA_MAKE_BUILD_TYPE_DEBUG
	bool "Debug build"
	help
	  When enabled, the build type of TF-A would be debug.

config TFA_BUILD_FIP
	bool "Generate FIP (Firmware Image Package)"
	help
	  Generate ARM Firmware Image Package (FIP) containing all boot stages.
	  Platforms using FIP should enable this explicitly in their board
	  defconfig.

config TFA_FIP_USE_BL33_ZEPHYR
	bool "Include Zephyr as BL33 for TF-A FIP generation"
	depends on TFA_BUILD_FIP
	default y
	help
	  Pass Zephyr binary as BL33 for TF-A FIP build.

config TFA_PLATFORM
	string
	help
	  Platform name for TF-A build system (PLAT= parameter).
	  Boards should set this in their Kconfig.defconfig file.

endif # BUILD_WITH_TFA
```
