## modules/fatfs/Kconfig
```kconfig
# Copyright (c) 2022 Nordic Semiconductor ASA
# SPDX-License-Identifier: Apache-2.0

config ZEPHYR_FATFSFS_MODULE
	bool

# Configuration of ELM FAT is found in subsys/fs/Kconfig.fatfs for historic
# reasons.
```

## modules/fff/Kconfig
```kconfig
# Copyright (c) 2021 Google LLC
# SPDX-License-Identifier: Apache-2.0

config ZEPHYR_FFF_MODULE
	bool

menuconfig FFF_TEST
	bool "FFF Test suite"
	help
	  Enable the FFF test suite. This should really only be called from the tests for FFF under
	  tests/ztest/mock_fff/. It brings in the test sources from the upstream FFF module.

if FFF_TEST

choice FFF_TEST_TYPE
	prompt "The type of FFF test to bring in"

config FFF_TEST_TYPE_C
	bool "Compile the FFF default C test suite as a zephyr library"

config FFF_TEST_TYPE_GLOBAL_C
	bool "Compile the FFF global C test suite as a zephyr library"

endchoice # FFF_TEST_TYPE

endif # FFF_TEST
```

## modules/hal_afbr/Kconfig
```kconfig
# Copyright (c) 2025 Croxel Inc.
# Copyright (c) 2025 CogniPilot Foundation
# SPDX-License-Identifier: Apache-2.0

config ZEPHYR_HAL_AFBR_MODULE
	bool

config AFBR_LIB
	bool
```

## modules/hal_ambiq/Kconfig.components
```kconfig
# SPDX-License-Identifier: Apache-2.0
#
# Copyright (c) 2023 Antmicro <www.antmicro.com>
# Copyright (c) 2025, Ambiq Micro Inc. <www.ambiq.com>

config AMBIQ_COMPONENT_USE_BT
	bool
	depends on SOC_AMBIQ_BT_SUPPORTED
	help
	  Use Bluetooth component from Ambiq

DT_CHOSEN_AMBIQ_GPU := ambiq,gpu

config AMBIQ_COMPONENT_USE_NEMAGFX
	bool
	default y
	depends on $(dt_chosen_enabled,$(DT_CHOSEN_AMBIQ_GPU))

config AMBIQ_COMPONENT_USE_NEMADC
	bool

if AMBIQ_COMPONENT_USE_NEMAGFX

config NEMAGFX_MAX_PENDING_COMMAND_LIST
	int "max value for pending command list"
	default 100
	range 10 200

config NEMAGFX_HEAP_SIZE_ASSETS
	int "NemaGFX assets heap size, unit: KB"
	default 256

DT_CHOSEN_AMBIQ_PSRAM := ambiq,psram
DT_CHOSEN_AMBIQ_EXTERNAL_RAM_REGION := ambiq,external-ram-region

config NEMAGFX_ASSETS_HEAP_IN_PSRAM
	bool "Locate NemaGFX assets heap in PSRAM"
	default y
	depends on $(dt_chosen_enabled,$(DT_CHOSEN_AMBIQ_PSRAM)) && $(dt_chosen_enabled,$(DT_CHOSEN_AMBIQ_EXTERNAL_RAM_REGION))

config NEMAGFX_HEAP_SIZE_RENDER
	int "NemaGFX render heap size, unit: KB"
	default 1280

config NEMAGFX_RENDER_HEAP_IN_NONCACHE_SRAM
	bool "Locate NemaGFX render heap in non-cache SSRAM"
	default y

config NEMAGFX_HEAP_SIZE_CPU_ONLY
	int "NemaGFX CPU only heap size, unit: KB"
	default 16

config NEMAGFX_CPU_ONLY_HEAP_IN_DTCM
	bool "Locate NemaGFX CPU only heap in DTCM"
	default y

config NEMAGFX_WAIT_GPU_IRQ_TIMEOUT_MS
	int "timeout value to wait for GPU complete IRQ, unit: ms"
	default 500

module = NEMAGFX
module-str = nemagfx
source "subsys/logging/Kconfig.template.log_config"

endif #AMBIQ_COMPONENT_USE_NEMAGFX

if AMBIQ_COMPONENT_USE_NEMADC

config NEMADC_WAIT_DC_VSYNC_TIMEOUT_MS
	int "timeout value to wait for DC VSYNC IRQ, unit: ms"
	default 500

module = NEMADC
module-str = nemadc
source "subsys/logging/Kconfig.template.log_config"

endif #AMBIQ_COMPONENT_USE_NEMADC
```

## modules/hal_ambiq/Kconfig.hal
```kconfig
# SPDX-License-Identifier: Apache-2.0
#
# Copyright (c) 2023 Antmicro <www.antmicro.com>
# Copyright (c) 2025, Ambiq Micro Inc. <www.ambiq.com>
# Copyright (c) 2025, Linumiz GmbH
#
config AMBIQ_HAL
	bool "Ambiq HAL drivers support"
	depends on SOC_SERIES_APOLLO2X || SOC_SERIES_APOLLO3X || SOC_SERIES_APOLLO4X || SOC_SERIES_APOLLO5X
	help
	  Use the Ambiq HAL

if AMBIQ_HAL

config AMBIQ_HAL_USE_ADC
	bool
	help
	  Use the ADC driver from Ambiq HAL

config AMBIQ_HAL_USE_ITM
	bool
	help
	  Use the ITM HAL from Ambiq

config AMBIQ_HAL_USE_TPIU
	bool
	help
	  Use the TPIU HAL from Ambiq

config AMBIQ_HAL_USE_DCU
	bool
	help
	  Use the DCU HAL from Ambiq

config AMBIQ_HAL_USE_GPIO
	bool
	help
	  Use the GPIO driver from Ambiq HAL

config AMBIQ_HAL_USE_STIMER
	bool
	help
	  Use the STIMER driver from Ambiq HAL

config AMBIQ_HAL_USE_TIMER
	bool
	help
	  Use the TIMER driver from Ambiq HAL

config AMBIQ_HAL_USE_WDT
	bool
	help
	  Use the WDT driver from Ambiq HAL

config AMBIQ_HAL_USE_UART
	bool
	help
	  Use the UART driver from Ambiq HAL

config AMBIQ_HAL_USE_I2C
	bool
	help
	  Use the I2C driver from Ambiq HAL

config AMBIQ_HAL_USE_SPIC
	bool
	help
	  Use the SPI Controller driver from Ambiq HAL

config AMBIQ_HAL_USE_SPID
	bool
	help
	  Use the SPI Device driver from Ambiq HAL

config AMBIQ_HAL_USE_MSPI
	bool
	help
	  Use the MSPI driver from Ambiq HAL

config AMBIQ_HAL_USE_HWINFO
	bool
	help
	  Use the HWINFO driver from Ambiq HAL

config AMBIQ_HAL_USE_BLEIF
	bool
	help
	  Use the BLEIF driver from Ambiq HAL

config AMBIQ_HAL_USE_ADC
	bool
	help
	  Use the ADC driver from Ambiq HAL

config AMBIQ_HAL_USE_USB
	bool
	help
	  Use the USB driver from Ambiq HAL

config AMBIQ_HAL_USE_SDIO
	bool
	help
	  Use the SDIO driver from Ambiq HAL

config AMBIQ_HAL_USE_ADC
	bool
	help
	  Use the ADC driver from Ambiq HAL

config AMBIQ_HAL_USE_DSI
	bool
	help
	  Use the DSI driver from Ambiq HAL

config AMBIQ_HAL_USE_USB
	bool
	help
	  Use the USB driver from Ambiq HAL

config AMBIQ_HAL_USE_PDM
	bool
	help
	  Use the PDM driver from Ambiq HAL

config AMBIQ_HAL_USE_I2S
	bool
	help
	  Use the I2S driver from Ambiq HAL

endif # AMBIQ_HAL
```

## modules/hal_at32/Kconfig
```kconfig
# Copyright (c) 2021 ATL-Electronics
# SPDX-License-Identifier: Apache-2.0

config ZEPHYR_HAL_AT32_MODULE
	bool

config HAS_AT32_HAL
	bool
	select HAS_CMSIS_CORE if ARM
```

## modules/hal_egis/Kconfig
```kconfig
#
# Copyright (c) 2025, Egis Technology Inc.
#
# SPDX-License-Identifier: Apache-2.0


config ZEPHYR_HAL_EGIS_MODULE
	bool "Egis core driver"
	default y
	depends on SOC_EGIS_ET171

rsource "et171/Kconfig.egis_et171"
```

## modules/hal_egis/et171/Kconfig.egis_et171
```kconfig
# Egis ET171 MCU

# Copyright 2025 Egis Technology Inc.
# SPDX-License-Identifier: Apache-2.0

config HAS_EGIS_ET171_HAL
	bool
	default y
	depends on SOC_EGIS_ET171

if HAS_EGIS_ET171_HAL

config HAS_EGIS_ET171_SXSMCRYPT
	bool "Using hardware crypt lib"
	select CACHE_ANDES if DCACHE
	select CACHE_MANAGEMENT if DCACHE
	select CACHE if DCACHE

config HAS_EGIS_ET171_USBCORE
	bool "Using usb lib"
	select CACHE_ANDES if DCACHE
	select CACHE_MANAGEMENT if DCACHE
	select CACHE if DCACHE

endif # HAS_EGIS_ET171_HAL
```

## modules/hal_espressif/Kconfig
```kconfig
# Copyright (c) 2026 Espressif Systems (Shanghai) Co., Ltd.
# SPDX-License-Identifier: Apache-2.0

if SOC_FAMILY_ESPRESSIF_ESP32

module = ESP_HAL
module-str = esp_hal
source "subsys/logging/Kconfig.template.log_config"

config ESP_HAL_EARLY_LOG_LEVEL
	int "Early boot log level for ESP HAL"
	default 3
	range 0 4
	help
	  Controls log output from ESP_EARLY_LOGx and ESP_DRAM_LOGx macros
	  that run before Zephyr's logging subsystem is initialized.
	  These use esp_rom_printf and are independent of CONFIG_LOG.
	  0 = Off, 1 = Error, 2 = Warning, 3 = Info, 4 = Debug

endif # SOC_FAMILY_ESPRESSIF_ESP32

# Include the HAL's own Kconfig
osource "$(ZEPHYR_HAL_ESPRESSIF_MODULE_DIR)/zephyr/Kconfig"
```

## modules/hal_ethos_u/Kconfig
```kconfig
# SPDX-FileCopyrightText: <text>Copyright 2021-2022, 2024-2025 Arm Limited and/or its
# affiliates <open-source-office@arm.com></text>
# SPDX-License-Identifier: Apache-2.0

config ETHOS_U
	bool "Ethos-U core driver"
	default n
	depends on MULTITHREADING
	help
	  This option enables the Arm Ethos-U core driver.

if ETHOS_U
menu "Ethos-U NPU configuration"
choice  ETHOS_U_NPU_CONFIG
	prompt "Ethos-U NPU configuration"
	default ETHOS_U55_128 if SOC_SERIES_MPS3
	default ETHOS_U65_256 if SOC_MPS4_CORSTONE315
	default ETHOS_U85_256 if SOC_MPS4_CORSTONE320
	default ETHOS_U55_256 if SOC_SERIES_M55M1X
config ETHOS_U55_64
	bool "using Ethos-U55 with 64 macs"
config ETHOS_U55_128
	bool "using Ethos-U55 with 128 macs"
config ETHOS_U55_256
	bool "using Ethos-U55 with 256 macs"
config ETHOS_U65_128
	bool "using Ethos-U65 with 128 macs"
config ETHOS_U65_256
	bool "using Ethos-U65 with 256 macs"
config ETHOS_U65_512
	bool "using Ethos-U65 with 512 macs"
config ETHOS_U85_128
	bool "using Ethos-U85 with 128 macs"
config ETHOS_U85_256
	bool "using Ethos-U85 with 256 macs"
config ETHOS_U85_512
	bool "using Ethos-U85 with 512 macs"
config ETHOS_U85_1024
	bool "using Ethos-U85 with 1024 macs"
config ETHOS_U85_2048
	bool "using Ethos-U85 with 2048 macs"
endchoice
endmenu

config ETHOS_U_NPU_NAME
	string
	default "ethos-u55-64" if ETHOS_U55_64
	default "ethos-u55-128" if ETHOS_U55_128
	default "ethos-u55-256" if ETHOS_U55_256
	default "ethos-u65-128" if ETHOS_U65_128
	default "ethos-u65-256" if ETHOS_U65_256
	default "ethos-u65-512" if ETHOS_U65_512
	default "ethos-u85-128" if ETHOS_U85_128
	default "ethos-u85-256" if ETHOS_U85_256
	default "ethos-u85-512" if ETHOS_U85_512
	default "ethos-u85-1024" if ETHOS_U85_1024
	default "ethos-u85-2048" if ETHOS_U85_2048
	help
	  Name of the used Ethos-U NPU

choice "ETHOS_U_LOG_LEVEL_CHOICE"
	prompt "Max compiled-in log level for ETHOS_U"
	default ETHOS_U_LOG_LEVEL_WRN
	depends on LOG

config ETHOS_U_LOG_LEVEL_NONE
	bool "None"

config ETHOS_U_LOG_LEVEL_ERR
	bool "Error"

config ETHOS_U_LOG_LEVEL_WRN
	bool "Warning"

config ETHOS_U_LOG_LEVEL_INF
	bool "Info"

config ETHOS_U_LOG_LEVEL_DBG
	bool "Debug"

config ETHOS_U_LOG_LEVEL_DEFAULT
	bool "Default"

endchoice

config ETHOS_U_LOG_LEVEL
	int
	# Always define the symbol so C compiles cleanly even if LOG/console is off.
	# When LOG is off, fall back to NONE (0).
	default 0 if !LOG
	default 0 if ETHOS_U_LOG_LEVEL_NONE
	default 1 if ETHOS_U_LOG_LEVEL_ERR
	default 2 if ETHOS_U_LOG_LEVEL_WRN
	default 3 if ETHOS_U_LOG_LEVEL_INF
	default 4 if ETHOS_U_LOG_LEVEL_DBG

endif
```

## modules/hal_gigadevice/Kconfig
```kconfig
# Copyright (c) 2021 ATL-Electronics
# SPDX-License-Identifier: Apache-2.0

config ZEPHYR_HAL_GIGADEVICE_MODULE
	bool

config GD32_HAS_AF_PINMUX
	bool
	help
	  This option should be selected if the series use an AF pinmux model.

config GD32_HAS_AFIO_PINMUX
	bool
	help
	  This option should be selected if the series use an AFIO pinmux model.

config HAS_GD32_HAL
	bool
	select HAS_CMSIS_CORE if SOC_FAMILY_GD32_ARM

if HAS_GD32_HAL

choice GD32_HXTAL_FREQUENCY
	prompt "High speed external oscillator clock frequency"
	default GD32_HXTAL_FIRMWARE_DEFINED if \
		SOC_SERIES_GD32F403 || SOC_SERIES_GD32F4XX || SOC_SERIES_GD32F3X0
	default GD32_HXTAL_25MHZ if SOC_SERIES_GD32VF103 || SOC_SERIES_GD32E50X
	default GD32_HXTAL_8MHZ if SOC_SERIES_GD32E10X
	help
	  Define value of high speed crystal oscillator (HXTAL) in Hz
	  This value sets the frequency of the oscillator.

config GD32_HXTAL_FIRMWARE_DEFINED
	bool "Firmware defined"
	depends on !SOC_SERIES_GD32VF103
	depends on !SOC_SERIES_GD32E10X
	help
	  Use default frequency defined in firmware for HXTAL
	  This is using for SoCs (e.g. gd32f4xx, gd32f3x0, etc ...)
	  that have default HXTAL definitions in firmware.

config GD32_HXTAL_8MHZ
	bool "8MHz"
	depends on SOC_SERIES_GD32VF103 || SOC_SERIES_GD32E10X
	help
	  Use 8MHz oscillator for HXTAL

config GD32_HXTAL_25MHZ
	bool "25MHz"
	depends on SOC_SERIES_GD32VF103 || SOC_SERIES_GD32E10X
	help
	  Use 25MHz oscillator for HXTAL

endchoice

config GD32_HAS_IRC_32K
	bool
	help
	  Use 32KHz oscillator for low speed internal RC Oscillator

config GD32_HAS_IRC_40K
	bool
	help
	  Use 40KHz oscillator for low speed internal RC Oscillator

config GD32_LOW_SPEED_IRC_FREQUENCY
	int
	default 32000 if GD32_HAS_IRC_32K
	default 40000 if GD32_HAS_IRC_40K
	help
	  Define value of low speed internal RC oscillator (IRC) in Hz

config GD32_DBG_SUPPORT
	bool "Use GD32 Debug features"
	select USE_GD32_DBG
	default y
	help
	  Enable GD32 Debug features.
	  This option makes allows using functions that access to
	  DBG_CTL register such as dbg_periph_enable().

config USE_GD32_ADC
	bool
	help
	  Enable GD32 Analog-to-Digital Converter (ADC) HAL module driver

config USE_GD32_BKP
	bool
	help
	  Enable GD32 Backup Registers (BKP) HAL module driver

config USE_GD32_CAN
	bool
	help
	  Enable GD32 Controller Area Network (CAN) HAL module driver

config USE_GD32_CEC
	bool
	help
	  Enable GD32 Consumer Electronics Control (CEC) HAL module driver

config USE_GD32_CMP
	bool
	help
	  Enable GD32 Comparator (CMP) HAL module driver

config USE_GD32_CRC
	bool
	help
	  Enable GD32 Cyclic redundancy check calculation unit (CRC) HAL
	  module driver

config USE_GD32_CTC
	bool
	help
	  Enable GD32 Clock Trim Controller (CTC) HAL module driver

config USE_GD32_DAC
	bool
	help
	  Enable GD32 Digital-to-Analog Converter (DAC) HAL module driver

config USE_GD32_DBG
	bool
	help
	  Enable GD32 Debug (DBG) HAL module driver

config USE_GD32_DCI
	bool
	help
		Enable GD32 Digital Camera Interface (DCI) HAL module driver

config USE_GD32_DMA
	bool
	help
	  Enable GD32 Direct Memory Access controller (DMA) HAL module driver

config USE_GD32_ENET
	bool
	help
	  Enable GD32 Ethernet (ENET) HAL module driver

config USE_GD32_EXMC
	bool
	help
	  Enable GD32 External Memory Controller (EXMC) HAL module driver

config USE_GD32_EXTI
	bool
	help
	  Enable GD32 Interrupt/Event controller (EXTI) HAL module driver

config USE_GD32_FMC
	bool
	help
	  Enable GD32 Flash Memory Controller (FMC) HAL module driver

config USE_GD32_FWDGT
	bool
	help
	  Enable GD32 Free Watchdog Timer (FWDGT) HAL module driver

config USE_GD32_GPIO
	bool
	default y
	help
	  Enable GD32 General-purpose and Alternate-Function I/Os
	  (GPIO and AFIO) HAL module driver

config USE_GD32_I2C
	bool
	help
	  Enable GD32 Inter-Integrated Circuit Interface (I2C) HAL module driver

config USE_GD32_IPA
	bool
	help
	  Enable GD32 Image Processing Accelerator (IPA) HAL module driver

config USE_GD32_IREF
	bool
	help
	  Enable GD32 Programmable Current Reference (IREF) HAL module driver

config USE_GD32_MISC
	bool
	help
	  Enable GD32 System Utilities (MISC) HAL module driver

config USE_GD32_PMU
	bool
	help
	  Enable GD32 Power Management Unit (PMU) HAL module driver

config USE_GD32_RCU
	bool
	default y
	help
	  Enable GD32 Reset and Clock Unit (RCU) HAL module driver

config USE_GD32_RTC
	bool
	help
	  Enable GD32 Real-Time Clock (RTC) HAL module driver

config USE_GD32_SDIO
	bool
	help
	  Enable GD32 Secure Digital Input/Output interface (SDIO) HAL module
	  driver

config USE_GD32_SPI
	bool
	help
	  Enable GD32 Serial Peripheral Interface(SPI) HAL module driver

config USE_GD32_SQPI
	bool
	help
	  Enable GD32 Serial/Quad Parallel Interface (SQPI) HAL module driver

config USE_GD32_SHRTIMER
	bool
	help
	  Enable GD32 Super High-Resolution Timer (SHRTIMER) HAL module driver

config USE_GD32_SYSCFG
	bool
	help
	  Enable GD32 System Configuration (SYSCFG) HAL module driver

config USE_GD32_TIMER
	bool
	help
	  Enable GD32 Timer (TIMER) HAL module driver

config USE_GD32_TLI
	bool
	help
	  Enable GD32 TFT-LCD Interface (TLI) HAL module driver

config USE_GD32_TMU
	bool
	help
	  Enable GD32 Trigonometric Math Unit (TMU) HAL module driver

config USE_GD32_TRNG
	bool
	help
	  Enable GD32 True Random Number Generator (TRNG) HAL module driver

config USE_GD32_TSI
	bool
	help
	  Enable GD32 Touch Sensing Interface (TSI) HAL module driver

config USE_GD32_USART
	bool
	help
	  Enable GD32 Universal Synchronous/Asynchronous Receiver/Transmitter
	  (USART) HAL module driver

config USE_GD32_USBD
	bool
	help
	  Enable GD32 Universal Serial Bus full-speed Device interface (USBD)
	  HAL module driver

config USE_GD32_USBFS
	bool
	help
	  Enable GD32 Universal Serial Bus on-the-go Full-Speed (USBFS) HAL
	  module driver

config USE_GD32_USBHS
	bool
	help
	  Enable GD32 Universal Serial Bus High-Speed interface (USBHS) HAL
	  module driver

config USE_GD32_WWDGT
	bool
	help
	  Enable GD32 Window Watchdog Timer (WWDGT) HAL module driver

endif # HAS_GD32_HAL
```
