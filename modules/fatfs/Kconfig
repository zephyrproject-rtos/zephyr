## modules/hal_infineon/Kconfig
```kconfig
# Copyright (c) 2022 Cypress Semiconductor Corporation.
# SPDX-License-Identifier: Apache-2.0

config ZEPHYR_HAL_INFINEON_MODULE
	bool

config ZEPHYR_HAL_INFINEON_MODULE_BLOBS
	bool

if SOC_FAMILY_INFINEON_CAT1 || SOC_FAMILY_PSOC6_LEGACY

config USE_INFINEON_ADC
	bool
	help
	  Enable Analog-to-Digital Converter (ADC) HAL module driver for Infineon devices

config USE_INFINEON_I2C
	bool
	help
	  Enable Inter-Integrated Circuit Interface (I2C) HAL module driver for Infineon devices

config USE_INFINEON_RTC
	bool
	help
	  Enable Real-Time Clock (RTC) HAL module driver for Infineon devices

config USE_INFINEON_SDIO
	bool
	help
	  Enable Secure Digital Input/Output interface (SDIO) HAL module for Infineon devices
	  driver

config USE_INFINEON_SDHC
	bool
	help
	  Enable SDHC HAL module for Infineon devices
	  driver

config USE_INFINEON_SPI
	bool
	help
	  Enable Serial Peripheral Interface (SPI) HAL module driver for Infineon devices


config USE_INFINEON_TIMER
	bool
	help
	  Enable Timer (Timer/Counter) HAL module driver for Infineon devices

config USE_INFINEON_LPTIMER
	bool
	help
	  Enable Low-Power Timer (LPTimer) HAL module driver for Infineon devices

config USE_INFINEON_TRNG
	bool
	help
	  Enable True Random Number Generator (TRNG) HAL module driver for Infineon devices

config USE_INFINEON_UART
	bool
	help
	  Enable Universal Asynchronous Receiver/Transmitter (UART) HAL module
	  driver for Infineon devices

config USE_INFINEON_PWM
	bool
	help
	  Enable Pulse Width Modulator (PWM) HAL module
	  driver for Infineon devices

config USE_INFINEON_WDT
	bool
	help
	  Enable WATCHDOG TIMER (WDT) HAL module
	  driver for Infineon devices

config USE_INFINEON_FLASH
	bool
	help
	  Enable Flash HAL module driver for Infineon devices

config USE_INFINEON_SMIF
	bool
	help
	  Enable SMIF HAL driver for Infineon devices

endif # SOC_FAMILY_INFINEON_CAT1 || SOC_FAMILY_PSOC6_LEGACY

config USE_INFINEON_ABSTRACTION_RTOS
	bool "Abstraction RTOS component (Zephyr support)"
	help
	  Enable Abstraction RTOS component with Zephyr support
```

## modules/hal_infineon/whd-zephyr-integration/Kconfig.cyw43xxx
```kconfig
# Copyright (c) 2022 Cypress Semiconductor Corporation (an Infineon company) or
# an affiliate of Cypress Semiconductor Corporation
# SPDX-License-Identifier: Apache-2.0

menuconfig WIFI_CYW43XXX
	bool "Infineon CYW43xxx SoC Wi-Fi support"
	select THREAD_CUSTOM_DATA
	select USE_INFINEON_SDIO
	select WIFI_OFFLOAD
	select NET_L2_WIFI_MGMT
	select WIFI_USE_NATIVE_NETWORKING
	select USE_INFINEON_ABSTRACTION_RTOS
	depends on DT_HAS_INFINEON_CYW43XXX_WIFI_SDIO_ENABLED
	help
	  Enable Infineon CYW43xxx SoC Wi-Fi support.

if WIFI_CYW43XXX

if SHELL
config SHELL_STACK_SIZE
	default 4096
endif # SHELL

config CYW43XXX_WIFI_EVENT_TASK_STACK_SIZE
	int "Event Task Stack Size"
	default 4096

config CYW43XXX_WIFI_EVENT_TASK_PRIO
	int "Event Task Priority"
	default 4

config CYW43XXX_WLAN_MFG_FIRMWARE
	bool "WLAN Manufacturing Firmware"
	help
	  Enable WLAN Manufacturing Firmware.

config WIFI_CYW43XXX_CUSTOM
	bool "Custom CYW43xx device/module"
	help
	  Select Custom CYW43xx device/module. For this option,
	  user must to provide path to FW, CLM and NVRAM for
	  custom or vendor CYW43xx modules.

choice  CYW43XXX_PART
	prompt "Select CYW43XXX part"
	depends on !WIFI_CYW43XXX_CUSTOM

config CYW4343W
	bool "CYW4343W"
	help
	  Enable Infineon CYW4343W Wi-Fi connectivity,
	  More information about CYW4343W device you can find on
	  https://www.infineon.com/cms/en/product/wireless-connectivity/airoc-wi-fi-plus-bluetooth-combos/cyw4343w/

config CYW4373
	bool "CYW4373"
	help
	  Enable Infineon CYW4373 Wi-Fi connectivity,
	  More information about CYW4373 device you can find on
	  https://www.infineon.com/cms/en/product/wireless-connectivity/airoc-wi-fi-plus-bluetooth-combos/cyw4373/

config CYW43012
	bool "CYW43012"
	help
	  Enable Infineon CYW43012 Wi-Fi connectivity,
	  More information about CYW43012 device you can find on
	  https://www.infineon.com/cms/en/product/wireless-connectivity/airoc-wi-fi-plus-bluetooth-combos/cyw43012/

config CYW43438
	bool "CYW43438"
	help
	  Enable Infineon CYW43438 Wi-Fi connectivity,
	  More information about CYW43438 device you can find on
	  https://www.infineon.com/cms/en/product/wireless-connectivity/airoc-wi-fi-plus-bluetooth-combos/cyw43438/

config CYW43439
	bool "CYW43439"
	help
	  Enable Infineon CYW43439 Wi-Fi connectivity,
	  More information about CYW43439 device you can find on
	  https://www.infineon.com/cms/en/product/wireless-connectivity/airoc-wi-fi-plus-bluetooth-combos/cyw43439/
endchoice

choice CYW43012_MODULE
	prompt "Select CYW43012 module"
	depends on CYW43012 && !WIFI_CYW43XXX_CUSTOM

config CYW43012_MURATA_1LV
	bool "MURATA-1LV"
	help
	  Murata Type 1LV module based on Infineon CYW43012 combo chipset
	  which supports Wi-Fi® 802.11a/b/g/n + Bluetooth® 5.0 BR/EDR/LE
	  up to 72.2Mbps PHY data rate on Wi-fi® and 3Mbps PHY data rate
	  on Bluetooth®. 2Mbps LE PHY is also supported.

	  Detailed information about Murata Type 1LV module you can find on
	  https://www.murata.com/en-us/products/connectivitymodule/wi-fi-bluetooth/overview/lineup/type1lv
endchoice

choice CYW4343W_MODULE
	prompt "Select CYW4343W module"
	depends on CYW4343W && !WIFI_CYW43XXX_CUSTOM

config CYW4343W_MURATA_1DX
	bool "MURATA-1DX"
	help
	  Murata Type 1DX modules based on Infineon CYW4343W combo chipset
	  which supports Wi-Fi® 802.11b/g/n + Bluetooth® 5.1 BR/EDR/LE
	  up to 65Mbps PHY data rate on Wi-fi® and 3Mbps PHY data rate
	  on Bluetooth®.

	  Detailed information about Type 1DX module you can find on
	  https://www.murata.com/en-us/products/connectivitymodule/wi-fi-bluetooth/overview/lineup/type1dx
endchoice

choice CYW4373_MODULE
	prompt "Select CYW4373 module"
	depends on CYW4373 && !WIFI_CYW43XXX_CUSTOM

config CYW4373_STERLING_LWB5PLUS
	bool "STERLING-LWB5plus"
	help
	  Laird Sterling LWB5+ 802.11ac / Bluetooth 5.0 M.2 Carrier Board
	  (E-Type Key w/ SDIO/UART)

	  Detailed information about Type Sterling LWB5+ module you can find on
	  https://www.lairdconnect.com/wireless-modules/wifi-modules-bluetooth/sterling-lwb5-plus-wifi-5-bluetooth-5-module
endchoice

choice CYW43439_MODULE
	prompt "Select CYW43439 module"
	depends on CYW43439 && !WIFI_CYW43XXX_CUSTOM

config CYW43439_MURATA_1YN
	bool "MURATA_1YN"
	help
	  Murata Type 1YN module based on Infineon CYW43439 combo chipset
	  which supports Wi-Fi® 802.11b/g/n + Bluetooth® 5.2 BR/EDR/LE
	  up to 65Mbps PHY data rate on Wi-fi® and 3Mbps PHY data rate on
	  Bluetooth®.

	  Detailed information about Murata Type 1YN module you can find on
	  https://www.murata.com/en-us/products/connectivitymodule/wi-fi-bluetooth/overview/lineup/type1yn
endchoice

endif # WIFI_CY43XXX
```

## modules/hal_intel/Kconfig
```kconfig
# Copyright (c) 2021 Intel Corporation.
# SPDX-License-Identifier: Apache-2.0

config HAS_INTEL
	bool

menu "intel hal drivers"
	depends on HAS_INTEL

config INTEL_DMA
	bool "Enable DMA driver"

config INTEL_UART
	bool "Enable UART driver"

config INTEL_TGPIO
	bool "Enable Time-Aware GPIO driver"

endmenu

config HAS_SEDI
	bool

menuconfig SEDI
	bool "SEDI driver support"
	depends on HAS_SEDI
	help
	  automatically set when either of SEDI_LIBRARY is selected.

if HAS_SEDI

config SEDI_LIBRARY
	bool "Enable SEDI drivers using external library"
	select SEDI
	help
	  This option enables SEDI device drivers. These drivers are actually shim
	  drivers based on drivers provided by SEDI BSP. The BSP provides a static
	  library (libsedi) which implements several drivers for peripherals

endif
```

## modules/hal_nordic/Kconfig
```kconfig
# Copyright (c) 2016-2021 Nordic Semiconductor ASA
# SPDX-License-Identifier: Apache-2.0

config ZEPHYR_HAL_NORDIC_MODULE
	bool

config HAS_NORDIC_DRIVERS
	bool

menu "Nordic drivers"
	depends on HAS_NORDIC_DRIVERS

choice NRF_802154_SOURCE
	prompt "Source of the IEEE 802.15.4 radio driver"

config NRF_802154_SOURCE_HAL_NORDIC
	bool "Open source"

endchoice

menuconfig NRF_802154_RADIO_DRIVER
	bool "NRF IEEE 802.15.4 radio driver"
	depends on HAS_HW_NRF_RADIO_IEEE802154
	select DYNAMIC_INTERRUPTS
	select ENTROPY_GENERATOR
	depends on !$(dt_nodelabel_enabled,timer1)
	help
	  This option enables nRF IEEE 802.15.4 radio driver in Zephyr. Note,
	  that beside the radio peripheral itself, this drivers occupies several
	  other peripherals. A complete list can be found in the hal_nordic
	  repository, within drivers/nrf_radio_802154/nrf_802154_peripherals.h
	  file. As the nRF IEEE 802.15.4 radio driver defines IRQ configuration
	  abstraction layer API and its Zephyr-specific implementation uses dynamic
	  interrupts, the DYNAMIC_INTERRUPTS switch is selected unconditionally.

if NRF_802154_RADIO_DRIVER

config NRF_802154_MULTIPROTOCOL_SUPPORT
	bool
	help
	  In dynamic multiprotocol applications, access to the radio peripheral
	  must be distributed by an arbiter. To support this arbitration
	  in the driver, this option must be enabled. Otherwise, the driver
	  assumes that access to the radio peripheral is granted indefinitely.

choice NRF_802154_SL_TYPE
	prompt "nRF IEEE 802.15.4 Service Layer Type"

config NRF_802154_SL_OPENSOURCE
	bool "Open source"
	select SENSOR if NRF_802154_TEMPERATURE_UPDATE
	select TEMP_NRF5 if NRF_802154_TEMPERATURE_UPDATE

endchoice

config NRF_802154_TEMPERATURE_UPDATE
	bool "nRF 802.15.4 temperature update"
	default y if !SOC_NRF54H20
	help
	  Enable temperature update for nRF 802.15.4 driver

config NRF_802154_TEMPERATURE_UPDATE_INIT_PRIO
	int "nRF52 IEEE 802.15.4 temperature update initialization priority"
	depends on NRF_802154_TEMPERATURE_UPDATE
	default 91
	help
	  Set the initialization priority of a temperature update for nRF 802.15.4 driver.

config NRF_802154_TEMPERATURE_UPDATE_PERIOD
	int "nRF 802.15.4 temperature update period in milliseconds"
	depends on NRF_802154_TEMPERATURE_UPDATE
	default 60000
	help
	  Period of a temperature update for nRF 802.15.4 driver in milliseconds

endif # NRF_802154_RADIO_DRIVER

config NRF_802154_SERIALIZATION
	bool
	select IPC_SERVICE
	select MBOX
	help
	  This helper symbol indicates that the nRF 802.15.4 serialization is available.

config NRF_802154_SER_HOST
	bool "nRF IEEE 802.15.4 Driver serialization host"
	depends on !NRF_802154_RADIO_DRIVER
	depends on !HAS_HW_NRF_RADIO_IEEE802154
	select IEEE802154_NRF5_EXT_IRQ_MGMT if IEEE802154_NRF5
	select NRF_802154_SERIALIZATION
	help
	  Enable serialization of nRF IEEE 802.15.4 Driver. This option is to be
	  used if radio is not available in the core, but radio services are
	  provided by a serialization backend.

menuconfig NRF_802154_SER_RADIO
	bool "nRF IEEE 802.15.4 Driver serialization radio"
	depends on HAS_HW_NRF_RADIO_IEEE802154
	depends on !IEEE802154_NRF5
	select NRF_802154_RADIO_DRIVER
	select NRF_802154_SERIALIZATION
	help
	  Enable serialization of nRF IEEE 802.15.4 Driver. This option is to be
	  used if radio is available in the core to provide radio services over
	  a serialization backend.

if NRF_802154_SER_RADIO

config NRF_802154_SER_RADIO_INIT_PRIO
	int "nRF52 IEEE 802.15.4 serialization initialization priority"
	default 51
	help
	  Set the initialization priority number. Do not mess with it unless
	  you know what you are doing.

endif

menu "nRF 802.15.4 serialization"
	depends on NRF_802154_SER_HOST || NRF_802154_SER_RADIO

config NRF_802154_SER_LOG
	bool "802.15.4 serialization logs"
	default n
	help
	  This option enable debug logs of 802.15.4 serialization module.

config NRF_802154_SER_DEFAULT_RESPONSE_TIMEOUT
	int "Default Spinel serialization response timeout in milliseconds"
	default 500
	help
	  This option specifies default timeout of spinel status response
	  in milliseconds.

endmenu # NRF_802154_SER_HOST || NRF_802154_SER_RADIO

if NRF_802154_RADIO_DRIVER || NRF_802154_SERIALIZATION

choice NRF_802154_CCA_MODE
	prompt "nRF IEEE 802.15.4 CCA mode"
	default NRF_802154_CCA_MODE_ED
	help
	  CCA mode

config NRF_802154_CCA_MODE_ED
	bool "Energy Above Threshold"

config NRF_802154_CCA_MODE_CARRIER
	bool "Carrier Seen"

config NRF_802154_CCA_MODE_CARRIER_AND_ED
	bool "Energy Above Threshold AND Carrier Seen"

config NRF_802154_CCA_MODE_CARRIER_OR_ED
	bool "Energy Above Threshold OR Carrier Seen"

endchoice

config NRF_802154_CCA_ED_THRESHOLD
	int "nRF IEEE 802.15.4 CCA Energy Detection threshold"
	default 45
	help
	  If energy detected in a given channel is above the value then the
	  channel is deemed busy. The unit is defined as per 802.15.4-2006 spec.

config NRF_802154_CCA_CORR_THRESHOLD
	int "nRF IEEE 802.15.4 CCA Correlator threshold"
	default 45

config NRF_802154_CCA_CORR_LIMIT
	int "nRF IEEE 802.15.4 CCA Correlator limit"
	default 2
	help
	  Limit for occurrences above correlator threshold. When not equal to
	  zero the correlator based signal detect is enabled.

config NRF_802154_RX_BUFFERS
	int "nRF 802.15.4 receive buffers"
	default 16
	help
	  Number of buffers in nRF 802.15.4 driver serialization host's receive queue.
	  If this value is modified, its remote counterpart must be set to the exact same value.

config NRF_802154_PENDING_SHORT_ADDRESSES
	int "nRF 802.15.4 pending short addresses"
	default 16
	help
	  Number of slots containing short addresses of nodes for which pending data is stored

config NRF_802154_PENDING_EXTENDED_ADDRESSES
	int "nRF 802.15.4 pending extended addresses"
	default 16
	help
	  Number of slots containing extended addresses of nodes for which pending data is stored

config NRF_802154_ENCRYPTION
	bool "nRF 802.15.4 AES-CCM* authentication & encryption"
	depends on !CRYPTO_NRF_ECB

config NRF_802154_SECURITY_KEY_STORAGE_SIZE
	int "nRF 802.15.4 security key storage size"
	default 3
	help
	  Number of encryption keys that the nRF 802.15.4 Radio Driver can store simultaneously.

config NRF_802154_CARRIER_FUNCTIONS
	bool "nRF 802.15.4 carrier functions"
	help
	  This option enables functions such as modulated carrier and continuous carrier.
	  If this option is modified on a multicore SoC, its remote counterpart must be set to the exact same value.

choice NRF_802154_ASSERT_CHOICE
	prompt "nRF 802.15.4 assert implementation"
	default NRF_802154_ASSERT_ZEPHYR_MINIMAL

config NRF_802154_ASSERT_ZEPHYR_MINIMAL
	bool "nRF 802.15.4 minimal assertions"
	help
	  This option provides minimal run-time checking of the nRF 802.15.4 Radio Driver's operation,
	  even if kernel-wide CONFIG_ASSERT is disabled. In case of an abnormal condition the function
	  `nrf_802154_assert_handler()` is called. File and line debug information are not provided
	  to save memory of the image file. Default implementation of the `nrf_802154_assert_handler`
	  involves a call to `k_panic`/`k_oops` and allows further tweaking of the behavior.
	  You can also provide your own implementation of `nrf_802154_assert_handler`.

config NRF_802154_ASSERT_ZEPHYR
	bool "nRF 802.15.4 Radio Driver assertions as Zephyr's standard __ASERT_NO_MSG"
	help
	  The run-time checking of the nRF 802.15.4 Radio Driver depends fully on the configuration
	  of the `__ASSERT_NO_MSG` macro, including the ability to completely turn off the run-time
	  checking.

endchoice # NRF_802154_ASSERT_CHOICE

endif # NRF_802154_RADIO_DRIVER || NRF_802154_SERIALIZATION

endmenu # HAS_NORDIC_DRIVERS

rsource "nrfs/Kconfig"
rsource "nrfx/Kconfig"
rsource "Kconfig.nrf_regtool"
```
