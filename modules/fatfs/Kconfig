## modules/hal_nordic/Kconfig.nrf_regtool
```kconfig
# Copyright (c) 2024 Nordic Semiconductor ASA
# SPDX-License-Identifier: Apache-2.0

menu "nrf-regtool options"
	depends on SOC_SERIES_NRF54HX

config NRF_REGTOOL_GENERATE_UICR
	bool "Generate UICR"
	help
	  Generate a UICR hex based on devicetree contents using nrf-regtool.
	  CPU domains that require UICR allocation aren't bootable without it
	  being programmed alongside the firmware.

config NRF_REGTOOL_VERBOSITY
	int "Verbosity level of console output"
	range 0 3
	default 0
	help
	  Level of verbose output that nrf-regtool will print to the console.

	  0. Only critical information and warnings.
	  1. Print a pretty, human-readable representation of a peripheral's
	     configuration. This is recommended for inspecting register values.
	  2. Print extra details for debugging purposes, such as memory maps of
	     the peripheral configurations, but in a less readable format.
	  3. Print even more details, which are typically only useful for
	     nrf-regtool developers.

config NRF_REGTOOL_EXTRA_GENERATE_ARGS
	string "Extra arguments to 'nrf-regtool generate'"
	help
	  List of additional arguments to every nrf-regtool invocation used for
	  generating hex files. Example value: "--fill all --fill-byte 0xff".
	  Run "nrf-regtool generate -h" to see all of the available options.

endmenu
```

## modules/hal_nordic/ironside/se/Kconfig
```kconfig
# Copyright (c) 2025 Nordic Semiconductor ASA
# SPDX-License-Identifier: Apache-2.0

config HAS_IRONSIDE_SE
	bool

config HAS_IRONSIDE_SE_CALL
	bool

menu "IronSide SE"
	depends on HAS_IRONSIDE_SE

config IRONSIDE_SE_CALL
	bool "IronSide calls"
	default y
	depends on HAS_IRONSIDE_SE_CALL
	help
	  Support for IronSide call APIs.

if IRONSIDE_SE_CALL

choice IRONSIDE_SE_CALL_DRIVER
	prompt "IronSide calls driver implementation"
	default IRONSIDE_SE_CALL_ZEPHYR if DT_HAS_NORDIC_IRONSIDE_CALL_ENABLED
	default IRONSIDE_SE_CALL_MINIMAL
	help
	  Driver implementation used for IronSide calls.

config IRONSIDE_SE_CALL_ZEPHYR
	bool "Zephyr driver"
	depends on DT_HAS_NORDIC_IRONSIDE_CALL_ENABLED
	depends on MULTITHREADING
	select EVENTS
	select MBOX
	help
	  Use the default driver for IronSide calls which supports concurrent
	  calls being made from different threads. This is the recommended implementation
	  and should be used in most applications.

config IRONSIDE_SE_CALL_MINIMAL
	bool "Minimal driver"
	help
	  Use the minimal driver for IronSide calls, which is included with the
	  IronSide APIs. This driver does not support concurrent calls from different
	  threads, and uses busy waiting instead of interrupts when waiting for a
	  reply from IronSide SE. It also does not perform data cache handling for the IPC
	  buffer, and instead assumes that the IPC buffer area is not cached.
	  This option is primarily intended for constrained applications such as bootloaders
	  and is not recommended for general use.

endchoice

config IRONSIDE_SE_CALL_INIT_PRIORITY
	int "IronSide calls' driver initialization priority"
	default 41
	depends on IRONSIDE_SE_CALL_ZEPHYR
	help
	  Initialization priority of the IronSide call protocol driver.
	  It must be below MBOX_INIT_PRIORITY, but higher than the priority of any feature
	  that depends on IRONSIDE_SE_CALL.

endif # IRONSIDE_SE_CALL

config IRONSIDE_SE_DVFS
	bool "DVFS support"
	depends on SOC_NRF54H20_CPUAPP
	depends on IRONSIDE_SE_CALL
	help
	  Support for changing the DVFS operating point.

if IRONSIDE_SE_DVFS

config IRONSIDE_SE_DVFS_ABB_STATUSANA_CHECK_MAX_ATTEMPTS
	int "ABB analog status check maximum attempts"
	range 0 255
	default 50
	help
	  Maximum attempts with 10us intervals before busy status will be reported.

endif # IRONSIDE_SE_DVFS

config NRF_MPCCONF_SECTION
	bool "Global Memory Privilege Controller (MPC) initialization section"
	depends on LINKER_DEVNULL_SUPPORT
	imply LINKER_DEVNULL_MEMORY
	help
	  Include static global Memory Privilege Controller (MPC) peripheral
	  initialization values from the build in a dedicated section. The section is
	  stripped from the firmware binary. If the UICR generator image is enabled,
	  it will include the stripped section in the generated UICR MPCCONF blob.
	  Currently the UICR generator supports at most one image setting this.

menuconfig NRF_PERIPHCONF_SECTION
	bool "Global peripheral initialization section"
	depends on LINKER_DEVNULL_SUPPORT
	help
	  Include static global domain peripheral initialization values from the
	  build in a dedicated section. The section is either stripped from the
	  firmware binary or kept as constant data, depending on how it will be
	  loaded at runtime.

if NRF_PERIPHCONF_SECTION

config NRF_PERIPHCONF_SECTION_STRIP
	bool "Strip the section from the binary"
	default y if !NRF_PERIPHCONF_SECTION_KEEP_BY_DEFAULT
	imply LINKER_DEVNULL_MEMORY
	help
	  Strip the PERIPHCONF section from the firmware binary.
	  If the UICR generator image is enabled, it will include the stripped section
	  in the generated UICR PERIPHCONF blob.

	  When this is disabled, the PERIPHCONF section will remain as data in the binary,
	  and will not included in the UICR PERIPHCONF blob. Instead, it is expected that
	  it will be loaded via the ironside_se_periphconf_write() API.

config NRF_PERIPHCONF_GENERATE_ENTRIES
	bool "Generate PERIPHCONF entries source file"
	default y
	help
	  Generate a C file containing PERIPHCONF entries based on the
	  device configuration in the devicetree.

config NRF_PERIPHCONF_GENERATE_ENTRIES_LOCK
	bool "Lock registers in PERIPHCONF"
	default y
	depends on NRF_PERIPHCONF_GENERATE_ENTRIES
	help
	  Set the lock bit in registers that support it.
	  Disable this to allow the registers to be reconfigured after boot.

endif # NRF_PERIPHCONF_SECTION

config NRF_PERIPHCONF_SECTION_KEEP_BY_DEFAULT
	bool "Keep the PERIPHCONF section by default (set by build system)"
	help
	  This is set from Sysbuild to change the default behavior for the image so that
	  CONFIG_NRF_PERIPHCONF_SECTION_STRIP=n unless explicitly configured otherwise.
	  To override this behavior, set CONFIG_NRF_PERIPHCONF_SECTION_STRIP=y directly.

config NRF_MPCCONF_API_IN_RAM
	bool "MPCCONF API in RAM"
	depends on IRONSIDE_SE_CALL
	depends on !IRONSIDE_SE_CALL_ZEPHYR || !XIP
	help
	  Ensure that the functions used to modify and lock the MPC configuration
	  - namely, ironside_se_mpcconf_write() and ironside_se_mpcconf_finish_init() -
	  are placed in RAM. This may be needed to reconfigure permissions for XIP memory.

	  This is not supported with the default IronSide call driver in Zephyr,
	  unless it and all of its dependencies are also relocated to be executed from RAM.

endmenu # IronSide SE
```

## modules/hal_nordic/nrfs/Kconfig
```kconfig
# Copyright (c) 2024 Nordic Semiconductor ASA
# SPDX-License-Identifier: Apache-2.0

config HAS_NRFS
	bool

menu "nRF Services"
	depends on HAS_NRFS

config NRFS_HAS_CLOCK_SERVICE
	bool

config NRFS_HAS_CONST_LATENCY_SERVICE
	bool

config NRFS_HAS_DIAG_SERVICE
	bool

config NRFS_HAS_DVFS_SERVICE
	bool

config NRFS_HAS_MRAM_SERVICE
	bool

config NRFS_HAS_PMIC_SERVICE
	bool

config NRFS_HAS_RESET_SERVICE
	bool

config NRFS_HAS_TEMP_SERVICE
	bool

config NRFS_HAS_VBUS_DETECTOR_SERVICE
	bool

config NRFS
	bool "nRF Services Support"
	select NRFS_LOCAL_DOMAIN if (SOC_NRF54H20_CPUAPP || SOC_NRF54H20_CPURAD)
	depends on HAS_NRFS
	help
	  This option enables the nRF Services library.

if NRFS

config NRFS_LOCAL_DOMAIN
	bool "nRF Services Local Domain Support"
	depends on $(dt_alias_enabled,ipc-to-cpusys)
	select IPC_SERVICE
	select MBOX
	select EVENTS
	select REBOOT
	help
	  This option enables the nRF Services Local Domain libraries.

config NRFS_DVFS_LOCAL_DOMAIN
	bool "Local domain that supports DVFS"
	depends on NRFS_LOCAL_DOMAIN
	depends on NRFS_DVFS_SERVICE_ENABLED
	default y if NRFS_DVFS_SERVICE_ENABLED

menu "Enabled Services"

module = NRFS
module-str = nRF-Services
source "subsys/logging/Kconfig.template.log_config"

config NRFS_RESET_SERVICE_ENABLED
	bool "Reset service"
	depends on NRFS_HAS_RESET_SERVICE

config NRFS_MRAM_SERVICE_ENABLED
	bool "MRAM latency service"
	depends on NRFS_HAS_MRAM_SERVICE

config NRFS_TEMP_SERVICE_ENABLED
	bool "Temperature service"
	depends on NRFS_HAS_TEMP_SERVICE
	default y

config NRFS_VBUS_DETECTOR_SERVICE_ENABLED
	bool "VBUS detector for the USB peripheral"
	depends on NRFS_HAS_VBUS_DETECTOR_SERVICE
	default y

config NRFS_CONST_LATENCY_SERVICE_ENABLED
	bool "DPPI constant latency service"
	depends on NRFS_HAS_CONST_LATENCY_SERVICE
	default y

config NRFS_PMIC_SERVICE_ENABLED
	bool "PMIC service"
	depends on NRFS_HAS_PMIC_SERVICE

config NRFS_DVFS_SERVICE_ENABLED
	bool "DVFS service"
	depends on NRFS_HAS_DVFS_SERVICE
	default y if SOC_NRF54H20_CPUAPP

config NRFS_DIAG_SERVICE_ENABLED
	bool "System Diagnostics service (only for development purposes)"
	depends on NRFS_HAS_DIAG_SERVICE

config NRFS_CLOCK_SERVICE_ENABLED
	bool "Clock service"
	depends on NRFS_HAS_CLOCK_SERVICE
	default y
endmenu

rsource "backends/Kconfig"
if NRFS_DVFS_LOCAL_DOMAIN
rsource "dvfs/Kconfig"
endif # NRFS_DVFS_LOCAL_DOMAIN

endif # NRFS
endmenu
```

## modules/hal_nordic/nrfs/backends/Kconfig
```kconfig
# Copyright (c) 2024 Nordic Semiconductor ASA
# SPDX-License-Identifier: Apache-2.0


menu "NRFS backend settings"

module = NRFS_BACKEND
module-str = NRFS backend
source "subsys/logging/Kconfig.template.log_config"

config NRFS_BACKEND_IPC_SERVICE_INIT_PRIO
	int "Initialization priority for NRFS IPC backend"
	default 51
	help
	  This should be higher than priority of other drivers/subsystems
	  used by NRFS backend. For example MBOX_INIT_PRIORITY which is 50.

config NRFS_MAX_BACKEND_PACKET_SIZE
	int "Maximum IPC data packet size in bytes"
	range 8 128
	default 32

config NRFS_BACKEND_TX_MSG_QUEUE_SIZE
	int "Size of TX buffer message queue size"
	range 1 16
	default 8

config NRFS_SEND_RETRY_DELAY
	int "Delay in us"
	range 1 100
	default 1
	help
	  Delay when waiting for next message send retry in case of send error.

config NRFS_SEND_RETRY_MAX_COUNT
	int "Max number of send retries"
	range 0 100
	default 5
	help
	  How many times nrfs will try to send message over ipc service until
	  error will be reported. For example when shared ipc memory is full.

endmenu
```

## modules/hal_nordic/nrfs/dvfs/Kconfig
```kconfig
#
# Copyright (c) 2024 Nordic Semiconductor ASA
#
# SPDX-License-Identifier: Apache-2.0
#

menu "Local domain DVFS library"

module = LOCAL_DOMAIN_DVFS_LIB
module-str = Local domain DVFS library
source "subsys/logging/Kconfig.template.log_config"

config NRFS_LOCAL_DOMAIN_DVFS_TEST
	bool "Local domain DVFS test"
	help
	  Disable hw registers interaction for testing.

config NRFS_LOCAL_DOMAIN_DVFS_SCALE_DOWN_AFTER_INIT
	bool "Local domain scale down after init"
	help
	  Request lowest oppoint after DVFS initialization.

config NRFS_LOCAL_DOMAIN_DOWNSCALE_SAFETY_TIMEOUT_US
	int "Voltage downscale procedure safety timeout in us"
	range 1 10000000
	default 1000000 if (NRFS_LOCAL_DOMAIN_DVFS_TEST || LOG)
	default 1500

config NRFS_LOCAL_DOMAIN_DVFS_HANDLER_TASK_STACK_SIZE
	int "Stack size used for DVFS handling task"
	range 256 2048
	default 1024 if LOG
	default 512

config NRFS_LOCAL_DOMAIN_DVFS_HANDLER_TASK_PRIORITY
	int "Priority of DVFS handling task"
	range -16 NUM_PREEMPT_PRIORITIES
	default 0

endmenu
```
