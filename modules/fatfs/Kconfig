## modules/hal_nordic/nrfx/Kconfig
```kconfig
# Copyright (c) 2016 Nordic Semiconductor ASA
# SPDX-License-Identifier: Apache-2.0

config HAS_NRFX
	bool

menu "nrfx drivers"
	depends on HAS_NRFX

rsource "Kconfig.logging"

config NRFX_ADC
	bool "ADC driver"
	depends on $(dt_nodelabel_exists,adc) && SOC_SERIES_NRF51

config NRFX_CLOCK
	bool "CLOCK driver"
	depends on $(dt_nodelabel_exists,clock)

if NRFX_CLOCK

config NRFX_CLOCK_USE_LFRC_CALIBRATION
	bool "Extend NRFX_CLOCK to use LFRC peripheral"

config NRFX_CLOCK_LFXO_TWO_STAGE_ENABLED
	bool "Two stage start sequence of the low frequency clock"

config NRFX_CLOCK_LF_CAL_ENABLED
	bool "LFRC Calibration enabled"

config NRFX_CLOCK_LF_SRC_RC
	bool "RC Oscillator"

config NRFX_CLOCK_LF_SRC_XTAL
	bool "Crystal Oscillator"

config NRFX_CLOCK_LF_SRC_SYNTH
	depends on !SOC_SERIES_NRF91
	bool "Synthesized from HFCLK"

config NRFX_CLOCK_LF_SRC_LOW_SWING
	depends on SOC_SERIES_NRF52
	bool "External low swing"

config NRFX_CLOCK_LF_SRC_FULL_SWING
	depends on SOC_SERIES_NRF52
	bool "External full swing"

endif # NRFX_CLOCK

config NRFX_COMP
	bool "COMP driver"
	depends on $(dt_nodelabel_exists,comp)

config NRFX_CRACEN
	bool "CRACEN drivers"
	depends on SOC_COMPATIBLE_NRF54LX
	select NRFX_CRACEN_BSIM_SUPPORT if SOC_SERIES_BSIM_NRFXX

config NRFX_CRACEN_BSIM_SUPPORT
	bool

config NRFX_EGU
	bool

config NRFX_EGU0
	bool "EGU0 driver instance"
	depends on $(dt_nodelabel_exists,egu0)
	select NRFX_EGU

config NRFX_EGU1
	bool "EGU1 driver instance"
	depends on $(dt_nodelabel_exists,egu1)
	select NRFX_EGU

config NRFX_EGU2
	bool "EGU2 driver instance"
	depends on $(dt_nodelabel_exists,egu2)
	select NRFX_EGU

config NRFX_EGU3
	bool "EGU3 driver instance"
	depends on $(dt_nodelabel_exists,egu3)
	select NRFX_EGU

config NRFX_EGU4
	bool "EGU4 driver instance"
	depends on $(dt_nodelabel_exists,egu4)
	select NRFX_EGU

config NRFX_EGU5
	bool "EGU5 driver instance"
	depends on $(dt_nodelabel_exists,egu5)
	select NRFX_EGU

config NRFX_EGU10
	bool "EGU10 driver instance"
	depends on $(dt_nodelabel_exists,egu10)
	select NRFX_EGU

config NRFX_EGU20
	bool "EGU20 driver instance"
	depends on $(dt_nodelabel_exists,egu20)
	select NRFX_EGU

config NRFX_EGU020
	bool "EGU020 driver instance"
	depends on $(dt_nodelabel_exists,egu020)
	select NRFX_EGU

config NRFX_EGU130
	bool "EGU130 driver instance"
	depends on $(dt_nodelabel_exists,egu130)
	select NRFX_EGU

config NRFX_GPIOTE
	bool

config NRFX_GPIOTE0
	bool "GPIOTE0 driver instance"
	depends on $(dt_nodelabel_exists,gpiote0)
	select NRFX_GPIOTE

config NRFX_GPIOTE1
	bool "GPIOTE1 driver instance"
	depends on $(dt_nodelabel_exists,gpiote1)
	select NRFX_GPIOTE

config NRFX_GPIOTE20
	bool "NRFX_GPIOTE20 driver instance"
	depends on $(dt_nodelabel_exists,gpiote20)
	select NRFX_GPIOTE

config NRFX_GPIOTE30
	bool "NRFX_GPIOTE30 driver instance"
	depends on $(dt_nodelabel_exists,gpiote30)
	select NRFX_GPIOTE

config NRFX_GPIOTE130
	bool "NRFX_GPIOTE130 driver instance"
	depends on $(dt_nodelabel_exists,gpiote130)
	select NRFX_GPIOTE

config NRFX_GPIOTE131
	bool "NRFX_GPIOTE131 driver instance"
	depends on $(dt_nodelabel_exists,gpiote131)
	select NRFX_GPIOTE

config NRFX_GPIOTE_NONUNIFORM_INSTANCES
	def_bool $(dt_nodelabel_enabled,gpiote0)
	depends on $(dt_nodelabel_bool_prop,gpiote0,fixed-channels-supported)

config NRFX_GPIOTE_NUM_OF_EVT_HANDLERS
	int "Number of event handlers"
	depends on NRFX_GPIOTE
	range 1 15
	help
	  Specifies number of handlers that can be registered to nrfx_gpiote driver
	  by the user.

config NRFX_GPPI
	bool "Generic PPI layer"
	help
	   Enable the nrfx_gppi utilities providing unified API for creating PPI
	   connections across SoC families.

config NRFX_GPPI_V1
	bool "GPPI layer legacy"
	depends on NRFX_GPPI
	default y if SOC_SERIES_NRF54H
	help
	  When enabled then legacy version of Generic PPI layer is used.

config NRFX_GRTC
	bool "GRTC driver"
	depends on $(dt_nodelabel_exists,grtc)

config NRFX_I2S
	bool "I2S driver"

config NRFX_IPC
	bool "IPC driver"
	depends on $(dt_nodelabel_exists,ipc)

config NRFX_LPCOMP
	bool "LPCOMP driver"
	depends on $(dt_nodelabel_exists,comp) && !SOC_NRF52810 && !SOC_NRF52811 && !SOC_NRF52820

config NRFX_MRAMC
	bool "MRAMC driver"
	depends on $(dt_has_compat,$(DT_COMPAT_NORDIC_NRF_MRAMC))

config NRFX_NFCT
	bool "NFCT driver"
	depends on $(dt_nodelabel_exists,nfct)
	select NRFX_TIMER

config NRFX_NVMC
	bool "NVMC driver"
	depends on $(dt_nodelabel_exists,flash_controller)

config NRFX_PDM
	bool "PDM driver"

config NRFX_POWER
	bool "POWER driver"
	depends on $(dt_nodelabel_exists,power)
	# On SoCs featuring the USBREG peripheral, the POWER driver uses
	# internally the USBREG driver.
	select NRFX_USBREG if $(dt_nodelabel_exists,usbreg)

config NRFX_PWM
	bool "PWM driver"

config NRFX_QDEC
	bool "QDEC driver"

config NRFX_QSPI
	bool "QSPI driver"
	depends on $(dt_nodelabel_exists,qspi)

config NRFX_RNG
	bool "RNG driver"
	depends on $(dt_nodelabel_exists,rng)

config NRFX_RRAMC
	bool "RRAMC driver"
	depends on $(dt_nodelabel_exists,rram_controller)

config NRFX_RTC
	bool

config NRFX_RTC0
	bool "RTC0 driver instance"
	depends on $(dt_nodelabel_exists,rtc0)
	select NRFX_RTC

config NRFX_RTC1
	bool "RTC1 driver instance"
	depends on $(dt_nodelabel_exists,rtc1)
	select NRFX_RTC

config NRFX_RTC2
	bool "RTC2 driver instance"
	depends on $(dt_nodelabel_exists,rtc2)
	select NRFX_RTC

config NRFX_RTC130
	bool "RTC130 driver instance"
	depends on $(dt_nodelabel_exists,rtc130)
	select NRFX_RTC

config NRFX_RTC131
	bool "RTC131 driver instance"
	depends on $(dt_nodelabel_exists,rtc131)
	select NRFX_RTC

config NRFX_SAADC
	bool "SAADC driver"
	depends on $(dt_nodelabel_exists,adc) && !SOC_SERIES_NRF51

config NRFX_SPI
	bool

config NRFX_SPI0
	bool "SPI0 driver instance"
	depends on $(dt_nodelabel_exists,spi0) && (SOC_SERIES_NRF51 || SOC_SERIES_NRF52)
	select NRFX_SPI

config NRFX_SPI1
	bool "SPI1 driver instance"
	depends on $(dt_nodelabel_exists,spi1) && (SOC_SERIES_NRF51 || SOC_SERIES_NRF52)
	select NRFX_SPI

config NRFX_SPI2
	bool "SPI2 driver instance"
	depends on $(dt_nodelabel_exists,spi2) && SOC_SERIES_NRF52
	select NRFX_SPI

config NRFX_SPIM
	bool "SPIM driver"
	depends on $(dt_has_compat,$(DT_COMPAT_NORDIC_NRF_SPIM))

config NRFX_SPIS
	bool "SPIS driver"
	depends on $(dt_has_compat,$(DT_COMPAT_NORDIC_NRF_SPIS))

config NRFX_SYSTICK
	bool "SYSTICK driver"
	depends on CPU_CORTEX_M_HAS_SYSTICK

config NRFX_TBM
	bool "TBM driver"
	depends on $(dt_nodelabel_exists,tbm)

config NRFX_TEMP
	bool "TEMP driver"
	depends on $(dt_nodelabel_exists,temp)

config NRFX_TIMER
	bool "TIMER driver"

config NRFX_TWI
	bool

config NRFX_TWI0
	bool "TWI0 driver instance"
	depends on $(dt_nodelabel_exists,i2c0) && (SOC_SERIES_NRF51 || SOC_SERIES_NRF52)
	select NRFX_TWI

config NRFX_TWI1
	bool "TWI1 driver instance"
	depends on $(dt_nodelabel_exists,i2c1) && (SOC_SERIES_NRF51 || SOC_SERIES_NRF52)
	select NRFX_TWI

config NRFX_TWIM
	bool "NRFX driver for TWIM peripheral"

config NRFX_TWIS
	bool "NRFX driver for TWIS peripheral"

config NRFX_UART
	bool

config NRFX_UART0
	bool "UART0 driver instance"
	depends on $(dt_nodelabel_exists,uart0) && (SOC_SERIES_NRF51 || SOC_SERIES_NRF52)
	select NRFX_UART

config NRFX_UARTE
	bool "UARTE driver"

config NRFX_UARTE_CONFIG_SKIP_GPIO_CONFIG
	bool "UARTE GPIO configuration support"
	depends on NRFX_UARTE

config NRFX_UARTE_CONFIG_SKIP_PSEL_CONFIG
	bool "UARTE PSEL configuration support"
	depends on NRFX_UARTE

config NRFX_UARTE_CONFIG_TX_LINK
	bool "UARTE TX transfer linking support"
	depends on NRFX_UARTE

config NRFX_UARTE_CONFIG_RX_CACHE_ENABLED
	bool "UARTE RX caching support"
	depends on NRFX_UARTE
	help
	  Feature might be enabled on platforms which has limitations regarding addresses
	  to which receiver can write data. If enabled then internal driver buffers
	  (cache buffers) are used for DMA transfers and data is copied to the user buffer.

config NRFX_USBREG
	bool "USBREG driver"
	depends on $(dt_nodelabel_exists,usbreg)

config NRFX_WDT
	bool

menu "Peripheral Resource Sharing module"

config NRFX_PRS
	bool

config NRFX_PRS_BOX_0
	bool "PRS box 0"
	select NRFX_PRS

config NRFX_PRS_BOX_1
	bool "PRS box 1"
	select NRFX_PRS

config NRFX_PRS_BOX_2
	bool "PRS box 2"
	select NRFX_PRS

config NRFX_PRS_BOX_3
	bool "PRS box 3"
	select NRFX_PRS

config NRFX_PRS_BOX_4
	bool "PRS box 4"
	select NRFX_PRS

endmenu

config NRFX_RESERVED_RESOURCES_HEADER
	string
	default "nrfx_reserved_resources.h"

endmenu # "nrfx drivers"
```

## modules/hal_nordic/nrfx/Kconfig.logging
```kconfig
# Copyright (c) 2023 Nordic Semiconductor ASA
# SPDX-License-Identifier: Apache-2.0

menu "nrfx drivers logging"
	depends on LOG

config NRFX_ADC_LOG
	bool "ADC driver logging"
	depends on NRFX_ADC

config NRFX_CLOCK_LOG
	bool "CLOCK driver logging"
	depends on NRFX_CLOCK

config NRFX_COMP_LOG
	bool "COMP driver logging"
	depends on NRFX_COMP

config NRFX_DPPI_LOG
	bool "DPPI driver logging"
	depends on NRFX_DPPI

config NRFX_EGU_LOG
	bool "EGU driver logging"
	depends on NRFX_EGU

config NRFX_GPIOTE_LOG
	bool "GPIOTE driver logging"
	depends on NRFX_GPIOTE

config NRFX_GRTC_LOG
	bool "GRTC driver logging"
	depends on NRFX_GRTC

config NRFX_I2S_LOG
	bool "I2S driver logging"
	depends on NRFX_I2S

config NRFX_IPC_LOG
	bool "IPC driver logging"
	depends on NRFX_IPC

config NRFX_LPCOMP_LOG
	bool "LPCOMP driver logging"
	depends on NRFX_LPCOMP

config NRFX_NFCT_LOG
	bool "NFCT driver logging"
	depends on NRFX_NFCT

config NRFX_NVMC_LOG
	bool "NVMC driver logging"
	depends on NRFX_NVMC

config NRFX_PDM_LOG
	bool "PDM driver logging"
	depends on NRFX_PDM

config NRFX_POWER_LOG
	bool "POWER driver logging"
	depends on NRFX_POWER

config NRFX_PPI_LOG
	bool "PPI driver logging"
	depends on NRFX_PPI

config NRFX_PRS_LOG
	bool "PRS driver logging"
	depends on NRFX_PRS

config NRFX_PWM_LOG
	bool "PWM driver logging"
	depends on NRFX_PWM

config NRFX_QDEC_LOG
	bool "QDEC driver logging"
	depends on NRFX_QDEC

config NRFX_QSPI_LOG
	bool "QSPI driver logging"
	depends on NRFX_QSPI

config NRFX_RNG_LOG
	bool "RNG driver logging"
	depends on NRFX_RNG

config NRFX_RTC_LOG
	bool "RTC driver logging"
	depends on NRFX_RTC

config NRFX_SAADC_LOG
	bool "SAADC driver logging"
	depends on NRFX_SAADC

config NRFX_SPI_LOG
	bool "SPI driver logging"
	depends on NRFX_SPI

config NRFX_SPIM_LOG
	bool "SPIM driver logging"
	depends on NRFX_SPIM

config NRFX_SPIS_LOG
	bool "SPIS driver logging"
	depends on NRFX_SPIS

config NRFX_SYSTICK_LOG
	bool "SYSTICK driver logging"
	depends on NRFX_SYSTICK

config NRFX_TEMP_LOG
	bool "TEMP driver logging"
	depends on NRFX_TEMP

config NRFX_TIMER_LOG
	bool "TIMER driver logging"
	depends on NRFX_TIMER

config NRFX_TWI_LOG
	bool "TWI driver logging"
	depends on NRFX_TWI

config NRFX_TWIM_LOG
	bool "TWIM driver logging"
	depends on NRFX_TWIM

config NRFX_TWIS_LOG
	bool "TWIS driver logging"
	depends on NRFX_TWIS

config NRFX_UART_LOG
	bool "UART driver logging"
	depends on NRFX_UART

config NRFX_UARTE_LOG
	bool "UARTE driver logging"
	depends on NRFX_UARTE

config NRFX_USBREG_LOG
	bool "USBREG driver logging"
	depends on NRFX_USBREG

config NRFX_WDT_LOG
	bool "WDT driver logging"
	depends on NRFX_WDT

endmenu # "nrfx drivers logging"
```

## modules/hal_nxp/imx/Kconfig.imx
```kconfig
# IMX M4 Core SDK

# Copyright (c) 2018, NXP
# SPDX-License-Identifier: Apache-2.0

config HAS_IMX_HAL
	bool
	select HAS_CMSIS_CORE
	depends on SOC_FAMILY_NXP_IMX
```

## modules/hal_nxp/mcux/Kconfig
```kconfig
# Copyright 2025 NXP
#
# SPDX-License-Identifier: Apache-2.0

config SOC_SDKNG_UNSUPPORTED
	bool
	default y if SOC_LPC11U66
	default y if SOC_LPC11U67
	default y if SOC_LPC11U68
	default y if SOC_LPC54114
	default y if SOC_MIMX8ML8_A53
	default y if SOC_MIMX8ML8_ADSP
	default y if SOC_MIMX8MM6_A53
	default y if SOC_MIMX8MN6_A53
	default y if SOC_MIMX8QM6
	default y if SOC_MIMX8QX6
	default y if SOC_MIMX8UD7_ADSP
	default y if SOC_MIMX9352_A55
	default y if SOC_MIMX9596_A55
	default y if SOC_MK22F12
	default y if SOC_MK64F12
	default y if SOC_MK66F18
	default y if SOC_MK80F25615
	default y if SOC_MK82F25615
	default y if SOC_MKE14F16
	default y if SOC_MKE16F16
	default y if SOC_MKE18F16
	default y if SOC_MKL25Z4
	default y if SOC_MKV56F24
	default y if SOC_MKV58F24
	default y if SOC_MKW22D5
	default y if SOC_MKW24D5
	default y if SOC_MKW40Z4
	default y if SOC_MKW41Z4

if (!SOC_SDKNG_UNSUPPORTED && !SOC_FAMILY_NXP_S32 && HAS_MCUX)

mainmenu "MCUX SDK Configuration"

# These items defines compile and link flags, which are not necessary for Zephyr
# so deactivate them.
config MCUX_PRJSEG_config.device_core.define
	bool
	default n

config MCUX_PRJSEG_config.arm.core.cm4
	bool
	default n

config MCUX_PRJSEG_config.arm.core.cm4f
	bool
	default n

config MCUX_PRJSEG_config.arm.core.fpu.no_fpu
	bool
	default n

config MCUX_PRJSEG_config.arm.core.fpu.fpv4_sp
	bool
	default n

config MCUX_PRJSEG_config.arm.core.cm7f
	bool
	default n

config MCUX_PRJSEG_config.arm.core.fpu.fpv5_dp
	bool
	default n

config MCUX_PRJSEG_config.arm.core.fpu.fpv5_sp
	bool
	default n

config MCUX_PRJSEG_config.arm.core.cm33
	bool
	default n

config MCUX_PRJSEG_config.arm.core.cm33_nodsp_nosau
	bool
	default n

config MCUX_PRJSEG_config.arm.core.cm33_dsp_nosau
	bool
	default n

config MCUX_PRJSEG_config.arm.core.cm33_nodsp_sau
	bool
	default n

config MCUX_PRJSEG_config.arm.core.cm0p
	bool
	default n

config MCUX_PRJSEG_config.arm.shared
	bool
	default n

config MCUX_PRJSEG_config.kinetis.shared
	bool
	default n

config MCUX_PRJSEG_config.wireless.shared
	bool
	default n

rsource "mcux-sdk-ng/components/Kconfig"
rsource "mcux-sdk-ng/device/Kconfig"
rsource "mcux-sdk-ng/drivers/Kconfig"
rsource "mcux-sdk-ng/middleware/Kconfig"

endif
```
