## modules/hal_nxp/Kconfig
```kconfig
#
# Copyright (c) 2021 Linaro, Limited
# Copyright 2025 NXP
#
# SPDX-License-Identifier: Apache-2.0


config ZEPHYR_HAL_NXP_MODULE
	bool

config ZEPHYR_HAL_NXP_MODULE_BLOBS
	bool

rsource "imx/Kconfig.imx"
rsource "s32/Kconfig.nxp_s32"
rsource "mcux/Kconfig.mcux"
```
