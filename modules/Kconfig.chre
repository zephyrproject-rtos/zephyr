## modules/Kconfig.chre
```kconfig
# Copyright 2023 Google LLC
# SPDX-License-Identifier: Apache-2.0

config ZEPHYR_CHRE_MODULE
	bool

config ZEPHYR_CHRE_MODULE_ACTIVE
	bool
	depends on ZEPHYR_CHRE_MODULE
```

## modules/Kconfig.esp32
```kconfig
# Copyright (c) 2022 Espressif Systems (Shanghai) Co., Ltd.
# SPDX-License-Identifier: Apache-2.0

config ZEPHYR_HAL_ESPRESSIF_MODULE
	bool

config ZEPHYR_HAL_ESPRESSIF_MODULE_BLOBS
	bool

config HAS_ESPRESSIF_HAL
	bool
	depends on SOC_FAMILY_ESPRESSIF_ESP32

if SOC_FAMILY_ESPRESSIF_ESP32

module = ESP_HAL
module-str = esp_hal
source "subsys/logging/Kconfig.template.log_config"

config ESP_HAL_EARLY_LOG_LEVEL
	int "Early boot log level for ESP HAL"
	default 3
	range 0 4
	help
	  Controls log output from ESP_EARLY_LOGx and ESP_DRAM_LOGx macros
	  that run before Zephyr's logging subsystem is initialized.
	  These use esp_rom_printf and are independent of CONFIG_LOG.
	  0 = Off, 1 = Error, 2 = Warning, 3 = Info, 4 = Debug

config ESP32_TIMER_TASK_STACK_SIZE
	int "Stack size of the high resolution ESP Timer"
	default 1536
	help
	  Set the stack size for the internal high resolution ESP Timer
	  used in Wi-Fi and BLE peripherals. Registered timer callbacks
	  run in this task's context, including Wi-Fi, BLE, mesh, PHY and
	  coexistence callbacks that dispatch here.

config ESP32_TIMER_TASK_PRIO
	int "Task priority of the high resolution ESP Timer"
	default 3
	help
	  Set the task priority for the internal high resolution ESP Timer
	  used in Wi-Fi and BLE peripherals.

config ESP32_MAC_BB_PD
	bool "Power down MAC and baseband of Wi-Fi and Bluetooth when PHY is disabled"
	depends on SOC_SERIES_ESP32C2 || SOC_SERIES_ESP32C3 || SOC_SERIES_ESP32C5 || \
		SOC_SERIES_ESP32C6 || SOC_SERIES_ESP32C61 || SOC_SERIES_ESP32S3
	depends on TICKLESS_KERNEL && PM
	help
	  If enabled, the MAC and baseband of Wi-Fi and Bluetooth will be powered
	  down when PHY is disabled. Enabling this setting reduces power consumption
	  by a small amount but increases RAM use by approximately 4 KB (Wi-Fi only),
	  2 KB (Bluetooth only) or 5.3 KB (Wi-Fi + Bluetooth).

config MAC_BB_PD
	bool "Power down MAC and baseband when PHY is disabled [DEPRECATED]"
	depends on SOC_SERIES_ESP32C2 || SOC_SERIES_ESP32C3 || SOC_SERIES_ESP32C5 || \
		SOC_SERIES_ESP32C6 || SOC_SERIES_ESP32C61 || SOC_SERIES_ESP32S3
	depends on TICKLESS_KERNEL && PM
	select DEPRECATED
	imply ESP32_MAC_BB_PD
	help
	  Deprecated. Use ESP32_MAC_BB_PD instead.

if (BT_ESP32 || WIFI_ESP32 || IEEE802154_ESP32)

config ESP32_PHY_MAX_TX_POWER
	int "Max Wi-Fi/BLE/IEEE802154 TX power (dBm)"
	range 10 20
	default 20
	help
	  Set maximum transmit power for the ESP32 radio. Actual transmit power for high
	  data rates may be lower than this setting.

config ESP32_SW_COEXIST_ENABLE
	bool "Software controls Wi-Fi/Bluetooth coexistence"
	default y if (BT_ESP32 && WIFI_ESP32) || \
		(WIFI_ESP32 && IEEE802154_ESP32) || \
		(IEEE802154_ESP32 && BT_ESP32)
	help
	  If enabled, Wi-Fi & Bluetooth coexistence is controlled by software rather than hardware.
	  Recommended for heavy traffic scenarios. Both coexistence configuration options are
	  automatically managed, no user intervention is required.
	  If only Bluetooth is used, it is recommended to disable this option to reduce binary file
	  size.

endif

endif # SOC_FAMILY_ESPRESSIF_ESP32
```

## modules/Kconfig.intel
```kconfig
# Copyright (c) 2023 Intel Corporation
# SPDX-License-Identifier: Apache-2.0

config ZEPHYR_HAL_INTEL_MODULE
	bool

config ZEPHYR_HAL_INTEL_MODULE_ACTIVE
	bool
	depends on ZEPHYR_HAL_INTEL_MODULE

config INTEL_HAL
	bool
	select ZEPHYR_HAL_INTEL_MODULE_ACTIVE
	help
	  Build the Intel HAL module during build process.
	  This is selected by the ARCH kconfig automatically.
```

## modules/Kconfig.libmctp
```kconfig
# libmctp configuration

# SPDX-FileCopyrightText: Copyright The Zephyr Project Contributors
# SPDX-License-Identifier: Apache-2.0

config ZEPHYR_LIBMCTP_MODULE
	bool

config ZEPHYR_LIBMCTP_MODULE_ACTIVE
	bool
	depends on ZEPHYR_LIBMCTP_MODULE
```

## modules/Kconfig.libmetal
```kconfig
# Copyright (c) 2018 Linaro Limited
# SPDX-License-Identifier: Apache-2.0

config ZEPHYR_LIBMETAL_MODULE
	bool

config ZEPHYR_LIBMETAL_MODULE_ACTIVE
	bool
	depends on ZEPHYR_LIBMETAL_MODULE

menuconfig LIBMETAL
	bool "libmetal Support"
	select ZEPHYR_LIBMETAL_MODULE_ACTIVE
	help
	  This option enables the libmetal HAL abstraction layer

config LIBMETAL_SRC_PATH
	string "libmetal library source path"
	default "libmetal"
	depends on LIBMETAL
	help
	  This option specifies the path to the source for the libmetal library
```

## modules/Kconfig.microchip
```kconfig
# Microchip MEC HAL drivers configuration

# SPDX-License-Identifier: Apache-2.0

config ZEPHYR_HAL_MICROCHIP_MODULE
	bool

config ZEPHYR_HAL_MICROCHIP_MODULE_ACTIVE
	bool
	depends on ZEPHYR_HAL_MICROCHIP_MODULE

config HAS_MEC_HAL
	bool "Microchip MEC HAL drivers support"
	select ZEPHYR_HAL_MICROCHIP_MODULE_ACTIVE

config HAS_MPFS_HAL
	bool "Microchip MPFS HAL drivers support"
	select ZEPHYR_HAL_MICROCHIP_MODULE_ACTIVE

config HAS_MEC5_HAL
	bool "Microchip MEC5 HAL drivers support"
	select ZEPHYR_HAL_MICROCHIP_MODULE_ACTIVE

config MICROCHIP_PIC32C
	bool
	select ZEPHYR_HAL_MICROCHIP_MODULE_ACTIVE

config MICROCHIP_SAM
	bool
	select ZEPHYR_HAL_MICROCHIP_MODULE_ACTIVE
```

## modules/Kconfig.mspm0
```kconfig
# MSPM0 SDK configuration

# Copyright (c) 2025 Texas Instruments
# SPDX-License-Identifier: Apache-2.0

# ZEPHYR_TI_MODULE is declared in Kconfig.simplelink.
config HAS_MSPM0_SDK
	bool
	select ZEPHYR_TI_MODULE_ACTIVE

if HAS_MSPM0_SDK

config USE_MSPM0_DL_GPIO
	bool

config USE_MSPM0_DL_AES
	bool

config USE_MSPM0_DL_UART
	bool

config USE_MSPM0_DL_TIMER
	bool

config USE_MSPM0_DL_MCAN
	bool

config USE_MSPM0_DL_DAC12
	bool

config USE_MSPM0_DL_SPI
	bool

config USE_MSPM0_DL_VREF
	bool

config USE_MSPM0_DL_ADC
	bool

config USE_MSPM0_DL_DMA
	bool

endif # HAS_MSPM0_SDK
```

## modules/Kconfig.nrf_hw_models
```kconfig
# BabbleSim nRF hardware models configuration

# SPDX-FileCopyrightText: Copyright The Zephyr Project Contributors
# SPDX-License-Identifier: Apache-2.0

config ZEPHYR_NRF_HW_MODELS_MODULE
	bool

config ZEPHYR_NRF_HW_MODELS_MODULE_ACTIVE
	bool
	depends on ZEPHYR_NRF_HW_MODELS_MODULE
	select ZEPHYR_HAL_NORDIC_MODULE_ACTIVE
	help
	  Simulated nRF peripherals for the BabbleSim boards. The models are
	  built against the nRF HAL, which the module.yml also records.
```

## modules/Kconfig.nuvoton
```kconfig
# SPDX-License-Identifier: Apache-2.0
#
# Copyright (c) 2020 Linumiz
# Author: Saravanan Sekar <saravanan@linumiz.com>

config HAS_NUMICRO_HAL
	bool
	select HAS_CMSIS_CORE
	depends on SOC_FAMILY_NUMICRO

menu "Nuvoton drivers"
	depends on HAS_NUMICRO_HAL

config HAS_NUMICRO_UART
	bool "NuMicro UART"
	help
	  Enable Nuvoton Universal asynchronous receiver transmitter HAL
	  module driver

endmenu

config HAS_NUMAKER_HAL
	bool
	select HAS_CMSIS_CORE
	depends on SOC_FAMILY_NUMAKER

menu "Nuvoton NuMaker drivers"
	depends on HAS_NUMAKER_HAL
	config HAS_NUMAKER_UART
		bool "NuMaker UART"
		help
		  Enable Nuvoton Universal asynchronous receiver transmitter HAL
		  module driver
	config HAS_NUMAKER_GPIO
		bool "NuMaker GPIO"
		help
		  Enable Nuvoton gpio HAL module driver
	config HAS_NUMAKER_FMC
		bool "NuMaker FMC"
		help
		  Enable Nuvoton FMC HAL module driver
	config HAS_NUMAKER_I2C
		bool "NuMaker I2C"
		help
		  Enable Nuvoton I2C HAL module driver
	config HAS_NUMAKER_SPI
		bool "NuMaker SPI"
		help
		  Enable Nuvoton SPI HAL module driver
	config HAS_NUMAKER_PWM
		bool "NuMaker PWM"
		help
		  Enable Nuvoton PWM HAL module driver
	config HAS_NUMAKER_BPWM
		bool "NuMaker BPWM"
		help
		  Enable Nuvoton Basic PWM (BPWM) HAL module driver
	config HAS_NUMAKER_ECAP
		bool "NuMaker ECAP"
		help
		  Enable Nuvoton Enhanced Input Capture (ECAP) HAL module driver
	config HAS_NUMAKER_I2S
		bool "NuMaker I2S"
		help
		  Enable Nuvoton I2S HAL module driver
	config HAS_NUMAKER_DMA
		bool "NuMaker PDMA"
		help
		  Enable Nuvoton Peripheral DMA (PDMA) HAL module driver
	config HAS_NUMAKER_USBD
		bool "NuMaker USB 1.1 device controller"
		help
		  Enable Nuvoton USB 1.1 device controller HAL module driver
	config HAS_NUMAKER_HSUSBD
		bool "NuMaker high-speed USB 2.0 device controller"
		help
		  Enable Nuvoton high-speed USB 2.0 device controller HAL module driver
	config HAS_NUMAKER_ETH
		bool "NuMaker ETH"
		help
		  Enable Nuvoton ETH EMAC HAL module driver
	config HAS_NUMAKER_CANFD
		bool "NuMaker CAN FD"
		help
		  Enable Nuvoton CAN FD HAL module driver
	config HAS_NUMAKER_ADC
		bool "NuMaker ADC"
		help
		  Enable Nuvoton ADC HAL module driver
	config HAS_NUMAKER_RMC
		bool "NuMaker RMC"
		help
		  Enable Nuvoton RMC HAL module driver
	config HAS_NUMAKER_RTC
		bool "NuMaker RTC"
		help
		  Enable Nuvoton RTC HAL module driver
	config HAS_NUMAKER_TMR
		bool "NuMaker Timer"
		help
		  Enable Nuvoton Timer HAL module driver
endmenu
```

## modules/Kconfig.open-amp
```kconfig
# Copyright (c) 2018 Linaro Limited
# SPDX-License-Identifier: Apache-2.0

config ZEPHYR_OPEN_AMP_MODULE
	bool

config ZEPHYR_OPEN_AMP_MODULE_ACTIVE
	bool
	depends on ZEPHYR_OPEN_AMP_MODULE

config OPENAMP
	bool "OpenAMP Support"
	select ZEPHYR_OPEN_AMP_MODULE_ACTIVE
	select LIBMETAL
	help
	  This option enables the OpenAMP IPC library

if OPENAMP

config OPENAMP_SRC_PATH
	string "OpenAMP library source path"
	default "open-amp"
	depends on OPENAMP
	help
	  This option specifies the path to the source for the open-amp library

config OPENAMP_MASTER
	bool "OpenAMP Master Support"
	default y
	help
	  This option enables support for OpenAMP VirtIO Master

config OPENAMP_SLAVE
	bool "OpenAMP Slave Support"
	default y
	help
	  This option enables support for OpenAMP VirtIO Slave

config OPENAMP_WITH_DCACHE
	bool "Build OpenAMP with vrings cache operations enabled"
	depends on CACHE_MANAGEMENT
	help
	  Build OpenAMP with vrings cache operations enabled.
endif # OPENAMP
```

## modules/Kconfig.picolibc
```kconfig
# Copyright 2023 Google LLC
# SPDX-License-Identifier: Apache-2.0

config ZEPHYR_PICOLIBC_MODULE
	bool

config ZEPHYR_PICOLIBC_MODULE_ACTIVE
	bool
	depends on ZEPHYR_PICOLIBC_MODULE
```

## modules/Kconfig.telink
```kconfig
# Copyright (c) 2021 Telink Semiconductor
# SPDX-License-Identifier: Apache-2.0

config ZEPHYR_HAL_TELINK_MODULE
	bool

config ZEPHYR_HAL_TELINK_MODULE_ACTIVE
	bool
	depends on ZEPHYR_HAL_TELINK_MODULE

config HAS_TELINK_DRIVERS
	bool "Telink Drivers"
	select ZEPHYR_HAL_TELINK_MODULE_ACTIVE
	help
	  This option enables Telink Drivers APIs.
```

## modules/Kconfig.vega
```kconfig
# Copyright (c) 2018 Foundries.io
# SPDX-License-Identifier: Apache-2.0

config ZEPHYR_OPENISA_MODULE
	bool

config ZEPHYR_OPENISA_MODULE_ACTIVE
	bool
	depends on ZEPHYR_OPENISA_MODULE

config VEGA_SDK_HAL
	bool "RV32M1 VEGA SDK support"
	depends on SOC_OPENISA_RV32M1
	select ZEPHYR_OPENISA_MODULE_ACTIVE

config HAS_RV32M1_LPUART
	bool
	help
	  Set if the low power uart (LPUART) module is present in the SoC.

config HAS_RV32M1_LPI2C
	bool
	help
	  Set if the low power i2c (LPI2C) module is present in the SoC.

config HAS_RV32M1_LPSPI
	bool
	help
	  Set if the low power spi (LPSPI) module is present in the SoC.

config HAS_RV32M1_TPM
	bool
	help
	  Set if the Timer/PWM (TPM) module is present in the SoC.

config HAS_RV32M1_FTFX
	bool
	help
	  Set if the flash memory (FTFA, FTFE, or FTFL) module is present in
	  the SoC.
```

## modules/Kconfig.xenlib
```kconfig
# zephyr-xenlib configuration

# SPDX-FileCopyrightText: Copyright The Zephyr Project Contributors
# SPDX-License-Identifier: Apache-2.0

config ZEPHYR_XENLIB_MODULE
	bool

config ZEPHYR_XENLIB_MODULE_ACTIVE
	bool
	depends on ZEPHYR_XENLIB_MODULE
```

## modules/Kconfig.xtensa
```kconfig
# Copyright (c) 2019 Intel Corporation
# SPDX-License-Identifier: Apache-2.0

config ZEPHYR_XTENSA_MODULE
	bool

config ZEPHYR_XTENSA_MODULE_ACTIVE
	bool
	depends on ZEPHYR_XTENSA_MODULE

config XTENSA_HAL
	bool
	select ZEPHYR_XTENSA_MODULE_ACTIVE
	help
	  Build the Xtensa HAL module during build process.
	  This is selected by the Xtensa ARCH kconfig automatically.
```

## modules/cmsis/Kconfig
```kconfig
# Copyright (c) 2016 Intel Corporation
# SPDX-License-Identifier: Apache-2.0

config ZEPHYR_CMSIS_MODULE
	bool

config HAS_CMSIS_CORE
	bool

config HAS_CMSIS_CORE_A
	bool
	select HAS_CMSIS_CORE

config HAS_CMSIS_CORE_R
	bool
	select HAS_CMSIS_CORE
```

## modules/cmsis_6/Kconfig
```kconfig
# Copyright (c) 2016 Intel Corporation
# Copyright 2025 Arm Limited and/or its affiliates <open-source-office@arm.com>
# SPDX-License-Identifier: Apache-2.0

config ZEPHYR_CMSIS_6_MODULE
	bool

config HAS_CMSIS_CORE
	bool

config HAS_CMSIS_CORE_M
	bool
	select HAS_CMSIS_CORE

if HAS_CMSIS_CORE

config CMSIS_M_CHECK_DEVICE_DEFINES
	bool "Check device defines"
	depends on HAS_CMSIS_CORE_M
	help
	  This options enables the validation of CMSIS configuration flags.

config CMSIS_CORE_HAS_SYSTEM_CORE_CLOCK
	bool
	help
	  Enable this option if CMSIS SystemCoreClock symbols is available.

endif
```

## modules/gpu-vglite/Kconfig
```kconfig
# Copyright 2026 NXP
# SPDX-License-Identifier: Apache-2.0


config ZEPHYR_GPU_VGLITE_MODULE
	bool

config VGLITE
	bool "VGLite support"
	select LV_USE_DRAW_VG_LITE
	help
	  Enable the external VGLite graphics driver.
```

## modules/hal_ambiq/Kconfig
```kconfig
# SPDX-License-Identifier: Apache-2.0
#
# Copyright (c) 2023 Antmicro <www.antmicro.com>
# Copyright (c) 2025, Ambiq Micro Inc. <www.ambiq.com>

config ZEPHYR_HAL_AMBIQ_MODULE
	bool

config ZEPHYR_HAL_AMBIQ_MODULE_ACTIVE
	bool
	depends on ZEPHYR_HAL_AMBIQ_MODULE

rsource "Kconfig.hal"
rsource "Kconfig.components"
```

## modules/hal_bouffalolab/Kconfig
```kconfig
# Copyright (c) 2021-2025 Gerson Fernando Budke <nandojve@gmail.com>
# Copyright (c) 2024-2025 MASSDRIVER EI (massdriver.space)
#
# SPDX-License-Identifier: Apache-2.0

config ZEPHYR_HAL_BOUFFALOLAB_MODULE
	bool

config ZEPHYR_HAL_BOUFFALOLAB_MODULE_ACTIVE
	bool
	depends on ZEPHYR_HAL_BOUFFALOLAB_MODULE

config HAS_BFLB_SOC_HAL
	bool
	select ZEPHYR_HAL_BOUFFALOLAB_MODULE_ACTIVE
	help
	  The Bouffalo Lab SoC headers and startup code. Selected by the SoC
	  family, whose sources are built against them.

config BFLB_FREERTOS_SHIM
	bool
	select ZEPHYR_HAL_BOUFFALOLAB_MODULE_ACTIVE
	help
	  FreeRTOS-to-Zephyr shim for Bouffalo Lab BLE controller blobs.
	  Selected by SoC-specific BLE drivers that need it.

config BFLB_BTBLE_TASK_PRIO
	int "BLE controller task priority"
	default 5
	depends on BFLB_FREERTOS_SHIM
	help
	  Priority level reported to the BLE controller blob via the
	  FreeRTOS shim uxTaskPriorityGet() function.

config BFLB_BTBLE_PORT_OS_SHIM
	bool
	select ZEPHYR_HAL_BOUFFALOLAB_MODULE_ACTIVE
	help
	  Zephyr RTOS port for the btblecontroller binary blob.
	  Implements the btblecontroller_* OS abstraction for BL702L/BL616.
	  Selected by SoC-specific BLE drivers that use the btblecontroller API.

config BFLB_WL80211_SHIM
	bool
	select ZEPHYR_HAL_BOUFFALOLAB_MODULE_ACTIVE
	help
	  WL80211 supplicant bridge and RTOS port shim for the WiFi blob.
	  Provides the wl80211_supplicant_* entry points and OS abstractions
	  that the MACSW blob requires. Selected by the BL61x WiFi driver.

config BFLB_SHIM_HEAP_SIZE
	int "BLE shim heap size"
	default 8192
	depends on BFLB_FREERTOS_SHIM || BFLB_BTBLE_PORT_OS_SHIM
	help
	  Size in bytes of the dedicated memory pool used by the BLE
	  controller shim layer for threads, stacks, and queues.
```

## modules/hal_cyw43/Kconfig
```kconfig
# Copyright (c) 2026 Igalia S.L.
# SPDX-License-Identifier: Apache-2.0

config ZEPHYR_HAL_CYW43_MODULE
	bool

config CYW43_DRIVER
	bool "Infineon CYW43439 support driver by George Robotics"
	help
	  Enables support for Infineon CYW43439.
```
