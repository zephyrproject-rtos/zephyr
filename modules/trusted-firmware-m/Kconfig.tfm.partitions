## modules/wolfssl/Kconfig.tls-generic
```kconfig
# Kconfig.tls - TLS/DTLS related options

#
# Copyright (c) 2018 Intel Corporation
# Copyright (c) 2018 Nordic Semiconductor ASA
#
# SPDX-License-Identifier: Apache-2.0
#

menu "TLS configuration"

menu "Supported TLS version"

config WOLFSSL_TLS_VERSION_1_0
	bool "Enable support for TLS 1.0"
	select WOLFSSL_ALLOW_TLSV10_ENABLED

config WOLFSSL_TLS_VERSION_1_1
	bool "Enable support for TLS 1.1"
	select WOLFSSL_NO_OLD_TLS_DISABLED

config WOLFSSL_TLS_VERSION_1_2
	bool "Enable support for TLS 1.2"
	default y

config WOLFSSL_TLS_VERSION_1_3
	bool "Enable support for TLS 1.3"
	select WOLFSSL_TLS13_ENABLED

endmenu

menu "Ciphersuite configuration"

comment "Supported key exchange modes"

config WOLFSSL_KEY_EXCHANGE_ALL_ENABLED
	bool "Enable all available ciphersuite modes"
	select WOLFSSL_KEY_EXCHANGE_PSK_ENABLED
	select WOLFSSL_KEY_EXCHANGE_DHE_PSK_ENABLED
	select WOLFSSL_KEY_EXCHANGE_ECDHE_PSK_ENABLED
	select WOLFSSL_KEY_EXCHANGE_RSA_PSK_ENABLED
	select WOLFSSL_KEY_EXCHANGE_RSA_ENABLED
	select WOLFSSL_KEY_EXCHANGE_DHE_RSA_ENABLED
	select WOLFSSL_KEY_EXCHANGE_ECDHE_RSA_ENABLED
	select WOLFSSL_KEY_EXCHANGE_ECDHE_ECDSA_ENABLED
	select WOLFSSL_KEY_EXCHANGE_ECDHE_ECDSA_ENABLED
	select WOLFSSL_KEY_EXCHANGE_ECDH_ECDSA_ENABLED
	select WOLFSSL_KEY_EXCHANGE_ECDH_RSA_ENABLED
	select WOLFSSL_KEY_EXCHANGE_ECJPAKE_ENABLED

config WOLFSSL_KEY_EXCHANGE_PSK_ENABLED
	bool "Enable the PSK based ciphersuite modes"

config WOLFSSL_KEY_EXCHANGE_DHE_PSK_ENABLED
	bool "Enable the DHE-PSK based ciphersuite modes"

config WOLFSSL_KEY_EXCHANGE_ECDHE_PSK_ENABLED
	bool "Enable the ECDHE-PSK based ciphersuite modes"

config WOLFSSL_KEY_EXCHANGE_RSA_PSK_ENABLED
	bool "Enable the RSA-PSK based ciphersuite modes"

config WOLFSSL_KEY_EXCHANGE_RSA_ENABLED
	bool "Enable the RSA-only based ciphersuite modes"
	default y

config WOLFSSL_KEY_EXCHANGE_DHE_RSA_ENABLED
	bool "Enable the DHE-RSA based ciphersuite modes"

config WOLFSSL_KEY_EXCHANGE_ECDHE_RSA_ENABLED
	bool "Enable the ECDHE-RSA based ciphersuite modes"

config WOLFSSL_KEY_EXCHANGE_ECDHE_ECDSA_ENABLED
	bool "Enable the ECDHE-ECDSA based ciphersuite modes"

config WOLFSSL_KEY_EXCHANGE_ECDH_ECDSA_ENABLED
	bool "Enable the ECDH-ECDSA based ciphersuite modes"

config WOLFSSL_KEY_EXCHANGE_ECDH_RSA_ENABLED
	bool "Enable the ECDH-RSA based ciphersuite modes"

config WOLFSSL_KEY_EXCHANGE_ECJPAKE_ENABLED
	bool "Enable the ECJPAKE based ciphersuite modes"

if WOLFSSL_KEY_EXCHANGE_ECDHE_PSK_ENABLED || \
   WOLFSSL_KEY_EXCHANGE_ECDHE_RSA_ENABLED || \
   WOLFSSL_KEY_EXCHANGE_ECDHE_ECDSA_ENABLED || \
   WOLFSSL_KEY_EXCHANGE_ECDH_ECDSA_ENABLED || \
   WOLFSSL_KEY_EXCHANGE_ECDH_RSA_ENABLED || \
   WOLFSSL_KEY_EXCHANGE_ECJPAKE_ENABLED

comment "Supported elliptic curves"

config WOLFSSL_ECP_ALL_ENABLED
	bool "Enable all available elliptic curves"
	select WOLFSSL_ECP_DP_SECP192R1_ENABLED
	select WOLFSSL_ECP_DP_SECP192R1_ENABLED
	select WOLFSSL_ECP_DP_SECP224R1_ENABLED
	select WOLFSSL_ECP_DP_SECP256R1_ENABLED
	select WOLFSSL_ECP_DP_SECP384R1_ENABLED
	select WOLFSSL_ECP_DP_SECP521R1_ENABLED
	select WOLFSSL_ECP_DP_SECP192K1_ENABLED
	select WOLFSSL_ECP_DP_SECP224K1_ENABLED
	select WOLFSSL_ECP_DP_SECP256K1_ENABLED
	select WOLFSSL_ECP_DP_BP256R1_ENABLED
	select WOLFSSL_ECP_DP_BP384R1_ENABLED
	select WOLFSSL_ECP_DP_BP512R1_ENABLED
	select WOLFSSL_ECP_DP_CURVE25519_ENABLED
	select WOLFSSL_ECP_DP_CURVE448_ENABLED
	select WOLFSSL_ECP_NIST_OPTIM

config WOLFSSL_ECP_DP_SECP192R1_ENABLED
	bool "Enable SECP192R1 elliptic curve"

config WOLFSSL_ECP_DP_SECP224R1_ENABLED
	bool "Enable SECP224R1 elliptic curve"

config WOLFSSL_ECP_DP_SECP256R1_ENABLED
	bool "Enable SECP256R1 elliptic curve"

config WOLFSSL_ECP_DP_SECP384R1_ENABLED
	bool "Enable SECP384R1 elliptic curve"

config WOLFSSL_ECP_DP_SECP521R1_ENABLED
	bool "Enable SECP521R1 elliptic curve"

config WOLFSSL_ECP_DP_SECP192K1_ENABLED
	bool "Enable SECP192K1 elliptic curve"

config WOLFSSL_ECP_DP_SECP224K1_ENABLED
	bool "Enable SECP224K1 elliptic curve"

config WOLFSSL_ECP_DP_SECP256K1_ENABLED
	bool "Enable SECP256K1 elliptic curve"

config WOLFSSL_ECP_DP_BP256R1_ENABLED
	bool "Enable BP256R1 elliptic curve"

config WOLFSSL_ECP_DP_BP384R1_ENABLED
	bool "Enable BP384R1 elliptic curve"

config WOLFSSL_ECP_DP_BP512R1_ENABLED
	bool "Enable BP512R1 elliptic curve"

config WOLFSSL_ECP_DP_CURVE25519_ENABLED
	bool "Enable CURVE25519 elliptic curve"

config WOLFSSL_ECP_DP_CURVE448_ENABLED
	bool "Enable CURVE448 elliptic curve"

config WOLFSSL_ECP_NIST_OPTIM
	bool "Enable NSIT curves optimization"

endif

comment "Supported cipher modes"

config WOLFSSL_CIPHER_ALL_ENABLED
	bool "Enable all available ciphers"
	select WOLFSSL_CIPHER_AES_ENABLED
	select WOLFSSL_CIPHER_CAMELLIA_ENABLED
	select WOLFSSL_CIPHER_DES_ENABLED
	select WOLFSSL_CIPHER_ARC4_ENABLED
	select WOLFSSL_CIPHER_CHACHA20_ENABLED
	select WOLFSSL_CIPHER_BLOWFISH_ENABLED
	select WOLFSSL_CIPHER_CCM_ENABLED
	select WOLFSSL_CIPHER_MODE_XTS_ENABLED
	select WOLFSSL_CIPHER_MODE_GCM_ENABLED
	select WOLFSSL_CIPHER_CBC_ENABLED
	select WOLFSSL_CHACHAPOLY_AEAD_ENABLED

config WOLFSSL_CIPHER_AES_ENABLED
	bool "Enable the AES block cipher"
	default y

config WOLFSSL_AES_ROM_TABLES
	depends on WOLFSSL_CIPHER_AES_ENABLED
	bool "Use precomputed AES tables stored in ROM."
	default y

config WOLFSSL_CIPHER_CAMELLIA_ENABLED
	bool "Enable the Camellia block cipher"

config WOLFSSL_CIPHER_DES_ENABLED
	bool "Enable the DES block cipher"
	default y

config WOLFSSL_CIPHER_ARC4_ENABLED
	bool "Enable the ARC4 stream cipher"

config WOLFSSL_CIPHER_CHACHA20_ENABLED
	bool "Enable the ChaCha20 stream cipher"

config WOLFSSL_CIPHER_BLOWFISH_ENABLED
	bool "Enable the Blowfish block cipher"

config WOLFSSL_CIPHER_CCM_ENABLED
	bool "Enable the Counter with CBC-MAC (CCM) mode for 128-bit block cipher"
	depends on WOLFSSL_CIPHER_AES_ENABLED || WOLFSSL_CIPHER_CAMELLIA_ENABLED

config WOLFSSL_CIPHER_MODE_XTS_ENABLED
	bool "Enable Xor-encrypt-xor with ciphertext stealing mode (XTS) for AES"
	depends on WOLFSSL_CIPHER_AES_ENABLED || WOLFSSL_CIPHER_CAMELLIA_ENABLED

config WOLFSSL_CIPHER_MODE_GCM_ENABLED
	bool "Enable the Galois/Counter Mode (GCM) for AES"
	depends on WOLFSSL_CIPHER_AES_ENABLED || WOLFSSL_CIPHER_CAMELLIA_ENABLED

config WOLFSSL_CIPHER_CBC_ENABLED
	bool "Enable Cipher Block Chaining mode (CBC) for symmetric ciphers"
	default y

config WOLFSSL_CHACHAPOLY_AEAD_ENABLED
	bool "Enable the ChaCha20-Poly1305 AEAD algorithm"
	depends on WOLFSSL_CIPHER_CHACHA20_ENABLED || WOLFSSL_MAC_POLY1305_ENABLED

comment "Supported message authentication methods"

config WOLFSSL_MAC_ALL_ENABLED
	bool "Enable all available MAC methods"
	select WOLFSSL_MAC_MD4_ENABLED
	select WOLFSSL_MAC_MD5_ENABLED
	select WOLFSSL_MAC_SHA1_ENABLED
	select WOLFSSL_MAC_SHA256_ENABLED
	select WOLFSSL_MAC_SHA512_ENABLED
	select WOLFSSL_MAC_POLY1305_ENABLED

config WOLFSSL_MAC_MD4_ENABLED
	bool "Enable the MD4 hash algorithm"

config WOLFSSL_MAC_MD5_ENABLED
	bool "Enable the MD5 hash algorithm"
	default y

config WOLFSSL_MAC_SHA1_ENABLED
	bool "Enable the SHA1 hash algorithm"
	default y

config WOLFSSL_MAC_SHA256_ENABLED
	bool "Enable the SHA-224 and SHA-256 hash algorithms"
	default y

config WOLFSSL_MAC_SHA512_ENABLED
	bool "Enable the SHA-384 and SHA-512 hash algorithms"

config WOLFSSL_MAC_POLY1305_ENABLED
	bool "Enable the Poly1305 MAC algorithm"

endmenu

comment "Random number generators"

config WOLFSSL_HMAC_DRBG_ENABLED
	bool "Enable the HMAC_DRBG random generator"
	default y

comment "Other configurations"

config WOLFSSL_HAVE_ASM
	bool "Enable use of assembly code"
	default y
	help
	  Enable use of assembly code in wolfSSL. This improves the performances
	  of asymmetric cryptography, however this might have an impact on the
	  code size.

endmenu
```

## modules/wolfssl/samples/wolfssl_benchmark/sample.yaml
```yaml
sample:
  description: wolfCrypt benchmark sample app
  name: wolfCrypt benchmark
common:
  tags: crypto wolfssl userspace random
  harness: console
  harness_config:
    type: one_line
    regex:
      - "Benchmark complete"
tests:
  sample.crypto.wolfssl_benchmark:
    platform_allow: qemu_x86
    integration_platforms:
      - qemu_x86
```

## modules/wolfssl/samples/wolfssl_test/boards/nrf5340dk_nrf5340_cpuapp_ns.conf
```kconfig
CONFIG_BUILD_WITH_TFM=y
CONFIG_TFM_PROFILE_TYPE_NOT_SET=y

# Set user_settings.h file to be used for native wolfSSL build settings
#CONFIG_WOLFSSL_SETTINGS_FILE="user_settings_custom.h"

##### PSA and CC3XX #####
# Enable Nordic Security Module
CONFIG_NRF_SECURITY=y
CONFIG_ENTROPY_DEVICE_RANDOM_GENERATOR=y
# Enable PSA API support (comes from mbedTLS)
CONFIG_MBEDTLS_PSA_CRYPTO_C=y
# Enable/configure mbedTLS heap
CONFIG_MBEDTLS_ENABLE_HEAP=y
CONFIG_MBEDTLS_HEAP_SIZE=8192
# Disable nrf_oberon crypto library PSA backend
CONFIG_PSA_CRYPTO_DRIVER_OBERON=n
# Enable ARM CryptoCell cc3xx driver PSA backend
CONFIG_PSA_CRYPTO_DRIVER_CC3XX=y

##### Logging #####
CONFIG_USE_SEGGER_RTT=y
CONFIG_LOG_BACKEND_RTT=y
CONFIG_SEGGER_RTT_BUFFER_SIZE_UP=15360
```

## modules/wolfssl/samples/wolfssl_test/sample.yaml
```yaml
sample:
  description: wolfCrypt test sample app
  name: wolfCrypt test
common:
  harness: console
  harness_config:
    type: one_line
    regex:
      - "Exiting main with return code: 0"
tests:
  sample.crypto.wolfssl_test:
    timeout: 120
    platform_allow: qemu_x86
    integration_platforms:
      - qemu_x86
  sample.crypto.wolfssl_test_no_malloc:
    timeout: 120
    platform_allow: qemu_x86
    extra_args: CONF_FILE="prj-no-malloc.conf"
    integration_platforms:
      - qemu_x86
```

## modules/wolfssl/samples/wolfssl_tls_sock/sample.yaml
```yaml
sample:
  description: wolfSSL TLS test application
  name: wolfSSL TLS Test
common:
  harness: console
  harness_config:
    type: multi_line
    regex:
      - "Server Return: 0"
      - "Client Return: 0"
      - "Done"
tests:
  sample.crypto.wolfssl_tls_sock:
    timeout: 60
    platform_allow: qemu_x86
    integration_platforms:
      - qemu_x86
  sample.crypto.wolfssl_tls_sock_no_malloc:
    timeout: 60
    platform_allow: qemu_x86
    extra_args: CONF_FILE="prj-no-malloc.conf"
    integration_platforms:
      - qemu_x86
```

## modules/wolfssl/samples/wolfssl_tls_thread/sample.yaml
```yaml
sample:
  description: wolfSSL TLS test application
  name: wolfSSL TLS Test
common:
  harness: console
  harness_config:
    type: multi_line
    regex:
      - "Server Return: 0"
      - "Server Error: 0"
      - "Client Return: 0"
      - "Client Error: 0"
tests:
  sample.crypto.wolfssl_tls_thread:
    timeout: 60
    platform_allow: qemu_x86
    integration_platforms:
      - qemu_x86
```

## modules/zcbor/Kconfig
```kconfig
# Copyright (c) 2022 Nordic Semiconductor ASA
# SPDX-License-Identifier: Apache-2.0

config ZEPHYR_ZCBOR_MODULE
	bool

config ZCBOR
	bool "zcbor CBOR library"
	depends on ZEPHYR_ZCBOR_MODULE
	help
	  zcbor CBOR encoder/decoder library

if ZCBOR

config ZCBOR_CANONICAL
	bool "Produce canonical CBOR"
	help
	  Enabling this will prevent zcbor from creating lists and maps with
	  indefinite-length arrays.
	  Enabling this also enables the state->constant_state->enforce_canonical
	  flag in all zcbor states. This flag controls validation of canonical
	  data when decoding. If you only want canonical encoding, please set
	  the enforce_canonical flag to false in all new state structs after
	  initialization.

config ZCBOR_STOP_ON_ERROR
	bool "Stop on error when processing (Must also be enabled in state var)"
	help
	  Make the stop_on_error functionality available. Note that it still
	  needs to be enabled in the state variable
	  (`state->constant_state->stop_on_error`).
	  This makes all functions abort their execution if called when an error
	  has already happened.

config ZCBOR_VERBOSE
	bool "Make zcbor code print messages via printf"

config ZCBOR_ASSERT
	def_bool ASSERT

config ZCBOR_BIG_ENDIAN
	def_bool BIG_ENDIAN

config ZCBOR_MAX_STR_LEN
	int "Default max length when calling zcbor_tstr_put_term()"
	default 256
	help
	  This can be manually used if no other value is readily available, but
	  using this is discouraged.

endif # ZCBOR
```

## modules/zephyr-xenlib/Kconfig
```kconfig
# Copyright (c) 2025 TOKITA Hiroshi
# SPDX-License-Identifier: Apache-2.0

config ZEPHYR_XENLIB_MODULE
	bool
```

## net/Kconfig
```kconfig
# Kconfig - net stack configuration options

#
# Copyright (c) 2015 Intel Corporation
#
# Licensed under the Apache License, Version 2.0 (the "License");
# you may not use this file except in compliance with the License.
# You may obtain a copy of the License at
#
#     http://www.apache.org/licenses/LICENSE-2.0
#
# Unless required by applicable law or agreed to in writing, software
# distributed under the License is distributed on an "AS IS" BASIS,
# WITHOUT WARRANTIES OR CONDITIONS OF ANY KIND, either express or implied.
# See the License for the specific language governing permissions and
# limitations under the License.
#

menu "Networking"

config NET_BUF
	bool "Network buffer support"
	default n
	help
	  This option enables support for generic network protocol
	  buffers.

config NET_BUF_DEBUG
	bool "Network buffer debugging"
	depends on NET_BUF
	select STDOUT_CONSOLE
	select SYS_LOG
	default n
	help
	  Enable debug logs and checks for the generic network buffers.

config NET_BUF_SIMPLE_DEBUG
	bool "Network buffer memory debugging"
	depends on NET_BUF_DEBUG
	select STDOUT_CONSOLE
	select SYS_LOG
	default n
	help
	  Enable extra debug logs and checks for the generic network buffers.

source "net/bluetooth/Kconfig"

config  NETWORKING
	bool "Link layer and IP networking support"
	select NANO_TIMEOUTS
	select NANO_TIMERS
	select NET_BUF
	select SYSTEM_WORKQUEUE
	select NANO_WORKQUEUE
	default n
	help
	  This option enabled generic link layer and IP networking support.

if NETWORKING

choice
	prompt "IP stack"
	default NET_UIP
	help
	  Select what IP stack to use. The legacy stack is
	  Contiki based uIP stack.

config NET_UIP
	bool "uIP"
	help
	  Choose this if unsure.

config NET_YAIP
	bool "New IP stack [EXPERIMENTAL]"
	help
	  New IP stack.
endchoice

source "net/ip/Kconfig"

source "net/yaip/Kconfig"


endif

endmenu
```
