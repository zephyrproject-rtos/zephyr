## net/yaip/Kconfig.debug
```kconfig
# Kconfig.debug - Debug Options

#
# Copyright (c) 2016 Intel Corporation.
#
# Licensed under the Apache License, Version 2.0 (the "License");
# you may not use this file except in compliance with the License.
# You may obtain a copy of the License at
#
#     http://www.apache.org/licenses/LICENSE-2.0
#
# Unless required by applicable law or agreed to in writing, software
# distributed under the License is distributed on an "AS IS" BASIS,
# WITHOUT WARRANTIES OR CONDITIONS OF ANY KIND, either express or implied.
# See the License for the specific language governing permissions and
# limitations under the License.
#

menuconfig NET_LOG
	bool "Enable network stack logging and debugging"
	default n
	select STDOUT_CONSOLE
	select SYS_LOG
	help
	Enable logging in various parts of the network stack.
	Specific debugging options to other sub-menus will be unlocked
	as well (IPv6, IPv4, ...).

if NET_LOG

config NET_DEBUG_CORE
	bool "Debug core IP stack"
	default n
	help
	Enables core network stack code part to output debug messages

config NET_DEBUG_IF
	bool "Debug network interface code"
	default n
	help
	Enables network interface code part to output debug messages

config NET_DEBUG_UTILS
	bool "Debug utility functions in IP stack"
	default n
	help
	Enables utility functions to output debug messages

config NET_DEBUG_CONTEXT
	bool "Debug network context allocation"
	default n
	help
	Enables printing of network context allocations and frees.

config NET_DEBUG_NET_BUF
	bool "Debug network buffer allocation"
	default n
	help
	Enables printing of network buffer allocations and frees.

config NET_DEBUG_CONN
	bool "Debug connection handling"
	default n
	help
	Enables connection debug messages

config NET_DEBUG_ROUTE
	bool "Debug route management"
	depends on NET_ROUTE
	default n
	help
	Enables routing engine debug messages

config NET_STATISTICS
	bool "Print network statistics"
	default n
	help
	Print network send/receive statistics to console.
	This takes memory so say 'n' if unsure.

endif # NET_LOG
```

## net/yaip/Kconfig.ipv4
```kconfig
# Kconfig.ipv4 - IPv4 Options

#
# Copyright (c) 2016 Intel Corporation.
#
# Licensed under the Apache License, Version 2.0 (the "License");
# you may not use this file except in compliance with the License.
# You may obtain a copy of the License at
#
#     http://www.apache.org/licenses/LICENSE-2.0
#
# Unless required by applicable law or agreed to in writing, software
# distributed under the License is distributed on an "AS IS" BASIS,
# WITHOUT WARRANTIES OR CONDITIONS OF ANY KIND, either express or implied.
# See the License for the specific language governing permissions and
# limitations under the License.
#

menuconfig NET_IPV4
	bool "IPv4"
	default n
	help
	Enable IPv4 support. If this is enabled then the device is
	able to send and receive IPv4 network packets.

if NET_IPV4

config NET_INITIAL_TTL
	int "Initial time to live for a connection"
	default 64
	help
	The value should be > 0

config NET_IF_UNICAST_IPV4_ADDR_COUNT
	int "Max number of unicast IPv4 addresses per network interface"
	default 1

config NET_IF_MCAST_IPV4_ADDR_COUNT
	int "Max number of multicast IPv4 addresses per network interface"
	default 1

if NET_LOG

config NET_DEBUG_IPV4
	bool "Debug core IPv4"
	default n
	help
	Enables core IPv4 code part to output debug messages

config NET_DEBUG_ICMPV4
	bool "Debug ICMPv4"
	default n
	help
	Enables ICMPv4 code part to output debug messages

endif # NET_LOG

endif # NET_IPV4
```

## net/yaip/Kconfig.ipv6
```kconfig
# Kconfig.ipv6 - IPv6 Options

#
# Copyright (c) 2016 Intel Corporation.
#
# Licensed under the Apache License, Version 2.0 (the "License");
# you may not use this file except in compliance with the License.
# You may obtain a copy of the License at
#
#     http://www.apache.org/licenses/LICENSE-2.0
#
# Unless required by applicable law or agreed to in writing, software
# distributed under the License is distributed on an "AS IS" BASIS,
# WITHOUT WARRANTIES OR CONDITIONS OF ANY KIND, either express or implied.
# See the License for the specific language governing permissions and
# limitations under the License.
#

menuconfig NET_IPV6
	bool "IPv6"
	default y
	help
	Enable IPv6 support. This should be selected by default as there
	is limited set of network bearers provided that support IPv4.

if NET_IPV6

config NET_IF_UNICAST_IPV6_ADDR_COUNT
	int "Max number of unicast IPv6 addresses per network interface"
	default 2

config NET_IF_MCAST_IPV6_ADDR_COUNT
	int "Max number of multicast IPv6 addresses per network interface"
	default 1

config NET_IF_IPV6_PREFIX_COUNT
	int "Max number of IPv6 prefixes per network interface"
	default 2

config NET_INITIAL_HOP_LIMIT
	int "Initial hop limit for a connection"
	default 64
	help
	The value should be > 0

config NET_IPV6_MAX_NEIGHBORS
	int "How many IPv6 neighbors are supported"
	default 8
	range 1 254
	help
	The value depends on your network needs.

config NET_IPV6_ND
	bool "Activate neighbor discovery"
	default y
	help
	The value depends on your network needs. ND should normally
	be active.

config NET_IPV6_DAD
	bool "Activate duplicate address detection"
	default y
	default n if !NET_IPV6_ND
	help
	The value depends on your network needs. DAD should normally
	be active.

config NET_IPV6_RA_RDNSS
	bool "Support RA RDNSS option"
	depends on !NET_IPV6_NO_ND
	default y
	help
	Support Router Advertisement Recursive DNS Server option.
	See RFC 6106 for details. The value depends on your network needs.

config NET_6LO
	bool "Enable 6lowpan IPv6 Compression library"
	help
	6lowpan compression and fragmentation.

config NET_6LO_DEBUG
	bool "Enable 6lowpan debug"
	depends on NET_6LO && NET_LOG

if NET_LOG

config NET_DEBUG_IPV6
	bool "Debug core IPv6"
	default n
	help
	Enables core IPv6 code part to output debug messages

config NET_DEBUG_ICMPV6
	bool "Debug ICMPv6"
	default n
	help
	Enables ICMPv6 code part to output debug messages

config NET_DEBUG_IPV6_NBR_CACHE
	bool "Debug IPv6 neighbour cache"
	default n
	help
	Enables Neighbour Cache code part to output debug messages

endif # NET_LOG

endif # NET_IPV6
```

## net/yaip/l2/Kconfig
```kconfig
#
# Copyright (c) 2016 Intel Corporation.
#
# Licensed under the Apache License, Version 2.0 (the "License");
# you may not use this file except in compliance with the License.
# You may obtain a copy of the License at
#
#     http://www.apache.org/licenses/LICENSE-2.0
#
# Unless required by applicable law or agreed to in writing, software
# distributed under the License is distributed on an "AS IS" BASIS,
# WITHOUT WARRANTIES OR CONDITIONS OF ANY KIND, either express or implied.
# See the License for the specific language governing permissions and
# limitations under the License.
#

config  NET_L2_DUMMY
	bool "Enable dummy l2 layer"
	default n
	default y if !NET_L2_ETHERNET && NET_SLIP
	help
	  Add a dummy L2 layer driver, usually in case you need SLIP in
	  TUN mode.

config  NET_L2_ETHERNET
	bool "Enable ethernet support"
	default n
	help
         Add suport for Ethernet, enabling selecting relevant hardware drivers.
	 If NET_SLIP and SLIP_TAP are selected, NET_L2_ETHERNET will enable to
	 fully simulate ethernet through SLIP.

config NET_ARP
       bool "Enable ARP"
       default y
       depends on NET_IPV4 && NET_L2_ETHERNET
       help
         Enable ARP support. This is necessary on hardware that requires it to
	 get IPv4 working (like Ethernet devices).

config NET_ARP_TABLE_SIZE
       int "Number of entries in ARP table."
       depends on NET_ARP
       default 2
       help
         Each entry in the ARP table consumes 22 bytes of memory.
```

## net/yaip/l2/ieee802154/Kconfig
```kconfig
#
# Copyright (c) 2016 Intel Corporation.
#
# Licensed under the Apache License, Version 2.0 (the "License");
# you may not use this file except in compliance with the License.
# You may obtain a copy of the License at
#
#     http://www.apache.org/licenses/LICENSE-2.0
#
# Unless required by applicable law or agreed to in writing, software
# distributed under the License is distributed on an "AS IS" BASIS,
# WITHOUT WARRANTIES OR CONDITIONS OF ANY KIND, either express or implied.
# See the License for the specific language governing permissions and
# limitations under the License.
#

menuconfig  NET_L2_IEEE802154
	bool "Enable IEEE 802.15.4 Radio"
	default n
	help
	  Add support for low rate WPAN IEEE 802.15.4 technology.

if NET_L2_IEEE802154

config  NET_L2_IEEE802154_DEBUG
	bool "Enable IEEE 802.15.4 stack debug messages"
	default n
	help
	  Enable it if you want to see what's happening. Only useful
	  for developers.

config  NET_L2_IEEE802154_RADIO_ALOHA
	bool "Enable IEEE 802.15.4 Aloha radio protocol"
	default y
	help
	  Use Aloha mechanism to transmit packets. This is a simplistic
	  way of transmitting packets and fits contexts where radio spectrum
	  is not too heavily loaded.

config  NET_L2_IEEE802154_RADIO_ALOHA_TX_RETRIES
	int "Transmission attempts"
	default 2
	help
	  Number of transmission attempts radio driver should do, before
	  replying it could not send the packet.

endif
```

## net/yaip/l2/ieee802154/Kconfig.radio
```kconfig
#
# Copyright (c) 2016 Intel Corporation.
#
# Licensed under the Apache License, Version 2.0 (the "License");
# you may not use this file except in compliance with the License.
# You may obtain a copy of the License at
#
#     http://www.apache.org/licenses/LICENSE-2.0
#
# Unless required by applicable law or agreed to in writing, software
# distributed under the License is distributed on an "AS IS" BASIS,
# WITHOUT WARRANTIES OR CONDITIONS OF ANY KIND, either express or implied.
# See the License for the specific language governing permissions and
# limitations under the License.
#

menu "IEEE 802.15.4 Radio protocol"

config NET_L2_IEEE802154_RADIO_TX_RETRIES
	int "Radio Transmission attempts"
	default 3
	range 1 7
	help
	Number of transmission attempts radio driver should do, before
	replying it could not send the packet.

choice
	prompt "Radio protocol"
	default NET_L2_IEEE802154_RADIO_CSMA_CA
	help
	Select which radio protocol to use.

config NET_L2_IEEE802154_RADIO_CSMA_CA
	bool "IEEE 802.15.4 CSMA-CA radio protocol"
	help
	Use CSMA-CA mechanism to transmit packets. This is the most common
	way of transmitting packets and fits most of all the usage. At least
	until the version 2011 of the specification.

config NET_L2_IEEE802154_RADIO_ALOHA
	bool "IEEE 802.15.4 Aloha radio protocol"
	help
	Use Aloha mechanism to transmit packets. This is a simplistic
	way of transmitting packets and fits contexts where radio spectrum
	is not too heavily loaded.
endchoice

if NET_L2_IEEE802154_RADIO_CSMA_CA

config NET_L2_IEEE802154_RADIO_CSMA_CA_MAX_BO
	int "CSMA maximum backoffs"
	default 4
	range 1 5
	help
	The maximum number of backoffs the CSMA-CA algorithm will attempt
	before declaring a channel access failure.

config NET_L2_IEEE802154_RADIO_CSMA_CA_MIN_BE
	int "CSMA MAC minimum backoff exponent"
	default 3
	range 1 8
	help
	The minimum value of the backoff exponent (BE) in the CSMA-CA
	algorithm.

config NET_L2_IEEE802154_RADIO_CSMA_CA_MAX_BE
	int "CSMA MAC maximum backoff exponent"
	default 5
	range 1 8
	help
	The maximum value of the backoff exponent (BE) in the CSMA-CA
	algorithm.

endif # NET_L2_IEEE802154_RADIO_CSMA_CA

endmenu
```
