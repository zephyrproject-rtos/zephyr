## modules/trusted-firmware-m/Kconfig.tfm.partitions
```kconfig
# Configuration for the partitions in the  TF-M Module

# Copyright (c) 2021 Nordic Semiconductor ASA
# SPDX-License-Identifier: Apache-2.0

if BUILD_WITH_TFM

config TFM_PARTITION_PROTECTED_STORAGE
	bool "Secure partition 'Protected Storage'"
	depends on TFM_PARTITION_PLATFORM # Specfically TFM_SP_PLATFORM_NV_COUNTER service
	depends on TFM_PARTITION_INTERNAL_TRUSTED_STORAGE
	depends on TFM_PARTITION_CRYPTO
	default y
	help
	  Setting this option will cause '-DTFM_PARTITION_PROTECTED_STORAGE'
	  to be passed to the TF-M build system. Look at 'config_default.cmake'
	  in the trusted-firmware-m repository for details regarding this
	  parameter. Any dependencies between the various TFM_PARTITION_*
	  options are handled by the build system in the trusted-firmware-m
	  repository.

config TFM_PARTITION_INTERNAL_TRUSTED_STORAGE
	bool "Secure partition 'Internal Trusted Storage'"
	default y
	help
	  Setting this option will cause '-DTFM_PARTITION_INTERNAL_TRUSTED_STORAGE'
	  to be passed to the TF-M build system. Look at 'config_default.cmake'
	  in the trusted-firmware-m repository for details regarding this
	  parameter. Any dependencies between the various TFM_PARTITION_*
	  options are handled by the build system in the trusted-firmware-m
	  repository.

config TFM_PARTITION_CRYPTO
	bool "Secure partition 'Crypto'"
	default y
	help
	  Setting this option will cause '-DTFM_PARTITION_CRYPTO'
	  to be passed to the TF-M build system. Look at 'config_default.cmake'
	  in the trusted-firmware-m repository for details regarding this
	  parameter. Any dependencies between the various TFM_PARTITION_*
	  options are handled by the build system in the trusted-firmware-m
	  repository.

config TFM_PARTITION_INITIAL_ATTESTATION
	bool "Secure partition 'Initial Attestation'"
	depends on TFM_PARTITION_CRYPTO
	depends on TFM_INITIAL_ATTESTATION_KEY
	default n
	help
	  Setting this option will cause '-DTFM_PARTITION_INITIAL_ATTESTATION'
	  to be passed to the TF-M build system. Look at 'config_default.cmake'
	  in the trusted-firmware-m repository for details regarding this
	  parameter. Any dependencies between the various TFM_PARTITION_*
	  options are handled by the build system in the trusted-firmware-m
	  repository.

config TFM_PARTITION_PLATFORM
	bool "Secure partition 'Platform'"
	default y
	help
	  Setting this option will cause '-DTFM_PARTITION_PLATFORM'
	  to be passed to the TF-M build system. Look at 'config_default.cmake'
	  in the trusted-firmware-m repository for details regarding this
	  parameter. Any dependencies between the various TFM_PARTITION_*
	  options are handled by the build system in the trusted-firmware-m
	  repository.

config TFM_PARTITION_FIRMWARE_UPDATE
	bool "Include the secure parition 'Firmware Update'"
	select TFM_MCUBOOT_DATA_SHARING
	default n
	help
	  Setting this option will cause '-DTFM_PARTITION_FIRMWARE_UPDATE'
	  to be passed to the TF-M build system. Look at 'config_default.cmake'
	  in the trusted-firmware-m repository for details regarding this
	  parameter. Any dependencies between the various TFM_PARTITION_*
	  options are handled by the build system in the trusted-firmware-m
	  repository.


choice TFM_PARTITION_LOG_LEVEL
	prompt "TF-M Partition Log Level" if !TFM_LOG_LEVEL_SILENCE
	default TFM_PARTITION_LOG_LEVEL_INFO
config TFM_PARTITION_LOG_LEVEL_DEBUG
	bool "Debug"
config TFM_PARTITION_LOG_LEVEL_INFO
	bool "Info"
config TFM_PARTITION_LOG_LEVEL_ERROR
	bool "Error"
config TFM_PARTITION_LOG_LEVEL_SILENCE
	bool "Off"
endchoice

endif # BUILD_WITH_TFM
```

## modules/u8g2/Kconfig
```kconfig
# Copyright (c) 2023 TOKITA Hiroshi
# SPDX-License-Identifier: Apache-2.0

config ZEPHYR_U8G2_MODULE
	bool

config U8G2
	bool "U8G2 library support"
```

## modules/uoscore-uedhoc/Kconfig
```kconfig
# Copyright (c) 2022 Nordic Semiconductor ASA
# SPDX-License-Identifier: Apache-2.0

menuconfig UOSCORE
	bool "UOSCORE library"
	depends on ZCBOR
	depends on ZCBOR_CANONICAL
	select UOSCORE_UEDHOC_CRYPTO_COMMON

	help
	  This option enables the UOSCORE library.

if UOSCORE

config UOSCORE_DEBUG
	bool "Debug logs in the uoscore library"

endif # UOSCORE

menuconfig UEDHOC
	bool "UEDHOC library"
	depends on ZCBOR
	depends on ZCBOR_CANONICAL
	select UOSCORE_UEDHOC_CRYPTO_COMMON
	help
	  This option enables the UEDHOC library.

if UEDHOC

config UEDHOC_DEBUG
	bool "Debug logs in the uedhoc library"

endif # UEDHOC

if UOSCORE || UEDHOC

config UOSCORE_UEDHOC_CRYPTO_COMMON
	bool
	select PSA_CRYPTO
	select PSA_WANT_ALG_ECDH
	select PSA_WANT_ALG_ECDSA
	select PSA_WANT_KEY_TYPE_ECC_KEY_PAIR_IMPORT
	select PSA_WANT_KEY_TYPE_ECC_KEY_PAIR_EXPORT
	select PSA_WANT_KEY_TYPE_ECC_KEY_PAIR_GENERATE
	select PSA_WANT_KEY_TYPE_ECC_PUBLIC_KEY
	select PSA_WANT_ECC_SECP_R1_256
	select PSA_WANT_KEY_TYPE_AES
	select PSA_WANT_ALG_CCM
	select PSA_WANT_KEY_TYPE_HMAC
	select PSA_WANT_ALG_HMAC
	select PSA_WANT_ALG_SHA_256
	# On TF-M platforms the PSA_WANT_xxx above do not enable the legacy
	# MBEDTLS_ECP_C build symbol which is required to enable the
	# mbedtls_pk_ec() function used in uOSCORE/uEDHOC.
	select MBEDTLS_ECP_C if BUILD_WITH_TFM
	select MBEDTLS_ECP_DP_SECP256R1_ENABLED if BUILD_WITH_TFM

endif # UOSCORE || UEDHOC
```

## modules/wasm-micro-runtime/Kconfig
```kconfig
# Configuration for the wasm-micro-runtime (WAMR) module

# Copyright (c) 2021 Intel Corporation
# SPDX-License-Identifier: Apache-2.0

config ZEPHYR_WAMR_MODULE
	bool

menuconfig WAMR
	bool "WebAssembly Micro Runtime support"
	help
	  This option enables the WebAssembly Micro Runtime library.

if WAMR

config WAMR_BUILD_TARGET
	string "WAMR build target architecture"
	help
	  Set the target CPU architecture. Current supported targets are:
		X86_64, X86_32, AARCH64, ARM, THUMB, XTENSA, ARC,
		RISCV64, RSCV32 and MIPS.
	  If it is not set, system will try to set it according to the
	  board name and other config info.
	  For ARM and THUMB, the format is <arch>[<sub-arch>][_VFP], where
	  <sub-arch> is the ARM sub-architecture and the "_VFP" suffix
	  means using VFP coprocessor registers s0-s15 (d0-d7) for passing
	  arguments or returning results in standard procedure-call. Both
	  <sub-arch> and "_VFP" are optional, e.g. ARMV7, ARMV7_VFP,
	  THUMBV7, THUMBV7_VFP and so on.
	  For AARCH64, the format is <arch>[<sub-arch>], VFP is enabled by
	  default. <sub-arch> is optional, e.g. AARCH64, AARCH64V8,
	  AARCH64V8.1 and so on.
	  For RISCV64, the format is <arch>[_abi], where "_abi" is
	  optional, currently the supported formats are RISCV64,
	  RISCV64_LP64D and RISCV64_LP64. RISCV64 and RISCV64_LP64D are
	  identical, using LP64D as abi (LP64 with hardware floating-point
	  calling convention for FLEN=64). And RISCV64_LP64 uses LP64 as
	  abi (Integer calling-convention only, and hardware floating-point
	  calling convention is not used).
	  For RISCV32, the format is <arch>[_abi], where "_abi" is
	  optional, currently the supported formats are RISCV32,
	  RISCV32_ILP32D and RISCV32_ILP32. RISCV32 and RISCV32_ILP32D are
	  identical, using ILP32D as abi (ILP32 with hardware
	  floating-point calling convention for FLEN=64). And RISCV32_ILP32
	  uses ILP32 as abi (Integer calling-convention only, and hardware
	  floating-point calling convention is not used).

config WAMR_INTERP
	bool "WebAssembly interpreter support"
	default y
	help
	  Enable WebAssembly interpreter

config WAMR_FAST_INTERP
	bool "WebAssembly fast interpreter support"
	depends on WAMR_INTERP
	default y
	help
	  Enable WebAssembly fast interpreter, if not, the classic
	  interpreter will be enabled

config WAMR_AOT
	bool "WebAssembly Ahead of Time support"
	default y
	help
	  Enable WebAssembly Ahead of Time

config WAMR_LIBC_BUILTIN
	bool "WAMR built-in libc native library support"
	default y
	help
	  Enable WAMR built-in libc native library

config WAMR_LIBC_WASI
	bool "WAMR WASI libc native library support"
	default n
	help
	  Enable WAMR WASI libc native library

config WAMR_LIB_PTHREAD
	bool "WAMR pthread native native library support"
	default n
	help
	  Enable WAMR built-in libc native library

config WAMR_SIMD
	bool "WAMR 128-bit SIMD support"
	depends on WAMR_AOT
	default y
	help
	  Enable WAMR 128-bit SIMD feature

config WAMR_REF_TYPES
	bool "WAMR reference types support"
	default n
	help
	  Enable WAMR reference types feature

config WAMR_MEMORY_PROFILING
	bool "WAMR runtime memory profiling support"
	default n
	help
	  Enable WAMR runtime memory profiling feature

config WAMR_PERF_PROFILING
	bool "WAMR runtime performance profiling support"
	default n
	help
	  Enable WAMR runtime performance profiling feature

config WAMR_DUMP_CALL_STACK
	bool "WAMR runtime dump call stack support"
	default n
	help
	  Enable dumping call stack when runtime throws
	  exception while executing wasm functions

config WAMR_MPU_STACK_COUNT
	int "WAMR MPU stack count"
	default 4
	help
	  The count of MPU stack: when multi-thread and Zephyr MPU are
	  enabled, the native thread's stack must be previously defined
	  by Macro provided by Zephyr, this setting configures how many
	  mpu stacks are enabled, or, how many threads can be created.

config WAMR_MPU_STACK_SIZE
	int "WAMR MPU stack size"
	default 4096
	help
	  The size of each MPU stack: when multi-thread and Zephyr MPU are
	  enabled, the native thread's stack must be previously defined
	  by Macro provided by Zephyr, this setting configures the size
	  of each MPU stack.

endif # WAMR
```

## modules/web3-iot-sdk/Kconfig
```kconfig
# Cryptography primitive options for TinyCrypt version 2.0

# Copyright (c) 2015 Intel Corporation
# SPDX-License-Identifier: Apache-2.0

menuconfig WEB3_IOT_SDK
	bool "web3 iot sdk Support"
	#select MBEDTLS
	help
		This option enables the Web3 IoT SDK.

if WEB3_IOT_SDK
config CRYPTO_IMPL
	string "the crypto library to use"
	default "Extern" if WEB3_IOT_SDK
	help
		the crypto library to use. 
		Possible values: "MbedTLS" , "TinyCrypt or Zephyr os". 

config BUILD_IOTEX_F
	bool "build the Iotex Firmware component"
	default  y
	help
		build the Iotex Firmware component. Defaults to ON.

config BUILD_PSA_TEST_SUITE
	bool "build the PSA Architecture test suite"
	default  n
	help
		build the PSA Architecture test suite. Defaults to OFF.

config BUILD_EXAMPLE_DEVICE_REGISTRATION
	bool "build the device registration example"
	default  n
	depends on TINYCRYPT_SHA256_HMAC
	help
		build the device registration example. Defaults to OFF.

config GIT_SUBMODULE_UPDATE
	bool "download or update any dependencies specified as submodules"
	default  n
	help
		download or update any dependencies specified as submodules. Defaults to ON.

endif
```

## modules/wolfssl/Kconfig
```kconfig
# Kconfig - Cryptography primitive options for wolfSSL

#
# Copyright (c) 2016 Intel Corporation
#
# Licensed under the Apache License, Version 2.0 (the "License");
# you may not use this file except in compliance with the License.
# You may obtain a copy of the License at
#
#     http://www.apache.org/licenses/LICENSE-2.0
#
# Unless required by applicable law or agreed to in writing, software
# distributed under the License is distributed on an "AS IS" BASIS,
# WITHOUT WARRANTIES OR CONDITIONS OF ANY KIND, either express or implied.
# See the License for the specific language governing permissions and
# limitations under the License.
#

config ZEPHYR_WOLFSSL_MODULE
        bool
config WOLFSSL_PROMPTLESS
        bool
        help
          Symbol to disable the prompt for WOLFSSL selection.
          This symbol may be used internally in a Kconfig tree to hide the
          wolfSSL menu prompt and instead handle the selection of WOLFSSL from
          dependent sub-configurations and thus prevent stuck symbol behavior.


menuconfig WOLFSSL
	bool "wolfSSL Support" if !WOLFSSL_PROMPTLESS
	help
	  This option enables the wolfSSL cryptography library.

if WOLFSSL

choice WOLFSSL_IMPLEMENTATION
	prompt "Select implementation"
	default WOLFSSL_BUILTIN

config WOLFSSL_BUILTIN
	bool "Enable wolfSSL integrated sources"
	help
	  Link with local wolfSSL sources instead of external library.

config WOLFSSL_LIBRARY
	bool "Enable wolfSSL external library"
	help
	  This option enables wolfSSL library.

endchoice

config WOLFSSL_SETTINGS_FILE
	string "wolfSSL settings file"
	depends on WOLFSSL_BUILTIN
	help
	  Use a specific wolfSSL settings file. The default config file
	  file can be tweaked with Kconfig. The default settings is
	  suitable to communicate with majority of HTTPS servers on the Internet,
	  but has relatively many features enabled. To optimize resources for
	  special TLS usage, use available Kconfig settings, or select an
	  alternative config.

rsource "Kconfig.tls-generic"

config WOLFCRYPT_FIPS
	bool "wolfCrypt FIPS support"
	depends on WOLFSSL_BUILTIN
	help
	  Enables FIPS support in wolfCrypt. Requires the wolfSSL FIPS ready
	  download that includes fips.c/fips_test.c.

config WOLFSSL_DTLS
  bool "wolfSSL DTLS support"
  help
    Enable DTLS support

config WOLFSSL_ALPN
  bool "wolfSSL ALPN support"
  help
    Enable ALPN support

config WOLFSSL_PSK
  bool "wolfSSL PSK support"
  help
    Enable PSK support

config WOLFSSL_MAX_FRAGMENT_LEN
  int
  default 3
  range 1 6
  help
    Sets the maximum fragment length wolfSSL will use, values 1-6 correspond to enum values
    WOLFSSL_MFL_* in ssl.h

config WOLFCRYPT_ARMASM
	bool "wolfCrypt ARM Assembly support"
	depends on WOLFSSL_BUILTIN
	help
	  wolfCrypt ARM (ARMv8/ARMv7) assembly support for AES, SHA-2, SHA-3,
	  ChaCha20/Poly1305 and Curve25519

config WOLFCRYPT_INTELASM
	bool "wolfCrypt Intel Assembly support"
	depends on WOLFSSL_BUILTIN
	help
	  wolfCrypt Intel Aassembly support (AVX/AVX2/AESNI)

config WOLFSSL_DEBUG
	bool "wolfSSL debug activation"
	depends on WOLFSSL_BUILTIN
	help
	  Enable debugging activation for wolfSSL configuration. If you use
	  wolfSSL/Zephyr integration (e.g. net_app), this will activate debug
	  logging (of the level configured by WOLFSSL_DEBUG_LEVEL).

config WOLFSSL_INSTALL_PATH
	string "wolfSSL install path"
	depends on WOLFSSL_LIBRARY
	help
	  This option holds the path where the wolfSSL libraries and headers are
	  installed. Make sure this option is properly set when WOLFSSL_LIBRARY
	  is enabled otherwise the build will fail.

config APP_LINK_WITH_WOLFSSL
	bool "Link 'app' with WOLFSSL"
	default y
	help
	  Add WOLFSSL header files to the 'app' include path. It may be
	  disabled if the include paths for WOLFSSL are causing aliasing
	  issues for 'app'.

endif
```
