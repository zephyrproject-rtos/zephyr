## modules/trusted-firmware-m/Kconfig.tfm.ps
```kconfig
# Copyright (c) 2026 Nordic Semiconductor ASA
# SPDX-License-Identifier: Apache-2.0

if TFM_PARTITION_PROTECTED_STORAGE

config TFM_PS_ROLLBACK_PROTECTION
	bool "Rollback protection"
	default y
	help
	  Enable rollback protection for the Protected Storage partition.

config TFM_PS_MAX_ASSET_SIZE_OVERRIDE
	bool "Override maximum Protected Storage asset size"
	help
	  Override the platform's default maximum size of a single asset to be
	  stored in Protected Storage (PS) with TFM_PS_MAX_ASSET_SIZE.

config TFM_PS_MAX_ASSET_SIZE
	int "Maximum Protected Storage asset size"
	depends on TFM_PS_MAX_ASSET_SIZE_OVERRIDE
	default 2048
	help
	  Maximum size (in bytes) of a single asset to be stored in Protected
	  Storage (PS).

endif # TFM_PARTITION_PROTECTED_STORAGE
```

## modules/xenlib/Kconfig
```kconfig
# Copyright (c) 2024 EPAM Systems
# SPDX-License-Identifier: Apache-2.0

if XEN

config ZEPHYR_XENLIB_MODULE
	bool

config XENLIB
	bool "xenlib library"
	depends on ZEPHYR_XENLIB_MODULE
	help
	  xenlib library

config XEN_STORE_COMMON
	bool
	help
	  Common code for handling xenstore.

config XEN_STORE_SRV
	bool "Enable XenStore server"
	select XEN_STORE_COMMON
	help
	  Enable xenstore server library. It should be included
	  if you are running Zephyr as Dom0.

config XEN_STORE_SRV_SHELL_CMDS
	depends on SHELL
	depends on XEN_STORE_SRV
	default y
	bool "Enable XenStore server shell"
	help
	  Enable shell for XenStore server.

config XEN_LIBFDT
	bool "Enable libfdt support"
	help
	  Enable libfdt module. This module allows you to generate
	  Domain device tree based on the parameters set in the
	  Domain config. It provides complete toolset to work with
	  flattened device tree.

config PARTIAL_DEVICE_TREE_SIZE
	int "Domain device tree size"
	default 8192
	help
	  Maximum size of the domain device tree

config XEN_DOMAIN_MANAGEMENT
	bool "Enable Xen Domain Management"
	help
	  Enable domain management library. This library allows you
	  to create, destroy and manage xen domains.

config XEN_DOMAIN_MANAGEMENT_SHELL_CMDS
	depends on SHELL
	depends on XEN_DOMAIN_MANAGEMENT
	default y
	bool "Enable Xen domain management shell"
	help
	  Enable shell for Xen domain management.

config XEN_DOMCFG_SECTION
	bool "Enable Xen domain config section"
	default y
	depends on XEN_DOMAIN_MANAGEMENT
	help
	  Enable gathering domain configurations to a common section.
	  This allows you to declare multiple domain configs with
	  a DECL_CONFIG macro. Configs can be later accessed by
	  their name.

config XEN_DOMCFG_READ_PDT
	bool "Enable reading of domain partial device-tree (PDT) binary"
	default y
	depends on XEN_DOMAIN_MANAGEMENT
	help
	  Enables reading of domain partial device-tree (PDT) binary by using
	  callbacks in struct xen_domain_cfg.
	  It also enables this feature in "xu create" shell command which will
	  try to load PDT binary using struct xen_domain_cfg callbacks.

config XEN_CONSOLE_SRV
	bool "Enable Xen Console server"
	help
	  Enable xen console server. It should be included if you
	  are running Zephyr as Dom0, otherwise any DomU that uses
	  Xen para-virtual console (PVC) may lock up. On other hand,
	  this server can be omitted if you are certain that DomUs
	  will never touch PV console.

config XEN_SHELL
	bool "Enable Xen shell commands"
	select SHELL
	help
	  Enable set of Xen shell commands for domain management.

config XENSTORE_SHELL_READ_SIZE
	int "Size of xs read buffer"
	default 256
	depends on XEN_SHELL
	help
	  Sets the maximum size that xs read cmd can handle

config XENSTORE_TREE_TRAVERSE_DEPTH
	int "Maximum xs traverse depth"
	default 8
	range 1 16
	help
	  Sets the maximum xs traverse depth to avoid stack overflow
	  in case of deeply nested XS trees.

config XEN_VCH
	bool "Enable Xen vchannels support"
	help
	  Enable vchannel communication library.

config VCH_PATH_MAXLEN
	int "Maximum length of vchannel ID to read from XenStore"
	default 32
	help
	  The maximum XenStore path size that identify a separate vchannel.

config PFN_CHUNK_SIZE
	int "Chunk size for memory mapping operations"
	default 128
	help
	  Chunk size for helper functions for mapping/unmapping
	  memory from guest domain to Dom0.

config DOMU_MAX
	int "Maximum number of DomUs"
	default 4
	range 1 32
	help
	  Maximum number of DomUs that can be created and launched.

config XSTAT
	bool "Enable XSTAT support"
	help
	  Enable xstat support which allows statistic information about running domains

config XSTAT_SHELL_CMDS
	depends on XSTAT
	depends on SHELL
	bool "Enable XSTAT shell commands"
	help
	  Enable set of XSTAT shell commands.

config XEN_DOM0LESS_BOOT
	bool "Xen dom0less boot support [EXPERIMENTAL]"
	help
	  Enable to support Xen dom0less boot. The domains started by Xen
	  will be identified and added to xenlib domain management subsystem, for each domain
	  xenstore will be initialized.

	  This is EXPERIMENTAL and depends on work in Xen mainline.

endif # XEN
```

## samples/application_development/code_relocation_nocopy/boards/b_u585i_iot02a.conf
```kconfig
# SPDX-FileCopyrightText: Copyright The Zephyr Project Contributors
# SPDX-License-Identifier: Apache-2.0

CONFIG_FLASH=y
CONFIG_MSPI_MEMMAP=y
CONFIG_LOG=y
CONFIG_MSPI_LOG_LEVEL_INF=y
CONFIG_FLASH_STM32_NOR_MEMMAP=y
```

## samples/bluetooth/audio/bap_broadcast_sink/Kconfig
```kconfig
# Copyright (c) 2022 Nordic Semiconductor ASA
# SPDX-License-Identifier: Apache-2.0

mainmenu "Bluetooth: Broadcast Audio Sink"

config SCAN_OFFLOAD
	bool "Whether to wait for a Broadcast Assistant"
	default y
	# enable PAST support if we can
	select BT_PER_ADV_SYNC_TRANSFER_RECEIVER if (!HAS_BT_CTLR || \
							BT_CTLR_SYNC_TRANSFER_RECEIVER_SUPPORT)
	help
	  If set to true, the sample will start advertising connectable for
	  Broadcast Assistants.

config SCAN_SELF
	bool "Whether to scan for Broadcast Sources without Broadcast Assistant"
	default y
	help
	  If set to true, the sample will start scanning for Broadcast Sources
	  without waiting for a Broadcast Assistant to connect.

config SCAN_DELAY
	int "Delay before starting scan (in seconds)"
	range 0 255
	default 10
	depends on SCAN_SELF
	help
	  Time to advertise connectable for a Broadcast Assistant to connect
	  before starting scanning for Broadcast Sources.

config TARGET_BROADCAST_NAME
	string "Target Broadcast Device Name"
	default ""
	help
	  Name of target broadcast device. If not empty string, sink device
	  will only listen to the specified broadcast source. Not case sensitive.

config MAX_CODEC_FRAMES_PER_SDU
	int "The maximum number of codec frame per SDU supported"
	default 1
	range 1 255
	help
	  Maximum number of codec frames per SDU supported by this device. Increasing this value
	  allows support for a greater variety of broadcasts, but also increases memory usage.

config ENABLE_LC3
	bool "Enable the LC3 codec"
	# By default let's enable it in the platforms we know are capable of supporting it
	default y
	depends on CPU_HAS_FPU && \
		(ARCH_POSIX || SOC_COMPATIBLE_NRF52X || SOC_COMPATIBLE_NRF5340_CPUAPP || \
			SOC_MIMXRT1062 || SOC_SF32LB525UC6)
	select LIBLC3
	select FPU

config USE_USB_AUDIO_OUTPUT
	bool "Use USB Audio as output"
	depends on ENABLE_LC3
	select USB_DEVICE_STACK_NEXT
	select USBD_AUDIO2_CLASS
	help
	  Enables USB audio as output as a USB peripheral. This does not support providing USB
	  audio to e.g. speakers that are also USB peripherals, but can be connected to e.g. a
	  phone or PC as a USB-in device (such as a USB microphone).
	  USB audio only supports a single audio channel.

config USE_CODEC_AUDIO_OUTPUT
	bool "Use Codec Audio as output"
	depends on ENABLE_LC3
	help
	  Enables codec audio as output. This uses the hardware audio codec for audio playback.
	  Supports audio output through the codec driver.
	  This is the master switch for codec audio output: when it is disabled no
	  codec is configured and no PCM is rendered, whichever audio data path is
	  selected below.

config USE_I2S_CODEC_TRANSPORT
	bool "Use I2S/SAI as the PCM transport to the codec"
	depends on USE_CODEC_AUDIO_OUTPUT
	help
	  Select this when the hardware codec is fed PCM over an I2S/SAI bus.
	  Leave it disabled for codecs with their own host interface.

config BAP_SINK_AUDIO_PATH_MPIPE
	bool
	default y if MPIPE && USE_CODEC_AUDIO_OUTPUT
	help
	  Selected automatically when the decode and output path is built on the
	  mpipe framework rather than driving the codec directly from the LC3
	  decoder thread.

	  The only sink of that pipeline is the hardware codec, so it is built
	  only when codec output is enabled as well: MPIPE on its own selects the
	  framework, it does not request audio output. Keeping this as a separate
	  symbol means the rest of the sample tests for "the mpipe audio path is
	  active" instead of re-deriving it from two options at every call site.


config USE_SPECIFIC_BROADCAST_CHANNEL
	bool "Use specific Broadcast Channel Audio Location"
	default y
	depends on USE_USB_AUDIO_OUTPUT
	help
	  Enables the use of a specific Channel Audio Location
	  (see config TARGET_BROADCAST_CHANNEL).

config TARGET_BROADCAST_CHANNEL
	int "Broadcast Channel Audio Location to sync to"
	range 0 3
	default 1
	depends on USE_SPECIFIC_BROADCAST_CHANNEL
	help
	  Channel Audio Location to sync to. These corresponds to the bt_audio_location,
	  supporting mono, left and right channels

config INFO_REPORTING_INTERVAL
	int "Number of SDUs received between each information report"
	default 1000
	help
	  Determines how often information about received data is logged.
	  Set to 0 to disable reporting.

config USE_CODEC_CLOCK
	bool "I2S BCK is generated by a selected codec device"
	depends on USE_I2S_CODEC_TRANSPORT
	help
	  If selected, the I2S peripheral will be configured to consume (receive) the
	  I2S BCK and WS signals and the codec will be configured to generate those.
	  If not selected, the I2S peripheral will generate them and the codec will
	  consume them.

config BAP_BROADCAST_SINK_PCM_BUFFER_PLAY_COUNT
	int "PCM playback ring buffer depth (in LC3 frame blocks)"
	default 12
	range 4 200
	depends on USE_I2S_CODEC_TRANSPORT
	help
	  Upper bound on the number of decoded PCM frame blocks buffered between
	  the LC3 decoder (producer) and the I2S playback thread (consumer). This
	  elastic buffer decouples the two so the SAI DMA can be fed continuously.
	  It caps the worst-case output latency: at one block per frame period,
	  12 blocks is about 120 ms with 10 ms frames. Once the ring is full the
	  oldest block is dropped, so raising this tolerates longer producer
	  stalls at the cost of more RAM and more latency before that drop
	  happens. Each block is one frame of interleaved PCM (worst case 1920
	  bytes at 48 kHz / 10 ms / stereo).

config BAP_BROADCAST_SINK_PCM_PREBUFFER_COUNT
	int "PCM blocks buffered before playout starts"
	default 4
	range 1 64
	depends on USE_I2S_CODEC_TRANSPORT
	help
	  Number of decoded PCM blocks the ring must hold before the playback
	  thread starts consuming it, and the level it rebuilds to after a
	  starvation. This is the cushion that absorbs arrival jitter and the
	  drift between the Bluetooth transmitter clock and the SAI sample clock,
	  so it sets the nominal output latency: at one block per frame period,
	  4 blocks is about 40 ms with 10 ms frames. Too small and ordinary
	  jitter empties the ring, forcing silence insertion; too large and
	  latency grows for no benefit. Must not exceed
	  BAP_BROADCAST_SINK_PCM_BUFFER_PLAY_COUNT.

config BAP_BROADCAST_SINK_PCM_BUFFER_PRELOAD_COUNT
	int "Number of silence blocks preloaded to the SAI DMA before start"
	default 2
	range 1 16
	depends on USE_I2S_CODEC_TRANSPORT
	help
	  Number of silence blocks primed into the SAI DMA queue before the I2S
	  transmit stream is started, so the frame clock is running before the
	  first decoded PCM arrives. This only covers the DMA queue itself; the
	  cushion of real audio is controlled by
	  BAP_BROADCAST_SINK_PCM_PREBUFFER_COUNT. Keep this small to minimise
	  start-up latency.

# Source common USB sample options used to initialize new experimental USB device stack.
# The scope of these options is limited to USB samples in project tree,
# you cannot use them in your own application.
source "samples/subsys/usb/common/Kconfig.sample_usbd"

source "Kconfig.zephyr"
```

## samples/bluetooth/audio/bap_unicast_server/Kconfig
```kconfig
# Copyright (c) 2025 Nordic Semiconductor ASA
# SPDX-License-Identifier: Apache-2.0

# LC3 decode plus audio_codec bring-up push main and sysworkq past their
# defaults. Declared before Kconfig.zephyr so our defaults are searched
# ahead of kernel/Kconfig's defaults.
if LIBLC3

config MAIN_STACK_SIZE
	default 4096

config SYSTEM_WORKQUEUE_STACK_SIZE
	default 4096

endif # LIBLC3

mainmenu "Bluetooth: BAP Unicast Server"

config INFO_REPORTING_INTERVAL
	int "Number of SDUs received between each information report"
	default 1000
	help
	  Determines how often information about received data is logged.
	  Set to 0 to disable reporting.

menu "Audio playback"
	depends on LIBLC3 && I2S && AUDIO_CODEC

config BAP_UNICAST_SERVER_I2S_WORKER_STACK_SIZE
	int "I2S worker thread stack size"
	default 4096
	help
	  Stack size of the thread that copies decoded PCM blocks into the
	  I2S TX mem_slab. Must accommodate the codec driver's write path;
	  4096 B is safe for the NXP SAI + WM8962 combination.

config BAP_UNICAST_SERVER_I2S_WORKER_PRIORITY
	int "I2S worker thread priority (cooperative)"
	default 5
	help
	  Cooperative priority of the I2S worker thread. Lower values run
	  ahead of BAP RX and may starve the host stack; higher values
	  increase the risk of underruns on marginal DMA timing.

config BAP_UNICAST_SERVER_I2S_DMA_BLOCK_COUNT
	int "I2S TX DMA block count"
	default 4
	range 2 16
	help
	  Number of decoded PCM blocks the SAI/DMA can hold. Each block is
	  one SDU worth of audio (up to ~1920 B for 48 kHz / 10 ms stereo).
	  Increase for looser DMA timing, decrease to shorten pause/resume
	  latency.

config BAP_UNICAST_SERVER_PCM_QUEUE_DEPTH
	int "Decode to I2S handoff queue depth"
	default 8
	range 2 32
	help
	  Number of decoded PCM blocks buffered between the BAP RX context
	  and the I2S worker. Larger values absorb SDU jitter; smaller
	  values reduce audio latency.

endmenu

source "Kconfig.zephyr"
```
