## samples/bluetooth/audio/common/Kconfig
```kconfig
# SPDX-FileCopyrightText: Copyright 2026 Ezurio LLC
# SPDX-License-Identifier: Apache-2.0

# PCM output backend for the shared LE Audio playback helper. Each backend owns
# the final transport (and any external codec); the LC3 decode and the playback
# pump stay backend-agnostic. Add a backend by adding an option here plus a
# pcm_sink_<backend>.c source in CMakeLists.txt.
choice SAMPLE_BT_AUDIO_PLAYBACK_SINK
	prompt "LE Audio playback PCM output backend"
	depends on LIBLC3 && FPU
	default SAMPLE_BT_AUDIO_PLAYBACK_SINK_I2S

config SAMPLE_BT_AUDIO_PLAYBACK_SINK_I2S
	bool "I2S with external audio codec"
	depends on I2S && AUDIO_CODEC
	depends on $(dt_alias_enabled,i2s-codec-tx) && $(dt_nodelabel_enabled,audio_codec)
	help
	  Stream decoded PCM out of the SoC I2S peripheral to an external codec
	  driven through the audio_codec API. Requires the i2s_codec_tx DT alias
	  and an audio_codec node.

endchoice

config SAMPLE_BT_AUDIO_PLAYBACK
	bool "Shared LE Audio playback helper"
	depends on SAMPLE_BT_AUDIO_PLAYBACK_SINK_I2S
	default y
	help
	  Compile the shared LE Audio playback helper under
	  samples/bluetooth/audio/common/. The helper decodes LC3 SDUs to PCM and
	  feeds the transport backend selected by SAMPLE_BT_AUDIO_PLAYBACK_SINK. It
	  is only available on boards that provide a usable backend; consuming
	  samples guard the playback calls with IS_ENABLED() so they build
	  unchanged when none is selected.

if SAMPLE_BT_AUDIO_PLAYBACK

config SAMPLE_BT_AUDIO_PLAYBACK_WORKER_STACK_SIZE
	int "LC3 decode / output worker thread stack size"
	default 4096
	help
	  Stack size of the worker thread that decodes LC3 SDUs and writes the
	  decoded PCM blocks to the output sink. Must accommodate the LC3
	  decoder and the sink driver's write path; 4096 B is safe for the
	  NXP SAI + WM8962 combination.

config SAMPLE_BT_AUDIO_PLAYBACK_WORKER_PRIORITY
	int "LC3 decode / output worker thread priority (preemptible)"
	default 5
	range 0 NUM_PREEMPT_PRIORITIES
	help
	  Preemptible priority of the worker thread that decodes LC3 SDUs and
	  feeds the output transport. It is preemptible so the Bluetooth RX thread
	  can interrupt a long decode; lower values run ahead of BAP RX and risk
	  starving the host, higher values increase the risk of transport
	  underruns.

config SAMPLE_BT_AUDIO_PLAYBACK_PCM_QUEUE_DEPTH
	int "BAP RX to decode worker handoff queue depth"
	default 8
	range 2 32
	help
	  Number of received LC3 SDUs buffered between the BAP RX context and
	  the decode/output worker. Larger values absorb SDU jitter; smaller
	  values reduce audio latency. Each queued SDU holds a reference on a
	  Bluetooth ISO RX buffer, so this should not exceed the ISO RX buffer
	  count.

if SAMPLE_BT_AUDIO_PLAYBACK_SINK_I2S

config SAMPLE_BT_AUDIO_PLAYBACK_MCLK_FREQUENCY
	int "Codec MCLK input frequency in Hz"
	default 0
	help
	  Assigns audio_codec_cfg.mclk_freq for the codec DAI configuration.
	  Most in-tree codec drivers (e.g. WM8962, WM8904, DA7212, WM8960,
	  TLV320AIC3110) derive MCLK themselves from a DT "clocks" phandle or
	  a driver-specific DT property, and ignore this value. It is only
	  consumed as-is by drivers with no other source for it - currently
	  TLV320DAC3100 (always), or WM8904/WM8962 boards that set
	  clock-source = "FLL" instead of wiring a clocks phandle.

config SAMPLE_BT_AUDIO_PLAYBACK_I2S_DMA_BLOCK_COUNT
	int "I2S TX DMA block count"
	default 4
	range 2 16
	help
	  Number of decoded PCM blocks the SAI/DMA can hold. Each block is
	  one SDU worth of audio (up to ~1920 B for 48 kHz / 10 ms stereo).
	  Increase for looser DMA timing, decrease to shorten pause/resume
	  latency.

config SAMPLE_BT_AUDIO_PLAYBACK_CODEC_VOL_MIN
	int "Codec output volume at VCS volume 0"
	default 0
	help
	  Value written to AUDIO_PROPERTY_OUTPUT_VOLUME when the VCS volume
	  is 0 (silence). The units and range are codec-specific: WM8962 uses
	  a 0..127 register, while codecs such as TLV320 express volume in dB
	  and use a negative range (e.g. -156). The VCS 0..255 scale is mapped
	  linearly onto CODEC_VOL_MIN..CODEC_VOL_MAX, so boards should set
	  these to match their codec instead of patching apply_volume().

config SAMPLE_BT_AUDIO_PLAYBACK_CODEC_VOL_MAX
	int "Codec output volume at VCS volume 255"
	default 255
	help
	  Value written to AUDIO_PROPERTY_OUTPUT_VOLUME when the VCS volume
	  is 255 (loudest). See CODEC_VOL_MIN. Defaults to the VCS maximum
	  (255) for an identity mapping; boards should override it with their
	  codec's loudest valid setting (e.g. 127 for the WM8962 register).

endif # SAMPLE_BT_AUDIO_PLAYBACK_SINK_I2S

module = SAMPLE_BT_AUDIO_PLAYBACK
module-str = LE Audio playback helper
source "subsys/logging/Kconfig.template.log_config"

endif # SAMPLE_BT_AUDIO_PLAYBACK
```

## samples/bluetooth/audio/tmap_peripheral/Kconfig
```kconfig
#
# Copyright (c) 2022 Codecoup
# Copyright 2023 NXP
#
# SPDX-License-Identifier: Apache-2.0
#

# LC3 decode plus audio_codec bring-up push main and sysworkq past their
# defaults. Declared before Kconfig.zephyr so our defaults are searched
# ahead of kernel/Kconfig's defaults.
if LIBLC3

config MAIN_STACK_SIZE
	default 4096

config SYSTEM_WORKQUEUE_STACK_SIZE
	default 4096

endif # LIBLC3

mainmenu "Bluetooth: Earbuds"

menu "Zephyr"
source "Kconfig.zephyr"
endmenu

menu "Earbuds"

config TMAP_PERIPHERAL_SET_RANK
	int "Device rank in set"
	depends on TMAP_PERIPHERAL_DUO
	range 1 2
	help
	  Rank of this device in set.

choice TMAP_PERIPHERAL_TYPE_CHOICE
	prompt "Earbuds type"
	help
	  Select the Earbuds Type to compile.

config TMAP_PERIPHERAL_SINGLE
	bool "Single ear headset"

config TMAP_PERIPHERAL_DUO
	depends on BT_CAP_ACCEPTOR_SET_MEMBER
	bool "Duo headset"

endchoice # TMAP_PERIPHERAL_TYPE_CHOICE

choice TMAP_PERIPHERAL_LOCATION
	prompt "Earbud Location"
	help
	  Select the Earbud location.

config TMAP_PERIPHERAL_LEFT
	bool "Left Ear"

config TMAP_PERIPHERAL_RIGHT
	bool "Right Ear"

config TMAP_PERIPHERAL_STEREO
	bool "Stereo speaker (front left + front right)"
	help
	  Advertise the sink and source PAC locations as a stereo speaker.
	  Required by some phones (e.g. Pixel running Android) before they
	  will route stereo media to a solo LE Audio device.

endchoice # TMAP_PERIPHERAL_LOCATION

config TMAP_PERIPHERAL_ROLE_CT
	bool "TMAP Call Terminal (CT) role"
	default y
	help
	  Advertise the TMAP Call Terminal role. Compiles in and
	  initializes the CCP client used to interact with a peer Call
	  Gateway (typically a phone). Disable to build a media-only
	  peripheral that does not participate in call control.

config TMAP_PERIPHERAL_ROLE_UMR
	bool "TMAP Unicast Media Receiver (UMR) role"
	default y
	help
	  Advertise the TMAP Unicast Media Receiver role. Compiles in and
	  initializes the MCP client on top of the BAP unicast sink to
	  interact with a peer Unicast Media Sender. Disable to build a
	  call-only peripheral that does not receive media playback.

config TMAP_PERIPHERAL_AUTO_CTRL
	bool "Run the CT/MCC control demo after TMAP discovery"
	depends on TMAP_PERIPHERAL_ROLE_CT || TMAP_PERIPHERAL_ROLE_UMR
	default y
	help
	  When enabled the sample originates a call via CCP and issues a
	  play/pause via MCP after discovering the peer. Disable this to
	  keep the sample as a passive media sink (UMR) that waits for the
	  peer to open a CIS to it.

menu "Audio playback"
	depends on LIBLC3 && I2S && AUDIO_CODEC

config TMAP_PERIPHERAL_I2S_WORKER_STACK_SIZE
	int "I2S worker thread stack size"
	default 4096
	help
	  Stack size of the thread that copies decoded PCM blocks into the
	  I2S TX mem_slab. Must accommodate the codec driver's write path;
	  4096 B is safe for the NXP SAI + WM8962 combination.

config TMAP_PERIPHERAL_I2S_WORKER_PRIORITY
	int "I2S worker thread priority (cooperative)"
	default 5
	help
	  Cooperative priority of the I2S worker thread. Lower values run
	  ahead of BAP RX and may starve the host stack; higher values
	  increase the risk of underruns on marginal DMA timing.

config TMAP_PERIPHERAL_I2S_DMA_BLOCK_COUNT
	int "I2S TX DMA block count"
	default 4
	range 2 16
	help
	  Number of decoded PCM blocks the SAI/DMA can hold. Each block is
	  one SDU worth of audio (up to ~1920 B for 48 kHz / 10 ms stereo).
	  Increase for looser DMA timing, decrease to shorten pause/resume
	  latency.

config TMAP_PERIPHERAL_PCM_QUEUE_DEPTH
	int "Decode to I2S handoff queue depth"
	default 8
	range 2 32
	help
	  Number of decoded PCM blocks buffered between the BAP RX context
	  and the I2S worker. Larger values absorb SDU jitter; smaller
	  values reduce audio latency.

endmenu

endmenu
```

## samples/bluetooth/audio/tmap_peripheral/boards/kit_pse84_eval_pse846gps2dbzc4a_m33_ns.conf
```kconfig
# SPDX-FileCopyrightText: Copyright (c) 2026 Infineon Technologies AG,
# SPDX-FileCopyrightText: or an affiliate of Infineon Technologies AG. All rights reserved.
#
# SPDX-License-Identifier: Apache-2.0

CONFIG_SPEED_OPTIMIZATIONS=y
CONFIG_LIBLC3=y
CONFIG_I2S=y
CONFIG_AUDIO=y
CONFIG_AUDIO_CODEC=y

CONFIG_SAMPLE_BT_AUDIO_PLAYBACK_MCLK_FREQUENCY=12288000
CONFIG_SAMPLE_BT_AUDIO_PLAYBACK_CODEC_VOL_MIN=-127
CONFIG_SAMPLE_BT_AUDIO_PLAYBACK_CODEC_VOL_MAX=0

CONFIG_TMAP_PERIPHERAL_STEREO=y
CONFIG_TMAP_PERIPHERAL_ROLE_CT=n
CONFIG_TMAP_PERIPHERAL_AUTO_CTRL=n
CONFIG_BT_ISO_RX_MTU=310
CONFIG_BT_RX_STACK_SIZE=4096
```

## samples/bluetooth/broadcaster/Kconfig
```kconfig
# Copyright The Zephyr Project Contributors
# SPDX-License-Identifier: Apache-2.0

mainmenu "Bluetooth: Broadcaster"

config SAMPLE_BT_USE_DISABLE
	bool "Periodically disable Bluetooth"
	help
	  When enabled, the sample enables Bluetooth and broadcasts for a
	  configurable duration, then disables Bluetooth for a configurable
	  duration, and repeats the cycle. When disabled (default), the sample
	  keeps Bluetooth enabled and broadcasts continuously.

if SAMPLE_BT_USE_DISABLE

config SAMPLE_BT_BROADCAST_DURATION_MS
	int "Broadcast duration (milliseconds)"
	range 1 2147483647
	default 5000
	help
	  Duration in milliseconds during which Bluetooth is enabled and the
	  sample broadcasts advertising packets before disabling Bluetooth.

config SAMPLE_BT_DISABLE_DURATION_MS
	int "Disable duration (milliseconds)"
	range 1 2147483647
	default 5000
	help
	  Duration in milliseconds during which Bluetooth is disabled before it
	  is enabled again to resume broadcasting.

endif # SAMPLE_BT_USE_DISABLE

source "Kconfig.zephyr"
```

## samples/bluetooth/broadcaster/sample.yaml
```yaml
sample:
  name: broadcaster
tests:
  sample.bluetooth.broadcaster:
    harness: bluetooth
    platform_allow:
      - qemu_cortex_m3
      - qemu_x86
      - lp_em_cc2340r5
      - lp_em_cc2340r5moda
      - lp_em_cc2340r53
      - lp_em_cc2340r53_wcsp
      - lp_em_cc2745r10_q1/cc2745r10_q1
      - lp_em_cc2745r10_q1/cc2755r10
      - nrf51dk/nrf51822
      - nrf52dk/nrf52832
      - cyw920829m2evk_02/cyw20829b0lkml
    tags: bluetooth
    integration_platforms:
      - qemu_cortex_m3
```

## samples/bluetooth/broadcaster_multiple/sample.yaml
```yaml
sample:
  name: Bluetooth Multiple Extended Advertising Broadcaster
common:
  harness: bluetooth
  tags:
    - bluetooth
tests:
  sample.bluetooth.broadcaster_multiple:
    platform_allow:
      - qemu_cortex_m3
      - qemu_x86
    integration_platforms:
      - qemu_cortex_m3
  sample.bluetooth.broadcaster_multiple.bt_ll_sw_split:
    extra_args:
      - EXTRA_CONF_FILE=overlay-bt_ll_sw_split.conf
    platform_allow:
      - nrf51dk/nrf51822
      - nrf52_bsim
      - nrf52dk/nrf52832
      - nrf52840dk/nrf52840
      - lp_em_cc2340r5
      - lp_em_cc2340r53
      - lp_em_cc2745r10_q1/cc2745r10_q1
      - lp_em_cc2745r10_q1/cc2755r10
    integration_platforms:
      - nrf52dk/nrf52832
      - nrf52840dk/nrf52840
```

## samples/bluetooth/central_gatt_write/Kconfig.gatt_write
```kconfig
# Copyright (c) 2025 Nordic Semiconductor ASA
# SPDX-License-Identifier: Apache-2.0

config USE_VARIABLE_LENGTH_DATA
	bool "Use variable length data in GATT Write without Response"
	help
	  Use increasing and decreasing length data in GATT Write without
	  Response.

config USE_CONN_UPDATE_ITERATION_ONCE
	bool "Test Connection Update"
	help
	  Perform Connection Update for a single iteration.

config USE_PHY_UPDATE_ITERATION_ONCE
	bool "Test PHY Update"
	depends on BT_USER_PHY_UPDATE
	help
	  Perform PHY Update for a single iteration.

config USE_NOTIFY
	bool "Use GATT Notifications instead of Write without Response"
	help
	  Exercise the one-directional GATT Notification throughput path: the
	  peripheral streams notifications and the central subscribes and
	  receives them. When disabled (default), both peers transmit GATT
	  Write without Response commands (full-duplex).
```

## samples/bluetooth/classic/handsfree/Kconfig
```kconfig
# Copyright (c) 2025 NXP
# SPDX-License-Identifier: Apache-2.0

source "Kconfig.zephyr"

config AUDIO_TRANSFER_INTERVAL
	int "Audio transfer interval"
	default 10
	range 1 100
	help
	  Controls the audio transfer interval.

config VOICE_BUFFERS
	int "VOICE Buffer Count"
	default 4
	help
	  Controls the initial count of audio data blocks.

config VOICE_RX_THREAD_STACK_SIZE
	int "VOICE RX thread stack size"
	default 1024
	help
	  Controls the VOICE RX thread stack size in bytes.

config VOICE_TX_THREAD_STACK_SIZE
	int "VOICE TX thread stack size"
	default 1024
	help
	  Controls the VOICE TX thread stack size in bytes.

config VOICE_RX_THREAD_PRIO
	int "VOICE RX thread priority"
	default 4
	help
	  Controls the VOICE RX thread priority

config VOICE_TX_THREAD_PRIO
	int "VOICE TX thread priority"
	default 3
	help
	  Controls the VOICE TX thread priority

config CODEC_BUFFERS
	int "CODEC Buffer Count"
	default VOICE_BUFFERS
	help
	  Controls the initial count of audio data blocks.

config CODEC_RX_THREAD_STACK_SIZE
	int "CODEC RX thread stack size"
	default 1024
	help
	  Controls the CODEC RX thread stack size in bytes.

config CODEC_RX_THREAD_PRIO
	int "CODEC RX thread priority"
	default 4
	help
	  Controls the CODEC RX thread priority

config APP_VOICE_OVER_HCI
	bool
	default BT_VOICE_OVER_HCI
	select RING_BUFFER
	imply LIBSBC if BT_HFP_HF_CODEC_MSBC
	help
	  Enables voice over HCI transport for handsfree application.

config APP_CVSD_CODEC_ENABLED
	bool "CVSD Encode and decode support"
	default y
	depends on BT_VOICE_OVER_HCI && !BT_H4_NXP_CTLR
	help
	  Enables CVSD codec support for voice over HCI.

config APP_HFP_HF_CODEC_MSBC_ENABLED
	bool
	default y
	depends on !BT_VOICE_OVER_HCI && BT_H4_NXP_CTLR
	select BT_HFP_HF_CODEC_NEG
	select BT_HFP_HF_CODEC_MSBC
	help
	  Enables mSBC codec support for voice over PCM.
```

## samples/bluetooth/classic/hid_device/Kconfig
```kconfig
# Copyright (c) 2026 SiFli Technologies(Nanjing) Co., Ltd
#
# SPDX-License-Identifier: Apache-2.0

mainmenu "Bluetooth Classic HID Device sample"

source "Kconfig.zephyr"
```

## samples/bluetooth/classic/hid_keyboard/Kconfig
```kconfig
# Copyright (c) 2026 SiFli Technologies(Nanjing) Co., Ltd
#
# SPDX-License-Identifier: Apache-2.0

mainmenu "Bluetooth Classic HID Keyboard sample"

source "Kconfig.zephyr"
```

## samples/bluetooth/classic/pan_ap/Kconfig
```kconfig
# Copyright (c) 2025
# SPDX-License-Identifier: Apache-2.0

mainmenu "Bluetooth PAN Access Point sample"

source "Kconfig.zephyr"
```

## samples/bluetooth/classic/pan_panu/Kconfig
```kconfig
# Copyright (c) 2025
# SPDX-License-Identifier: Apache-2.0

mainmenu "Bluetooth PAN User sample"

source "Kconfig.zephyr"
```

## samples/bluetooth/classic/pan_panu/boards/sf32lb52_devkit_lcd.conf
```kconfig
CONFIG_HEAP_MEM_POOL_SIZE=32768
CONFIG_MAIN_STACK_SIZE=4096
CONFIG_SYSTEM_WORKQUEUE_STACK_SIZE=4096
```
