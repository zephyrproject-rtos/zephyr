## samples/bluetooth/extended_adv/advertiser/sample.yaml
```yaml
sample:
  name: Bluetooth Extended Advertising Advertiser
tests:
  sample.bluetooth.extended_advertising.advertiser:
    harness: bluetooth
    platform_allow:
      - lp_em_cc2340r5
      - lp_em_cc2340r5moda
      - lp_em_cc2340r53
      - lp_em_cc2340r53_wcsp
      - lp_em_cc2745r10_q1/cc2745r10_q1
      - lp_em_cc2745r10_q1/cc2755r10
      - lp_em_cc2755p10
      - nrf52840dk/nrf52840
    tags: bluetooth
```
