## modules/minih264/Kconfig
```kconfig
# SPDX-FileCopyrightText: Copyright The Zephyr Project Contributors
# SPDX-License-Identifier: Apache-2.0

config ZEPHYR_MINIH264_MODULE
	bool

config MINIH264
	bool "MiniH264 software H.264 encoder"
	depends on ZEPHYR_MINIH264_MODULE
	help
	  Software H.264 encoder from the minih264 module. It produces
	  Baseline profile streams with CAVLC entropy coding from planar
	  YUV 4:2:0 frames, and needs no hardware acceleration. The build
	  disables the denoiser, threading and the SVC extension.
```

## modules/nanopb/Kconfig
```kconfig
# Copyright (c) 2021 Basalte bv
# SPDX-License-Identifier: Apache-2.0

config ZEPHYR_NANOPB_MODULE
	bool

menuconfig NANOPB
	bool "Nanopb Support"
	help
	  This option enables the Nanopb library and generator.

if NANOPB

config NANOPB_ENABLE_MALLOC
	bool "Malloc usage"
	help
	  This option enables dynamic allocation support in the decoder.

config NANOPB_MAX_REQUIRED_FIELDS
	int "Max number of required fields"
	default 64
	help
	  Maximum number of proto2 required fields to check for presence.
	  Default and minimum value is 64.

config NANOPB_NO_ERRMSG
	bool "Disable error messages"
	help
	  Disable error message support to save code size. Only error
	  information is the true/false return value.

config NANOPB_BUFFER_ONLY
	bool "Buffers only"
	help
	  Disable support for custom streams. Only supports encoding and
	  decoding with memory buffers. Speeds up execution and slightly
	  decreases code size.

config NANOPB_WITHOUT_64BIT
	bool "Disable 64-bit integer fields"
	help
	  Disable support of 64-bit integer fields, for old compilers or
	  for a slight speedup on 8-bit platforms.

config NANOPB_ENCODE_ARRAYS_UNPACKED
	bool "Encode arrays unpacked"
	help
	  Encode scalar arrays in the unpacked format, which takes up more
	  space.
	  Only to be used when the decoder on the receiving side cannot
	  process packed arrays, such as protobuf.js versions before 2020.

config NANOPB_VALIDATE_UTF8
	bool "Validate UTF-8"
	help
	  Check whether incoming strings are valid UTF-8 sequences.
	  Adds a small performance and code size penalty.

config NANOPB_MESSAGE_NESTING_MAX
	int "Max nesting depth of decoded messages"
	default 0
	help
	  Maximum nesting depth of submessages accepted by the decoder.
	  Decoding fails when a message is nested deeper. This bounds the
	  stack usage when decoding untrusted data of recursive message
	  types.
	  Set to 0 to disable the limit.

config NANOPB_UNSAFE_DECODE_ONEOF_CALLBACKS
	bool "Decode callback fields directly inside oneofs [UNSAFE]"
	select NOT_SECURE
	help
	  Call callbacks set on fields that are placed directly inside a
	  oneof when decoding. Without this option the decoder clears such
	  callbacks, so they are never called.
	  This is not safe when decoding untrusted data, which can make the
	  decoder call a function pointer taken from the message contents.
	  Only enable it for existing code that decodes trusted data, and
	  prefer the submsg_callback, no_unions or callback_function
	  generator options.

endif # NANOPB
```

## samples/bluetooth/audio/bap_broadcast_sink/boards/esp32s31_function_coreboard_hpcore.conf
```kconfig
# Copyright (c) 2026 Espressif Systems (Shanghai) Co., Ltd.
# SPDX-License-Identifier: Apache-2.0

CONFIG_USE_CODEC_AUDIO_OUTPUT=y
CONFIG_CODEC_AUDIO_OUTPUT_I2S=y
CONFIG_AUDIO=y
CONFIG_AUDIO_CODEC=y
CONFIG_FPU_SHARING=y

# One BIS: the codec output is mono
CONFIG_BT_BAP_BROADCAST_SNK_STREAM_COUNT=1
CONFIG_BT_ISO_MAX_CHAN=1

CONFIG_BT_AUDIO_CODEC_CFG_MAX_METADATA_SIZE=255
```

## samples/bluetooth/audio/bap_broadcast_source/boards/nrf21540dk_nrf52840.conf
```kconfig
# Use USB Audio as audio source
CONFIG_USE_USB_AUDIO_INPUT=y
CONFIG_SAMPLE_USBD_PRODUCT="USB Broadcast Audio nRF21540DK"

CONFIG_UDC_DRIVER_LOG_LEVEL_WRN=y
CONFIG_USBD_LOG_LEVEL_WRN=y
CONFIG_USBD_UAC2_LOG_LEVEL_WRN=y
```

## samples/bluetooth/audio/bap_broadcast_source/boards/nrf52840dongle_nrf52840.conf
```kconfig
# Use USB Audio as audio source
CONFIG_USE_USB_AUDIO_INPUT=y
CONFIG_SAMPLE_USBD_PRODUCT="USB Broadcast Source sample"

CONFIG_BOARD_SERIAL_BACKEND_CDC_ACM=n

CONFIG_UDC_DRIVER_LOG_LEVEL_WRN=y
CONFIG_USBD_LOG_LEVEL_WRN=y
CONFIG_USBD_UAC2_LOG_LEVEL_WRN=y
```

## samples/bluetooth/audio/bap_broadcast_source/boards/nrf5340_audio_dk_nrf5340_cpuapp.conf
```kconfig
# Use USB Audio as audio source
CONFIG_USE_USB_AUDIO_INPUT=y
CONFIG_SAMPLE_USBD_PRODUCT="USB Broadcast Source sample"

CONFIG_BAP_BROADCAST_48_2_1=y

CONFIG_UDC_DRIVER_LOG_LEVEL_WRN=y
CONFIG_USBD_LOG_LEVEL_WRN=y
CONFIG_USBD_UAC2_LOG_LEVEL_WRN=y
```

## samples/drivers/i2s/i2s_codec/boards/esp32s31_function_coreboard_hpcore.conf
```kconfig
# Copyright (c) 2026 Espressif Systems (Shanghai) Co., Ltd.
# SPDX-License-Identifier: Apache-2.0

CONFIG_I2S_MCLK_FREQUENCY=4096000
```

## samples/drivers/i2s/i2s_codec/boards/lpcxpresso54628.conf
```kconfig
# SPDX-FileCopyrightText: Copyright The Zephyr Project Contributors
# SPDX-License-Identifier: Apache-2.0

CONFIG_EXTRA_BLOCKS=10
```

## samples/drivers/i2s/i2s_codec/boards/wio_tracker_l2_esp32s3_procpu.conf
```kconfig
# SPDX-FileCopyrightText: Copyright The Zephyr Project Contributors
# SPDX-License-Identifier: Apache-2.0

CONFIG_I2S_MCLK_FREQUENCY=4096000
CONFIG_EXTRA_BLOCKS=8
```

## samples/drivers/i2s/output/Kconfig
```kconfig
# Copyright (c) 2026 Mario Paja
# SPDX-License-Identifier: Apache-2.0

config SAMPLE_I2S_OPT_BIT_CLK_GATED
	bool "Run I2S bit clock only while sending data"
	default y if SOC_FAMILY_STM32
	default y if I2S_SILABS_USART
	help
	  Enable I2S bit clock (BCLK) so that it runs
	  only while audio data is actively being transmitted.

config SAMPLE_I2S_FORMAT_PCM_SHORT
	bool "Send the stream also in the PCM short frame format"
	help
	  After the I2S format, send the stream again with the PCM short
	  frame format and one channel.

config SAMPLE_I2S_FORMAT_PCM_LONG
	bool "Send the stream also in the PCM long frame format"
	help
	  After the I2S format, send the stream again with the PCM long
	  frame format and one channel.

config HEAP_MEM_POOL_ADD_SIZE_SAMPLE
	int
	default 256 if SOC_FAMILY_STM32 && I2S_STM32_SAI

source "Kconfig.zephyr"
```

## samples/drivers/i2s/output/boards/ek_ra6m5.conf
```kconfig
# Copyright (c) 2026 Renesas Electronics Corporation
# SPDX-License-Identifier: Apache-2.0

CONFIG_I2S_INIT_PRIORITY=52
CONFIG_SAMPLE_I2S_FORMAT_PCM_SHORT=y
CONFIG_SAMPLE_I2S_FORMAT_PCM_LONG=y
```

## samples/drivers/uart/async_api/boards/nucleo_h7s3l8.conf
```kconfig
#
# Copyright (c) 2026 Mario Paja
#
# SPDX-License-Identifier: Apache-2.0
#
CONFIG_DCACHE=n
```

## samples/net/ice_lite/Kconfig
```kconfig
# SPDX-FileCopyrightText: 2026 Muhammad Waleed Badar
# SPDX-License-Identifier: Apache-2.0

config NET_SAMPLE_ICE_LITE_PORT
	int "UDP port of the host candidate"
	default 5000
	range 1 65535
	help
	  UDP port the sample answers connectivity checks on.

source "samples/net/common/Kconfig"
source "Kconfig.zephyr"
```

## samples/net/sockets/echo_server/Kconfig
```kconfig
# Private config options for echo-server sample app

# Copyright (c) 2018 Intel Corporation
# SPDX-License-Identifier: Apache-2.0

mainmenu "Networking echo-server sample application"

config NET_SAMPLE_NUM_HANDLERS
	int "How many connections to serve at the same time"
	default 1
	help
	  Each connection is served by a thread which needs
	  memory. Only increase the value here if really needed.

config NET_SAMPLE_PSK_HEADER_FILE
	string "Header file containing PSK"
	default "dummy_psk.h"
	depends on MBEDTLS_KEY_EXCHANGE_PSK_ENABLED
	help
	  Name of a header file containing a
	  pre-shared key.

config NET_SAMPLE_CERTS_WITH_SC
	bool "Signed certificates"
	depends on NET_SOCKETS_SOCKOPT_TLS
	help
	  Enable this flag, if you are interested to run this
	  application with signed certificates and keys.

config NET_SAMPLE_WEBSOCKET_CONSOLE
	bool "Websocket console support"
	default y if WEBSOCKET_CONSOLE
	help
	  Enable this flag, if you are interested to enable websocket console.
	  You can use the ws-console.conf to set websocket options.

config NET_SAMPLE_HTTPS_SERVICE
	bool "Enable HTTPS service for the Webconsole"
	default y if NET_SAMPLE_WEBSOCKET_CONSOLE
	depends on NET_SOCKETS_SOCKOPT_TLS || TLS_CREDENTIALS

config ZVFS_EVENTFD_ADD_SIZE_NET_SAMPLE_ECHO_SERVER
	int "Number of eventfds needed by the echo-server UDP threads"
	default 2 if NET_IPV4 && NET_IPV6
	default 1
	depends on ZVFS_EVENTFD && NET_SOCKETS_SOCKOPT_TLS
	help
	  With TLS, each UDP thread of the sample polls one zvfs eventfd, which
	  wakes it when the server stops.

if USB_DEVICE_STACK_NEXT

# Source common USB sample options used to initialize new experimental USB
# device stack. The scope of these options is limited to USB samples in project
# tree, you cannot use them in your own application.
source "samples/subsys/usb/common/Kconfig.sample_usbd"

endif

source "samples/net/common/Kconfig"
source "Kconfig.zephyr"
```

## samples/net/tailscale/Kconfig
```kconfig
# SPDX-FileCopyrightText: FoBE Studio
# SPDX-License-Identifier: Apache-2.0

mainmenu "Tailscale client sample"

config SAMPLE_TAILSCALE_HOSTNAME
	string "Node name"
	default "zephyr-node"

config SAMPLE_TAILSCALE_PEER
	string "Optional tailnet echo server DNS name"
	help
	  After the policy is ready, connect TCP/9001 and UDP/9000 to this
	  node through the managed network.

config SAMPLE_TAILSCALE_PRIVATE_CONSOLE
	bool "Display enrollment URL on a physically private console"
	help
	  Enable only when console access and recordings are restricted to
	  the person provisioning this device.

config SAMPLE_TAILSCALE_SNTP_BOOTSTRAP
	bool "Bootstrap the sample clock with network-provided time"
	help
	  Use only on a network whose time source you trust. Otherwise the
	  application expects platform provisioning or an RTC to set UTC.

source "Kconfig.zephyr"
```

## samples/net/tailscale/boards/weact_esp32s3_mini_esp32s3_procpu.conf
```kconfig
# SPDX-FileCopyrightText: FoBE Studio
# SPDX-License-Identifier: Apache-2.0

CONFIG_WIFI=y
CONFIG_WIFI_CREDENTIALS=y
CONFIG_WIFI_CREDENTIALS_BACKEND_SETTINGS=y
CONFIG_WIFI_CREDENTIALS_CONNECT_STORED=y
CONFIG_WIREGUARD_INTERFACE="wlan0"
CONFIG_SOC_FAMILY_ESPRESSIF_SPIRAM=y
CONFIG_SOC_FAMILY_ESPRESSIF_SPIRAM_SIZE=2097152
CONFIG_SOC_FAMILY_ESPRESSIF_SPIRAM_MODE_QUAD=y
CONFIG_MBEDTLS_HEAP_CUSTOM_SECTION=y
```
