## modules/Kconfig.sysbuild
```kconfig
# Copyright (c) 2019 Intel Corporation
# Copyright (c) 2022 Nordic Semiconductor
#
# SPDX-License-Identifier: Apache-2.0

comment "Available modules."

source "$(KCONFIG_BINARY_DIR)/Kconfig.sysbuild.modules"

comment "Unavailable modules, please install those via the project manifest."

# List of comments to display when Zephyr modules are not available, please
# use the following syntax:
# ---------------------------------------------------
# comment "<module_name> module not available."
#	depends on !SYSBUILD_<MODULE_NAME_UPPER>_MODULE
#
# Remember to add the following code inside the `<module>/Kconfig file:
# ---------------------------------------------------
# config SYSBUILD_<MODULE_NAME_UPPER>_MODULE
# 	bool

# This ensures that symbols are available in Kconfig for dependency checking
# and referencing, while keeping the settings themselves unavailable when the
# modules are not present in the workspace
if 0
osource "modules/*/Kconfig.sysbuild"
endif
```

## modules/Kconfig.syst
```kconfig
# Copyright (c) 2019 Intel Corporation
# SPDX-License-Identifier: Apache-2.0

config MIPI_SYST_LIB
	bool "MIPI SyS-T Library Support"
	help
	  This option enables the MIPI SyS-T Library

if MIPI_SYST_LIB

config MIPI_SYST_STP
	bool "STP Transport Layer for MIPI SyS-T"
	help
	  This option enables support for the STP
	  Transport Layer for MIPI SyS-T

config MIPI_SYST_RAW_DATA
	bool "output MIPI SyS-T raw data packet"
	help
	  This option outputs MIPI SyS-T raw data packet

config MIPI_SYST_NO_WHCAR
	bool
	default y if MINIMAL_LIBC
	help
	  Tell MIPI Sys-T library to not build with
	  wchar support.

endif
```

## modules/Kconfig.tfm
```kconfig
# Configuration for the TF-M Module

# Copyright (c) 2019, 2020 Linaro Limited
# Copyright (c) 2020 Nordic Semiconductor ASA
# SPDX-License-Identifier: Apache-2.0


config TFM_BOARD
	string
	default "nordic_nrf/nrf9160dk_nrf9160" if BOARD_NRF9160DK_NRF9160NS
	default "nordic_nrf/nrf5340dk_nrf5340_cpuapp" if BOARD_NRF5340DK_NRF5340_CPUAPPNS
	default "nordic_nrf/nrf5340pdk_nrf5340_cpuapp" if BOARD_NRF5340PDK_NRF5340_CPUAPPNS
	default "nxp/lpcxpresso55s69" if BOARD_LPCXPRESSO55S69_CPU0
	default "mps2/an521" if BOARD_MPS2_AN521
	default "stm/nucleo_l552ze_q" if BOARD_NUCLEO_L552ZE_Q
	default "musca_b1" if BOARD_MUSCA_B1
	default "musca_s1" if BOARD_MUSCA_S1
	help
	  The board name used for building TFM. Building with TFM requires that
	  TFM has been ported to the given board/SoC.

menuconfig BUILD_WITH_TFM
	bool "Build with TF-M as the Secure Execution Environment"
	depends on TRUSTED_EXECUTION_NONSECURE
	depends on TFM_BOARD != ""
	depends on ARM_TRUSTZONE_M
	imply INIT_ARCH_HW_AT_BOOT
	help
	  When enabled, this option instructs the Zephyr build process to
	  additionaly generate a TF-M image for the Secure Execution
	  environment, along with the Zephyr image. The Zephyr image
	  itself is to be executed in the Non-Secure Processing Environment.
	  The required dependency on TRUSTED_EXECUTION_NONSECURE
	  ensures that the Zephyr image is built as a Non-Secure image. Both
	  TF-M and Zephyr images, as well as the veneer object file that links
	  them, are generated during the normal Zephyr build process.

	  Note:
	    Building with the "_nonsecure" BOARD variant (e.g.
	    "mps2_an521_nonsecure") ensures that
	    CONFIG_TRUSTED_EXECUTION_NONSECURE ie enabled.

if BUILD_WITH_TFM

config TFM_KEY_FILE_S
	string "Path to private key used to sign secure firmware images."
	depends on BUILD_WITH_TFM
	default "${ZEPHYR_BASE}/../modules/tee/tfm/trusted-firmware-m/bl2/ext/mcuboot/root-RSA-3072.pem"
	help
	  The path and filename for the .pem file containing the private key
	  that should be used by the BL2 bootloader when signing secure
	  firmware images.

config TFM_KEY_FILE_NS
	string "Path to private key used to sign non-secure firmware images."
	depends on BUILD_WITH_TFM
	default "${ZEPHYR_BASE}/../modules/tee/tfm/trusted-firmware-m/bl2/ext/mcuboot/root-RSA-3072_1.pem"
	help
	  The path and filename for the .pem file containing the private key
	  that should be used by the BL2 bootloader when signing non-secure
	  firmware images.

config TFM_PROFILE
	string "The build profile used for TFM Secure image."
	depends on BUILD_WITH_TFM
	help
	  Build profile used to build tfm_s image. The available values are
	  profile_medium and profile_small. The default profile does not need
	  to have this configuration set.

config TFM_ISOLATION_LEVEL
	int "Isolation level setting."
	range 1 3
	depends on BUILD_WITH_TFM
	help
	  Manually set the required TFM isolation level. Possible values are
	  1,2 or 3; the default is set by build configuration.

choice TFM_BL2
	prompt "BL2 configuration, should TFM build with MCUboot support"
	default TFM_BL2_CONFIG_FILE_DEFAULT

config TFM_BL2_CONFIG_FILE_DEFAULT
	bool "Use TFM BL2 setting from TFM configuration file"
	help
	  This option does not set -DBL2 in TFM, which means the TF-M platform's
	  default is used. Currently all TF-M platforms have BL2=ON as default.

config TFM_BL2_TRUE
	bool "TFM BL2 enabled"

config TFM_BL2_FALSE
	bool "TFM BL2 disabled"

endchoice

config TFM_IPC
	bool "IPC"
	help
	  When enabled, this option signifies that the TF-M build supports
	  the PSA API (IPC mode) instead of the secure library mode.

config TFM_REGRESSION
	bool "Regression tests"
	help
	  When enabled, this option signifies that the TF-M build includes
	  the Secure and the Non-Secure regression tests.


if !TFM_BL2_FALSE

config ROM_START_OFFSET
	hex "ROM Start Offset accounting for BL2 Header in the NS image"
	default 0x400
	help
	  By default BL2 header size in TF-M is 0x400. ROM_START_OFFSET
	  needs to be updated if TF-M switches to use a different header
	  size for BL2.

endif # !TFM_BL2_FALSE

endif # BUILD_WITH_TFM
```

## modules/Kconfig.tinycbor
```kconfig
# Copyright (c) 2018 Intel Corporation
# SPDX-License-Identifier: Apache-2.0

config TINYCBOR
	bool "DEPRECATED: tinyCBOR Support"
	help
	  This option enables the tinyCBOR library.
	  Note: This module is deprecated, please use ZCBOR instead.

if TINYCBOR

config CBOR_ENCODER_NO_CHECK_USER
	bool "No encoder checks for user args for validity"
	help
	  This option specifies whether a check user exists for a cbor encoder.

config CBOR_PARSER_MAX_RECURSIONS
	int "Parser max recursions"
	default 1024
	help
	  This option specifies max recursions for the parser.

config CBOR_PARSER_NO_STRICT_CHECKS
	bool "No strict parser checks"
	help
	  This option enables the strict parser checks.

config CBOR_FLOATING_POINT
	bool "Floating point support"
	select REQUIRES_FULL_LIBC
	help
	  This option enables floating point support.

config CBOR_HALF_FLOAT_TYPE
	bool "Half float type support"
	select REQUIRES_FULL_LIBC
	help
	  This option enables half float type support.

config CBOR_WITHOUT_OPEN_MEMSTREAM
	bool "Without open memstream"
	default y
	help
	  This option enables open memstream support.

config CBOR_PRETTY_PRINTING
	bool "Implement pretty printing functionality"
	help
	  This option enables cbor_value_to_pretty_stream function.

endif # TINYCBOR
```

## modules/Kconfig.tinycrypt
```kconfig
# Cryptography primitive options for TinyCrypt version 2.0

# Copyright (c) 2015 Intel Corporation
# SPDX-License-Identifier: Apache-2.0

config ZEPHYR_TINYCRYPT_MODULE
	bool

config TINYCRYPT
	bool "TinyCrypt Support"
	depends on ZEPHYR_TINYCRYPT_MODULE
	help
	  This option enables the TinyCrypt cryptography library.

if TINYCRYPT
config TINYCRYPT_CTR_PRNG
	bool "PRNG in counter mode"
	help
	  This option enables support for the pseudo-random number
	  generator in counter mode.

config TINYCRYPT_SHA256
	bool "SHA-256 Hash function support"
	help
	  This option enables support for SHA-256
	  hash function primitive.

config TINYCRYPT_SHA256_HMAC
	bool "HMAC (via SHA256) message auth support"
	depends on TINYCRYPT_SHA256
	help
	  This option enables support for HMAC using SHA-256
	  message authentication code.

config TINYCRYPT_SHA256_HMAC_PRNG
	bool "PRNG (via HMAC-SHA256) support"
	depends on TINYCRYPT_SHA256_HMAC
	help
	  This option enables support for pseudo-random number
	  generator.

config TINYCRYPT_ECC_DH
	bool "ECC_DH anonymous key agreement protocol"
	help
	  This option enables support for the Elliptic curve
	  Diffie-Hellman anonymous key agreement protocol.

	  Enabling ECC requires a cryptographically secure random number
	  generator.

config TINYCRYPT_ECC_DSA
	bool "ECC_DSA digital signature algorithm"
	help
	  This option enables support for the Elliptic Curve Digital
	  Signature Algorithm (ECDSA).

	  Enabling ECC requires a cryptographically secure random number
	  generator.

config TINYCRYPT_AES
	bool "AES-128 decrypt/encrypt"
	help
	  This option enables support for AES-128 decrypt and encrypt.

config TINYCRYPT_AES_CBC
	bool "AES-128 block cipher"
	depends on TINYCRYPT_AES
	help
	  This option enables support for AES-128 block cipher mode.

config TINYCRYPT_AES_CTR
	bool "AES-128 counter mode"
	depends on TINYCRYPT_AES
	help
	  This option enables support for AES-128 counter mode.

config TINYCRYPT_AES_CCM
	bool "AES-128 CCM mode"
	depends on TINYCRYPT_AES
	help
	  This option enables support for AES-128 CCM mode.

config TINYCRYPT_AES_CMAC
	bool "AES-128 CMAC mode"
	depends on TINYCRYPT_AES
	help
	  This option enables support for AES-128 CMAC mode.
endif
```

## modules/Kconfig.tiva_c
```kconfig
# SPDX-License-Identifier: Apache-2.0
#
# Copyright (c) 2026 Linumiz
# Author: Sri Surya <srisurya@linumiz.com>

config HAS_TIVAWARE
	bool

config USE_TIVAWARE_ADC
	bool

config USE_TIVAWARE_AES
	bool

config USE_TIVAWARE_CAN
	bool

config USE_TIVAWARE_COMP
	bool

config USE_TIVAWARE_CPU
	bool

config USE_TIVAWARE_CRC
	bool

config USE_TIVAWARE_DES
	bool

config USE_TIVAWARE_EEPROM
	bool

config USE_TIVAWARE_EMAC
	bool

config USE_TIVAWARE_EPI
	bool

config USE_TIVAWARE_FLASH
	bool

config USE_TIVAWARE_FPU
	bool

config USE_TIVAWARE_GPIO
	bool

config USE_TIVAWARE_HIBERNATE
	bool

config USE_TIVAWARE_I2C
	bool

config USE_TIVAWARE_INTERRUPT
	bool

config USE_TIVAWARE_LCD
	bool

config USE_TIVAWARE_MPU
	bool

config USE_TIVAWARE_ONEWIRE
	bool

config USE_TIVAWARE_PWM
	bool

config USE_TIVAWARE_QEI
	bool

config USE_TIVAWARE_SHAMD5
	bool

config USE_TIVAWARE_SSI
	bool

config USE_TIVAWARE_SW_CRC
	bool

config USE_TIVAWARE_SYSCTL
	bool

config USE_TIVAWARE_SYSEXC
	bool

config USE_TIVAWARE_SYSTICK
	bool

config USE_TIVAWARE_TIMER
	bool

config USE_TIVAWARE_UART
	bool

config USE_TIVAWARE_UDMA
	bool

config USE_TIVAWARE_USB
	bool

config USE_TIVAWARE_WATCHDOG
	bool
```

## modules/Kconfig.wurthelektronik
```kconfig
# Würth Elektronik HAL config
# Copyright (c) 2022 Würth Elektronik eiSos GmbH & Co. KG
# SPDX-License-Identifier: Apache-2.0

config HAS_WESENSORS
	bool
```

## modules/Kconfig.xhsc
```kconfig
# Copyright (c) 2026 Liu Changjie <liucj1228@outlook.com>
# SPDX-License-Identifier: Apache-2.0

config HAS_HC32_DDL
	bool
	select HAS_CMSIS_CORE
	depends on SOC_FAMILY_XHSC_HC32

if HAS_HC32_DDL

config HC32_DDL_DEBUG
	bool "HC32 DDL assertions"

config HC32_LL_ICG
	bool
	default y

config HC32_LL_FCG
	bool

config HC32_LL_GPIO
	bool

config HC32_LL_USART
	bool

config HC32_LL_UTILITY
	bool
	default y

endif # HAS_HC32_DDL
```

## modules/Kconfig.xuantie
```kconfig
# Copyright (C) 2017-2024 Alibaba Group Holding Limited
#
# SPDX-License-Identifier: Apache-2.0
#

config XUANTIE_HAL
	bool
	help
	  temporary placeholder character
```

## modules/TraceRecorder/Kconfig
```kconfig
# Zephyr module config for TraceRecorder.
# The real Kconfig for the module is located in the module repository,
# this file is to ensure ZEPHYR_TRACERECORDER_MODULE is defined also when the
# module is unavailable.

# Copyright (c) 2021 Nordic Semiconductor ASA
# SPDX-License-Identifier: Apache-2.0

config ZEPHYR_TRACERECORDER_MODULE
	bool
```

## modules/acpica/Kconfig
```kconfig
# Copyright (c) 2023 Intel Corporation.
# SPDX-License-Identifier: Apache-2.0

menu "ACPI driver support"

config ACPI
	bool

if ACPI

config ACPI_DSDT_SUPPORT
	bool  "Build source code for DSDT ACPICA support"
	default y if PCIE
	help
	  Build source code for DSDT support

endif #ACPI

endmenu
```
