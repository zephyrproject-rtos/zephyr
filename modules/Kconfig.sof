## modules/chre/Kconfig
```kconfig
# Copyright (c) 2021 Google LLC
# SPDX-License-Identifier: Apache-2.0

config ZEPHYR_CHRE_MODULE
	bool

menuconfig CHRE
	bool "CHRE Support"
	help
	  This option enables the CHRE library.

if CHRE

module = CHRE
module-str = chre
source "subsys/logging/Kconfig.template.log_config"

config CHRE_MESSAGE_TO_HOST_MAX_SIZE
	int "Maximum message size to send to the host (bytes)"
	default 4000
	help
	  Defines the maximum message size that can be sent to the host.

config CHRE_ASSERTIONS
	bool "Enable CHRE assertions"
	help
	  When enabled, CHRE will include various assertions which will trigger
	  calls to chreAbort if resolve to false.

config CHRE_AUDIO_SUPPORT_ENABLED
	bool "Enable audio support"
	help
	  When enabled, CHRE will include the code needed to support the audio
	  framework. The framework should be provided via chrePalAudioGetApi()

config CHRE_GNSS_SUPPORT_ENABLED
	bool "Enable GNSS support"
	help
	  When enabled, CHRE will include the code needed to support the GNSS
	  framework. The framework should be provided via chrePalGnssGetApi()

config CHRE_SENSORS_SUPPORT_ENABLED
	bool "Enable sensor support"
	help
	  When enabled, CHRE will include the code needed to support the sensor
	  framework. The framework should be provided via chrePalSensorGetApi()

config CHRE_WIFI_SUPPORT_ENABLED
	bool "Enable WiFi support"
	help
	  When enabled, CHRE will include the code needed to support the WiFi
	  framework. The framework should be provided via chrePalWifiGetApi()

endif # CHRE
```

## modules/cmsis-dsp/Kconfig
```kconfig
# Copyright (c) 2023 Meta Platforms
# SPDX-License-Identifier: Apache-2.0

config ZEPHYR_CMSIS_DSP_MODULE
	bool

config CMSIS_DSP
	bool "CMSIS-DSP Library Support"
	help
	  This option enables the CMSIS-DSP library.
```

## modules/cmsis_nn/Kconfig
```kconfig
# Copyright (c) 2023 Meta Platforms
# SPDX-License-Identifier: Apache-2.0

config ZEPHYR_CMSIS_NN_MODULE
	bool

menuconfig CMSIS_NN
	bool "CMSIS-NN Library Support"
	depends on CPU_CORTEX_M
	select CMSIS_DSP
	help
	  This option enables the CMSIS-NN library.

if CMSIS_NN

config CMSIS_NN_ACTIVATION
	bool "Activation"
	help
	  This option enables the NN libraries for the activation layers
	  It can perform activation layers, including ReLU (Rectified
	  Linear Unit), sigmoid, and tanh.

config CMSIS_NN_BASICMATH
	bool "Basic Math for NN"
	help
	  This option enables the NN libraries for the basic maths operations.
	  It adds functionality for element-wise add and multiplication functions.

config CMSIS_NN_CONCATENATION
	bool "Concatenation"
	help
	  This option enables the NN libraries for the concatenation layers.

config CMSIS_NN_CONVOLUTION
	bool "Convolution"
	imply CMSIS_NN_NNSUPPORT
	help
	  Collection of convolution, depthwise convolution functions and
	  their variants. The convolution is implemented in 2 steps: im2col
	  and GEMM. GEMM is performed with CMSIS-DSP arm_mat_mult similar options.

config CMSIS_NN_FULLYCONNECTED
	bool "Fully Connected"
	imply CMSIS_NN_NNSUPPORT
	help
	  Collection of fully-connected and matrix multiplication functions.

config CMSIS_NN_NNSUPPORT
	bool "NN Support"
	help
	  When off, its default behavior is all tables are included.

config CMSIS_NN_POOLING
	bool "Pooling"
	imply CMSIS_NN_NNSUPPORT
	help
	  This option enables pooling layers, including max pooling,
	  and average pooling.

config CMSIS_NN_RESHAPE
	bool "Reshape"
	help
	  This option enables the NN libraries for the reshape layers.

config CMSIS_NN_SOFTMAX
	bool "Softmax"
	help
	  This option enables the NN libraries for the softmax layers (exp2 based).

config CMSIS_NN_SVD
	bool "SVD"
	imply CMSIS_NN_NNSUPPORT
	help
	  This option enabled the NN libraries for Single Value Decomposition Filter layers.

config CMSIS_NN_LSTM
	bool "Long Short-Term Memory"
	help
	  This option enables the NN libraries for Long Short-Term Memory.

endif #CMSIS_NN
```

## modules/coremark/Kconfig
```kconfig
#
# Copyright (c) 2025 Ambiq Micro Inc. <www.ambiq.com>
#
# SPDX-License-Identifier: Apache-2.0
#

menuconfig COREMARK
	bool "Coremark benchmark"

if COREMARK

config COREMARK_ITERATIONS
	int "Number of the iterations to run"
	range 100 10000
	default 1000
	help
	  Option is used to specify the number of the iterations to run the benchmark.
	  Coremark should execute at least 10 seconds to have the valid results.
	  The minimum number of interations depends on the platform and its configuration.

config COREMARK_THREADS_NUMBER
	int "Number of the threads for the parallel benchmark execution"
	default 1
	range 1 4
	help
	  Specify the number of the threads to use for the coremark execution.
	  1 - means the execution only from the main thread.

choice COREMARK_RUN_TYPE
	prompt "Coremark run type"
	default COREMARK_RUN_TYPE_PERFORMANCE
	help
	   Specify the purpose of the coremark execution. Depending on the type
	   different memory size is required to operate with.

config COREMARK_RUN_TYPE_PERFORMANCE
	bool "Performance run"

config COREMARK_RUN_TYPE_PROFILE
	bool "Profile run"

config COREMARK_RUN_TYPE_VALIDATION
	bool "Validation run"

endchoice # COREMARK_RUN_TYPE

config COREMARK_DATA_SIZE
	int "Total size for the data algorithms will operate on"
	default 500 if COREMARK_RUN_TYPE_VALIDATION
	default 1200 if COREMARK_RUN_TYPE_PROFILE
	default 2000 if COREMARK_RUN_TYPE_PERFORMANCE
	range 100 2000
	help
	  Specifies size for the data algorithms. You can choose different values
	  for it. But note, that for registering your results it is required to
	  run CoreMark with default values for PROFILE and PERFORMANCE run types.

choice COREMARK_MEMORY_METHOD
	prompt "Memory Method"
	default COREMARK_MEMORY_METHOD_STACK
	help
	  Option defines the method to get a block of memory.

config COREMARK_MEMORY_METHOD_STACK
	bool "Stack"
	help
	  Main thread stack is used for this memory method. Be sure, that there
	  is enough memory allocated with MAIN_STACK_SIZE option. Size depends
	  on data size, coremarks operates on and number of threads. It should
	  be higher than:
	    COREMARK_DATA_SIZE * COREMARK_THREADS_NUMBER + main thread context.

config COREMARK_MEMORY_METHOD_STATIC
	bool "Static"

config COREMARK_MEMORY_METHOD_MALLOC
	bool "Malloc"
	help
	  in order to use this option you need to set up system heap size using
	  HEAP_MEM_POOL_SIZE option. Size depends on number of parallel
	  contexts executed and COREMARK_RUN_TYPE. It should be higher than
	  COREMARK_DATA_SIZE * COREMARK_THREADS_NUMBER.

endchoice # COREMARK_MEMORY_METHOD

endif
```

## modules/dhara/Kconfig
```kconfig
# Copyright (c) 2025 Endress+Hauser GmbH+Co. KG
# SPDX-License-Identifier: Apache-2.0

config ZEPHYR_DHARA_MODULE
	bool
```

## modules/embarc_mli/Kconfig
```kconfig
# Copyright (c) 2021 Synopsys
# SPDX-License-Identifier: Apache-2.0

config ZEPHYR_EMBARC_MLI_MODULE
	bool

config EMBARC_MLI
	bool "embarc_mli Support"
	help
	  This option enables the embarc_mli library.
```

## modules/esp-serial-flasher/Kconfig
```kconfig
# Copyright (c) 2025 Espressif Systems (Shanghai) Co., Ltd.
# SPDX-License-Identifier: Apache-2.0

config ZEPHYR_ESP_SERIAL_FLASHER_MODULE
	bool

config ESP_SERIAL_FLASHER
	bool "ESP Serial Flasher library"
	depends on ZEPHYR_ESP_SERIAL_FLASHER_MODULE
	select CONSOLE_SUBSYS
	help
	  esp-serial-flasher library

if ESP_SERIAL_FLASHER

config ESP_SERIAL_FLASHER_UART_BUFSIZE
	int "ESP Serial Flasher UART buffer size"
	default 512
	help
	  Buffer size for UART TX and RX packets

endif # ESP_SERIAL_FLASHER
```

## modules/executorch/Kconfig
```kconfig
# Copyright (c) 2025 Petri Oksanen
# SPDX-License-Identifier: Apache-2.0

config ZEPHYR_EXECUTORCH_MODULE
	bool

config EXECUTORCH
	bool "ExecuTorch Support"
	select REQUIRES_FULL_LIBCPP
	help
	  This option enables the ExecuTorch library.

if EXECUTORCH

rsource "Kconfig.backends"

config EXECUTORCH_ENABLE_LOGGING
	bool "Enable ExecuTorch logging"
	default y
	help
	  Enable logging within the ExecuTorch runtime.

config EXECUTORCH_ENABLE_EVENT_TRACER
	bool "Enable ExecuTorch event tracer"
	default n
	help
	  Enable the event tracer for performance profiling.

config EXECUTORCH_ENABLE_PROGRAM_VERIFICATION
	bool "Enable ExecuTorch program verification"
	default n
	help
	  Enable verification of the ExecuTorch program flatbuffer.

config EXECUTORCH_OPTIMIZE_FOR_SIZE
	bool "Optimize ExecuTorch for size"
	default y
	help
	  Optimize the ExecuTorch library for size (-Os).

config EXECUTORCH_BUILD_EXECUTOR_RUNNER
	bool "Build ExecuTorch executor runner"
	default n
	help
	  Build the executor_runner utility. Note: this may require POSIX 
	  functions not available in Zephyr and is typically not needed 
	  for embedded applications.

config EXECUTORCH_BUILD_DATA_LOADER
	bool "Build ExecuTorch data loader extension"
	default n
	help
	  Build the file data loader extension. Note: this requires POSIX 
	  file I/O functions and is typically not needed for embedded 
	  applications that load models from memory.

config EXECUTORCH_BUILD_PORTABLE_OPS
	bool "Build ExecuTorch portable operators library"
	default y
	help
	  Build the default portable operators library that includes all 
	  available operators. When disabled, you should use selective 
	  operator building to include only needed operators, but the 
	  underlying kernel implementations will still be available.

config EXECUTORCH_METHOD_ALLOCATOR_POOL_SIZE
	int "Method allocator pool size in bytes"
	default 16384
	help
	  Size of the method allocator pool in bytes. This memory is used
	  for allocating ExecuTorch method instances and their metadata.
	  Default is 16KB which should be sufficient for most small models.
	  Larger models may require more memory.

config EXECUTORCH_TEMP_ALLOCATOR_POOL_SIZE
	int "Temporary allocator pool size in bytes"
	default 2048
	help
	  Size of the temporary allocator pool in bytes. This memory is used
	  for temporary allocations during model execution such as intermediate
	  tensor calculations. Default is 2KB which should be sufficient for
	  simple operations. Complex models may require more memory.

config EXECUTORCH_MODEL_NAME
	string "Model filename for header generation"
	default "model_add.pte"
	help
	  Filename of the pre-generated .pte model file located in the example_files
	  directory. This file will be used to generate gen_ops_def.yml and the
	  corresponding model header file. The model must be generated manually
	  outside the Zephyr build process.

endif # EXECUTORCH 
```

## modules/executorch/Kconfig.backends
```kconfig
# Kconfig for ExecutorCH Backends

choice EXECUTORCH_BACKEND
	prompt "ExecuTorch backend"
	default EXECUTORCH_BACKEND_NONE
	help
		Select the ExecuTorch backend to build. This will enable the
		appropriate kernels and libraries for the selected hardware target.

config EXECUTORCH_BACKEND_NONE
	bool "None"
	help
		Do not build any specific backend. Only the core ExecuTorch
		runtime will be available.

config EXECUTORCH_BACKEND_ARM
	bool "ARM"
	help
		Enable the ARM backend for Cortex-M and Ethos-U targets.

config EXECUTORCH_BACKEND_XNNPACK
	bool "XNNPACK"
	help
		Enable the XNNPACK backend for running on the host CPU. This is
		useful for testing and development on a laptop or PC.

endchoice 
```

## modules/external-tracing/Kconfig
```kconfig
# Zephyr module config for external tracing.
# The real Kconfig for the module is located externally,
# this file is to ensure ZEPHYR_EXTERNALTRACING_MODULE is defined also when the
# module is unavailable.

# Copyright (c) 2021 Jon Lamb <jon@auxon.io>
# SPDX-License-Identifier: Apache-2.0

config ZEPHYR_EXTERNALTRACING_MODULE
	bool
```
